/begin CHARACTERISTIC SnsrOffsLrng.SnsrOffsLrngFctEna.Logl "MICROSAR RTE" VALUE 0x0 RTE_RL_BOOLEAN 0 RTE_CM_BOOLEAN 0 255 SYMBOL_LINK "Rte_CalprmRom_CalRegn02CmnGroupC_DEFAULT_RTE_CALPRM_GROUP.SnsrOffsLrngFctEna_Logl" 0 DISPLAY_IDENTIFIER SnsrOffsLrng.CalibrationPorts.SnsrOffsLrngFctEna.Logl /end CHARACTERISTIC
/begin CHARACTERISTIC SnsrOffsLrng.SnsrOffsLrngHwAgLrngDrvgDstThd.Val "MICROSAR RTE" VALUE 0x0 RTE_RL_FLOAT32_IEEE 0 NO_COMPU_METHOD -3.402823466e+38 3.402823466e+38 SYMBOL_LINK "Rte_CalprmRom_CalRegn02CmnGroupC_DEFAULT_RTE_CALPRM_GROUP.SnsrOffsLrngHwAgLrngDrvgDstThd_Val" 0 DISPLAY_IDENTIFIER SnsrOffsLrng.CalibrationPorts.SnsrOffsLrngHwAgLrngDrvgDstThd.Val /end CHARACTERISTIC
/begin CHARACTERISTIC SnsrOffsLrng.SnsrOffsLrngHwAgLrngEna.Logl "MICROSAR RTE" VALUE 0x0 RTE_RL_BOOLEAN 0 RTE_CM_BOOLEAN 0 255 SYMBOL_LINK "Rte_CalprmRom_CalRegn02CmnGroupC_DEFAULT_RTE_CALPRM_GROUP.SnsrOffsLrngHwAgLrngEna_Logl" 0 DISPLAY_IDENTIFIER SnsrOffsLrng.CalibrationPorts.SnsrOffsLrngHwAgLrngEna.Logl /end CHARACTERISTIC
/begin CHARACTERISTIC SnsrOffsLrng.SnsrOffsLrngHwAgLrngHwVelThd.Val "MICROSAR RTE" VALUE 0x0 RTE_RL_FLOAT32_IEEE 0 NO_COMPU_METHOD -3.402823466e+38 3.402823466e+38 SYMBOL_LINK "Rte_CalprmRom_CalRegn02CmnGroupC_DEFAULT_RTE_CALPRM_GROUP.SnsrOffsLrngHwAgLrngHwVelThd_Val" 0 DISPLAY_IDENTIFIER SnsrOffsLrng.CalibrationPorts.SnsrOffsLrngHwAgLrngHwVelThd.Val /end CHARACTERISTIC
/begin CHARACTERISTIC SnsrOffsLrng.SnsrOffsLrngHwAgLrngSysTqThd.Val "MICROSAR RTE" VALUE 0x0 RTE_RL_FLOAT32_IEEE 0 NO_COMPU_METHOD -3.402823466e+38 3.402823466e+38 SYMBOL_LINK "Rte_CalprmRom_CalRegn02CmnGroupC_DEFAULT_RTE_CALPRM_GROUP.SnsrOffsLrngHwAgLrngSysTqThd_Val" 0 DISPLAY_IDENTIFIER SnsrOffsLrng.CalibrationPorts.SnsrOffsLrngHwAgLrngSysTqThd.Val /end CHARACTERISTIC
/begin CHARACTERISTIC SnsrOffsLrng.SnsrOffsLrngHwAgLrngSysTqThdMed.Val "MICROSAR RTE" VALUE 0x0 RTE_RL_FLOAT32_IEEE 0 NO_COMPU_METHOD -3.402823466e+38 3.402823466e+38 SYMBOL_LINK "Rte_CalprmRom_CalRegn02CmnGroupC_DEFAULT_RTE_CALPRM_GROUP.SnsrOffsLrngHwAgLrngSysTqThdMed_Val" 0 DISPLAY_IDENTIFIER SnsrOffsLrng.CalibrationPorts.SnsrOffsLrngHwAgLrngSysTqThdMed.Val /end CHARACTERISTIC
/begin CHARACTERISTIC SnsrOffsLrng.SnsrOffsLrngHwAgLrngSysTqThdTrustd.Val "MICROSAR RTE" VALUE 0x0 RTE_RL_FLOAT32_IEEE 0 NO_COMPU_METHOD -3.402823466e+38 3.402823466e+38 SYMBOL_LINK "Rte_CalprmRom_CalRegn02CmnGroupC_DEFAULT_RTE_CALPRM_GROUP.SnsrOffsLrngHwAgLrngSysTqThdTrustd_Val" 0 DISPLAY_IDENTIFIER SnsrOffsLrng.CalibrationPorts.SnsrOffsLrngHwAgLrngSysTqThdTrustd.Val /end CHARACTERISTIC
/begin CHARACTERISTIC SnsrOffsLrng.SnsrOffsLrngHwAgLrngSysTqThdWide.Val "MICROSAR RTE" VALUE 0x0 RTE_RL_FLOAT32_IEEE 0 NO_COMPU_METHOD -3.402823466e+38 3.402823466e+38 SYMBOL_LINK "Rte_CalprmRom_CalRegn02CmnGroupC_DEFAULT_RTE_CALPRM_GROUP.SnsrOffsLrngHwAgLrngSysTqThdWide_Val" 0 DISPLAY_IDENTIFIER SnsrOffsLrng.CalibrationPorts.SnsrOffsLrngHwAgLrngSysTqThdWide.Val /end CHARACTERISTIC
/begin CHARACTERISTIC SnsrOffsLrng.SnsrOffsLrngHwAgLrngTi.Val "MICROSAR RTE" VALUE 0x0 RTE_RL_FLOAT32_IEEE 0 NO_COMPU_METHOD -3.402823466e+38 3.402823466e+38 SYMBOL_LINK "Rte_CalprmRom_CalRegn02Cmn_DEFAULT_RTE_CALPRM_GROUP.SnsrOffsLrngHwAgLrngTi_Val" 0 DISPLAY_IDENTIFIER SnsrOffsLrng.CalibrationPorts.SnsrOffsLrngHwAgLrngTi.Val /end CHARACTERISTIC
/begin CHARACTERISTIC SnsrOffsLrng.SnsrOffsLrngHwAgLrngVehSpdThd.Val "MICROSAR RTE" VALUE 0x0 RTE_RL_FLOAT32_IEEE 0 NO_COMPU_METHOD -3.402823466e+38 3.402823466e+38 SYMBOL_LINK "Rte_CalprmRom_CalRegn02CmnGroupC_DEFAULT_RTE_CALPRM_GROUP.SnsrOffsLrngHwAgLrngVehSpdThd_Val" 0 DISPLAY_IDENTIFIER SnsrOffsLrng.CalibrationPorts.SnsrOffsLrngHwAgLrngVehSpdThd.Val /end CHARACTERISTIC
/begin CHARACTERISTIC SnsrOffsLrng.SnsrOffsLrngHwAgLrngYawOffsDbnd.Val "MICROSAR RTE" VALUE 0x0 RTE_RL_FLOAT32_IEEE 0 NO_COMPU_METHOD -3.402823466e+38 3.402823466e+38 SYMBOL_LINK "Rte_CalprmRom_CalRegn02CmnGroupC_DEFAULT_RTE_CALPRM_GROUP.SnsrOffsLrngHwAgLrngYawOffsDbnd_Val" 0 DISPLAY_IDENTIFIER SnsrOffsLrng.CalibrationPorts.SnsrOffsLrngHwAgLrngYawOffsDbnd.Val /end CHARACTERISTIC
/begin CHARACTERISTIC SnsrOffsLrng.SnsrOffsLrngHwAgLrngYawRateThd.Val "MICROSAR RTE" VALUE 0x0 RTE_RL_FLOAT32_IEEE 0 NO_COMPU_METHOD -3.402823466e+38 3.402823466e+38 SYMBOL_LINK "Rte_CalprmRom_CalRegn02CmnGroupC_DEFAULT_RTE_CALPRM_GROUP.SnsrOffsLrngHwAgLrngYawRateThd_Val" 0 DISPLAY_IDENTIFIER SnsrOffsLrng.CalibrationPorts.SnsrOffsLrngHwAgLrngYawRateThd.Val /end CHARACTERISTIC
/begin CHARACTERISTIC SnsrOffsLrng.SnsrOffsLrngHwAgOffsLim.Val "MICROSAR RTE" VALUE 0x0 RTE_RL_FLOAT32_IEEE 0 NO_COMPU_METHOD -3.402823466e+38 3.402823466e+38 SYMBOL_LINK "Rte_CalprmRom_CalRegn02CmnGroupC_DEFAULT_RTE_CALPRM_GROUP.SnsrOffsLrngHwAgOffsLim_Val" 0 DISPLAY_IDENTIFIER SnsrOffsLrng.CalibrationPorts.SnsrOffsLrngHwAgOffsLim.Val /end CHARACTERISTIC
/begin CHARACTERISTIC SnsrOffsLrng.SnsrOffsLrngHwTqLrngEna.Logl "MICROSAR RTE" VALUE 0x0 RTE_RL_BOOLEAN 0 RTE_CM_BOOLEAN 0 255 SYMBOL_LINK "Rte_CalprmRom_CalRegn02CmnGroupC_DEFAULT_RTE_CALPRM_GROUP.SnsrOffsLrngHwTqLrngEna_Logl" 0 DISPLAY_IDENTIFIER SnsrOffsLrng.CalibrationPorts.SnsrOffsLrngHwTqLrngEna.Logl /end CHARACTERISTIC
/begin CHARACTERISTIC SnsrOffsLrng.SnsrOffsLrngHwTqLrngEnaTiThd.Val "MICROSAR RTE" VALUE 0x0 RTE_RL_FLOAT32_IEEE 0 NO_COMPU_METHOD -3.402823466e+38 3.402823466e+38 SYMBOL_LINK "Rte_CalprmRom_CalRegn02CmnGroupC_DEFAULT_RTE_CALPRM_GROUP.SnsrOffsLrngHwTqLrngEnaTiThd_Val" 0 DISPLAY_IDENTIFIER SnsrOffsLrng.CalibrationPorts.SnsrOffsLrngHwTqLrngEnaTiThd.Val /end CHARACTERISTIC
/begin CHARACTERISTIC SnsrOffsLrng.SnsrOffsLrngHwTqLrngHwAgDbnd.Val "MICROSAR RTE" VALUE 0x0 RTE_RL_FLOAT32_IEEE 0 NO_COMPU_METHOD -3.402823466e+38 3.402823466e+38 SYMBOL_LINK "Rte_CalprmRom_CalRegn02CmnGroupC_DEFAULT_RTE_CALPRM_GROUP.SnsrOffsLrngHwTqLrngHwAgDbnd_Val" 0 DISPLAY_IDENTIFIER SnsrOffsLrng.CalibrationPorts.SnsrOffsLrngHwTqLrngHwAgDbnd.Val /end CHARACTERISTIC
/begin CHARACTERISTIC SnsrOffsLrng.SnsrOffsLrngHwTqLrngHwAgThd.Val "MICROSAR RTE" VALUE 0x0 RTE_RL_FLOAT32_IEEE 0 NO_COMPU_METHOD -3.402823466e+38 3.402823466e+38 SYMBOL_LINK "Rte_CalprmRom_CalRegn02CmnGroupC_DEFAULT_RTE_CALPRM_GROUP.SnsrOffsLrngHwTqLrngHwAgThd_Val" 0 DISPLAY_IDENTIFIER SnsrOffsLrng.CalibrationPorts.SnsrOffsLrngHwTqLrngHwAgThd.Val /end CHARACTERISTIC
/begin CHARACTERISTIC SnsrOffsLrng.SnsrOffsLrngHwTqLrngHwTqThd.Val "MICROSAR RTE" VALUE 0x0 RTE_RL_FLOAT32_IEEE 0 NO_COMPU_METHOD -3.402823466e+38 3.402823466e+38 SYMBOL_LINK "Rte_CalprmRom_CalRegn02CmnGroupC_DEFAULT_RTE_CALPRM_GROUP.SnsrOffsLrngHwTqLrngHwTqThd_Val" 0 DISPLAY_IDENTIFIER SnsrOffsLrng.CalibrationPorts.SnsrOffsLrngHwTqLrngHwTqThd.Val /end CHARACTERISTIC
/begin CHARACTERISTIC SnsrOffsLrng.SnsrOffsLrngHwTqLrngHwTqZeroOffsThd.Val "MICROSAR RTE" VALUE 0x0 RTE_RL_FLOAT32_IEEE 0 NO_COMPU_METHOD -3.402823466e+38 3.402823466e+38 SYMBOL_LINK "Rte_CalprmRom_CalRegn02Cmn_DEFAULT_RTE_CALPRM_GROUP.SnsrOffsLrngHwTqLrngHwTqZeroOffsThd_Val" 0 DISPLAY_IDENTIFIER SnsrOffsLrng.CalibrationPorts.SnsrOffsLrngHwTqLrngHwTqZeroOffsThd.Val /end CHARACTERISTIC
/begin CHARACTERISTIC SnsrOffsLrng.SnsrOffsLrngHwTqLrngHwVelThd.Val "MICROSAR RTE" VALUE 0x0 RTE_RL_FLOAT32_IEEE 0 NO_COMPU_METHOD -3.402823466e+38 3.402823466e+38 SYMBOL_LINK "Rte_CalprmRom_CalRegn02CmnGroupC_DEFAULT_RTE_CALPRM_GROUP.SnsrOffsLrngHwTqLrngHwVelThd_Val" 0 DISPLAY_IDENTIFIER SnsrOffsLrng.CalibrationPorts.SnsrOffsLrngHwTqLrngHwVelThd.Val /end CHARACTERISTIC
/begin CHARACTERISTIC SnsrOffsLrng.SnsrOffsLrngHwTqLrngMeasTi.Val "MICROSAR RTE" VALUE 0x0 RTE_RL_FLOAT32_IEEE 0 NO_COMPU_METHOD -3.402823466e+38 3.402823466e+38 SYMBOL_LINK "Rte_CalprmRom_CalRegn02Cmn_DEFAULT_RTE_CALPRM_GROUP.SnsrOffsLrngHwTqLrngMeasTi_Val" 0 DISPLAY_IDENTIFIER SnsrOffsLrng.CalibrationPorts.SnsrOffsLrngHwTqLrngMeasTi.Val /end CHARACTERISTIC
/begin CHARACTERISTIC SnsrOffsLrng.SnsrOffsLrngHwTqLrngMeasTiScar.Val "MICROSAR RTE" VALUE 0x0 RTE_RL_FLOAT32_IEEE 0 NO_COMPU_METHOD -3.402823466e+38 3.402823466e+38 SYMBOL_LINK "Rte_CalprmRom_CalRegn02CmnGroupC_DEFAULT_RTE_CALPRM_GROUP.SnsrOffsLrngHwTqLrngMeasTiScar_Val" 0 DISPLAY_IDENTIFIER SnsrOffsLrng.CalibrationPorts.SnsrOffsLrngHwTqLrngMeasTiScar.Val /end CHARACTERISTIC
/begin CHARACTERISTIC SnsrOffsLrng.SnsrOffsLrngHwTqLrngSampleImbThd1.Val "MICROSAR RTE" VALUE 0x0 RTE_RL_FLOAT32_IEEE 0 NO_COMPU_METHOD -3.402823466e+38 3.402823466e+38 SYMBOL_LINK "Rte_CalprmRom_CalRegn02Cmn_DEFAULT_RTE_CALPRM_GROUP.SnsrOffsLrngHwTqLrngSampleImbThd1_Val" 0 DISPLAY_IDENTIFIER SnsrOffsLrng.CalibrationPorts.SnsrOffsLrngHwTqLrngSampleImbThd1.Val /end CHARACTERISTIC
/begin CHARACTERISTIC SnsrOffsLrng.SnsrOffsLrngHwTqLrngSampleImbThd2.Val "MICROSAR RTE" VALUE 0x0 RTE_RL_FLOAT32_IEEE 0 NO_COMPU_METHOD -3.402823466e+38 3.402823466e+38 SYMBOL_LINK "Rte_CalprmRom_CalRegn02Cmn_DEFAULT_RTE_CALPRM_GROUP.SnsrOffsLrngHwTqLrngSampleImbThd2_Val" 0 DISPLAY_IDENTIFIER SnsrOffsLrng.CalibrationPorts.SnsrOffsLrngHwTqLrngSampleImbThd2.Val /end CHARACTERISTIC
/begin CHARACTERISTIC SnsrOffsLrng.SnsrOffsLrngHwTqLrngSampleThd1.Val "MICROSAR RTE" VALUE 0x0 RTE_RL_UWORD 0 NO_COMPU_METHOD 0 65535 SYMBOL_LINK "Rte_CalprmRom_CalRegn02Cmn_DEFAULT_RTE_CALPRM_GROUP.SnsrOffsLrngHwTqLrngSampleThd1_Val" 0 DISPLAY_IDENTIFIER SnsrOffsLrng.CalibrationPorts.SnsrOffsLrngHwTqLrngSampleThd1.Val /end CHARACTERISTIC
/begin CHARACTERISTIC SnsrOffsLrng.SnsrOffsLrngHwTqLrngSampleThd2.Val "MICROSAR RTE" VALUE 0x0 RTE_RL_UWORD 0 NO_COMPU_METHOD 0 65535 SYMBOL_LINK "Rte_CalprmRom_CalRegn02Cmn_DEFAULT_RTE_CALPRM_GROUP.SnsrOffsLrngHwTqLrngSampleThd2_Val" 0 DISPLAY_IDENTIFIER SnsrOffsLrng.CalibrationPorts.SnsrOffsLrngHwTqLrngSampleThd2.Val /end CHARACTERISTIC
/begin CHARACTERISTIC SnsrOffsLrng.SnsrOffsLrngHwTqLrngTiWghtCoeff.Val "MICROSAR RTE" VALUE 0x0 RTE_RL_FLOAT32_IEEE 0 NO_COMPU_METHOD -3.402823466e+38 3.402823466e+38 SYMBOL_LINK "Rte_CalprmRom_CalRegn02Cmn_DEFAULT_RTE_CALPRM_GROUP.SnsrOffsLrngHwTqLrngTiWghtCoeff_Val" 0 DISPLAY_IDENTIFIER SnsrOffsLrng.CalibrationPorts.SnsrOffsLrngHwTqLrngTiWghtCoeff.Val /end CHARACTERISTIC
/begin CHARACTERISTIC SnsrOffsLrng.SnsrOffsLrngHwTqLrngVehSpdThd.Val "MICROSAR RTE" VALUE 0x0 RTE_RL_FLOAT32_IEEE 0 NO_COMPU_METHOD -3.402823466e+38 3.402823466e+38 SYMBOL_LINK "Rte_CalprmRom_CalRegn02CmnGroupC_DEFAULT_RTE_CALPRM_GROUP.SnsrOffsLrngHwTqLrngVehSpdThd_Val" 0 DISPLAY_IDENTIFIER SnsrOffsLrng.CalibrationPorts.SnsrOffsLrngHwTqLrngVehSpdThd.Val /end CHARACTERISTIC
/begin CHARACTERISTIC SnsrOffsLrng.SnsrOffsLrngHwTqOffsLim.Val "MICROSAR RTE" VALUE 0x0 RTE_RL_FLOAT32_IEEE 0 NO_COMPU_METHOD -3.402823466e+38 3.402823466e+38 SYMBOL_LINK "Rte_CalprmRom_CalRegn02CmnGroupC_DEFAULT_RTE_CALPRM_GROUP.SnsrOffsLrngHwTqOffsLim_Val" 0 DISPLAY_IDENTIFIER SnsrOffsLrng.CalibrationPorts.SnsrOffsLrngHwTqOffsLim.Val /end CHARACTERISTIC
/begin CHARACTERISTIC SnsrOffsLrng.SnsrOffsLrngHwVelFilFrq.Val "MICROSAR RTE" VALUE 0x0 RTE_RL_FLOAT32_IEEE 0 NO_COMPU_METHOD -3.402823466e+38 3.402823466e+38 SYMBOL_LINK "Rte_CalprmRom_CalRegn02Inin00_DEFAULT_RTE_CALPRM_GROUP.SnsrOffsLrngHwVelFilFrq_Val" 0 DISPLAY_IDENTIFIER SnsrOffsLrng.CalibrationPorts.SnsrOffsLrngHwVelFilFrq.Val /end CHARACTERISTIC
/begin CHARACTERISTIC SnsrOffsLrng.SnsrOffsLrngSampleCntForHwTqLrngRst.Val "MICROSAR RTE" VALUE 0x0 RTE_RL_UWORD 0 NO_COMPU_METHOD 0 65535 SYMBOL_LINK "Rte_CalprmRom_CalRegn01Cmn_DEFAULT_RTE_CALPRM_GROUP.SnsrOffsLrngSampleCntForHwTqLrngRst_Val" 0 DISPLAY_IDENTIFIER SnsrOffsLrng.CalibrationPorts.SnsrOffsLrngSampleCntForHwTqLrngRst.Val /end CHARACTERISTIC
/begin CHARACTERISTIC SnsrOffsLrng.SnsrOffsLrngTqAndAgFilFrq.Val "MICROSAR RTE" VALUE 0x0 RTE_RL_FLOAT32_IEEE 0 NO_COMPU_METHOD -3.402823466e+38 3.402823466e+38 SYMBOL_LINK "Rte_CalprmRom_CalRegn02Inin00_DEFAULT_RTE_CALPRM_GROUP.SnsrOffsLrngTqAndAgFilFrq_Val" 0 DISPLAY_IDENTIFIER SnsrOffsLrng.CalibrationPorts.SnsrOffsLrngTqAndAgFilFrq.Val /end CHARACTERISTIC
/begin CHARACTERISTIC SnsrOffsLrng.SnsrOffsLrngTqInpDetnHwTqFilFrq.Val "MICROSAR RTE" VALUE 0x0 RTE_RL_FLOAT32_IEEE 0 NO_COMPU_METHOD -3.402823466e+38 3.402823466e+38 SYMBOL_LINK "Rte_CalprmRom_CalRegn02Inin00_DEFAULT_RTE_CALPRM_GROUP.SnsrOffsLrngTqInpDetnHwTqFilFrq_Val" 0 DISPLAY_IDENTIFIER SnsrOffsLrng.CalibrationPorts.SnsrOffsLrngTqInpDetnHwTqFilFrq.Val /end CHARACTERISTIC
/begin CHARACTERISTIC SnsrOffsLrng.SnsrOffsLrngTqInpDetnPwrEstimnThd.Val "MICROSAR RTE" VALUE 0x0 RTE_RL_FLOAT32_IEEE 0 NO_COMPU_METHOD -3.402823466e+38 3.402823466e+38 SYMBOL_LINK "Rte_CalprmRom_CalRegn02CmnGroupC_DEFAULT_RTE_CALPRM_GROUP.SnsrOffsLrngTqInpDetnPwrEstimnThd_Val" 0 DISPLAY_IDENTIFIER SnsrOffsLrng.CalibrationPorts.SnsrOffsLrngTqInpDetnPwrEstimnThd.Val /end CHARACTERISTIC
/begin CHARACTERISTIC SnsrOffsLrng.SnsrOffsLrngTqInpDetnSinGenrAmp.Val "MICROSAR RTE" VALUE 0x0 RTE_RL_FLOAT32_IEEE 0 NO_COMPU_METHOD -3.402823466e+38 3.402823466e+38 SYMBOL_LINK "Rte_CalprmRom_CalRegn02CmnGroupC_DEFAULT_RTE_CALPRM_GROUP.SnsrOffsLrngTqInpDetnSinGenrAmp_Val" 0 DISPLAY_IDENTIFIER SnsrOffsLrng.CalibrationPorts.SnsrOffsLrngTqInpDetnSinGenrAmp.Val /end CHARACTERISTIC
/begin CHARACTERISTIC SnsrOffsLrng.SnsrOffsLrngTqInpDetnSinGenrFrq.Val "MICROSAR RTE" VALUE 0x0 RTE_RL_FLOAT32_IEEE 0 NO_COMPU_METHOD -3.402823466e+38 3.402823466e+38 SYMBOL_LINK "Rte_CalprmRom_CalRegn02CmnGroupC_DEFAULT_RTE_CALPRM_GROUP.SnsrOffsLrngTqInpDetnSinGenrFrq_Val" 0 DISPLAY_IDENTIFIER SnsrOffsLrng.CalibrationPorts.SnsrOffsLrngTqInpDetnSinGenrFrq.Val /end CHARACTERISTIC
/begin CHARACTERISTIC SnsrOffsLrng.SnsrOffsLrngTqInpDetnStg1FilGain.Val "MICROSAR RTE" VALUE 0x0 RTE_RL_FLOAT32_IEEE 0 NO_COMPU_METHOD -3.402823466e+38 3.402823466e+38 SYMBOL_LINK "Rte_CalprmRom_CalRegn02CmnGroupC_DEFAULT_RTE_CALPRM_GROUP.SnsrOffsLrngTqInpDetnStg1FilGain_Val" 0 DISPLAY_IDENTIFIER SnsrOffsLrng.CalibrationPorts.SnsrOffsLrngTqInpDetnStg1FilGain.Val /end CHARACTERISTIC
/begin CHARACTERISTIC SnsrOffsLrng.SnsrOffsLrngTqInpDetnStg1WinSize.Val "MICROSAR RTE" VALUE 0x0 RTE_RL_UBYTE 0 NO_COMPU_METHOD 0 255 SYMBOL_LINK "Rte_CalprmRom_CalRegn02CmnGroupC_DEFAULT_RTE_CALPRM_GROUP.SnsrOffsLrngTqInpDetnStg1WinSize_Val" 0 DISPLAY_IDENTIFIER SnsrOffsLrng.CalibrationPorts.SnsrOffsLrngTqInpDetnStg1WinSize.Val /end CHARACTERISTIC
/begin CHARACTERISTIC SnsrOffsLrng.SnsrOffsLrngTqInpDetnStg2FilGainCen.Val "MICROSAR RTE" VALUE 0x0 RTE_RL_FLOAT32_IEEE 0 NO_COMPU_METHOD -3.402823466e+38 3.402823466e+38 SYMBOL_LINK "Rte_CalprmRom_CalRegn02CmnGroupC_DEFAULT_RTE_CALPRM_GROUP.SnsrOffsLrngTqInpDetnStg2FilGainCen_Val" 0 DISPLAY_IDENTIFIER SnsrOffsLrng.CalibrationPorts.SnsrOffsLrngTqInpDetnStg2FilGainCen.Val /end CHARACTERISTIC
/begin CHARACTERISTIC SnsrOffsLrng.SnsrOffsLrngTqInpDetnStg2FilGainDwn.Val "MICROSAR RTE" VALUE 0x0 RTE_RL_FLOAT32_IEEE 0 NO_COMPU_METHOD -3.402823466e+38 3.402823466e+38 SYMBOL_LINK "Rte_CalprmRom_CalRegn02CmnGroupC_DEFAULT_RTE_CALPRM_GROUP.SnsrOffsLrngTqInpDetnStg2FilGainDwn_Val" 0 DISPLAY_IDENTIFIER SnsrOffsLrng.CalibrationPorts.SnsrOffsLrngTqInpDetnStg2FilGainDwn.Val /end CHARACTERISTIC
/begin CHARACTERISTIC SnsrOffsLrng.SnsrOffsLrngTqInpDetnStg2FilGainUp.Val "MICROSAR RTE" VALUE 0x0 RTE_RL_FLOAT32_IEEE 0 NO_COMPU_METHOD -3.402823466e+38 3.402823466e+38 SYMBOL_LINK "Rte_CalprmRom_CalRegn02CmnGroupC_DEFAULT_RTE_CALPRM_GROUP.SnsrOffsLrngTqInpDetnStg2FilGainUp_Val" 0 DISPLAY_IDENTIFIER SnsrOffsLrng.CalibrationPorts.SnsrOffsLrngTqInpDetnStg2FilGainUp.Val /end CHARACTERISTIC
/begin CHARACTERISTIC SnsrOffsLrng.SnsrOffsLrngTqInpDetnStg2WinSize.Val "MICROSAR RTE" VALUE 0x0 RTE_RL_UWORD 0 NO_COMPU_METHOD 0 65535 SYMBOL_LINK "Rte_CalprmRom_CalRegn02CmnGroupC_DEFAULT_RTE_CALPRM_GROUP.SnsrOffsLrngTqInpDetnStg2WinSize_Val" 0 DISPLAY_IDENTIFIER SnsrOffsLrng.CalibrationPorts.SnsrOffsLrngTqInpDetnStg2WinSize.Val /end CHARACTERISTIC
/begin CHARACTERISTIC SnsrOffsLrng.SnsrOffsLrngYawACdngFilFrq.Val "MICROSAR RTE" VALUE 0x0 RTE_RL_FLOAT32_IEEE 0 NO_COMPU_METHOD -3.402823466e+38 3.402823466e+38 SYMBOL_LINK "Rte_CalprmRom_CalRegn02Inin00_DEFAULT_RTE_CALPRM_GROUP.SnsrOffsLrngYawACdngFilFrq_Val" 0 DISPLAY_IDENTIFIER SnsrOffsLrng.CalibrationPorts.SnsrOffsLrngYawACdngFilFrq.Val /end CHARACTERISTIC
/begin CHARACTERISTIC SnsrOffsLrng.SnsrOffsLrngYawLrngEna.Logl "MICROSAR RTE" VALUE 0x0 RTE_RL_BOOLEAN 0 RTE_CM_BOOLEAN 0 255 SYMBOL_LINK "Rte_CalprmRom_CalRegn02CmnGroupC_DEFAULT_RTE_CALPRM_GROUP.SnsrOffsLrngYawLrngEna_Logl" 0 DISPLAY_IDENTIFIER SnsrOffsLrng.CalibrationPorts.SnsrOffsLrngYawLrngEna.Logl /end CHARACTERISTIC
/begin CHARACTERISTIC SnsrOffsLrng.SnsrOffsLrngYawLrngHwAgThd.Val "MICROSAR RTE" VALUE 0x0 RTE_RL_FLOAT32_IEEE 0 NO_COMPU_METHOD -3.402823466e+38 3.402823466e+38 SYMBOL_LINK "Rte_CalprmRom_CalRegn02CmnGroupC_DEFAULT_RTE_CALPRM_GROUP.SnsrOffsLrngYawLrngHwAgThd_Val" 0 DISPLAY_IDENTIFIER SnsrOffsLrng.CalibrationPorts.SnsrOffsLrngYawLrngHwAgThd.Val /end CHARACTERISTIC
/begin CHARACTERISTIC SnsrOffsLrng.SnsrOffsLrngYawLrngTi.Val "MICROSAR RTE" VALUE 0x0 RTE_RL_FLOAT32_IEEE 0 NO_COMPU_METHOD -3.402823466e+38 3.402823466e+38 SYMBOL_LINK "Rte_CalprmRom_CalRegn02Cmn_DEFAULT_RTE_CALPRM_GROUP.SnsrOffsLrngYawLrngTi_Val" 0 DISPLAY_IDENTIFIER SnsrOffsLrng.CalibrationPorts.SnsrOffsLrngYawLrngTi.Val /end CHARACTERISTIC
/begin CHARACTERISTIC SnsrOffsLrng.SnsrOffsLrngYawLrngYawAThd.Val "MICROSAR RTE" VALUE 0x0 RTE_RL_FLOAT32_IEEE 0 NO_COMPU_METHOD -3.402823466e+38 3.402823466e+38 SYMBOL_LINK "Rte_CalprmRom_CalRegn02CmnGroupC_DEFAULT_RTE_CALPRM_GROUP.SnsrOffsLrngYawLrngYawAThd_Val" 0 DISPLAY_IDENTIFIER SnsrOffsLrng.CalibrationPorts.SnsrOffsLrngYawLrngYawAThd.Val /end CHARACTERISTIC
/begin CHARACTERISTIC SnsrOffsLrng.SnsrOffsLrngYawOffsFrshTiThd.Val "MICROSAR RTE" VALUE 0x0 RTE_RL_FLOAT32_IEEE 0 NO_COMPU_METHOD -3.402823466e+38 3.402823466e+38 SYMBOL_LINK "Rte_CalprmRom_CalRegn02CmnGroupC_DEFAULT_RTE_CALPRM_GROUP.SnsrOffsLrngYawOffsFrshTiThd_Val" 0 DISPLAY_IDENTIFIER SnsrOffsLrng.CalibrationPorts.SnsrOffsLrngYawOffsFrshTiThd.Val /end CHARACTERISTIC
/begin CHARACTERISTIC SnsrOffsLrng.SnsrOffsLrngYawRateCdngFilFrq.Val "MICROSAR RTE" VALUE 0x0 RTE_RL_FLOAT32_IEEE 0 NO_COMPU_METHOD -3.402823466e+38 3.402823466e+38 SYMBOL_LINK "Rte_CalprmRom_CalRegn02Inin00_DEFAULT_RTE_CALPRM_GROUP.SnsrOffsLrngYawRateCdngFilFrq_Val" 0 DISPLAY_IDENTIFIER SnsrOffsLrng.CalibrationPorts.SnsrOffsLrngYawRateCdngFilFrq.Val /end CHARACTERISTIC
/begin CHARACTERISTIC SnsrOffsLrng.SnsrOffsLrngYawRateOffsLim.Val "MICROSAR RTE" VALUE 0x0 RTE_RL_FLOAT32_IEEE 0 NO_COMPU_METHOD -3.402823466e+38 3.402823466e+38 SYMBOL_LINK "Rte_CalprmRom_CalRegn02CmnGroupC_DEFAULT_RTE_CALPRM_GROUP.SnsrOffsLrngYawRateOffsLim_Val" 0 DISPLAY_IDENTIFIER SnsrOffsLrng.CalibrationPorts.SnsrOffsLrngYawRateOffsLim.Val /end CHARACTERISTIC
/begin CHARACTERISTIC SnsrOffsLrng.SysGlbPrmSysTqRat.Val "MICROSAR RTE" VALUE 0x0 RTE_RL_FLOAT32_IEEE 0 NO_COMPU_METHOD -3.402823466e+38 3.402823466e+38 SYMBOL_LINK "Rte_CalprmRom_CalRegn03Inin00_DEFAULT_RTE_CALPRM_GROUP.SysGlbPrmSysTqRat_Val" 0 DISPLAY_IDENTIFIER SnsrOffsLrng.CalibrationPorts.SysGlbPrmSysTqRat.Val /end CHARACTERISTIC
/begin CHARACTERISTIC StHlthSigNormn.CurrMeasCorrlnMaxErrCurr.Val "MICROSAR RTE" VALUE 0x0 RTE_RL_FLOAT32_IEEE 0 NO_COMPU_METHOD -3.402823466e+38 3.402823466e+38 SYMBOL_LINK "Rte_CalprmRom_CalRegn01Cmn_DEFAULT_RTE_CALPRM_GROUP.CurrMeasCorrlnMaxErrCurr_Val" 0 DISPLAY_IDENTIFIER StHlthSigNormn.CalibrationPorts.CurrMeasCorrlnMaxErrCurr.Val /end CHARACTERISTIC
/begin CHARACTERISTIC StHlthSigNormn.DutyCycThermProtnDutyCycFildThd.Val "MICROSAR RTE" VALUE 0x0 RTE_RL_UWORD 0 NO_COMPU_METHOD 0 65535 SYMBOL_LINK "Rte_CalprmRom_CalRegn01Cmn_DEFAULT_RTE_CALPRM_GROUP.DutyCycThermProtnDutyCycFildThd_Val" 0 DISPLAY_IDENTIFIER StHlthSigNormn.CalibrationPorts.DutyCycThermProtnDutyCycFildThd.Val /end CHARACTERISTIC
/begin CHARACTERISTIC StHlthSigNormn.EcuTMeasRngDiagcMax.Val "MICROSAR RTE" VALUE 0x0 RTE_RL_FLOAT32_IEEE 0 NO_COMPU_METHOD -3.402823466e+38 3.402823466e+38 SYMBOL_LINK "Rte_CalprmRom_CalRegn01Cmn_DEFAULT_RTE_CALPRM_GROUP.EcuTMeasRngDiagcMax_Val" 0 DISPLAY_IDENTIFIER StHlthSigNormn.CalibrationPorts.EcuTMeasRngDiagcMax.Val /end CHARACTERISTIC
/begin CHARACTERISTIC StHlthSigNormn.EcuTMeasRngDiagcMin.Val "MICROSAR RTE" VALUE 0x0 RTE_RL_FLOAT32_IEEE 0 NO_COMPU_METHOD -3.402823466e+38 3.402823466e+38 SYMBOL_LINK "Rte_CalprmRom_CalRegn01Cmn_DEFAULT_RTE_CALPRM_GROUP.EcuTMeasRngDiagcMin_Val" 0 DISPLAY_IDENTIFIER StHlthSigNormn.CalibrationPorts.EcuTMeasRngDiagcMin.Val /end CHARACTERISTIC
/begin CHARACTERISTIC StHlthSigNormn.EotLrngAuthyStrtLrn.Val "MICROSAR RTE" VALUE 0x0 RTE_RL_FLOAT32_IEEE 0 NO_COMPU_METHOD -3.402823466e+38 3.402823466e+38 SYMBOL_LINK "Rte_CalprmRom_CalRegn03Inin00_DEFAULT_RTE_CALPRM_GROUP.EotLrngAuthyStrtLrn_Val" 0 DISPLAY_IDENTIFIER StHlthSigNormn.CalibrationPorts.EotLrngAuthyStrtLrn.Val /end CHARACTERISTIC
/begin CHARACTERISTIC StHlthSigNormn.HwTqCorrlnChATraSumSetFltThd.Val "MICROSAR RTE" VALUE 0x0 RTE_RL_FLOAT32_IEEE 0 NO_COMPU_METHOD -3.402823466e+38 3.402823466e+38 SYMBOL_LINK "Rte_CalprmRom_CalRegn01Cmn_DEFAULT_RTE_CALPRM_GROUP.HwTqCorrlnChATraSumSetFltThd_Val" 0 DISPLAY_IDENTIFIER StHlthSigNormn.CalibrationPorts.HwTqCorrlnChATraSumSetFltThd.Val /end CHARACTERISTIC
/begin CHARACTERISTIC StHlthSigNormn.HwTqCorrlnChBTraSumSetFltThd.Val "MICROSAR RTE" VALUE 0x0 RTE_RL_FLOAT32_IEEE 0 NO_COMPU_METHOD -3.402823466e+38 3.402823466e+38 SYMBOL_LINK "Rte_CalprmRom_CalRegn01Cmn_DEFAULT_RTE_CALPRM_GROUP.HwTqCorrlnChBTraSumSetFltThd_Val" 0 DISPLAY_IDENTIFIER StHlthSigNormn.CalibrationPorts.HwTqCorrlnChBTraSumSetFltThd.Val /end CHARACTERISTIC
/begin CHARACTERISTIC StHlthSigNormn.MotDrvDiagcErrThd.Val "MICROSAR RTE" VALUE 0x0 RTE_RL_ULONG 0 NO_COMPU_METHOD 0 4294967295 SYMBOL_LINK "Rte_CalprmRom_CalRegn01Cmn_DEFAULT_RTE_CALPRM_GROUP.MotDrvDiagcErrThd_Val" 0 DISPLAY_IDENTIFIER StHlthSigNormn.CalibrationPorts.MotDrvDiagcErrThd.Val /end CHARACTERISTIC
/begin CHARACTERISTIC StHlthSigNormn.StHlthSigNormnAbsltMotPosDifStHlthDiagThd.Val "MICROSAR RTE" VALUE 0x0 RTE_RL_UBYTE 0 NO_COMPU_METHOD 0 255 SYMBOL_LINK "Rte_CalprmRom_CalRegn01Cmn_DEFAULT_RTE_CALPRM_GROUP.StHlthSigNormnAbsltMotPosDifStHlthDiagThd_Val" 0 DISPLAY_IDENTIFIER StHlthSigNormn.CalibrationPorts.StHlthSigNormnAbsltMotPosDifStHlthDiagThd.Val /end CHARACTERISTIC
/begin CHARACTERISTIC StHlthSigNormn.StHlthSigNormnCurrMotSumStHlthDiagThd.Val "MICROSAR RTE" VALUE 0x0 RTE_RL_UBYTE 0 NO_COMPU_METHOD 0 255 SYMBOL_LINK "Rte_CalprmRom_CalRegn01Cmn_DEFAULT_RTE_CALPRM_GROUP.StHlthSigNormnCurrMotSumStHlthDiagThd_Val" 0 DISPLAY_IDENTIFIER StHlthSigNormn.CalibrationPorts.StHlthSigNormnCurrMotSumStHlthDiagThd.Val /end CHARACTERISTIC
/begin CHARACTERISTIC StHlthSigNormn.StHlthSigNormnDigTqStHlthDiagThd.Val "MICROSAR RTE" VALUE 0x0 RTE_RL_UBYTE 0 NO_COMPU_METHOD 0 255 SYMBOL_LINK "Rte_CalprmRom_CalRegn01Cmn_DEFAULT_RTE_CALPRM_GROUP.StHlthSigNormnDigTqStHlthDiagThd_Val" 0 DISPLAY_IDENTIFIER StHlthSigNormn.CalibrationPorts.StHlthSigNormnDigTqStHlthDiagThd.Val /end CHARACTERISTIC
/begin CHARACTERISTIC StHlthSigNormn.StHlthSigNormnDutyCycFltLimThd.Val "MICROSAR RTE" VALUE 0x0 RTE_RL_UWORD 0 NO_COMPU_METHOD 0 65535 SYMBOL_LINK "Rte_CalprmRom_CalRegn01Cmn_DEFAULT_RTE_CALPRM_GROUP.StHlthSigNormnDutyCycFltLimThd_Val" 0 DISPLAY_IDENTIFIER StHlthSigNormn.CalibrationPorts.StHlthSigNormnDutyCycFltLimThd.Val /end CHARACTERISTIC
/begin CHARACTERISTIC StHlthSigNormn.StHlthSigNormnHiCtrlrT.Val "MICROSAR RTE" VALUE 0x0 RTE_RL_FLOAT32_IEEE 0 NO_COMPU_METHOD -3.402823466e+38 3.402823466e+38 SYMBOL_LINK "Rte_CalprmRom_CalRegn01Inin00_DEFAULT_RTE_CALPRM_GROUP.StHlthSigNormnHiCtrlrT_Val" 0 DISPLAY_IDENTIFIER StHlthSigNormn.CalibrationPorts.StHlthSigNormnHiCtrlrT.Val /end CHARACTERISTIC
/begin CHARACTERISTIC StHlthSigNormn.StHlthSigNormnIdptSigStHlthSca.Val "MICROSAR RTE" VALUE 0x0 RTE_RL_UBYTE 0 NO_COMPU_METHOD 0 255 SYMBOL_LINK "Rte_CalprmRom_CalRegn01Cmn_DEFAULT_RTE_CALPRM_GROUP.StHlthSigNormnIdptSigStHlthSca_Val" 0 DISPLAY_IDENTIFIER StHlthSigNormn.CalibrationPorts.StHlthSigNormnIdptSigStHlthSca.Val /end CHARACTERISTIC
/begin CHARACTERISTIC StHlthSigNormn.StHlthSigNormnLoCtrlrT.Val "MICROSAR RTE" VALUE 0x0 RTE_RL_FLOAT32_IEEE 0 NO_COMPU_METHOD -3.402823466e+38 3.402823466e+38 SYMBOL_LINK "Rte_CalprmRom_CalRegn01Inin00_DEFAULT_RTE_CALPRM_GROUP.StHlthSigNormnLoCtrlrT_Val" 0 DISPLAY_IDENTIFIER StHlthSigNormn.CalibrationPorts.StHlthSigNormnLoCtrlrT.Val /end CHARACTERISTIC
/begin CHARACTERISTIC StHlthSigNormn.StHlthSigNormnMaxFricThd.Val "MICROSAR RTE" VALUE 0x0 RTE_RL_FLOAT32_IEEE 0 NO_COMPU_METHOD -3.402823466e+38 3.402823466e+38 SYMBOL_LINK "Rte_CalprmRom_CalRegn01Cmn_DEFAULT_RTE_CALPRM_GROUP.StHlthSigNormnMaxFricThd_Val" 0 DISPLAY_IDENTIFIER StHlthSigNormn.CalibrationPorts.StHlthSigNormnMaxFricThd.Val /end CHARACTERISTIC
/begin CHARACTERISTIC StHlthSigNormn.StHlthSigNormnMinRackTrvlLim.Val "MICROSAR RTE" VALUE 0x0 RTE_RL_FLOAT32_IEEE 0 NO_COMPU_METHOD -3.402823466e+38 3.402823466e+38 SYMBOL_LINK "Rte_CalprmRom_CalRegn01Cmn_DEFAULT_RTE_CALPRM_GROUP.StHlthSigNormnMinRackTrvlLim_Val" 0 DISPLAY_IDENTIFIER StHlthSigNormn.CalibrationPorts.StHlthSigNormnMinRackTrvlLim.Val /end CHARACTERISTIC
/begin CHARACTERISTIC StHlthSigNormn.StHlthSigNormnMotPosStHlthDiagThd.Val "MICROSAR RTE" VALUE 0x0 RTE_RL_UBYTE 0 NO_COMPU_METHOD 0 255 SYMBOL_LINK "Rte_CalprmRom_CalRegn01Cmn_DEFAULT_RTE_CALPRM_GROUP.StHlthSigNormnMotPosStHlthDiagThd_Val" 0 DISPLAY_IDENTIFIER StHlthSigNormn.CalibrationPorts.StHlthSigNormnMotPosStHlthDiagThd.Val /end CHARACTERISTIC
/begin CHARACTERISTIC StHlthSigNormn.StHlthSigNormnMotVelCal.Val "MICROSAR RTE" VALUE 0x0 RTE_RL_FLOAT32_IEEE 0 NO_COMPU_METHOD -3.402823466e+38 3.402823466e+38 SYMBOL_LINK "Rte_CalprmRom_CalRegn01Cmn_DEFAULT_RTE_CALPRM_GROUP.StHlthSigNormnMotVelCal_Val" 0 DISPLAY_IDENTIFIER StHlthSigNormn.CalibrationPorts.StHlthSigNormnMotVelCal.Val /end CHARACTERISTIC
/begin CHARACTERISTIC StHlthSigNormn.StHlthSigNormnPhaInfoStHlthDiagThd.Val "MICROSAR RTE" VALUE 0x0 RTE_RL_UBYTE 0 NO_COMPU_METHOD 0 255 SYMBOL_LINK "Rte_CalprmRom_CalRegn01Cmn_DEFAULT_RTE_CALPRM_GROUP.StHlthSigNormnPhaInfoStHlthDiagThd_Val" 0 DISPLAY_IDENTIFIER StHlthSigNormn.CalibrationPorts.StHlthSigNormnPhaInfoStHlthDiagThd.Val /end CHARACTERISTIC
/begin CHARACTERISTIC StHlthSigNormn.StHlthSigNormnStHlthCorrlnErr.Val "MICROSAR RTE" VALUE 0x0 RTE_RL_UWORD 0 NO_COMPU_METHOD 0 65535 SYMBOL_LINK "Rte_CalprmRom_CalRegn01Cmn_DEFAULT_RTE_CALPRM_GROUP.StHlthSigNormnStHlthCorrlnErr_Val" 0 DISPLAY_IDENTIFIER StHlthSigNormn.CalibrationPorts.StHlthSigNormnStHlthCorrlnErr.Val /end CHARACTERISTIC
/begin CHARACTERISTIC StHlthSigNormn.StHlthSigNormnStHlthCurrMotSum.Val "MICROSAR RTE" VALUE 0x0 RTE_RL_FLOAT32_IEEE 0 NO_COMPU_METHOD -3.402823466e+38 3.402823466e+38 SYMBOL_LINK "Rte_CalprmRom_CalRegn01Cmn_DEFAULT_RTE_CALPRM_GROUP.StHlthSigNormnStHlthCurrMotSum_Val" 0 DISPLAY_IDENTIFIER StHlthSigNormn.CalibrationPorts.StHlthSigNormnStHlthCurrMotSum.Val /end CHARACTERISTIC
/begin CHARACTERISTIC StHlthSigNormn.StHlthSigNormnStHlthPhaInfo.Val "MICROSAR RTE" VALUE 0x0 RTE_RL_FLOAT32_IEEE 0 NO_COMPU_METHOD -3.402823466e+38 3.402823466e+38 SYMBOL_LINK "Rte_CalprmRom_CalRegn01Cmn_DEFAULT_RTE_CALPRM_GROUP.StHlthSigNormnStHlthPhaInfo_Val" 0 DISPLAY_IDENTIFIER StHlthSigNormn.CalibrationPorts.StHlthSigNormnStHlthPhaInfo.Val /end CHARACTERISTIC
/begin CHARACTERISTIC StHlthSigNormn.StHlthSigNormnValMaxStHlthErr.Val "MICROSAR RTE" VALUE 0x0 RTE_RL_FLOAT32_IEEE 0 NO_COMPU_METHOD -3.402823466e+38 3.402823466e+38 SYMBOL_LINK "Rte_CalprmRom_CalRegn01Cmn_DEFAULT_RTE_CALPRM_GROUP.StHlthSigNormnValMaxStHlthErr_Val" 0 DISPLAY_IDENTIFIER StHlthSigNormn.CalibrationPorts.StHlthSigNormnValMaxStHlthErr.Val /end CHARACTERISTIC
/begin CHARACTERISTIC StHlthSigNormn.StHlthSigNormnValMinStHlthErr.Val "MICROSAR RTE" VALUE 0x0 RTE_RL_FLOAT32_IEEE 0 NO_COMPU_METHOD -3.402823466e+38 3.402823466e+38 SYMBOL_LINK "Rte_CalprmRom_CalRegn01Cmn_DEFAULT_RTE_CALPRM_GROUP.StHlthSigNormnValMinStHlthErr_Val" 0 DISPLAY_IDENTIFIER StHlthSigNormn.CalibrationPorts.StHlthSigNormnValMinStHlthErr.Val /end CHARACTERISTIC
/begin CHARACTERISTIC StHlthSigNormn.StHlthSigNormnWhlImbRejctnThd.Val "MICROSAR RTE" VALUE 0x0 RTE_RL_FLOAT32_IEEE 0 NO_COMPU_METHOD -3.402823466e+38 3.402823466e+38 SYMBOL_LINK "Rte_CalprmRom_CalRegn01Cmn_DEFAULT_RTE_CALPRM_GROUP.StHlthSigNormnWhlImbRejctnThd_Val" 0 DISPLAY_IDENTIFIER StHlthSigNormn.CalibrationPorts.StHlthSigNormnWhlImbRejctnThd.Val /end CHARACTERISTIC
/begin CHARACTERISTIC StHlthSigNormn.SysGlbPrmMotPoleCnt.Val "MICROSAR RTE" VALUE 0x0 RTE_RL_UBYTE 0 NO_COMPU_METHOD 0 255 SYMBOL_LINK "Rte_CalprmRom_CalRegn01Inin00_DEFAULT_RTE_CALPRM_GROUP.SysGlbPrmMotPoleCnt_Val" 0 DISPLAY_IDENTIFIER StHlthSigNormn.CalibrationPorts.SysGlbPrmMotPoleCnt.Val /end CHARACTERISTIC
/begin CHARACTERISTIC StabyCmp.StabyCmpAssiScaBlndX.Ary1D "MICROSAR RTE" VAL_BLK 0x0 RTE_RL_UWORD 0 NO_COMPU_METHOD 0 65535 MATRIX_DIM 2 1 1 SYMBOL_LINK "Rte_CalprmRom_CalRegn03Inin00_DEFAULT_RTE_CALPRM_GROUP.StabyCmpAssiScaBlndX_Ary1D" 0 DISPLAY_IDENTIFIER StabyCmp.CalibrationPorts.StabyCmpAssiScaBlndX.Ary1D /end CHARACTERISTIC
/begin CHARACTERISTIC StabyCmp.StabyCmpAssiScaBlndY.Ary1D "MICROSAR RTE" VAL_BLK 0x0 RTE_RL_UWORD 0 NO_COMPU_METHOD 0 65535 MATRIX_DIM 2 1 1 SYMBOL_LINK "Rte_CalprmRom_CalRegn03Inin00_DEFAULT_RTE_CALPRM_GROUP.StabyCmpAssiScaBlndY_Ary1D" 0 DISPLAY_IDENTIFIER StabyCmp.CalibrationPorts.StabyCmpAssiScaBlndY.Ary1D /end CHARACTERISTIC
/begin CHARACTERISTIC StabyCmp.StabyCmpHwTqLpFilFrq.Val "MICROSAR RTE" VALUE 0x0 RTE_RL_FLOAT32_IEEE 0 NO_COMPU_METHOD -3.402823466e+38 3.402823466e+38 SYMBOL_LINK "Rte_CalprmRom_CalRegn03Inin00_DEFAULT_RTE_CALPRM_GROUP.StabyCmpHwTqLpFilFrq_Val" 0 DISPLAY_IDENTIFIER StabyCmp.CalibrationPorts.StabyCmpHwTqLpFilFrq.Val /end CHARACTERISTIC
/begin CHARACTERISTIC StabyCmp.StabyCmpNotchFil1Struct.Rec.FilGainA1 "MICROSAR RTE" VALUE 0x0 RTE_RL_FLOAT32_IEEE 0 NO_COMPU_METHOD -3.402823466e+38 3.402823466e+38 SYMBOL_LINK "Rte_CalprmRom_CalRegn03Inin00_DEFAULT_RTE_CALPRM_GROUP.StabyCmpNotchFil1Struct_Rec.FilGainA1" 0 DISPLAY_IDENTIFIER StabyCmp.CalibrationPorts.StabyCmpNotchFil1Struct.Rec.FilGainA1 /end CHARACTERISTIC
/begin CHARACTERISTIC StabyCmp.StabyCmpNotchFil1Struct.Rec.FilGainA2 "MICROSAR RTE" VALUE 0x0 RTE_RL_FLOAT32_IEEE 0 NO_COMPU_METHOD -3.402823466e+38 3.402823466e+38 SYMBOL_LINK "Rte_CalprmRom_CalRegn03Inin00_DEFAULT_RTE_CALPRM_GROUP.StabyCmpNotchFil1Struct_Rec.FilGainA2" 0 DISPLAY_IDENTIFIER StabyCmp.CalibrationPorts.StabyCmpNotchFil1Struct.Rec.FilGainA2 /end CHARACTERISTIC
/begin CHARACTERISTIC StabyCmp.StabyCmpNotchFil1Struct.Rec.FilGainB0 "MICROSAR RTE" VALUE 0x0 RTE_RL_FLOAT32_IEEE 0 NO_COMPU_METHOD -3.402823466e+38 3.402823466e+38 SYMBOL_LINK "Rte_CalprmRom_CalRegn03Inin00_DEFAULT_RTE_CALPRM_GROUP.StabyCmpNotchFil1Struct_Rec.FilGainB0" 0 DISPLAY_IDENTIFIER StabyCmp.CalibrationPorts.StabyCmpNotchFil1Struct.Rec.FilGainB0 /end CHARACTERISTIC
/begin CHARACTERISTIC StabyCmp.StabyCmpNotchFil1Struct.Rec.FilGainB1 "MICROSAR RTE" VALUE 0x0 RTE_RL_FLOAT32_IEEE 0 NO_COMPU_METHOD -3.402823466e+38 3.402823466e+38 SYMBOL_LINK "Rte_CalprmRom_CalRegn03Inin00_DEFAULT_RTE_CALPRM_GROUP.StabyCmpNotchFil1Struct_Rec.FilGainB1" 0 DISPLAY_IDENTIFIER StabyCmp.CalibrationPorts.StabyCmpNotchFil1Struct.Rec.FilGainB1 /end CHARACTERISTIC
/begin CHARACTERISTIC StabyCmp.StabyCmpNotchFil1Struct.Rec.FilGainB2 "MICROSAR RTE" VALUE 0x0 RTE_RL_FLOAT32_IEEE 0 NO_COMPU_METHOD -3.402823466e+38 3.402823466e+38 SYMBOL_LINK "Rte_CalprmRom_CalRegn03Inin00_DEFAULT_RTE_CALPRM_GROUP.StabyCmpNotchFil1Struct_Rec.FilGainB2" 0 DISPLAY_IDENTIFIER StabyCmp.CalibrationPorts.StabyCmpNotchFil1Struct.Rec.FilGainB2 /end CHARACTERISTIC
/begin CHARACTERISTIC StabyCmp.StabyCmpNotchFil2Struct.Rec.FilGainA1 "MICROSAR RTE" VALUE 0x0 RTE_RL_FLOAT32_IEEE 0 NO_COMPU_METHOD -3.402823466e+38 3.402823466e+38 SYMBOL_LINK "Rte_CalprmRom_CalRegn03Inin00_DEFAULT_RTE_CALPRM_GROUP.StabyCmpNotchFil2Struct_Rec.FilGainA1" 0 DISPLAY_IDENTIFIER StabyCmp.CalibrationPorts.StabyCmpNotchFil2Struct.Rec.FilGainA1 /end CHARACTERISTIC
/begin CHARACTERISTIC StabyCmp.StabyCmpNotchFil2Struct.Rec.FilGainA2 "MICROSAR RTE" VALUE 0x0 RTE_RL_FLOAT32_IEEE 0 NO_COMPU_METHOD -3.402823466e+38 3.402823466e+38 SYMBOL_LINK "Rte_CalprmRom_CalRegn03Inin00_DEFAULT_RTE_CALPRM_GROUP.StabyCmpNotchFil2Struct_Rec.FilGainA2" 0 DISPLAY_IDENTIFIER StabyCmp.CalibrationPorts.StabyCmpNotchFil2Struct.Rec.FilGainA2 /end CHARACTERISTIC
/begin CHARACTERISTIC StabyCmp.StabyCmpNotchFil2Struct.Rec.FilGainB0 "MICROSAR RTE" VALUE 0x0 RTE_RL_FLOAT32_IEEE 0 NO_COMPU_METHOD -3.402823466e+38 3.402823466e+38 SYMBOL_LINK "Rte_CalprmRom_CalRegn03Inin00_DEFAULT_RTE_CALPRM_GROUP.StabyCmpNotchFil2Struct_Rec.FilGainB0" 0 DISPLAY_IDENTIFIER StabyCmp.CalibrationPorts.StabyCmpNotchFil2Struct.Rec.FilGainB0 /end CHARACTERISTIC
/begin CHARACTERISTIC StabyCmp.StabyCmpNotchFil2Struct.Rec.FilGainB1 "MICROSAR RTE" VALUE 0x0 RTE_RL_FLOAT32_IEEE 0 NO_COMPU_METHOD -3.402823466e+38 3.402823466e+38 SYMBOL_LINK "Rte_CalprmRom_CalRegn03Inin00_DEFAULT_RTE_CALPRM_GROUP.StabyCmpNotchFil2Struct_Rec.FilGainB1" 0 DISPLAY_IDENTIFIER StabyCmp.CalibrationPorts.StabyCmpNotchFil2Struct.Rec.FilGainB1 /end CHARACTERISTIC
/begin CHARACTERISTIC StabyCmp.StabyCmpNotchFil2Struct.Rec.FilGainB2 "MICROSAR RTE" VALUE 0x0 RTE_RL_FLOAT32_IEEE 0 NO_COMPU_METHOD -3.402823466e+38 3.402823466e+38 SYMBOL_LINK "Rte_CalprmRom_CalRegn03Inin00_DEFAULT_RTE_CALPRM_GROUP.StabyCmpNotchFil2Struct_Rec.FilGainB2" 0 DISPLAY_IDENTIFIER StabyCmp.CalibrationPorts.StabyCmpNotchFil2Struct.Rec.FilGainB2 /end CHARACTERISTIC
/begin MEASUREMENT SnsrOffsLrng.HwTqLrngStRst "MICROSAR RTE" UBYTE RTE_CM_BOOLEAN 0 0 0 255 ECU_ADDRESS 0 SYMBOL_LINK "Rte_SnsrOffsLrng_HwTqLrngStRst" 0 DISPLAY_IDENTIFIER SnsrOffsLrng.PerInstanceMemories.HwTqLrngStRst /end MEASUREMENT
/begin MEASUREMENT SnsrOffsLrng.HwTqLrngTqInpDetnEnaPrev "MICROSAR RTE" UBYTE RTE_CM_BOOLEAN 0 0 0 255 ECU_ADDRESS 0 SYMBOL_LINK "Rte_SnsrOffsLrng_HwTqLrngTqInpDetnEnaPrev" 0 DISPLAY_IDENTIFIER SnsrOffsLrng.PerInstanceMemories.HwTqLrngTqInpDetnEnaPrev /end MEASUREMENT
/begin MEASUREMENT SnsrOffsLrng.HwTqLrngTqInpPrsnt "MICROSAR RTE" UBYTE RTE_CM_BOOLEAN 0 0 0 255 ECU_ADDRESS 0 SYMBOL_LINK "Rte_SnsrOffsLrng_HwTqLrngTqInpPrsnt" 0 DISPLAY_IDENTIFIER SnsrOffsLrng.PerInstanceMemories.HwTqLrngTqInpPrsnt /end MEASUREMENT
/begin MEASUREMENT SnsrOffsLrng.HwTqMeasFil1.FilGain "MICROSAR RTE" FLOAT32_IEEE NO_COMPU_METHOD 0 0 -3.402823466e+38 3.402823466e+38 ECU_ADDRESS 0 SYMBOL_LINK "Rte_SnsrOffsLrng_HwTqMeasFil1.FilGain" 0 DISPLAY_IDENTIFIER SnsrOffsLrng.PerInstanceMemories.HwTqMeasFil1.FilGain /end MEASUREMENT
/begin MEASUREMENT SnsrOffsLrng.HwTqMeasFil1.FilSt "MICROSAR RTE" FLOAT32_IEEE NO_COMPU_METHOD 0 0 -3.402823466e+38 3.402823466e+38 ECU_ADDRESS 0 SYMBOL_LINK "Rte_SnsrOffsLrng_HwTqMeasFil1.FilSt" 0 DISPLAY_IDENTIFIER SnsrOffsLrng.PerInstanceMemories.HwTqMeasFil1.FilSt /end MEASUREMENT
/begin MEASUREMENT SnsrOffsLrng.HwTqMeasFil2.FilGain "MICROSAR RTE" FLOAT32_IEEE NO_COMPU_METHOD 0 0 -3.402823466e+38 3.402823466e+38 ECU_ADDRESS 0 SYMBOL_LINK "Rte_SnsrOffsLrng_HwTqMeasFil2.FilGain" 0 DISPLAY_IDENTIFIER SnsrOffsLrng.PerInstanceMemories.HwTqMeasFil2.FilGain /end MEASUREMENT
/begin MEASUREMENT SnsrOffsLrng.HwTqMeasFil2.FilSt "MICROSAR RTE" FLOAT32_IEEE NO_COMPU_METHOD 0 0 -3.402823466e+38 3.402823466e+38 ECU_ADDRESS 0 SYMBOL_LINK "Rte_SnsrOffsLrng_HwTqMeasFil2.FilSt" 0 DISPLAY_IDENTIFIER SnsrOffsLrng.PerInstanceMemories.HwTqMeasFil2.FilSt /end MEASUREMENT
/begin MEASUREMENT SnsrOffsLrng.HwTqOffs.Val "MICROSAR RTE" FLOAT32_IEEE NO_COMPU_METHOD 0 0 -3.402823466e+38 3.402823466e+38 ECU_ADDRESS 0 SYMBOL_LINK "Rte_SnsrOffsLrng_HwTqOffs_Val" 0 DISPLAY_IDENTIFIER SnsrOffsLrng.SenderPorts.HwTqOffs.Val /end MEASUREMENT
/begin MEASUREMENT SnsrOffsLrng.HwVel.Val "MICROSAR RTE" FLOAT32_IEEE NO_COMPU_METHOD 0 0 -3.402823466e+38 3.402823466e+38 ECU_ADDRESS 0 SYMBOL_LINK "Rte_CDD_MotVel_HwVel_Val" 0 DISPLAY_IDENTIFIER SnsrOffsLrng.ReceiverPorts.HwVel.Val /end MEASUREMENT
/begin MEASUREMENT SnsrOffsLrng.HwVelCdngFil.FilGain "MICROSAR RTE" FLOAT32_IEEE NO_COMPU_METHOD 0 0 -3.402823466e+38 3.402823466e+38 ECU_ADDRESS 0 SYMBOL_LINK "Rte_SnsrOffsLrng_HwVelCdngFil.FilGain" 0 DISPLAY_IDENTIFIER SnsrOffsLrng.PerInstanceMemories.HwVelCdngFil.FilGain /end MEASUREMENT
/begin MEASUREMENT SnsrOffsLrng.HwVelCdngFil.FilSt "MICROSAR RTE" FLOAT32_IEEE NO_COMPU_METHOD 0 0 -3.402823466e+38 3.402823466e+38 ECU_ADDRESS 0 SYMBOL_LINK "Rte_SnsrOffsLrng_HwVelCdngFil.FilSt" 0 DISPLAY_IDENTIFIER SnsrOffsLrng.PerInstanceMemories.HwVelCdngFil.FilSt /end MEASUREMENT
/begin MEASUREMENT SnsrOffsLrng.MotTqCmdCrf.Val "MICROSAR RTE" FLOAT32_IEEE NO_COMPU_METHOD 0 0 -3.402823466e+38 3.402823466e+38 ECU_ADDRESS 0 SYMBOL_LINK "Rte_MotTqTranlDampg_MotTqCmdCrfDampd_Val" 0 DISPLAY_IDENTIFIER SnsrOffsLrng.ReceiverPorts.MotTqCmdCrf.Val /end MEASUREMENT
/begin MEASUREMENT SnsrOffsLrng.SnsrOffsLrnd.HwAgLrndTi "MICROSAR RTE" FLOAT32_IEEE NO_COMPU_METHOD 0 0 -3.402823466e+38 3.402823466e+38 ECU_ADDRESS 0 SYMBOL_LINK "Rte_SnsrOffsLrng_SnsrOffsLrnd.HwAgLrndTi" 0 DISPLAY_IDENTIFIER SnsrOffsLrng.PerInstanceMemories.SnsrOffsLrnd.HwAgLrndTi /end MEASUREMENT
/begin MEASUREMENT SnsrOffsLrng.SnsrOffsLrnd.HwAgLrngHwAgFilSt "MICROSAR RTE" SWORD NO_COMPU_METHOD 0 0 -32768 32767 ECU_ADDRESS 0 SYMBOL_LINK "Rte_SnsrOffsLrng_SnsrOffsLrnd.HwAgLrngHwAgFilSt" 0 DISPLAY_IDENTIFIER SnsrOffsLrng.PerInstanceMemories.SnsrOffsLrnd.HwAgLrngHwAgFilSt /end MEASUREMENT
/begin MEASUREMENT SnsrOffsLrng.SnsrOffsLrnd.HwAgLrngSysTqFilSt "MICROSAR RTE" SWORD NO_COMPU_METHOD 0 0 -32768 32767 ECU_ADDRESS 0 SYMBOL_LINK "Rte_SnsrOffsLrng_SnsrOffsLrnd.HwAgLrngSysTqFilSt" 0 DISPLAY_IDENTIFIER SnsrOffsLrng.PerInstanceMemories.SnsrOffsLrnd.HwAgLrngSysTqFilSt /end MEASUREMENT
/begin MEASUREMENT SnsrOffsLrng.SnsrOffsLrnd.HwAgLrngYawOffsRef "MICROSAR RTE" SWORD NO_COMPU_METHOD 0 0 -32768 32767 ECU_ADDRESS 0 SYMBOL_LINK "Rte_SnsrOffsLrng_SnsrOffsLrnd.HwAgLrngYawOffsRef" 0 DISPLAY_IDENTIFIER SnsrOffsLrng.PerInstanceMemories.SnsrOffsLrnd.HwAgLrngYawOffsRef /end MEASUREMENT
/begin MEASUREMENT SnsrOffsLrng.SnsrOffsLrnd.HwAgOffs "MICROSAR RTE" SWORD NO_COMPU_METHOD 0 0 -32768 32767 ECU_ADDRESS 0 SYMBOL_LINK "Rte_SnsrOffsLrng_SnsrOffsLrnd.HwAgOffs" 0 DISPLAY_IDENTIFIER SnsrOffsLrng.PerInstanceMemories.SnsrOffsLrnd.HwAgOffs /end MEASUREMENT
/begin MEASUREMENT SnsrOffsLrng.SnsrOffsLrnd.HwTqLrngCovariMtrx "MICROSAR RTE" FLOAT32_IEEE NO_COMPU_METHOD 0 0 -3.402823466e+38 3.402823466e+38 MATRIX_DIM 3 3 1 ECU_ADDRESS 0 SYMBOL_LINK "Rte_SnsrOffsLrng_SnsrOffsLrnd.HwTqLrngCovariMtrx" 0 DISPLAY_IDENTIFIER SnsrOffsLrng.PerInstanceMemories.SnsrOffsLrnd.HwTqLrngCovariMtrx /end MEASUREMENT
/begin MEASUREMENT SnsrOffsLrng.SnsrOffsLrnd.HwTqLrngEstimnVect "MICROSAR RTE" FLOAT32_IEEE NO_COMPU_METHOD 0 0 -3.402823466e+38 3.402823466e+38 MATRIX_DIM 3 1 1 ECU_ADDRESS 0 SYMBOL_LINK "Rte_SnsrOffsLrng_SnsrOffsLrnd.HwTqLrngEstimnVect" 0 DISPLAY_IDENTIFIER SnsrOffsLrng.PerInstanceMemories.SnsrOffsLrnd.HwTqLrngEstimnVect /end MEASUREMENT
/begin MEASUREMENT SnsrOffsLrng.SnsrOffsLrnd.HwTqLrngHwAgRef "MICROSAR RTE" SWORD NO_COMPU_METHOD 0 0 -32768 32767 ECU_ADDRESS 0 SYMBOL_LINK "Rte_SnsrOffsLrng_SnsrOffsLrnd.HwTqLrngHwAgRef" 0 DISPLAY_IDENTIFIER SnsrOffsLrng.PerInstanceMemories.SnsrOffsLrnd.HwTqLrngHwAgRef /end MEASUREMENT
/begin MEASUREMENT SnsrOffsLrng.SnsrOffsLrnd.HwTqLrngSampleCntNeg "MICROSAR RTE" UWORD NO_COMPU_METHOD 0 0 0 65535 ECU_ADDRESS 0 SYMBOL_LINK "Rte_SnsrOffsLrng_SnsrOffsLrnd.HwTqLrngSampleCntNeg" 0 DISPLAY_IDENTIFIER SnsrOffsLrng.PerInstanceMemories.SnsrOffsLrnd.HwTqLrngSampleCntNeg /end MEASUREMENT
/begin MEASUREMENT SnsrOffsLrng.SnsrOffsLrnd.HwTqLrngSampleCntPos "MICROSAR RTE" UWORD NO_COMPU_METHOD 0 0 0 65535 ECU_ADDRESS 0 SYMBOL_LINK "Rte_SnsrOffsLrng_SnsrOffsLrnd.HwTqLrngSampleCntPos" 0 DISPLAY_IDENTIFIER SnsrOffsLrng.PerInstanceMemories.SnsrOffsLrnd.HwTqLrngSampleCntPos /end MEASUREMENT
/begin MEASUREMENT SnsrOffsLrng.SnsrOffsLrnd.HwTqLrngSts "MICROSAR RTE" UBYTE NO_COMPU_METHOD 0 0 0 255 ECU_ADDRESS 0 SYMBOL_LINK "Rte_SnsrOffsLrng_SnsrOffsLrnd.HwTqLrngSts" 0 DISPLAY_IDENTIFIER SnsrOffsLrng.PerInstanceMemories.SnsrOffsLrnd.HwTqLrngSts /end MEASUREMENT
/begin MEASUREMENT SnsrOffsLrng.SnsrOffsLrnd.HwTqOffs "MICROSAR RTE" SWORD NO_COMPU_METHOD 0 0 -32768 32767 ECU_ADDRESS 0 SYMBOL_LINK "Rte_SnsrOffsLrng_SnsrOffsLrnd.HwTqOffs" 0 DISPLAY_IDENTIFIER SnsrOffsLrng.PerInstanceMemories.SnsrOffsLrnd.HwTqOffs /end MEASUREMENT
/begin MEASUREMENT SnsrOffsLrng.SnsrOffsLrnd.YawRateElpdTi "MICROSAR RTE" FLOAT32_IEEE NO_COMPU_METHOD 0 0 -3.402823466e+38 3.402823466e+38 ECU_ADDRESS 0 SYMBOL_LINK "Rte_SnsrOffsLrng_SnsrOffsLrnd.YawRateElpdTi" 0 DISPLAY_IDENTIFIER SnsrOffsLrng.PerInstanceMemories.SnsrOffsLrnd.YawRateElpdTi /end MEASUREMENT
/begin MEASUREMENT SnsrOffsLrng.SnsrOffsLrnd.YawRateOffs "MICROSAR RTE" SWORD NO_COMPU_METHOD 0 0 -32768 32767 ECU_ADDRESS 0 SYMBOL_LINK "Rte_SnsrOffsLrng_SnsrOffsLrnd.YawRateOffs" 0 DISPLAY_IDENTIFIER SnsrOffsLrng.PerInstanceMemories.SnsrOffsLrnd.YawRateOffs /end MEASUREMENT
/begin MEASUREMENT SnsrOffsLrng.SnsrOffsLrnd.YawRateOffsVld "MICROSAR RTE" UBYTE RTE_CM_BOOLEAN 0 0 0 255 ECU_ADDRESS 0 SYMBOL_LINK "Rte_SnsrOffsLrng_SnsrOffsLrnd.YawRateOffsVld" 0 DISPLAY_IDENTIFIER SnsrOffsLrng.PerInstanceMemories.SnsrOffsLrnd.YawRateOffsVld /end MEASUREMENT
/begin MEASUREMENT SnsrOffsLrng.SysTqCdngFil.FilGain "MICROSAR RTE" FLOAT32_IEEE NO_COMPU_METHOD 0 0 -3.402823466e+38 3.402823466e+38 ECU_ADDRESS 0 SYMBOL_LINK "Rte_SnsrOffsLrng_SysTqCdngFil.FilGain" 0 DISPLAY_IDENTIFIER SnsrOffsLrng.PerInstanceMemories.SysTqCdngFil.FilGain /end MEASUREMENT
/begin MEASUREMENT SnsrOffsLrng.SysTqCdngFil.FilSt "MICROSAR RTE" FLOAT32_IEEE NO_COMPU_METHOD 0 0 -3.402823466e+38 3.402823466e+38 ECU_ADDRESS 0 SYMBOL_LINK "Rte_SnsrOffsLrng_SysTqCdngFil.FilSt" 0 DISPLAY_IDENTIFIER SnsrOffsLrng.PerInstanceMemories.SysTqCdngFil.FilSt /end MEASUREMENT
/begin MEASUREMENT SnsrOffsLrng.TqInpDetnEnaTi "MICROSAR RTE" FLOAT32_IEEE NO_COMPU_METHOD 0 0 -3.402823466e+38 3.402823466e+38 ECU_ADDRESS 0 SYMBOL_LINK "Rte_SnsrOffsLrng_TqInpDetnEnaTi" 0 DISPLAY_IDENTIFIER SnsrOffsLrng.PerInstanceMemories.TqInpDetnEnaTi /end MEASUREMENT
/begin MEASUREMENT SnsrOffsLrng.TqInpDetnHwTqFil.FilGain "MICROSAR RTE" FLOAT32_IEEE NO_COMPU_METHOD 0 0 -3.402823466e+38 3.402823466e+38 ECU_ADDRESS 0 SYMBOL_LINK "Rte_SnsrOffsLrng_TqInpDetnHwTqFil.FilGain" 0 DISPLAY_IDENTIFIER SnsrOffsLrng.PerInstanceMemories.TqInpDetnHwTqFil.FilGain /end MEASUREMENT
/begin MEASUREMENT SnsrOffsLrng.TqInpDetnHwTqFil.FilSt "MICROSAR RTE" FLOAT32_IEEE NO_COMPU_METHOD 0 0 -3.402823466e+38 3.402823466e+38 ECU_ADDRESS 0 SYMBOL_LINK "Rte_SnsrOffsLrng_TqInpDetnHwTqFil.FilSt" 0 DISPLAY_IDENTIFIER SnsrOffsLrng.PerInstanceMemories.TqInpDetnHwTqFil.FilSt /end MEASUREMENT
/begin MEASUREMENT SnsrOffsLrng.TqInpDetnHwTqPreProc "MICROSAR RTE" FLOAT32_IEEE NO_COMPU_METHOD 0 0 -3.402823466e+38 3.402823466e+38 ECU_ADDRESS 0 SYMBOL_LINK "Rte_SnsrOffsLrng_TqInpDetnHwTqPreProc" 0 DISPLAY_IDENTIFIER SnsrOffsLrng.PerInstanceMemories.TqInpDetnHwTqPreProc /end MEASUREMENT
/begin MEASUREMENT SnsrOffsLrng.TqInpDetnPreProcEnaLoop "MICROSAR RTE" UWORD NO_COMPU_METHOD 0 0 0 65535 ECU_ADDRESS 0 SYMBOL_LINK "Rte_SnsrOffsLrng_TqInpDetnPreProcEnaLoop" 0 DISPLAY_IDENTIFIER SnsrOffsLrng.PerInstanceMemories.TqInpDetnPreProcEnaLoop /end MEASUREMENT
/begin MEASUREMENT SnsrOffsLrng.TqInpDetnSinGenrAg "MICROSAR RTE" FLOAT32_IEEE NO_COMPU_METHOD 0 0 -3.402823466e+38 3.402823466e+38 ECU_ADDRESS 0 SYMBOL_LINK "Rte_SnsrOffsLrng_TqInpDetnSinGenrAg" 0 DISPLAY_IDENTIFIER SnsrOffsLrng.PerInstanceMemories.TqInpDetnSinGenrAg /end MEASUREMENT
/begin MEASUREMENT SnsrOffsLrng.TqInpDetnStg1Buf "MICROSAR RTE" FLOAT32_IEEE NO_COMPU_METHOD 0 0 -3.402823466e+38 3.402823466e+38 MATRIX_DIM 72 1 1 ECU_ADDRESS 0 SYMBOL_LINK "Rte_SnsrOffsLrng_TqInpDetnStg1Buf" 0 DISPLAY_IDENTIFIER SnsrOffsLrng.PerInstanceMemories.TqInpDetnStg1Buf /end MEASUREMENT
/begin MEASUREMENT SnsrOffsLrng.TqInpDetnStg1FilSt1 "MICROSAR RTE" FLOAT32_IEEE NO_COMPU_METHOD 0 0 -3.402823466e+38 3.402823466e+38 ECU_ADDRESS 0 SYMBOL_LINK "Rte_SnsrOffsLrng_TqInpDetnStg1FilSt1" 0 DISPLAY_IDENTIFIER SnsrOffsLrng.PerInstanceMemories.TqInpDetnStg1FilSt1 /end MEASUREMENT
/begin MEASUREMENT SnsrOffsLrng.TqInpDetnStg1FilSt2 "MICROSAR RTE" FLOAT32_IEEE NO_COMPU_METHOD 0 0 -3.402823466e+38 3.402823466e+38 ECU_ADDRESS 0 SYMBOL_LINK "Rte_SnsrOffsLrng_TqInpDetnStg1FilSt2" 0 DISPLAY_IDENTIFIER SnsrOffsLrng.PerInstanceMemories.TqInpDetnStg1FilSt2 /end MEASUREMENT
/begin MEASUREMENT SnsrOffsLrng.TqInpDetnStg1Idx "MICROSAR RTE" UBYTE NO_COMPU_METHOD 0 0 0 255 ECU_ADDRESS 0 SYMBOL_LINK "Rte_SnsrOffsLrng_TqInpDetnStg1Idx" 0 DISPLAY_IDENTIFIER SnsrOffsLrng.PerInstanceMemories.TqInpDetnStg1Idx /end MEASUREMENT
/begin MEASUREMENT SnsrOffsLrng.TqInpDetnStg2CenFilSt1 "MICROSAR RTE" FLOAT32_IEEE NO_COMPU_METHOD 0 0 -3.402823466e+38 3.402823466e+38 ECU_ADDRESS 0 SYMBOL_LINK "Rte_SnsrOffsLrng_TqInpDetnStg2CenFilSt1" 0 DISPLAY_IDENTIFIER SnsrOffsLrng.PerInstanceMemories.TqInpDetnStg2CenFilSt1 /end MEASUREMENT
/begin MEASUREMENT SnsrOffsLrng.TqInpDetnStg2CenFilSt2 "MICROSAR RTE" FLOAT32_IEEE NO_COMPU_METHOD 0 0 -3.402823466e+38 3.402823466e+38 ECU_ADDRESS 0 SYMBOL_LINK "Rte_SnsrOffsLrng_TqInpDetnStg2CenFilSt2" 0 DISPLAY_IDENTIFIER SnsrOffsLrng.PerInstanceMemories.TqInpDetnStg2CenFilSt2 /end MEASUREMENT
/begin MEASUREMENT SnsrOffsLrng.TqInpDetnStg2DwnFilSt1 "MICROSAR RTE" FLOAT32_IEEE NO_COMPU_METHOD 0 0 -3.402823466e+38 3.402823466e+38 ECU_ADDRESS 0 SYMBOL_LINK "Rte_SnsrOffsLrng_TqInpDetnStg2DwnFilSt1" 0 DISPLAY_IDENTIFIER SnsrOffsLrng.PerInstanceMemories.TqInpDetnStg2DwnFilSt1 /end MEASUREMENT
/begin MEASUREMENT SnsrOffsLrng.TqInpDetnStg2DwnFilSt2 "MICROSAR RTE" FLOAT32_IEEE NO_COMPU_METHOD 0 0 -3.402823466e+38 3.402823466e+38 ECU_ADDRESS 0 SYMBOL_LINK "Rte_SnsrOffsLrng_TqInpDetnStg2DwnFilSt2" 0 DISPLAY_IDENTIFIER SnsrOffsLrng.PerInstanceMemories.TqInpDetnStg2DwnFilSt2 /end MEASUREMENT
/begin MEASUREMENT SnsrOffsLrng.TqInpDetnStg2UpFilSt1 "MICROSAR RTE" FLOAT32_IEEE NO_COMPU_METHOD 0 0 -3.402823466e+38 3.402823466e+38 ECU_ADDRESS 0 SYMBOL_LINK "Rte_SnsrOffsLrng_TqInpDetnStg2UpFilSt1" 0 DISPLAY_IDENTIFIER SnsrOffsLrng.PerInstanceMemories.TqInpDetnStg2UpFilSt1 /end MEASUREMENT
/begin MEASUREMENT SnsrOffsLrng.TqInpDetnStg2UpFilSt2 "MICROSAR RTE" FLOAT32_IEEE NO_COMPU_METHOD 0 0 -3.402823466e+38 3.402823466e+38 ECU_ADDRESS 0 SYMBOL_LINK "Rte_SnsrOffsLrng_TqInpDetnStg2UpFilSt2" 0 DISPLAY_IDENTIFIER SnsrOffsLrng.PerInstanceMemories.TqInpDetnStg2UpFilSt2 /end MEASUREMENT
/begin MEASUREMENT SnsrOffsLrng.VehSpd.Val "MICROSAR RTE" FLOAT32_IEEE NO_COMPU_METHOD 0 0 -3.402823466e+38 3.402823466e+38 ECU_ADDRESS 0 SYMBOL_LINK "Rte_VehSigCdng_VehSpd_Val" 0 DISPLAY_IDENTIFIER SnsrOffsLrng.ReceiverPorts.VehSpd.Val /end MEASUREMENT
/begin MEASUREMENT SnsrOffsLrng.VehSpdVld.Logl "MICROSAR RTE" UBYTE RTE_CM_BOOLEAN 0 0 0 255 ECU_ADDRESS 0 SYMBOL_LINK "Rte_VehSigCdng_VehSpdVld_Logl" 0 DISPLAY_IDENTIFIER SnsrOffsLrng.ReceiverPorts.VehSpdVld.Logl /end MEASUREMENT
/begin MEASUREMENT SnsrOffsLrng.VehYawRate.Val "MICROSAR RTE" FLOAT32_IEEE NO_COMPU_METHOD 0 0 -3.402823466e+38 3.402823466e+38 ECU_ADDRESS 0 SYMBOL_LINK "Rte_VehSigCdng_VehYawRate_Val" 0 DISPLAY_IDENTIFIER SnsrOffsLrng.ReceiverPorts.VehYawRate.Val /end MEASUREMENT
/begin MEASUREMENT SnsrOffsLrng.VehYawRateLrngStRst "MICROSAR RTE" UBYTE RTE_CM_BOOLEAN 0 0 0 255 ECU_ADDRESS 0 SYMBOL_LINK "Rte_SnsrOffsLrng_VehYawRateLrngStRst" 0 DISPLAY_IDENTIFIER SnsrOffsLrng.PerInstanceMemories.VehYawRateLrngStRst /end MEASUREMENT
/begin MEASUREMENT SnsrOffsLrng.VehYawRateOffs.Val "MICROSAR RTE" FLOAT32_IEEE NO_COMPU_METHOD 0 0 -3.402823466e+38 3.402823466e+38 ECU_ADDRESS 0 SYMBOL_LINK "Rte_SnsrOffsLrng_VehYawRateOffs_Val" 0 DISPLAY_IDENTIFIER SnsrOffsLrng.SenderPorts.VehYawRateOffs.Val /end MEASUREMENT
/begin MEASUREMENT SnsrOffsLrng.VehYawRateOffsFrsh "MICROSAR RTE" UBYTE RTE_CM_BOOLEAN 0 0 0 255 ECU_ADDRESS 0 SYMBOL_LINK "Rte_SnsrOffsLrng_VehYawRateOffsFrsh" 0 DISPLAY_IDENTIFIER SnsrOffsLrng.PerInstanceMemories.VehYawRateOffsFrsh /end MEASUREMENT
/begin MEASUREMENT SnsrOffsLrng.VehYawRateVld.Logl "MICROSAR RTE" UBYTE RTE_CM_BOOLEAN 0 0 0 255 ECU_ADDRESS 0 SYMBOL_LINK "Rte_GmMsg1E9BusHiSpd_SerlComYawRateVld_Logl" 0 DISPLAY_IDENTIFIER SnsrOffsLrng.ReceiverPorts.VehYawRateVld.Logl /end MEASUREMENT
/begin MEASUREMENT SnsrOffsLrng.YawACdngFil.FilGain "MICROSAR RTE" FLOAT32_IEEE NO_COMPU_METHOD 0 0 -3.402823466e+38 3.402823466e+38 ECU_ADDRESS 0 SYMBOL_LINK "Rte_SnsrOffsLrng_YawACdngFil.FilGain" 0 DISPLAY_IDENTIFIER SnsrOffsLrng.PerInstanceMemories.YawACdngFil.FilGain /end MEASUREMENT
/begin MEASUREMENT SnsrOffsLrng.YawACdngFil.FilSt "MICROSAR RTE" FLOAT32_IEEE NO_COMPU_METHOD 0 0 -3.402823466e+38 3.402823466e+38 ECU_ADDRESS 0 SYMBOL_LINK "Rte_SnsrOffsLrng_YawACdngFil.FilSt" 0 DISPLAY_IDENTIFIER SnsrOffsLrng.PerInstanceMemories.YawACdngFil.FilSt /end MEASUREMENT
/begin MEASUREMENT SnsrOffsLrng.YawCdngFil1.FilGain "MICROSAR RTE" FLOAT32_IEEE NO_COMPU_METHOD 0 0 -3.402823466e+38 3.402823466e+38 ECU_ADDRESS 0 SYMBOL_LINK "Rte_SnsrOffsLrng_YawCdngFil1.FilGain" 0 DISPLAY_IDENTIFIER SnsrOffsLrng.PerInstanceMemories.YawCdngFil1.FilGain /end MEASUREMENT
/begin MEASUREMENT SnsrOffsLrng.YawCdngFil1.FilSt "MICROSAR RTE" FLOAT32_IEEE NO_COMPU_METHOD 0 0 -3.402823466e+38 3.402823466e+38 ECU_ADDRESS 0 SYMBOL_LINK "Rte_SnsrOffsLrng_YawCdngFil1.FilSt" 0 DISPLAY_IDENTIFIER SnsrOffsLrng.PerInstanceMemories.YawCdngFil1.FilSt /end MEASUREMENT
/begin MEASUREMENT SnsrOffsLrng.YawCdngFil2.FilGain "MICROSAR RTE" FLOAT32_IEEE NO_COMPU_METHOD 0 0 -3.402823466e+38 3.402823466e+38 ECU_ADDRESS 0 SYMBOL_LINK "Rte_SnsrOffsLrng_YawCdngFil2.FilGain" 0 DISPLAY_IDENTIFIER SnsrOffsLrng.PerInstanceMemories.YawCdngFil2.FilGain /end MEASUREMENT
/begin MEASUREMENT SnsrOffsLrng.YawCdngFil2.FilSt "MICROSAR RTE" FLOAT32_IEEE NO_COMPU_METHOD 0 0 -3.402823466e+38 3.402823466e+38 ECU_ADDRESS 0 SYMBOL_LINK "Rte_SnsrOffsLrng_YawCdngFil2.FilSt" 0 DISPLAY_IDENTIFIER SnsrOffsLrng.PerInstanceMemories.YawCdngFil2.FilSt /end MEASUREMENT
/begin MEASUREMENT SnsrOffsLrng.YawLrngElpdLrngTi "MICROSAR RTE" FLOAT32_IEEE NO_COMPU_METHOD 0 0 -3.402823466e+38 3.402823466e+38 ECU_ADDRESS 0 SYMBOL_LINK "Rte_SnsrOffsLrng_YawLrngElpdLrngTi" 0 DISPLAY_IDENTIFIER SnsrOffsLrng.PerInstanceMemories.YawLrngElpdLrngTi /end MEASUREMENT
/begin MEASUREMENT SnsrOffsLrng.YawLrngFil1.FilGain "MICROSAR RTE" FLOAT32_IEEE NO_COMPU_METHOD 0 0 -3.402823466e+38 3.402823466e+38 ECU_ADDRESS 0 SYMBOL_LINK "Rte_SnsrOffsLrng_YawLrngFil1.FilGain" 0 DISPLAY_IDENTIFIER SnsrOffsLrng.PerInstanceMemories.YawLrngFil1.FilGain /end MEASUREMENT
/begin MEASUREMENT SnsrOffsLrng.YawLrngFil1.FilSt "MICROSAR RTE" FLOAT32_IEEE NO_COMPU_METHOD 0 0 -3.402823466e+38 3.402823466e+38 ECU_ADDRESS 0 SYMBOL_LINK "Rte_SnsrOffsLrng_YawLrngFil1.FilSt" 0 DISPLAY_IDENTIFIER SnsrOffsLrng.PerInstanceMemories.YawLrngFil1.FilSt /end MEASUREMENT
/begin MEASUREMENT SnsrOffsLrng.YawLrngFil2.FilGain "MICROSAR RTE" FLOAT32_IEEE NO_COMPU_METHOD 0 0 -3.402823466e+38 3.402823466e+38 ECU_ADDRESS 0 SYMBOL_LINK "Rte_SnsrOffsLrng_YawLrngFil2.FilGain" 0 DISPLAY_IDENTIFIER SnsrOffsLrng.PerInstanceMemories.YawLrngFil2.FilGain /end MEASUREMENT
/begin MEASUREMENT SnsrOffsLrng.YawLrngFil2.FilSt "MICROSAR RTE" FLOAT32_IEEE NO_COMPU_METHOD 0 0 -3.402823466e+38 3.402823466e+38 ECU_ADDRESS 0 SYMBOL_LINK "Rte_SnsrOffsLrng_YawLrngFil2.FilSt" 0 DISPLAY_IDENTIFIER SnsrOffsLrng.PerInstanceMemories.YawLrngFil2.FilSt /end MEASUREMENT
/begin MEASUREMENT SnsrOffsLrng.YawRatePrev "MICROSAR RTE" FLOAT32_IEEE NO_COMPU_METHOD 0 0 -3.402823466e+38 3.402823466e+38 ECU_ADDRESS 0 SYMBOL_LINK "Rte_SnsrOffsLrng_YawRatePrev" 0 DISPLAY_IDENTIFIER SnsrOffsLrng.PerInstanceMemories.YawRatePrev /end MEASUREMENT
/begin MEASUREMENT SnsrOffsLrng.dSnsrOffsLrngHwAgFild "MICROSAR RTE" FLOAT32_IEEE NO_COMPU_METHOD 0 0 -3.402823466e+38 3.402823466e+38 ECU_ADDRESS 0 SYMBOL_LINK "Rte_SnsrOffsLrng_dSnsrOffsLrngHwAgFild" 0 DISPLAY_IDENTIFIER SnsrOffsLrng.PerInstanceMemories.dSnsrOffsLrngHwAgFild /end MEASUREMENT
/begin MEASUREMENT SnsrOffsLrng.dSnsrOffsLrngHwAgLrngCdnVld "MICROSAR RTE" UBYTE RTE_CM_BOOLEAN 0 0 0 255 ECU_ADDRESS 0 SYMBOL_LINK "Rte_SnsrOffsLrng_dSnsrOffsLrngHwAgLrngCdnVld" 0 DISPLAY_IDENTIFIER SnsrOffsLrng.PerInstanceMemories.dSnsrOffsLrngHwAgLrngCdnVld /end MEASUREMENT
/begin MEASUREMENT SnsrOffsLrng.dSnsrOffsLrngHwAgLrngEna "MICROSAR RTE" UBYTE RTE_CM_BOOLEAN 0 0 0 255 ECU_ADDRESS 0 SYMBOL_LINK "Rte_SnsrOffsLrng_dSnsrOffsLrngHwAgLrngEna" 0 DISPLAY_IDENTIFIER SnsrOffsLrng.PerInstanceMemories.dSnsrOffsLrngHwAgLrngEna /end MEASUREMENT
/begin MEASUREMENT SnsrOffsLrng.dSnsrOffsLrngHwAgLrngRst "MICROSAR RTE" UBYTE RTE_CM_BOOLEAN 0 0 0 255 ECU_ADDRESS 0 SYMBOL_LINK "Rte_SnsrOffsLrng_dSnsrOffsLrngHwAgLrngRst" 0 DISPLAY_IDENTIFIER SnsrOffsLrng.PerInstanceMemories.dSnsrOffsLrngHwAgLrngRst /end MEASUREMENT
/begin MEASUREMENT SnsrOffsLrng.dSnsrOffsLrngHwAgLrngSysTqLoThd "MICROSAR RTE" FLOAT32_IEEE NO_COMPU_METHOD 0 0 -3.402823466e+38 3.402823466e+38 ECU_ADDRESS 0 SYMBOL_LINK "Rte_SnsrOffsLrng_dSnsrOffsLrngHwAgLrngSysTqLoThd" 0 DISPLAY_IDENTIFIER SnsrOffsLrng.PerInstanceMemories.dSnsrOffsLrngHwAgLrngSysTqLoThd /end MEASUREMENT
/begin MEASUREMENT SnsrOffsLrng.dSnsrOffsLrngHwAgLrngSysTqUpThd "MICROSAR RTE" FLOAT32_IEEE NO_COMPU_METHOD 0 0 -3.402823466e+38 3.402823466e+38 ECU_ADDRESS 0 SYMBOL_LINK "Rte_SnsrOffsLrng_dSnsrOffsLrngHwAgLrngSysTqUpThd" 0 DISPLAY_IDENTIFIER SnsrOffsLrng.PerInstanceMemories.dSnsrOffsLrngHwAgLrngSysTqUpThd /end MEASUREMENT
/begin MEASUREMENT SnsrOffsLrng.dSnsrOffsLrngHwAgLrngSysTqVldt "MICROSAR RTE" UBYTE RTE_CM_BOOLEAN 0 0 0 255 ECU_ADDRESS 0 SYMBOL_LINK "Rte_SnsrOffsLrng_dSnsrOffsLrngHwAgLrngSysTqVldt" 0 DISPLAY_IDENTIFIER SnsrOffsLrng.PerInstanceMemories.dSnsrOffsLrngHwAgLrngSysTqVldt /end MEASUREMENT
/begin MEASUREMENT SnsrOffsLrng.dSnsrOffsLrngHwAgLrngTiVldt "MICROSAR RTE" UBYTE RTE_CM_BOOLEAN 0 0 0 255 ECU_ADDRESS 0 SYMBOL_LINK "Rte_SnsrOffsLrng_dSnsrOffsLrngHwAgLrngTiVldt" 0 DISPLAY_IDENTIFIER SnsrOffsLrng.PerInstanceMemories.dSnsrOffsLrngHwAgLrngTiVldt /end MEASUREMENT
/begin MEASUREMENT SnsrOffsLrng.dSnsrOffsLrngHwTqLrngEna "MICROSAR RTE" UBYTE RTE_CM_BOOLEAN 0 0 0 255 ECU_ADDRESS 0 SYMBOL_LINK "Rte_SnsrOffsLrng_dSnsrOffsLrngHwTqLrngEna" 0 DISPLAY_IDENTIFIER SnsrOffsLrng.PerInstanceMemories.dSnsrOffsLrngHwTqLrngEna /end MEASUREMENT
/begin MEASUREMENT SnsrOffsLrng.dSnsrOffsLrngHwTqLrngEstimnVldt "MICROSAR RTE" UBYTE RTE_CM_BOOLEAN 0 0 0 255 ECU_ADDRESS 0 SYMBOL_LINK "Rte_SnsrOffsLrng_dSnsrOffsLrngHwTqLrngEstimnVldt" 0 DISPLAY_IDENTIFIER SnsrOffsLrng.PerInstanceMemories.dSnsrOffsLrngHwTqLrngEstimnVldt /end MEASUREMENT
/begin MEASUREMENT SnsrOffsLrng.dSnsrOffsLrngHwTqLrngHwAgMeas "MICROSAR RTE" FLOAT32_IEEE NO_COMPU_METHOD 0 0 -3.402823466e+38 3.402823466e+38 ECU_ADDRESS 0 SYMBOL_LINK "Rte_SnsrOffsLrng_dSnsrOffsLrngHwTqLrngHwAgMeas" 0 DISPLAY_IDENTIFIER SnsrOffsLrng.PerInstanceMemories.dSnsrOffsLrngHwTqLrngHwAgMeas /end MEASUREMENT
/begin MEASUREMENT SnsrOffsLrng.dSnsrOffsLrngHwTqLrngHwTqMeas "MICROSAR RTE" FLOAT32_IEEE NO_COMPU_METHOD 0 0 -3.402823466e+38 3.402823466e+38 ECU_ADDRESS 0 SYMBOL_LINK "Rte_SnsrOffsLrng_dSnsrOffsLrngHwTqLrngHwTqMeas" 0 DISPLAY_IDENTIFIER SnsrOffsLrng.PerInstanceMemories.dSnsrOffsLrngHwTqLrngHwTqMeas /end MEASUREMENT
/begin MEASUREMENT SnsrOffsLrng.dSnsrOffsLrngHwTqLrngHwTqOffsRaw "MICROSAR RTE" FLOAT32_IEEE NO_COMPU_METHOD 0 0 -3.402823466e+38 3.402823466e+38 ECU_ADDRESS 0 SYMBOL_LINK "Rte_SnsrOffsLrng_dSnsrOffsLrngHwTqLrngHwTqOffsRaw" 0 DISPLAY_IDENTIFIER SnsrOffsLrng.PerInstanceMemories.dSnsrOffsLrngHwTqLrngHwTqOffsRaw /end MEASUREMENT
/begin MEASUREMENT SnsrOffsLrng.dSnsrOffsLrngHwTqLrngMeasEna "MICROSAR RTE" UBYTE RTE_CM_BOOLEAN 0 0 0 255 ECU_ADDRESS 0 SYMBOL_LINK "Rte_SnsrOffsLrng_dSnsrOffsLrngHwTqLrngMeasEna" 0 DISPLAY_IDENTIFIER SnsrOffsLrng.PerInstanceMemories.dSnsrOffsLrngHwTqLrngMeasEna /end MEASUREMENT
/begin MEASUREMENT SnsrOffsLrng.dSnsrOffsLrngHwTqLrngSampleCntTot "MICROSAR RTE" FLOAT32_IEEE NO_COMPU_METHOD 0 0 -3.402823466e+38 3.402823466e+38 ECU_ADDRESS 0 SYMBOL_LINK "Rte_SnsrOffsLrng_dSnsrOffsLrngHwTqLrngSampleCntTot" 0 DISPLAY_IDENTIFIER SnsrOffsLrng.PerInstanceMemories.dSnsrOffsLrngHwTqLrngSampleCntTot /end MEASUREMENT
/begin MEASUREMENT SnsrOffsLrng.dSnsrOffsLrngHwTqLrngSampleImb "MICROSAR RTE" FLOAT32_IEEE NO_COMPU_METHOD 0 0 -3.402823466e+38 3.402823466e+38 ECU_ADDRESS 0 SYMBOL_LINK "Rte_SnsrOffsLrng_dSnsrOffsLrngHwTqLrngSampleImb" 0 DISPLAY_IDENTIFIER SnsrOffsLrng.PerInstanceMemories.dSnsrOffsLrngHwTqLrngSampleImb /end MEASUREMENT
/begin MEASUREMENT SnsrOffsLrng.dSnsrOffsLrngHwTqLrngTqInpPrsnt "MICROSAR RTE" UBYTE RTE_CM_BOOLEAN 0 0 0 255 ECU_ADDRESS 0 SYMBOL_LINK "Rte_SnsrOffsLrng_dSnsrOffsLrngHwTqLrngTqInpPrsnt" 0 DISPLAY_IDENTIFIER SnsrOffsLrng.PerInstanceMemories.dSnsrOffsLrngHwTqLrngTqInpPrsnt /end MEASUREMENT
/begin MEASUREMENT SnsrOffsLrng.dSnsrOffsLrngHwTqLrngTqInpPrsntVld "MICROSAR RTE" UBYTE RTE_CM_BOOLEAN 0 0 0 255 ECU_ADDRESS 0 SYMBOL_LINK "Rte_SnsrOffsLrng_dSnsrOffsLrngHwTqLrngTqInpPrsntVld" 0 DISPLAY_IDENTIFIER SnsrOffsLrng.PerInstanceMemories.dSnsrOffsLrngHwTqLrngTqInpPrsntVld /end MEASUREMENT
/begin MEASUREMENT SnsrOffsLrng.dSnsrOffsLrngHwVelFild "MICROSAR RTE" FLOAT32_IEEE NO_COMPU_METHOD 0 0 -3.402823466e+38 3.402823466e+38 ECU_ADDRESS 0 SYMBOL_LINK "Rte_SnsrOffsLrng_dSnsrOffsLrngHwVelFild" 0 DISPLAY_IDENTIFIER SnsrOffsLrng.PerInstanceMemories.dSnsrOffsLrngHwVelFild /end MEASUREMENT
/begin MEASUREMENT SnsrOffsLrng.dSnsrOffsLrngSysTqFild "MICROSAR RTE" FLOAT32_IEEE NO_COMPU_METHOD 0 0 -3.402823466e+38 3.402823466e+38 ECU_ADDRESS 0 SYMBOL_LINK "Rte_SnsrOffsLrng_dSnsrOffsLrngSysTqFild" 0 DISPLAY_IDENTIFIER SnsrOffsLrng.PerInstanceMemories.dSnsrOffsLrngSysTqFild /end MEASUREMENT
/begin MEASUREMENT SnsrOffsLrng.dSnsrOffsLrngTqInpDetnHwTqFild "MICROSAR RTE" FLOAT32_IEEE NO_COMPU_METHOD 0 0 -3.402823466e+38 3.402823466e+38 ECU_ADDRESS 0 SYMBOL_LINK "Rte_SnsrOffsLrng_dSnsrOffsLrngTqInpDetnHwTqFild" 0 DISPLAY_IDENTIFIER SnsrOffsLrng.PerInstanceMemories.dSnsrOffsLrngTqInpDetnHwTqFild /end MEASUREMENT
/begin MEASUREMENT SnsrOffsLrng.dSnsrOffsLrngTqInpDetnStg1Outp "MICROSAR RTE" FLOAT32_IEEE NO_COMPU_METHOD 0 0 -3.402823466e+38 3.402823466e+38 ECU_ADDRESS 0 SYMBOL_LINK "Rte_SnsrOffsLrng_dSnsrOffsLrngTqInpDetnStg1Outp" 0 DISPLAY_IDENTIFIER SnsrOffsLrng.PerInstanceMemories.dSnsrOffsLrngTqInpDetnStg1Outp /end MEASUREMENT
/begin MEASUREMENT SnsrOffsLrng.dSnsrOffsLrngTqInpPrsntRaw "MICROSAR RTE" UBYTE RTE_CM_BOOLEAN 0 0 0 255 ECU_ADDRESS 0 SYMBOL_LINK "Rte_SnsrOffsLrng_dSnsrOffsLrngTqInpPrsntRaw" 0 DISPLAY_IDENTIFIER SnsrOffsLrng.PerInstanceMemories.dSnsrOffsLrngTqInpPrsntRaw /end MEASUREMENT
/begin MEASUREMENT SnsrOffsLrng.dSnsrOffsLrngYawA "MICROSAR RTE" FLOAT32_IEEE NO_COMPU_METHOD 0 0 -3.402823466e+38 3.402823466e+38 ECU_ADDRESS 0 SYMBOL_LINK "Rte_SnsrOffsLrng_dSnsrOffsLrngYawA" 0 DISPLAY_IDENTIFIER SnsrOffsLrng.PerInstanceMemories.dSnsrOffsLrngYawA /end MEASUREMENT
/begin MEASUREMENT SnsrOffsLrng.dSnsrOffsLrngYawLrngBiasEstimnRaw "MICROSAR RTE" FLOAT32_IEEE NO_COMPU_METHOD 0 0 -3.402823466e+38 3.402823466e+38 ECU_ADDRESS 0 SYMBOL_LINK "Rte_SnsrOffsLrng_dSnsrOffsLrngYawLrngBiasEstimnRaw" 0 DISPLAY_IDENTIFIER SnsrOffsLrng.PerInstanceMemories.dSnsrOffsLrngYawLrngBiasEstimnRaw /end MEASUREMENT
/begin MEASUREMENT SnsrOffsLrng.dSnsrOffsLrngYawLrngCdnVld "MICROSAR RTE" UBYTE RTE_CM_BOOLEAN 0 0 0 255 ECU_ADDRESS 0 SYMBOL_LINK "Rte_SnsrOffsLrng_dSnsrOffsLrngYawLrngCdnVld" 0 DISPLAY_IDENTIFIER SnsrOffsLrng.PerInstanceMemories.dSnsrOffsLrngYawLrngCdnVld /end MEASUREMENT
/begin MEASUREMENT SnsrOffsLrng.dSnsrOffsLrngYawLrngEna "MICROSAR RTE" UBYTE RTE_CM_BOOLEAN 0 0 0 255 ECU_ADDRESS 0 SYMBOL_LINK "Rte_SnsrOffsLrng_dSnsrOffsLrngYawLrngEna" 0 DISPLAY_IDENTIFIER SnsrOffsLrng.PerInstanceMemories.dSnsrOffsLrngYawLrngEna /end MEASUREMENT
/begin MEASUREMENT SnsrOffsLrng.dSnsrOffsLrngYawRateFild "MICROSAR RTE" FLOAT32_IEEE NO_COMPU_METHOD 0 0 -3.402823466e+38 3.402823466e+38 ECU_ADDRESS 0 SYMBOL_LINK "Rte_SnsrOffsLrng_dSnsrOffsLrngYawRateFild" 0 DISPLAY_IDENTIFIER SnsrOffsLrng.PerInstanceMemories.dSnsrOffsLrngYawRateFild /end MEASUREMENT
/begin MEASUREMENT SnsrOffsLrng.dSnsrOffsLrngYawRateFildCorrd "MICROSAR RTE" FLOAT32_IEEE NO_COMPU_METHOD 0 0 -3.402823466e+38 3.402823466e+38 ECU_ADDRESS 0 SYMBOL_LINK "Rte_SnsrOffsLrng_dSnsrOffsLrngYawRateFildCorrd" 0 DISPLAY_IDENTIFIER SnsrOffsLrng.PerInstanceMemories.dSnsrOffsLrngYawRateFildCorrd /end MEASUREMENT
/begin MEASUREMENT StHlthSigNormn.AbsltMotPosABDifStHlth.Val "MICROSAR RTE" UBYTE NO_COMPU_METHOD 0 0 0 255 ECU_ADDRESS 0 SYMBOL_LINK "Rte_StHlthSigNormn_AbsltMotPosABDifStHlth_Val" 0 DISPLAY_IDENTIFIER StHlthSigNormn.SenderPorts.AbsltMotPosABDifStHlth.Val /end MEASUREMENT
/begin MEASUREMENT StHlthSigNormn.AbsltMotPosABDifStHlthSts "MICROSAR RTE" UBYTE NO_COMPU_METHOD 0 0 0 255 ECU_ADDRESS 0 SYMBOL_LINK "Rte_StHlthSigNormn_AbsltMotPosABDifStHlthSts" 0 DISPLAY_IDENTIFIER StHlthSigNormn.PerInstanceMemories.AbsltMotPosABDifStHlthSts /end MEASUREMENT
/begin MEASUREMENT StHlthSigNormn.AbsltMotPosACDifStHlth.Val "MICROSAR RTE" UBYTE NO_COMPU_METHOD 0 0 0 255 ECU_ADDRESS 0 SYMBOL_LINK "Rte_StHlthSigNormn_AbsltMotPosACDifStHlth_Val" 0 DISPLAY_IDENTIFIER StHlthSigNormn.SenderPorts.AbsltMotPosACDifStHlth.Val /end MEASUREMENT
/begin MEASUREMENT StHlthSigNormn.AbsltMotPosACDifStHlthSts "MICROSAR RTE" UBYTE NO_COMPU_METHOD 0 0 0 255 ECU_ADDRESS 0 SYMBOL_LINK "Rte_StHlthSigNormn_AbsltMotPosACDifStHlthSts" 0 DISPLAY_IDENTIFIER StHlthSigNormn.PerInstanceMemories.AbsltMotPosACDifStHlthSts /end MEASUREMENT
/begin MEASUREMENT StHlthSigNormn.AbsltMotPosBCDifStHlth.Val "MICROSAR RTE" UBYTE NO_COMPU_METHOD 0 0 0 255 ECU_ADDRESS 0 SYMBOL_LINK "Rte_StHlthSigNormn_AbsltMotPosBCDifStHlth_Val" 0 DISPLAY_IDENTIFIER StHlthSigNormn.SenderPorts.AbsltMotPosBCDifStHlth.Val /end MEASUREMENT
/begin MEASUREMENT StHlthSigNormn.AbsltMotPosBCDifStHlthSts "MICROSAR RTE" UBYTE NO_COMPU_METHOD 0 0 0 255 ECU_ADDRESS 0 SYMBOL_LINK "Rte_StHlthSigNormn_AbsltMotPosBCDifStHlthSts" 0 DISPLAY_IDENTIFIER StHlthSigNormn.PerInstanceMemories.AbsltMotPosBCDifStHlthSts /end MEASUREMENT
/begin MEASUREMENT StHlthSigNormn.CtrlrTRng.Val "MICROSAR RTE" UBYTE NO_COMPU_METHOD 0 0 0 255 ECU_ADDRESS 0 SYMBOL_LINK "Rte_StHlthSigNormn_CtrlrTRng_Val" 0 DISPLAY_IDENTIFIER StHlthSigNormn.SenderPorts.CtrlrTRng.Val /end MEASUREMENT
/begin MEASUREMENT StHlthSigNormn.CtrlrTStHlth.Val "MICROSAR RTE" UBYTE NO_COMPU_METHOD 0 0 0 255 ECU_ADDRESS 0 SYMBOL_LINK "Rte_StHlthSigNormn_CtrlrTStHlth_Val" 0 DISPLAY_IDENTIFIER StHlthSigNormn.SenderPorts.CtrlrTStHlth.Val /end MEASUREMENT
/begin MEASUREMENT StHlthSigNormn.CurrMotSumABC.Val "MICROSAR RTE" FLOAT32_IEEE NO_COMPU_METHOD 0 0 -3.402823466e+38 3.402823466e+38 ECU_ADDRESS 0 SYMBOL_LINK "Rte_CurrMeasCorrln_CurrMotSumABC_Val" 0 DISPLAY_IDENTIFIER StHlthSigNormn.ReceiverPorts.CurrMotSumABC.Val /end MEASUREMENT
/begin MEASUREMENT StHlthSigNormn.CurrMotSumABCStHlth.Val "MICROSAR RTE" UBYTE NO_COMPU_METHOD 0 0 0 255 ECU_ADDRESS 0 SYMBOL_LINK "Rte_StHlthSigNormn_CurrMotSumABCStHlth_Val" 0 DISPLAY_IDENTIFIER StHlthSigNormn.SenderPorts.CurrMotSumABCStHlth.Val /end MEASUREMENT
/begin MEASUREMENT StHlthSigNormn.CurrMotSumABCStHlthSts "MICROSAR RTE" UBYTE NO_COMPU_METHOD 0 0 0 255 ECU_ADDRESS 0 SYMBOL_LINK "Rte_StHlthSigNormn_CurrMotSumABCStHlthSts" 0 DISPLAY_IDENTIFIER StHlthSigNormn.PerInstanceMemories.CurrMotSumABCStHlthSts /end MEASUREMENT
/begin MEASUREMENT StHlthSigNormn.CurrMotSumDEF.Val "MICROSAR RTE" FLOAT32_IEEE NO_COMPU_METHOD 0 0 -3.402823466e+38 3.402823466e+38 ECU_ADDRESS 0 SYMBOL_LINK "Rte_CurrMeasCorrln_CurrMotSumDEF_Val" 0 DISPLAY_IDENTIFIER StHlthSigNormn.ReceiverPorts.CurrMotSumDEF.Val /end MEASUREMENT
/begin MEASUREMENT StHlthSigNormn.CurrMotSumDEFStHlth.Val "MICROSAR RTE" UBYTE NO_COMPU_METHOD 0 0 0 255 ECU_ADDRESS 0 SYMBOL_LINK "Rte_StHlthSigNormn_CurrMotSumDEFStHlth_Val" 0 DISPLAY_IDENTIFIER StHlthSigNormn.SenderPorts.CurrMotSumDEFStHlth.Val /end MEASUREMENT
/begin MEASUREMENT StHlthSigNormn.CurrMotSumDEFStHlthSts "MICROSAR RTE" UBYTE NO_COMPU_METHOD 0 0 0 255 ECU_ADDRESS 0 SYMBOL_LINK "Rte_StHlthSigNormn_CurrMotSumDEFStHlthSts" 0 DISPLAY_IDENTIFIER StHlthSigNormn.PerInstanceMemories.CurrMotSumDEFStHlthSts /end MEASUREMENT
/begin MEASUREMENT StHlthSigNormn.DigTqIdptSigStHlth.Val "MICROSAR RTE" UBYTE NO_COMPU_METHOD 0 0 0 255 ECU_ADDRESS 0 SYMBOL_LINK "Rte_StHlthSigNormn_DigTqIdptSigStHlth_Val" 0 DISPLAY_IDENTIFIER StHlthSigNormn.SenderPorts.DigTqIdptSigStHlth.Val /end MEASUREMENT
/begin MEASUREMENT StHlthSigNormn.DigTqIdptSigStHlthSts "MICROSAR RTE" UBYTE NO_COMPU_METHOD 0 0 0 255 ECU_ADDRESS 0 SYMBOL_LINK "Rte_StHlthSigNormn_DigTqIdptSigStHlthSts" 0 DISPLAY_IDENTIFIER StHlthSigNormn.PerInstanceMemories.DigTqIdptSigStHlthSts /end MEASUREMENT
/begin MEASUREMENT StHlthSigNormn.DigTqSnsrAStHlth.Val "MICROSAR RTE" UBYTE NO_COMPU_METHOD 0 0 0 255 ECU_ADDRESS 0 SYMBOL_LINK "Rte_StHlthSigNormn_DigTqSnsrAStHlth_Val" 0 DISPLAY_IDENTIFIER StHlthSigNormn.SenderPorts.DigTqSnsrAStHlth.Val /end MEASUREMENT
/begin MEASUREMENT StHlthSigNormn.DigTqSnsrAStHlthSts "MICROSAR RTE" UBYTE NO_COMPU_METHOD 0 0 0 255 ECU_ADDRESS 0 SYMBOL_LINK "Rte_StHlthSigNormn_DigTqSnsrAStHlthSts" 0 DISPLAY_IDENTIFIER StHlthSigNormn.PerInstanceMemories.DigTqSnsrAStHlthSts /end MEASUREMENT
/begin MEASUREMENT StHlthSigNormn.DigTqSnsrBStHlth.Val "MICROSAR RTE" UBYTE NO_COMPU_METHOD 0 0 0 255 ECU_ADDRESS 0 SYMBOL_LINK "Rte_StHlthSigNormn_DigTqSnsrBStHlth_Val" 0 DISPLAY_IDENTIFIER StHlthSigNormn.SenderPorts.DigTqSnsrBStHlth.Val /end MEASUREMENT
/begin MEASUREMENT StHlthSigNormn.DigTqSnsrBStHlthSts "MICROSAR RTE" UBYTE NO_COMPU_METHOD 0 0 0 255 ECU_ADDRESS 0 SYMBOL_LINK "Rte_StHlthSigNormn_DigTqSnsrBStHlthSts" 0 DISPLAY_IDENTIFIER StHlthSigNormn.PerInstanceMemories.DigTqSnsrBStHlthSts /end MEASUREMENT
/begin MEASUREMENT StHlthSigNormn.DutyCycStHlth.Val "MICROSAR RTE" UBYTE NO_COMPU_METHOD 0 0 0 255 ECU_ADDRESS 0 SYMBOL_LINK "Rte_StHlthSigNormn_DutyCycStHlth_Val" 0 DISPLAY_IDENTIFIER StHlthSigNormn.SenderPorts.DutyCycStHlth.Val /end MEASUREMENT
/begin MEASUREMENT StHlthSigNormn.DutyCycThermProtnMaxOutp.Val "MICROSAR RTE" UWORD NO_COMPU_METHOD 0 0 0 65535 ECU_ADDRESS 0 SYMBOL_LINK "Rte_DutyCycThermProtn_DutyCycThermProtnMaxOutp_Val" 0 DISPLAY_IDENTIFIER StHlthSigNormn.ReceiverPorts.DutyCycThermProtnMaxOutp.Val /end MEASUREMENT
/begin MEASUREMENT StHlthSigNormn.EcuTFild.Val "MICROSAR RTE" FLOAT32_IEEE NO_COMPU_METHOD 0 0 -3.402823466e+38 3.402823466e+38 ECU_ADDRESS 0 SYMBOL_LINK "Rte_EcuTMeas_EcuTFild_Val" 0 DISPLAY_IDENTIFIER StHlthSigNormn.ReceiverPorts.EcuTFild.Val /end MEASUREMENT
/begin MEASUREMENT StHlthSigNormn.EcuTRngIgnCyc "MICROSAR RTE" UBYTE NO_COMPU_METHOD 0 0 0 255 ECU_ADDRESS 0 SYMBOL_LINK "Rte_StHlthSigNormn_EcuTRngIgnCyc" 0 DISPLAY_IDENTIFIER StHlthSigNormn.PerInstanceMemories.EcuTRngIgnCyc /end MEASUREMENT
/begin MEASUREMENT StHlthSigNormn.EntrEot "MICROSAR RTE" UBYTE RTE_CM_BOOLEAN 0 0 0 255 ECU_ADDRESS 0 SYMBOL_LINK "Rte_StHlthSigNormn_EntrEot" 0 DISPLAY_IDENTIFIER StHlthSigNormn.PerInstanceMemories.EntrEot /end MEASUREMENT
/begin MEASUREMENT StHlthSigNormn.EotImpctCntr "MICROSAR RTE" UBYTE NO_COMPU_METHOD 0 0 0 255 ECU_ADDRESS 0 SYMBOL_LINK "Rte_StHlthSigNormn_EotImpctCntr" 0 DISPLAY_IDENTIFIER StHlthSigNormn.PerInstanceMemories.EotImpctCntr /end MEASUREMENT
/begin MEASUREMENT StHlthSigNormn.EotImpctStHlth.Val "MICROSAR RTE" UBYTE NO_COMPU_METHOD 0 0 0 255 ECU_ADDRESS 0 SYMBOL_LINK "Rte_StHlthSigNormn_EotImpctStHlth_Val" 0 DISPLAY_IDENTIFIER StHlthSigNormn.SenderPorts.EotImpctStHlth.Val /end MEASUREMENT
/begin MEASUREMENT StHlthSigNormn.FricEstimnStHlth.Val "MICROSAR RTE" UBYTE NO_COMPU_METHOD 0 0 0 255 ECU_ADDRESS 0 SYMBOL_LINK "Rte_StHlthSigNormn_FricEstimnStHlth_Val" 0 DISPLAY_IDENTIFIER StHlthSigNormn.SenderPorts.FricEstimnStHlth.Val /end MEASUREMENT
/begin MEASUREMENT StHlthSigNormn.HwAg.Val "MICROSAR RTE" FLOAT32_IEEE NO_COMPU_METHOD 0 0 -3.402823466e+38 3.402823466e+38 ECU_ADDRESS 0 SYMBOL_LINK "Rte_HwAgSysArbn_PinionAg_Val" 0 DISPLAY_IDENTIFIER StHlthSigNormn.ReceiverPorts.HwAg.Val /end MEASUREMENT
/begin MEASUREMENT StHlthSigNormn.HwAgEotCcw.Val "MICROSAR RTE" FLOAT32_IEEE NO_COMPU_METHOD 0 0 -3.402823466e+38 3.402823466e+38 ECU_ADDRESS 0 SYMBOL_LINK "Rte_EotLrng_HwAgEotCcw_Val" 0 DISPLAY_IDENTIFIER StHlthSigNormn.ReceiverPorts.HwAgEotCcw.Val /end MEASUREMENT
/begin MEASUREMENT StHlthSigNormn.HwAgEotCw.Val "MICROSAR RTE" FLOAT32_IEEE NO_COMPU_METHOD 0 0 -3.402823466e+38 3.402823466e+38 ECU_ADDRESS 0 SYMBOL_LINK "Rte_EotLrng_HwAgEotCw_Val" 0 DISPLAY_IDENTIFIER StHlthSigNormn.ReceiverPorts.HwAgEotCw.Val /end MEASUREMENT
/begin MEASUREMENT StHlthSigNormn.HwAuthy.Val "MICROSAR RTE" FLOAT32_IEEE NO_COMPU_METHOD 0 0 -3.402823466e+38 3.402823466e+38 ECU_ADDRESS 0 SYMBOL_LINK "Rte_HwAgSysArbn_PinionAgConf_Val" 0 DISPLAY_IDENTIFIER StHlthSigNormn.ReceiverPorts.HwAuthy.Val /end MEASUREMENT
/begin MEASUREMENT StHlthSigNormn.HwTqChACorrlnTraErr.Val "MICROSAR RTE" FLOAT32_IEEE NO_COMPU_METHOD 0 0 -3.402823466e+38 3.402823466e+38 ECU_ADDRESS 0 SYMBOL_LINK "Rte_HwTqCorrln_HwTqChACorrlnTraErr_Val" 0 DISPLAY_IDENTIFIER StHlthSigNormn.ReceiverPorts.HwTqChACorrlnTraErr.Val /end MEASUREMENT
/begin MEASUREMENT StHlthSigNormn.HwTqChBCorrlnTraErr.Val "MICROSAR RTE" FLOAT32_IEEE NO_COMPU_METHOD 0 0 -3.402823466e+38 3.402823466e+38 ECU_ADDRESS 0 SYMBOL_LINK "Rte_HwTqCorrln_HwTqChBCorrlnTraErr_Val" 0 DISPLAY_IDENTIFIER StHlthSigNormn.ReceiverPorts.HwTqChBCorrlnTraErr.Val /end MEASUREMENT
/begin MEASUREMENT StHlthSigNormn.HwTqIdptSig.Val "MICROSAR RTE" UBYTE NO_COMPU_METHOD 0 0 0 255 ECU_ADDRESS 0 SYMBOL_LINK "Rte_HwTqCorrln_HwTqIdptSig_Val" 0 DISPLAY_IDENTIFIER StHlthSigNormn.ReceiverPorts.HwTqIdptSig.Val /end MEASUREMENT
/begin MEASUREMENT StHlthSigNormn.LclRamEccSngBitCntrOutp.Val "MICROSAR RTE" UBYTE NO_COMPU_METHOD 0 0 0 255 ECU_ADDRESS 0 SYMBOL_LINK "Rte_CDD_RamMem_LclRamEccSngBitCntrOutp_Val" 0 DISPLAY_IDENTIFIER StHlthSigNormn.ReceiverPorts.LclRamEccSngBitCntrOutp.Val /end MEASUREMENT
/begin MEASUREMENT StHlthSigNormn.MaxLrndFric.Val "MICROSAR RTE" FLOAT32_IEEE NO_COMPU_METHOD 0 0 -3.402823466e+38 3.402823466e+38 ECU_ADDRESS 0 SYMBOL_LINK "Rte_SysFricLrng_MaxLrndFric_Val" 0 DISPLAY_IDENTIFIER StHlthSigNormn.ReceiverPorts.MaxLrndFric.Val /end MEASUREMENT
/begin MEASUREMENT StHlthSigNormn.MotAg2VltgSqd.Val "MICROSAR RTE" FLOAT32_IEEE NO_COMPU_METHOD 0 0 -3.402823466e+38 3.402823466e+38 ECU_ADDRESS 0 SYMBOL_LINK "Rte_StHlthSigNormn_MotAg2VltgSqd_Val" 0 DISPLAY_IDENTIFIER StHlthSigNormn.ReceiverPorts.MotAg2VltgSqd.Val /end MEASUREMENT
/begin MEASUREMENT StHlthSigNormn.MotAgABErrTerm.Val "MICROSAR RTE" UWORD NO_COMPU_METHOD 0 0 0 65535 ECU_ADDRESS 0 SYMBOL_LINK "Rte_StHlthSigNormn_MotAgABErrTerm_Val" 0 DISPLAY_IDENTIFIER StHlthSigNormn.ReceiverPorts.MotAgABErrTerm.Val /end MEASUREMENT
/begin MEASUREMENT StHlthSigNormn.MotAgACErrTerm.Val "MICROSAR RTE" UWORD NO_COMPU_METHOD 0 0 0 65535 ECU_ADDRESS 0 SYMBOL_LINK "Rte_StHlthSigNormn_MotAgACErrTerm_Val" 0 DISPLAY_IDENTIFIER StHlthSigNormn.ReceiverPorts.MotAgACErrTerm.Val /end MEASUREMENT
/begin MEASUREMENT StHlthSigNormn.MotAgBCErrTerm.Val "MICROSAR RTE" UWORD NO_COMPU_METHOD 0 0 0 65535 ECU_ADDRESS 0 SYMBOL_LINK "Rte_StHlthSigNormn_MotAgBCErrTerm_Val" 0 DISPLAY_IDENTIFIER StHlthSigNormn.ReceiverPorts.MotAgBCErrTerm.Val /end MEASUREMENT
/begin MEASUREMENT StHlthSigNormn.MotAgCorrlnErrThd "MICROSAR RTE" UWORD NO_COMPU_METHOD 0 0 0 65535 ECU_ADDRESS 0 SYMBOL_LINK "Rte_StHlthSigNormn_MotAgCorrlnErrThd" 0 DISPLAY_IDENTIFIER StHlthSigNormn.PerInstanceMemories.MotAgCorrlnErrThd /end MEASUREMENT
/begin MEASUREMENT StHlthSigNormn.MotDrvErrA.Val "MICROSAR RTE" FLOAT32_IEEE NO_COMPU_METHOD 0 0 -3.402823466e+38 3.402823466e+38 ECU_ADDRESS 0 SYMBOL_LINK "Rte_MotDrvDiagc_MotDrvErrA_Val" 0 DISPLAY_IDENTIFIER StHlthSigNormn.ReceiverPorts.MotDrvErrA.Val /end MEASUREMENT
/begin MEASUREMENT StHlthSigNormn.MotDrvErrB.Val "MICROSAR RTE" FLOAT32_IEEE NO_COMPU_METHOD 0 0 -3.402823466e+38 3.402823466e+38 ECU_ADDRESS 0 SYMBOL_LINK "Rte_MotDrvDiagc_MotDrvErrB_Val" 0 DISPLAY_IDENTIFIER StHlthSigNormn.ReceiverPorts.MotDrvErrB.Val /end MEASUREMENT
/begin MEASUREMENT StHlthSigNormn.MotDrvErrC.Val "MICROSAR RTE" FLOAT32_IEEE NO_COMPU_METHOD 0 0 -3.402823466e+38 3.402823466e+38 ECU_ADDRESS 0 SYMBOL_LINK "Rte_MotDrvDiagc_MotDrvErrC_Val" 0 DISPLAY_IDENTIFIER StHlthSigNormn.ReceiverPorts.MotDrvErrC.Val /end MEASUREMENT
/begin MEASUREMENT StHlthSigNormn.MotDrvErrD.Val "MICROSAR RTE" FLOAT32_IEEE NO_COMPU_METHOD 0 0 -3.402823466e+38 3.402823466e+38 ECU_ADDRESS 0 SYMBOL_LINK "Rte_MotDrvDiagc_MotDrvErrD_Val" 0 DISPLAY_IDENTIFIER StHlthSigNormn.ReceiverPorts.MotDrvErrD.Val /end MEASUREMENT
/begin MEASUREMENT StHlthSigNormn.MotDrvErrE.Val "MICROSAR RTE" FLOAT32_IEEE NO_COMPU_METHOD 0 0 -3.402823466e+38 3.402823466e+38 ECU_ADDRESS 0 SYMBOL_LINK "Rte_MotDrvDiagc_MotDrvErrE_Val" 0 DISPLAY_IDENTIFIER StHlthSigNormn.ReceiverPorts.MotDrvErrE.Val /end MEASUREMENT
/begin MEASUREMENT StHlthSigNormn.MotDrvErrF.Val "MICROSAR RTE" FLOAT32_IEEE NO_COMPU_METHOD 0 0 -3.402823466e+38 3.402823466e+38 ECU_ADDRESS 0 SYMBOL_LINK "Rte_MotDrvDiagc_MotDrvErrF_Val" 0 DISPLAY_IDENTIFIER StHlthSigNormn.ReceiverPorts.MotDrvErrF.Val /end MEASUREMENT
/begin MEASUREMENT StHlthSigNormn.MotPosStHlth.Val "MICROSAR RTE" UBYTE NO_COMPU_METHOD 0 0 0 255 ECU_ADDRESS 0 SYMBOL_LINK "Rte_StHlthSigNormn_MotPosStHlth_Val" 0 DISPLAY_IDENTIFIER StHlthSigNormn.SenderPorts.MotPosStHlth.Val /end MEASUREMENT
/begin MEASUREMENT StHlthSigNormn.MotPosStHlthSts "MICROSAR RTE" UBYTE NO_COMPU_METHOD 0 0 0 255 ECU_ADDRESS 0 SYMBOL_LINK "Rte_StHlthSigNormn_MotPosStHlthSts" 0 DISPLAY_IDENTIFIER StHlthSigNormn.PerInstanceMemories.MotPosStHlthSts /end MEASUREMENT
/begin MEASUREMENT StHlthSigNormn.MotVelCrf.Val "MICROSAR RTE" FLOAT32_IEEE NO_COMPU_METHOD 0 0 -3.402823466e+38 3.402823466e+38 ECU_ADDRESS 0 SYMBOL_LINK "Rte_CDD_MotVel_MotVelCrf_Val" 0 DISPLAY_IDENTIFIER StHlthSigNormn.ReceiverPorts.MotVelCrf.Val /end MEASUREMENT
/begin MEASUREMENT StHlthSigNormn.OutpAssiStHlth.Val "MICROSAR RTE" UBYTE NO_COMPU_METHOD 0 0 0 255 ECU_ADDRESS 0 SYMBOL_LINK "Rte_StHlthSigNormn_OutpAssiStHlth_Val" 0 DISPLAY_IDENTIFIER StHlthSigNormn.SenderPorts.OutpAssiStHlth.Val /end MEASUREMENT
/begin MEASUREMENT StHlthSigNormn.PhaAStHlth.Val "MICROSAR RTE" UBYTE NO_COMPU_METHOD 0 0 0 255 ECU_ADDRESS 0 SYMBOL_LINK "Rte_StHlthSigNormn_PhaAStHlth_Val" 0 DISPLAY_IDENTIFIER StHlthSigNormn.SenderPorts.PhaAStHlth.Val /end MEASUREMENT
/begin MEASUREMENT StHlthSigNormn.PhaAStHlthSts "MICROSAR RTE" UBYTE NO_COMPU_METHOD 0 0 0 255 ECU_ADDRESS 0 SYMBOL_LINK "Rte_StHlthSigNormn_PhaAStHlthSts" 0 DISPLAY_IDENTIFIER StHlthSigNormn.PerInstanceMemories.PhaAStHlthSts /end MEASUREMENT
/begin MEASUREMENT StHlthSigNormn.PhaBStHlth.Val "MICROSAR RTE" UBYTE NO_COMPU_METHOD 0 0 0 255 ECU_ADDRESS 0 SYMBOL_LINK "Rte_StHlthSigNormn_PhaBStHlth_Val" 0 DISPLAY_IDENTIFIER StHlthSigNormn.SenderPorts.PhaBStHlth.Val /end MEASUREMENT
/begin MEASUREMENT StHlthSigNormn.PhaBStHlthSts "MICROSAR RTE" UBYTE NO_COMPU_METHOD 0 0 0 255 ECU_ADDRESS 0 SYMBOL_LINK "Rte_StHlthSigNormn_PhaBStHlthSts" 0 DISPLAY_IDENTIFIER StHlthSigNormn.PerInstanceMemories.PhaBStHlthSts /end MEASUREMENT
/begin MEASUREMENT StHlthSigNormn.PhaCStHlth.Val "MICROSAR RTE" UBYTE NO_COMPU_METHOD 0 0 0 255 ECU_ADDRESS 0 SYMBOL_LINK "Rte_StHlthSigNormn_PhaCStHlth_Val" 0 DISPLAY_IDENTIFIER StHlthSigNormn.SenderPorts.PhaCStHlth.Val /end MEASUREMENT
/begin MEASUREMENT StHlthSigNormn.PhaCStHlthSts "MICROSAR RTE" UBYTE NO_COMPU_METHOD 0 0 0 255 ECU_ADDRESS 0 SYMBOL_LINK "Rte_StHlthSigNormn_PhaCStHlthSts" 0 DISPLAY_IDENTIFIER StHlthSigNormn.PerInstanceMemories.PhaCStHlthSts /end MEASUREMENT
/begin MEASUREMENT StHlthSigNormn.PhaDStHlth.Val "MICROSAR RTE" UBYTE NO_COMPU_METHOD 0 0 0 255 ECU_ADDRESS 0 SYMBOL_LINK "Rte_StHlthSigNormn_PhaDStHlth_Val" 0 DISPLAY_IDENTIFIER StHlthSigNormn.SenderPorts.PhaDStHlth.Val /end MEASUREMENT
/begin MEASUREMENT StHlthSigNormn.PhaDStHlthSts "MICROSAR RTE" UBYTE NO_COMPU_METHOD 0 0 0 255 ECU_ADDRESS 0 SYMBOL_LINK "Rte_StHlthSigNormn_PhaDStHlthSts" 0 DISPLAY_IDENTIFIER StHlthSigNormn.PerInstanceMemories.PhaDStHlthSts /end MEASUREMENT
/begin MEASUREMENT StHlthSigNormn.PhaEStHlth.Val "MICROSAR RTE" UBYTE NO_COMPU_METHOD 0 0 0 255 ECU_ADDRESS 0 SYMBOL_LINK "Rte_StHlthSigNormn_PhaEStHlth_Val" 0 DISPLAY_IDENTIFIER StHlthSigNormn.SenderPorts.PhaEStHlth.Val /end MEASUREMENT
/begin MEASUREMENT StHlthSigNormn.PhaEStHlthSts "MICROSAR RTE" UBYTE NO_COMPU_METHOD 0 0 0 255 ECU_ADDRESS 0 SYMBOL_LINK "Rte_StHlthSigNormn_PhaEStHlthSts" 0 DISPLAY_IDENTIFIER StHlthSigNormn.PerInstanceMemories.PhaEStHlthSts /end MEASUREMENT
/begin MEASUREMENT StHlthSigNormn.PhaFStHlth.Val "MICROSAR RTE" UBYTE NO_COMPU_METHOD 0 0 0 255 ECU_ADDRESS 0 SYMBOL_LINK "Rte_StHlthSigNormn_PhaFStHlth_Val" 0 DISPLAY_IDENTIFIER StHlthSigNormn.SenderPorts.PhaFStHlth.Val /end MEASUREMENT
/begin MEASUREMENT StHlthSigNormn.PhaFStHlthSts "MICROSAR RTE" UBYTE NO_COMPU_METHOD 0 0 0 255 ECU_ADDRESS 0 SYMBOL_LINK "Rte_StHlthSigNormn_PhaFStHlthSts" 0 DISPLAY_IDENTIFIER StHlthSigNormn.PerInstanceMemories.PhaFStHlthSts /end MEASUREMENT
/begin MEASUREMENT StHlthSigNormn.RackLimrEotSig0Avl.Logl "MICROSAR RTE" UBYTE RTE_CM_BOOLEAN 0 0 0 255 ECU_ADDRESS 0 SYMBOL_LINK "Rte_CDD_HwTq0Meas_RackLimrEotSig0Avl_Logl" 0 DISPLAY_IDENTIFIER StHlthSigNormn.ReceiverPorts.RackLimrEotSig0Avl.Logl /end MEASUREMENT
/begin MEASUREMENT StHlthSigNormn.RackLimrEotSig1Avl.Logl "MICROSAR RTE" UBYTE RTE_CM_BOOLEAN 0 0 0 255 ECU_ADDRESS 0 SYMBOL_LINK "Rte_CDD_HwTq1Meas_RackLimrEotSig1Avl_Logl" 0 DISPLAY_IDENTIFIER StHlthSigNormn.ReceiverPorts.RackLimrEotSig1Avl.Logl /end MEASUREMENT
/begin MEASUREMENT StHlthSigNormn.RamEccSngBitCorrnStHlth.Val "MICROSAR RTE" UBYTE NO_COMPU_METHOD 0 0 0 255 ECU_ADDRESS 0 SYMBOL_LINK "Rte_StHlthSigNormn_RamEccSngBitCorrnStHlth_Val" 0 DISPLAY_IDENTIFIER StHlthSigNormn.SenderPorts.RamEccSngBitCorrnStHlth.Val /end MEASUREMENT
/begin MEASUREMENT StHlthSigNormn.VltgRng.Val "MICROSAR RTE" UBYTE NO_COMPU_METHOD 0 0 0 255 ECU_ADDRESS 0 SYMBOL_LINK "Rte_StHlthSigNormn_VltgRng_Val" 0 DISPLAY_IDENTIFIER StHlthSigNormn.SenderPorts.VltgRng.Val /end MEASUREMENT
/begin MEASUREMENT StHlthSigNormn.VltgRngIgnCyc "MICROSAR RTE" UBYTE NO_COMPU_METHOD 0 0 0 255 ECU_ADDRESS 0 SYMBOL_LINK "Rte_StHlthSigNormn_VltgRngIgnCyc" 0 DISPLAY_IDENTIFIER StHlthSigNormn.PerInstanceMemories.VltgRngIgnCyc /end MEASUREMENT
/begin MEASUREMENT StHlthSigNormn.WhlImbMaxCmpStHlth.Val "MICROSAR RTE" UBYTE NO_COMPU_METHOD 0 0 0 255 ECU_ADDRESS 0 SYMBOL_LINK "Rte_StHlthSigNormn_WhlImbMaxCmpStHlth_Val" 0 DISPLAY_IDENTIFIER StHlthSigNormn.SenderPorts.WhlImbMaxCmpStHlth.Val /end MEASUREMENT
/begin MEASUREMENT StHlthSigNormn.WhlImbRejctnCmd.Val "MICROSAR RTE" FLOAT32_IEEE NO_COMPU_METHOD 0 0 -3.402823466e+38 3.402823466e+38 ECU_ADDRESS 0 SYMBOL_LINK "Rte_WhlImbRejctn_WhlImbRejctnCmd_Val" 0 DISPLAY_IDENTIFIER StHlthSigNormn.ReceiverPorts.WhlImbRejctnCmd.Val /end MEASUREMENT
/begin MEASUREMENT StHlthSigStc.AbsltMotPosABDifStHlth.Val "MICROSAR RTE" UBYTE NO_COMPU_METHOD 0 0 0 255 ECU_ADDRESS 0 SYMBOL_LINK "Rte_StHlthSigNormn_AbsltMotPosABDifStHlth_Val" 0 DISPLAY_IDENTIFIER StHlthSigStc.ReceiverPorts.AbsltMotPosABDifStHlth.Val /end MEASUREMENT
/begin MEASUREMENT StHlthSigStc.AbsltMotPosACDifStHlth.Val "MICROSAR RTE" UBYTE NO_COMPU_METHOD 0 0 0 255 ECU_ADDRESS 0 SYMBOL_LINK "Rte_StHlthSigNormn_AbsltMotPosACDifStHlth_Val" 0 DISPLAY_IDENTIFIER StHlthSigStc.ReceiverPorts.AbsltMotPosACDifStHlth.Val /end MEASUREMENT
/begin MEASUREMENT StHlthSigStc.AbsltMotPosBCDifStHlth.Val "MICROSAR RTE" UBYTE NO_COMPU_METHOD 0 0 0 255 ECU_ADDRESS 0 SYMBOL_LINK "Rte_StHlthSigNormn_AbsltMotPosBCDifStHlth_Val" 0 DISPLAY_IDENTIFIER StHlthSigStc.ReceiverPorts.AbsltMotPosBCDifStHlth.Val /end MEASUREMENT
/begin MEASUREMENT StHlthSigStc.CtrlrTStHlth.Val "MICROSAR RTE" UBYTE NO_COMPU_METHOD 0 0 0 255 ECU_ADDRESS 0 SYMBOL_LINK "Rte_StHlthSigNormn_CtrlrTStHlth_Val" 0 DISPLAY_IDENTIFIER StHlthSigStc.ReceiverPorts.CtrlrTStHlth.Val /end MEASUREMENT
/begin MEASUREMENT StHlthSigStc.CurrMotSumABCStHlth.Val "MICROSAR RTE" UBYTE NO_COMPU_METHOD 0 0 0 255 ECU_ADDRESS 0 SYMBOL_LINK "Rte_StHlthSigNormn_CurrMotSumABCStHlth_Val" 0 DISPLAY_IDENTIFIER StHlthSigStc.ReceiverPorts.CurrMotSumABCStHlth.Val /end MEASUREMENT
/begin MEASUREMENT StHlthSigStc.CurrMotSumDEFStHlth.Val "MICROSAR RTE" UBYTE NO_COMPU_METHOD 0 0 0 255 ECU_ADDRESS 0 SYMBOL_LINK "Rte_StHlthSigNormn_CurrMotSumDEFStHlth_Val" 0 DISPLAY_IDENTIFIER StHlthSigStc.ReceiverPorts.CurrMotSumDEFStHlth.Val /end MEASUREMENT
/begin MEASUREMENT StHlthSigStc.DigTqIdptSigStHlth.Val "MICROSAR RTE" UBYTE NO_COMPU_METHOD 0 0 0 255 ECU_ADDRESS 0 SYMBOL_LINK "Rte_StHlthSigNormn_DigTqIdptSigStHlth_Val" 0 DISPLAY_IDENTIFIER StHlthSigStc.ReceiverPorts.DigTqIdptSigStHlth.Val /end MEASUREMENT
/begin MEASUREMENT StHlthSigStc.DigTqSnsrAStHlth.Val "MICROSAR RTE" UBYTE NO_COMPU_METHOD 0 0 0 255 ECU_ADDRESS 0 SYMBOL_LINK "Rte_StHlthSigNormn_DigTqSnsrAStHlth_Val" 0 DISPLAY_IDENTIFIER StHlthSigStc.ReceiverPorts.DigTqSnsrAStHlth.Val /end MEASUREMENT
/begin MEASUREMENT StHlthSigStc.DigTqSnsrBStHlth.Val "MICROSAR RTE" UBYTE NO_COMPU_METHOD 0 0 0 255 ECU_ADDRESS 0 SYMBOL_LINK "Rte_StHlthSigNormn_DigTqSnsrBStHlth_Val" 0 DISPLAY_IDENTIFIER StHlthSigStc.ReceiverPorts.DigTqSnsrBStHlth.Val /end MEASUREMENT
/begin MEASUREMENT StHlthSigStc.DutyCycStHlth.Val "MICROSAR RTE" UBYTE NO_COMPU_METHOD 0 0 0 255 ECU_ADDRESS 0 SYMBOL_LINK "Rte_StHlthSigNormn_DutyCycStHlth_Val" 0 DISPLAY_IDENTIFIER StHlthSigStc.ReceiverPorts.DutyCycStHlth.Val /end MEASUREMENT
/begin MEASUREMENT StHlthSigStc.EotImpctStHlth.Val "MICROSAR RTE" UBYTE NO_COMPU_METHOD 0 0 0 255 ECU_ADDRESS 0 SYMBOL_LINK "Rte_StHlthSigNormn_EotImpctStHlth_Val" 0 DISPLAY_IDENTIFIER StHlthSigStc.ReceiverPorts.EotImpctStHlth.Val /end MEASUREMENT
/begin MEASUREMENT StHlthSigStc.FricEstimnStHlth.Val "MICROSAR RTE" UBYTE NO_COMPU_METHOD 0 0 0 255 ECU_ADDRESS 0 SYMBOL_LINK "Rte_StHlthSigNormn_FricEstimnStHlth_Val" 0 DISPLAY_IDENTIFIER StHlthSigStc.ReceiverPorts.FricEstimnStHlth.Val /end MEASUREMENT
/begin MEASUREMENT StHlthSigStc.MotPosStHlth.Val "MICROSAR RTE" UBYTE NO_COMPU_METHOD 0 0 0 255 ECU_ADDRESS 0 SYMBOL_LINK "Rte_StHlthSigNormn_MotPosStHlth_Val" 0 DISPLAY_IDENTIFIER StHlthSigStc.ReceiverPorts.MotPosStHlth.Val /end MEASUREMENT
/begin MEASUREMENT StHlthSigStc.OutpAssiStHlth.Val "MICROSAR RTE" UBYTE NO_COMPU_METHOD 0 0 0 255 ECU_ADDRESS 0 SYMBOL_LINK "Rte_StHlthSigNormn_OutpAssiStHlth_Val" 0 DISPLAY_IDENTIFIER StHlthSigStc.ReceiverPorts.OutpAssiStHlth.Val /end MEASUREMENT
/begin MEASUREMENT StHlthSigStc.PhaAStHlth.Val "MICROSAR RTE" UBYTE NO_COMPU_METHOD 0 0 0 255 ECU_ADDRESS 0 SYMBOL_LINK "Rte_StHlthSigNormn_PhaAStHlth_Val" 0 DISPLAY_IDENTIFIER StHlthSigStc.ReceiverPorts.PhaAStHlth.Val /end MEASUREMENT
/begin MEASUREMENT StHlthSigStc.PhaBStHlth.Val "MICROSAR RTE" UBYTE NO_COMPU_METHOD 0 0 0 255 ECU_ADDRESS 0 SYMBOL_LINK "Rte_StHlthSigNormn_PhaBStHlth_Val" 0 DISPLAY_IDENTIFIER StHlthSigStc.ReceiverPorts.PhaBStHlth.Val /end MEASUREMENT
/begin MEASUREMENT StHlthSigStc.PhaCStHlth.Val "MICROSAR RTE" UBYTE NO_COMPU_METHOD 0 0 0 255 ECU_ADDRESS 0 SYMBOL_LINK "Rte_StHlthSigNormn_PhaCStHlth_Val" 0 DISPLAY_IDENTIFIER StHlthSigStc.ReceiverPorts.PhaCStHlth.Val /end MEASUREMENT
/begin MEASUREMENT StHlthSigStc.PhaDStHlth.Val "MICROSAR RTE" UBYTE NO_COMPU_METHOD 0 0 0 255 ECU_ADDRESS 0 SYMBOL_LINK "Rte_StHlthSigNormn_PhaDStHlth_Val" 0 DISPLAY_IDENTIFIER StHlthSigStc.ReceiverPorts.PhaDStHlth.Val /end MEASUREMENT
/begin MEASUREMENT StHlthSigStc.PhaEStHlth.Val "MICROSAR RTE" UBYTE NO_COMPU_METHOD 0 0 0 255 ECU_ADDRESS 0 SYMBOL_LINK "Rte_StHlthSigNormn_PhaEStHlth_Val" 0 DISPLAY_IDENTIFIER StHlthSigStc.ReceiverPorts.PhaEStHlth.Val /end MEASUREMENT
/begin MEASUREMENT StHlthSigStc.PhaFStHlth.Val "MICROSAR RTE" UBYTE NO_COMPU_METHOD 0 0 0 255 ECU_ADDRESS 0 SYMBOL_LINK "Rte_StHlthSigNormn_PhaFStHlth_Val" 0 DISPLAY_IDENTIFIER StHlthSigStc.ReceiverPorts.PhaFStHlth.Val /end MEASUREMENT
/begin MEASUREMENT StHlthSigStc.RamEccSngBitCorrnStHlth.Val "MICROSAR RTE" UBYTE NO_COMPU_METHOD 0 0 0 255 ECU_ADDRESS 0 SYMBOL_LINK "Rte_StHlthSigNormn_RamEccSngBitCorrnStHlth_Val" 0 DISPLAY_IDENTIFIER StHlthSigStc.ReceiverPorts.RamEccSngBitCorrnStHlth.Val /end MEASUREMENT
/begin MEASUREMENT StHlthSigStc.SigStcHistDataAry "MICROSAR RTE" UBYTE NO_COMPU_METHOD 0 0 0 255 MATRIX_DIM 225 1 1 ECU_ADDRESS 0 SYMBOL_LINK "Rte_StHlthSigStc_SigStcHistDataAry" 0 DISPLAY_IDENTIFIER StHlthSigStc.PerInstanceMemories.SigStcHistDataAry /end MEASUREMENT
/begin MEASUREMENT StHlthSigStc.VldNvm "MICROSAR RTE" UBYTE RTE_CM_BOOLEAN 0 0 0 255 ECU_ADDRESS 0 SYMBOL_LINK "Rte_StHlthSigStc_VldNvm" 0 DISPLAY_IDENTIFIER StHlthSigStc.PerInstanceMemories.VldNvm /end MEASUREMENT
/begin MEASUREMENT StHlthSigStc.WhlImbMaxCmpStHlth.Val "MICROSAR RTE" UBYTE NO_COMPU_METHOD 0 0 0 255 ECU_ADDRESS 0 SYMBOL_LINK "Rte_StHlthSigNormn_WhlImbMaxCmpStHlth_Val" 0 DISPLAY_IDENTIFIER StHlthSigStc.ReceiverPorts.WhlImbMaxCmpStHlth.Val /end MEASUREMENT
/begin MEASUREMENT StOutpCtrl.LoaRateLim.Val "MICROSAR RTE" FLOAT32_IEEE NO_COMPU_METHOD 0 0 0.1 500.0 ECU_ADDRESS 0 SYMBOL_LINK "Rte_LoaMgr_LoaRateLim_Val" 0 DISPLAY_IDENTIFIER StOutpCtrl.ReceiverPorts.LoaRateLim.Val /end MEASUREMENT
/begin MEASUREMENT StOutpCtrl.LoaSca.Val "MICROSAR RTE" FLOAT32_IEEE NO_COMPU_METHOD 0 0 0.0 1.0 ECU_ADDRESS 0 SYMBOL_LINK "Rte_LoaMgr_LoaSca_Val" 0 DISPLAY_IDENTIFIER StOutpCtrl.ReceiverPorts.LoaSca.Val /end MEASUREMENT
/begin MEASUREMENT StOutpCtrl.StOutpCtrlPrevCmdSca "MICROSAR RTE" FLOAT32_IEEE NO_COMPU_METHOD 0 0 0.0 1.0 ECU_ADDRESS 0 SYMBOL_LINK "Rte_StOutpCtrl_StOutpCtrlPrevCmdSca" 0 DISPLAY_IDENTIFIER StOutpCtrl.PerInstanceMemories.StOutpCtrlPrevCmdSca /end MEASUREMENT
/begin MEASUREMENT StOutpCtrl.StOutpCtrlPrevSrc "MICROSAR RTE" UBYTE NO_COMPU_METHOD 0 0 1 3 ECU_ADDRESS 0 SYMBOL_LINK "Rte_StOutpCtrl_StOutpCtrlPrevSrc" 0 DISPLAY_IDENTIFIER StOutpCtrl.PerInstanceMemories.StOutpCtrlPrevSrc /end MEASUREMENT
/begin MEASUREMENT StOutpCtrl.SysDiMotTqCmdSca.Val "MICROSAR RTE" FLOAT32_IEEE NO_COMPU_METHOD 0 0 0.0 1.0 ECU_ADDRESS 0 SYMBOL_LINK "Rte_DiagcMgr_SysDiMotTqCmdSca_Val" 0 DISPLAY_IDENTIFIER StOutpCtrl.ReceiverPorts.SysDiMotTqCmdSca.Val /end MEASUREMENT
/begin MEASUREMENT StOutpCtrl.SysDiRampRate.Val "MICROSAR RTE" FLOAT32_IEEE NO_COMPU_METHOD 0 0 0.1 500.0 ECU_ADDRESS 0 SYMBOL_LINK "Rte_DiagcMgr_SysDiRampRate_Val" 0 DISPLAY_IDENTIFIER StOutpCtrl.ReceiverPorts.SysDiRampRate.Val /end MEASUREMENT
/begin MEASUREMENT StOutpCtrl.SysMotTqCmdRampRateDi.Logl "MICROSAR RTE" UBYTE RTE_CM_BOOLEAN 0 0 0 255 ECU_ADDRESS 0 SYMBOL_LINK "Rte_CmnMfgSrv_SysMotTqCmdRampRateDi_Logl" 0 DISPLAY_IDENTIFIER StOutpCtrl.ReceiverPorts.SysMotTqCmdRampRateDi.Logl /end MEASUREMENT
/begin MEASUREMENT StOutpCtrl.SysMotTqCmdSca.Val "MICROSAR RTE" FLOAT32_IEEE NO_COMPU_METHOD 0 0 0.0 1.0 ECU_ADDRESS 0 SYMBOL_LINK "Rte_StOutpCtrl_SysMotTqCmdSca_Val" 0 DISPLAY_IDENTIFIER StOutpCtrl.SenderPorts.SysMotTqCmdSca.Val /end MEASUREMENT
/begin MEASUREMENT StOutpCtrl.SysOperMotTqCmdSca.Val "MICROSAR RTE" FLOAT32_IEEE NO_COMPU_METHOD 0 0 0.0 1.0 ECU_ADDRESS 0 SYMBOL_LINK "Rte_GmVehPwrMod_SysOperMotTqCmdSca_Val" 0 DISPLAY_IDENTIFIER StOutpCtrl.ReceiverPorts.SysOperMotTqCmdSca.Val /end MEASUREMENT
/begin MEASUREMENT StOutpCtrl.SysOperRampRate.Val "MICROSAR RTE" FLOAT32_IEEE NO_COMPU_METHOD 0 0 0.1 500.0 ECU_ADDRESS 0 SYMBOL_LINK "Rte_GmVehPwrMod_SysOperRampRate_Val" 0 DISPLAY_IDENTIFIER StOutpCtrl.ReceiverPorts.SysOperRampRate.Val /end MEASUREMENT
/begin MEASUREMENT StOutpCtrl.SysStFltOutpReqDi.Logl "MICROSAR RTE" UBYTE RTE_CM_BOOLEAN 0 0 0 255 ECU_ADDRESS 0 SYMBOL_LINK "Rte_DiagcMgr_SysStFltOutpReqDi_Logl" 0 DISPLAY_IDENTIFIER StOutpCtrl.ReceiverPorts.SysStFltOutpReqDi.Logl /end MEASUREMENT
/begin MEASUREMENT StOutpCtrl.SysStReqDi.Logl "MICROSAR RTE" UBYTE RTE_CM_BOOLEAN 0 0 0 255 ECU_ADDRESS 0 SYMBOL_LINK "Rte_StOutpCtrl_SysStReqDi_Logl" 0 DISPLAY_IDENTIFIER StOutpCtrl.SenderPorts.SysStReqDi.Logl /end MEASUREMENT
/begin MEASUREMENT StOutpCtrl.VehStrtStopMotTqCmdSca.Val "MICROSAR RTE" FLOAT32_IEEE NO_COMPU_METHOD 0 0 0.0 1.0 ECU_ADDRESS 0 SYMBOL_LINK "Rte_GmStrtStop_VehStrtStopMotTqCmdSca_Val" 0 DISPLAY_IDENTIFIER StOutpCtrl.ReceiverPorts.VehStrtStopMotTqCmdSca.Val /end MEASUREMENT
/begin MEASUREMENT StOutpCtrl.VehStrtStopRampRate.Val "MICROSAR RTE" FLOAT32_IEEE NO_COMPU_METHOD 0 0 0.1 500.0 ECU_ADDRESS 0 SYMBOL_LINK "Rte_GmStrtStop_VehStrtStopRampRate_Val" 0 DISPLAY_IDENTIFIER StOutpCtrl.ReceiverPorts.VehStrtStopRampRate.Val /end MEASUREMENT
/begin MEASUREMENT StOutpCtrl.dStOutpCtrlRateLim "MICROSAR RTE" FLOAT32_IEEE NO_COMPU_METHOD 0 0 0 500 ECU_ADDRESS 0 SYMBOL_LINK "Rte_StOutpCtrl_dStOutpCtrlRateLim" 0 DISPLAY_IDENTIFIER StOutpCtrl.PerInstanceMemories.dStOutpCtrlRateLim /end MEASUREMENT
/begin MEASUREMENT StOutpCtrl.dStOutpCtrlTarSca "MICROSAR RTE" FLOAT32_IEEE NO_COMPU_METHOD 0 0 0.0 1.0 ECU_ADDRESS 0 SYMBOL_LINK "Rte_StOutpCtrl_dStOutpCtrlTarSca" 0 DISPLAY_IDENTIFIER StOutpCtrl.PerInstanceMemories.dStOutpCtrlTarSca /end MEASUREMENT
/begin MEASUREMENT StabyCmp.AssiCmd.Val "MICROSAR RTE" FLOAT32_IEEE NO_COMPU_METHOD 0 0 -3.402823466e+38 3.402823466e+38 ECU_ADDRESS 0 SYMBOL_LINK "Rte_StabyCmp_AssiCmd_Val" 0 DISPLAY_IDENTIFIER StabyCmp.SenderPorts.AssiCmd.Val /end MEASUREMENT
/begin MEASUREMENT StabyCmp.AssiCmdBasSca.Val "MICROSAR RTE" FLOAT32_IEEE NO_COMPU_METHOD 0 0 -3.402823466e+38 3.402823466e+38 ECU_ADDRESS 0 SYMBOL_LINK "Rte_GmTqArbn_AssiCmdBasSca_Val" 0 DISPLAY_IDENTIFIER StabyCmp.ReceiverPorts.AssiCmdBasSca.Val /end MEASUREMENT
/begin MEASUREMENT StabyCmp.AssiCmdSum.Val "MICROSAR RTE" FLOAT32_IEEE NO_COMPU_METHOD 0 0 -3.402823466e+38 3.402823466e+38 ECU_ADDRESS 0 SYMBOL_LINK "Rte_AssiPahFwl_AssiCmdSum_Val" 0 DISPLAY_IDENTIFIER StabyCmp.ReceiverPorts.AssiCmdSum.Val /end MEASUREMENT
/begin MEASUREMENT StabyCmp.AssiNotch1Fil.FilSt1 "MICROSAR RTE" FLOAT32_IEEE NO_COMPU_METHOD 0 0 -3.402823466e+38 3.402823466e+38 ECU_ADDRESS 0 SYMBOL_LINK "Rte_StabyCmp_AssiNotch1Fil.FilSt1" 0 DISPLAY_IDENTIFIER StabyCmp.PerInstanceMemories.AssiNotch1Fil.FilSt1 /end MEASUREMENT
/begin MEASUREMENT StabyCmp.AssiNotch1Fil.FilSt2 "MICROSAR RTE" FLOAT32_IEEE NO_COMPU_METHOD 0 0 -3.402823466e+38 3.402823466e+38 ECU_ADDRESS 0 SYMBOL_LINK "Rte_StabyCmp_AssiNotch1Fil.FilSt2" 0 DISPLAY_IDENTIFIER StabyCmp.PerInstanceMemories.AssiNotch1Fil.FilSt2 /end MEASUREMENT
/begin MEASUREMENT StabyCmp.AssiNotch2Fil.FilSt1 "MICROSAR RTE" FLOAT32_IEEE NO_COMPU_METHOD 0 0 -3.402823466e+38 3.402823466e+38 ECU_ADDRESS 0 SYMBOL_LINK "Rte_StabyCmp_AssiNotch2Fil.FilSt1" 0 DISPLAY_IDENTIFIER StabyCmp.PerInstanceMemories.AssiNotch2Fil.FilSt1 /end MEASUREMENT
/begin MEASUREMENT StabyCmp.AssiNotch2Fil.FilSt2 "MICROSAR RTE" FLOAT32_IEEE NO_COMPU_METHOD 0 0 -3.402823466e+38 3.402823466e+38 ECU_ADDRESS 0 SYMBOL_LINK "Rte_StabyCmp_AssiNotch2Fil.FilSt2" 0 DISPLAY_IDENTIFIER StabyCmp.PerInstanceMemories.AssiNotch2Fil.FilSt2 /end MEASUREMENT
/begin MEASUREMENT StabyCmp.AssiNotch3Fil.FilSt1 "MICROSAR RTE" FLOAT32_IEEE NO_COMPU_METHOD 0 0 -3.402823466e+38 3.402823466e+38 ECU_ADDRESS 0 SYMBOL_LINK "Rte_StabyCmp_AssiNotch3Fil.FilSt1" 0 DISPLAY_IDENTIFIER StabyCmp.PerInstanceMemories.AssiNotch3Fil.FilSt1 /end MEASUREMENT
/begin MEASUREMENT StabyCmp.AssiNotch3Fil.FilSt2 "MICROSAR RTE" FLOAT32_IEEE NO_COMPU_METHOD 0 0 -3.402823466e+38 3.402823466e+38 ECU_ADDRESS 0 SYMBOL_LINK "Rte_StabyCmp_AssiNotch3Fil.FilSt2" 0 DISPLAY_IDENTIFIER StabyCmp.PerInstanceMemories.AssiNotch3Fil.FilSt2 /end MEASUREMENT
/begin MEASUREMENT StabyCmp.AssiNotch4Fil.FilSt1 "MICROSAR RTE" FLOAT32_IEEE NO_COMPU_METHOD 0 0 -3.402823466e+38 3.402823466e+38 ECU_ADDRESS 0 SYMBOL_LINK "Rte_StabyCmp_AssiNotch4Fil.FilSt1" 0 DISPLAY_IDENTIFIER StabyCmp.PerInstanceMemories.AssiNotch4Fil.FilSt1 /end MEASUREMENT
/begin MEASUREMENT StabyCmp.AssiNotch4Fil.FilSt2 "MICROSAR RTE" FLOAT32_IEEE NO_COMPU_METHOD 0 0 -3.402823466e+38 3.402823466e+38 ECU_ADDRESS 0 SYMBOL_LINK "Rte_StabyCmp_AssiNotch4Fil.FilSt2" 0 DISPLAY_IDENTIFIER StabyCmp.PerInstanceMemories.AssiNotch4Fil.FilSt2 /end MEASUREMENT
/begin MEASUREMENT StabyCmp.AssiPahLimrActv.Val "MICROSAR RTE" FLOAT32_IEEE NO_COMPU_METHOD 0 0 -3.402823466e+38 3.402823466e+38 ECU_ADDRESS 0 SYMBOL_LINK "Rte_AssiPahFwl_AssiPahLimrActv_Val" 0 DISPLAY_IDENTIFIER StabyCmp.ReceiverPorts.AssiPahLimrActv.Val /end MEASUREMENT
/begin MEASUREMENT StabyCmp.HwTq.Val "MICROSAR RTE" FLOAT32_IEEE NO_COMPU_METHOD 0 0 -3.402823466e+38 3.402823466e+38 ECU_ADDRESS 0 SYMBOL_LINK "Rte_Swp_HwTqSwp_Val" 0 DISPLAY_IDENTIFIER StabyCmp.ReceiverPorts.HwTq.Val /end MEASUREMENT
/begin MEASUREMENT StabyCmp.HwTqLpFil.FilGain "MICROSAR RTE" FLOAT32_IEEE NO_COMPU_METHOD 0 0 -3.402823466e+38 3.402823466e+38 ECU_ADDRESS 0 SYMBOL_LINK "Rte_StabyCmp_HwTqLpFil.FilGain" 0 DISPLAY_IDENTIFIER StabyCmp.PerInstanceMemories.HwTqLpFil.FilGain /end MEASUREMENT
/begin MEASUREMENT StabyCmp.HwTqLpFil.FilSt "MICROSAR RTE" FLOAT32_IEEE NO_COMPU_METHOD 0 0 -3.402823466e+38 3.402823466e+38 ECU_ADDRESS 0 SYMBOL_LINK "Rte_StabyCmp_HwTqLpFil.FilSt" 0 DISPLAY_IDENTIFIER StabyCmp.PerInstanceMemories.HwTqLpFil.FilSt /end MEASUREMENT
/begin GROUP SnsrOffsLrng.HwTqLrngStRst "MICROSAR RTE" /begin SUB_GROUP /end SUB_GROUP /begin FUNCTION_LIST /end FUNCTION_LIST /begin REF_CHARACTERISTIC /end REF_CHARACTERISTIC /begin REF_MEASUREMENT SnsrOffsLrng.HwTqLrngStRst /end REF_MEASUREMENT /end GROUP
/begin GROUP SnsrOffsLrng.HwTqLrngTqInpDetnEnaPrev "MICROSAR RTE" /begin SUB_GROUP /end SUB_GROUP /begin FUNCTION_LIST /end FUNCTION_LIST /begin REF_CHARACTERISTIC /end REF_CHARACTERISTIC /begin REF_MEASUREMENT SnsrOffsLrng.HwTqLrngTqInpDetnEnaPrev /end REF_MEASUREMENT /end GROUP
/begin GROUP SnsrOffsLrng.HwTqLrngTqInpPrsnt "MICROSAR RTE" /begin SUB_GROUP /end SUB_GROUP /begin FUNCTION_LIST /end FUNCTION_LIST /begin REF_CHARACTERISTIC /end REF_CHARACTERISTIC /begin REF_MEASUREMENT SnsrOffsLrng.HwTqLrngTqInpPrsnt /end REF_MEASUREMENT /end GROUP
/begin GROUP SnsrOffsLrng.HwTqMeasFil1 "MICROSAR RTE" /begin SUB_GROUP /end SUB_GROUP /begin FUNCTION_LIST /end FUNCTION_LIST /begin REF_CHARACTERISTIC /end REF_CHARACTERISTIC
 /begin REF_MEASUREMENT SnsrOffsLrng.HwTqMeasFil1.FilGain SnsrOffsLrng.HwTqMeasFil1.FilSt /end REF_MEASUREMENT
/end GROUP
/begin GROUP SnsrOffsLrng.HwTqMeasFil2 "MICROSAR RTE" /begin SUB_GROUP /end SUB_GROUP /begin FUNCTION_LIST /end FUNCTION_LIST /begin REF_CHARACTERISTIC /end REF_CHARACTERISTIC
 /begin REF_MEASUREMENT SnsrOffsLrng.HwTqMeasFil2.FilGain SnsrOffsLrng.HwTqMeasFil2.FilSt /end REF_MEASUREMENT
/end GROUP
/begin GROUP SnsrOffsLrng.HwTqOffs.Val "MICROSAR RTE" /begin SUB_GROUP /end SUB_GROUP /begin FUNCTION_LIST /end FUNCTION_LIST /begin REF_CHARACTERISTIC /end REF_CHARACTERISTIC /begin REF_MEASUREMENT SnsrOffsLrng.HwTqOffs.Val /end REF_MEASUREMENT /end GROUP
/begin GROUP SnsrOffsLrng.HwVel.Val "MICROSAR RTE" /begin SUB_GROUP /end SUB_GROUP /begin FUNCTION_LIST /end FUNCTION_LIST /begin REF_CHARACTERISTIC /end REF_CHARACTERISTIC /begin REF_MEASUREMENT SnsrOffsLrng.HwVel.Val /end REF_MEASUREMENT /end GROUP
/begin GROUP SnsrOffsLrng.HwVelCdngFil "MICROSAR RTE" /begin SUB_GROUP /end SUB_GROUP /begin FUNCTION_LIST /end FUNCTION_LIST /begin REF_CHARACTERISTIC /end REF_CHARACTERISTIC
 /begin REF_MEASUREMENT SnsrOffsLrng.HwVelCdngFil.FilGain SnsrOffsLrng.HwVelCdngFil.FilSt /end REF_MEASUREMENT
/end GROUP
/begin GROUP SnsrOffsLrng.MotTqCmdCrf.Val "MICROSAR RTE" /begin SUB_GROUP /end SUB_GROUP /begin FUNCTION_LIST /end FUNCTION_LIST /begin REF_CHARACTERISTIC /end REF_CHARACTERISTIC /begin REF_MEASUREMENT SnsrOffsLrng.MotTqCmdCrf.Val /end REF_MEASUREMENT /end GROUP
/begin GROUP SnsrOffsLrng.PerInstanceMemories "MICROSAR RTE"
 /begin SUB_GROUP SnsrOffsLrng.HwAgCdngFil SnsrOffsLrng.HwAgLrngDrvgDstPrev SnsrOffsLrng.HwAgLrngFil1 SnsrOffsLrng.HwAgLrngFil2 SnsrOffsLrng.HwAgLrngStRst SnsrOffsLrng.HwAgLrngSysTqFil1 SnsrOffsLrng.HwAgLrngSysTqFil2 SnsrOffsLrng.HwAgMeasFil1 SnsrOffsLrng.HwAgMeasFil2 SnsrOffsLrng.HwTqLrngEnaTmrRef SnsrOffsLrng.HwTqLrngMeasTmrRef SnsrOffsLrng.HwTqLrngStRst SnsrOffsLrng.HwTqLrngTqInpDetnEnaPrev SnsrOffsLrng.HwTqLrngTqInpPrsnt SnsrOffsLrng.HwTqMeasFil1 SnsrOffsLrng.HwTqMeasFil2 SnsrOffsLrng.HwVelCdngFil SnsrOffsLrng.SnsrOffsLrnd SnsrOffsLrng.SysTqCdngFil SnsrOffsLrng.TqInpDetnEnaTi SnsrOffsLrng.TqInpDetnHwTqFil SnsrOffsLrng.TqInpDetnHwTqPreProc SnsrOffsLrng.TqInpDetnPreProcEnaLoop SnsrOffsLrng.TqInpDetnSinGenrAg SnsrOffsLrng.TqInpDetnStg1Buf SnsrOffsLrng.TqInpDetnStg1FilSt1 SnsrOffsLrng.TqInpDetnStg1FilSt2 SnsrOffsLrng.TqInpDetnStg1Idx SnsrOffsLrng.TqInpDetnStg2CenFilSt1 SnsrOffsLrng.TqInpDetnStg2CenFilSt2 SnsrOffsLrng.TqInpDetnStg2DwnFilSt1 SnsrOffsLrng.TqInpDetnStg2DwnFilSt2 SnsrOffsLrng.TqInpDetnStg2UpFilSt1 SnsrOffsLrng.TqInpDetnStg2UpFilSt2 SnsrOffsLrng.VehYawRateLrngStRst SnsrOffsLrng.VehYawRateOffsFrsh SnsrOffsLrng.YawACdngFil SnsrOffsLrng.YawCdngFil1 SnsrOffsLrng.YawCdngFil2 SnsrOffsLrng.YawLrngElpdLrngTi SnsrOffsLrng.YawLrngFil1 SnsrOffsLrng.YawLrngFil2 SnsrOffsLrng.YawRatePrev SnsrOffsLrng.dSnsrOffsLrngHwAgFild SnsrOffsLrng.dSnsrOffsLrngHwAgLrngCdnVld SnsrOffsLrng.dSnsrOffsLrngHwAgLrngEna SnsrOffsLrng.dSnsrOffsLrngHwAgLrngRst SnsrOffsLrng.dSnsrOffsLrngHwAgLrngSysTqLoThd SnsrOffsLrng.dSnsrOffsLrngHwAgLrngSysTqUpThd SnsrOffsLrng.dSnsrOffsLrngHwAgLrngSysTqVldt SnsrOffsLrng.dSnsrOffsLrngHwAgLrngTiVldt SnsrOffsLrng.dSnsrOffsLrngHwTqLrngEna SnsrOffsLrng.dSnsrOffsLrngHwTqLrngEstimnVldt SnsrOffsLrng.dSnsrOffsLrngHwTqLrngHwAgMeas SnsrOffsLrng.dSnsrOffsLrngHwTqLrngHwTqMeas SnsrOffsLrng.dSnsrOffsLrngHwTqLrngHwTqOffsRaw SnsrOffsLrng.dSnsrOffsLrngHwTqLrngMeasEna SnsrOffsLrng.dSnsrOffsLrngHwTqLrngSampleCntTot SnsrOffsLrng.dSnsrOffsLrngHwTqLrngSampleImb SnsrOffsLrng.dSnsrOffsLrngHwTqLrngTqInpPrsnt SnsrOffsLrng.dSnsrOffsLrngHwTqLrngTqInpPrsntVld SnsrOffsLrng.dSnsrOffsLrngHwVelFild SnsrOffsLrng.dSnsrOffsLrngSysTqFild SnsrOffsLrng.dSnsrOffsLrngTqInpDetnHwTqFild SnsrOffsLrng.dSnsrOffsLrngTqInpDetnStg1Outp SnsrOffsLrng.dSnsrOffsLrngTqInpPrsntRaw SnsrOffsLrng.dSnsrOffsLrngYawA SnsrOffsLrng.dSnsrOffsLrngYawLrngBiasEstimnRaw SnsrOffsLrng.dSnsrOffsLrngYawLrngCdnVld SnsrOffsLrng.dSnsrOffsLrngYawLrngEna SnsrOffsLrng.dSnsrOffsLrngYawRateFild SnsrOffsLrng.dSnsrOffsLrngYawRateFildCorrd /end SUB_GROUP
 /begin FUNCTION_LIST /end FUNCTION_LIST
 /begin REF_CHARACTERISTIC /end REF_CHARACTERISTIC
 /begin REF_MEASUREMENT /end REF_MEASUREMENT
/end GROUP
/begin GROUP SnsrOffsLrng.ReceiverPorts "MICROSAR RTE"
 /begin SUB_GROUP SnsrOffsLrng.HwAg.Val SnsrOffsLrng.HwAgAuthy.Val SnsrOffsLrng.HwTq.Val SnsrOffsLrng.HwVel.Val SnsrOffsLrng.MotTqCmdCrf.Val SnsrOffsLrng.VehSpd.Val SnsrOffsLrng.VehSpdVld.Logl SnsrOffsLrng.VehYawRate.Val SnsrOffsLrng.VehYawRateVld.Logl /end SUB_GROUP
 /begin FUNCTION_LIST /end FUNCTION_LIST
 /begin REF_CHARACTERISTIC /end REF_CHARACTERISTIC
 /begin REF_MEASUREMENT /end REF_MEASUREMENT
/end GROUP
/begin GROUP SnsrOffsLrng.SenderPorts "MICROSAR RTE"
 /begin SUB_GROUP SnsrOffsLrng.HwAgOffs.Val SnsrOffsLrng.HwTqOffs.Val SnsrOffsLrng.VehYawRateOffs.Val /end SUB_GROUP
 /begin FUNCTION_LIST /end FUNCTION_LIST
 /begin REF_CHARACTERISTIC /end REF_CHARACTERISTIC
 /begin REF_MEASUREMENT /end REF_MEASUREMENT
/end GROUP
/begin GROUP SnsrOffsLrng.SnsrOffsLrnd "MICROSAR RTE" /begin SUB_GROUP /end SUB_GROUP /begin FUNCTION_LIST /end FUNCTION_LIST /begin REF_CHARACTERISTIC /end REF_CHARACTERISTIC
 /begin REF_MEASUREMENT SnsrOffsLrng.SnsrOffsLrnd.HwAgLrndTi SnsrOffsLrng.SnsrOffsLrnd.HwAgLrngHwAgFilSt SnsrOffsLrng.SnsrOffsLrnd.HwAgLrngSysTqFilSt SnsrOffsLrng.SnsrOffsLrnd.HwAgLrngYawOffsRef SnsrOffsLrng.SnsrOffsLrnd.HwAgOffs SnsrOffsLrng.SnsrOffsLrnd.HwTqLrngCovariMtrx SnsrOffsLrng.SnsrOffsLrnd.HwTqLrngEstimnVect SnsrOffsLrng.SnsrOffsLrnd.HwTqLrngHwAgRef SnsrOffsLrng.SnsrOffsLrnd.HwTqLrngSampleCntNeg SnsrOffsLrng.SnsrOffsLrnd.HwTqLrngSampleCntPos SnsrOffsLrng.SnsrOffsLrnd.HwTqLrngSts SnsrOffsLrng.SnsrOffsLrnd.HwTqOffs SnsrOffsLrng.SnsrOffsLrnd.YawRateElpdTi SnsrOffsLrng.SnsrOffsLrnd.YawRateOffs SnsrOffsLrng.SnsrOffsLrnd.YawRateOffsVld /end REF_MEASUREMENT
/end GROUP
/begin GROUP SnsrOffsLrng.SnsrOffsLrngFctEna.Logl "MICROSAR RTE" /begin SUB_GROUP /end SUB_GROUP /begin FUNCTION_LIST /end FUNCTION_LIST /begin REF_CHARACTERISTIC SnsrOffsLrng.SnsrOffsLrngFctEna.Logl /end REF_CHARACTERISTIC /begin REF_MEASUREMENT /end REF_MEASUREMENT /end GROUP
/begin GROUP SnsrOffsLrng.SnsrOffsLrngHwAgLrngDrvgDstThd.Val "MICROSAR RTE" /begin SUB_GROUP /end SUB_GROUP /begin FUNCTION_LIST /end FUNCTION_LIST /begin REF_CHARACTERISTIC SnsrOffsLrng.SnsrOffsLrngHwAgLrngDrvgDstThd.Val /end REF_CHARACTERISTIC /begin REF_MEASUREMENT /end REF_MEASUREMENT /end GROUP
/begin GROUP SnsrOffsLrng.SnsrOffsLrngHwAgLrngEna.Logl "MICROSAR RTE" /begin SUB_GROUP /end SUB_GROUP /begin FUNCTION_LIST /end FUNCTION_LIST /begin REF_CHARACTERISTIC SnsrOffsLrng.SnsrOffsLrngHwAgLrngEna.Logl /end REF_CHARACTERISTIC /begin REF_MEASUREMENT /end REF_MEASUREMENT /end GROUP
/begin GROUP SnsrOffsLrng.SnsrOffsLrngHwAgLrngHwVelThd.Val "MICROSAR RTE" /begin SUB_GROUP /end SUB_GROUP /begin FUNCTION_LIST /end FUNCTION_LIST /begin REF_CHARACTERISTIC SnsrOffsLrng.SnsrOffsLrngHwAgLrngHwVelThd.Val /end REF_CHARACTERISTIC /begin REF_MEASUREMENT /end REF_MEASUREMENT /end GROUP
/begin GROUP SnsrOffsLrng.SnsrOffsLrngHwAgLrngSysTqThd.Val "MICROSAR RTE" /begin SUB_GROUP /end SUB_GROUP /begin FUNCTION_LIST /end FUNCTION_LIST /begin REF_CHARACTERISTIC SnsrOffsLrng.SnsrOffsLrngHwAgLrngSysTqThd.Val /end REF_CHARACTERISTIC /begin REF_MEASUREMENT /end REF_MEASUREMENT /end GROUP
/begin GROUP SnsrOffsLrng.SnsrOffsLrngHwAgLrngSysTqThdMed.Val "MICROSAR RTE" /begin SUB_GROUP /end SUB_GROUP /begin FUNCTION_LIST /end FUNCTION_LIST /begin REF_CHARACTERISTIC SnsrOffsLrng.SnsrOffsLrngHwAgLrngSysTqThdMed.Val /end REF_CHARACTERISTIC /begin REF_MEASUREMENT /end REF_MEASUREMENT /end GROUP
/begin GROUP SnsrOffsLrng.SnsrOffsLrngHwAgLrngSysTqThdTrustd.Val "MICROSAR RTE" /begin SUB_GROUP /end SUB_GROUP /begin FUNCTION_LIST /end FUNCTION_LIST /begin REF_CHARACTERISTIC SnsrOffsLrng.SnsrOffsLrngHwAgLrngSysTqThdTrustd.Val /end REF_CHARACTERISTIC /begin REF_MEASUREMENT /end REF_MEASUREMENT /end GROUP
/begin GROUP SnsrOffsLrng.SnsrOffsLrngHwAgLrngSysTqThdWide.Val "MICROSAR RTE" /begin SUB_GROUP /end SUB_GROUP /begin FUNCTION_LIST /end FUNCTION_LIST /begin REF_CHARACTERISTIC SnsrOffsLrng.SnsrOffsLrngHwAgLrngSysTqThdWide.Val /end REF_CHARACTERISTIC /begin REF_MEASUREMENT /end REF_MEASUREMENT /end GROUP
/begin GROUP SnsrOffsLrng.SnsrOffsLrngHwAgLrngTi.Val "MICROSAR RTE" /begin SUB_GROUP /end SUB_GROUP /begin FUNCTION_LIST /end FUNCTION_LIST /begin REF_CHARACTERISTIC SnsrOffsLrng.SnsrOffsLrngHwAgLrngTi.Val /end REF_CHARACTERISTIC /begin REF_MEASUREMENT /end REF_MEASUREMENT /end GROUP
/begin GROUP SnsrOffsLrng.SnsrOffsLrngHwAgLrngVehSpdThd.Val "MICROSAR RTE" /begin SUB_GROUP /end SUB_GROUP /begin FUNCTION_LIST /end FUNCTION_LIST /begin REF_CHARACTERISTIC SnsrOffsLrng.SnsrOffsLrngHwAgLrngVehSpdThd.Val /end REF_CHARACTERISTIC /begin REF_MEASUREMENT /end REF_MEASUREMENT /end GROUP
/begin GROUP SnsrOffsLrng.SnsrOffsLrngHwAgLrngYawOffsDbnd.Val "MICROSAR RTE" /begin SUB_GROUP /end SUB_GROUP /begin FUNCTION_LIST /end FUNCTION_LIST /begin REF_CHARACTERISTIC SnsrOffsLrng.SnsrOffsLrngHwAgLrngYawOffsDbnd.Val /end REF_CHARACTERISTIC /begin REF_MEASUREMENT /end REF_MEASUREMENT /end GROUP
/begin GROUP SnsrOffsLrng.SnsrOffsLrngHwAgLrngYawRateThd.Val "MICROSAR RTE" /begin SUB_GROUP /end SUB_GROUP /begin FUNCTION_LIST /end FUNCTION_LIST /begin REF_CHARACTERISTIC SnsrOffsLrng.SnsrOffsLrngHwAgLrngYawRateThd.Val /end REF_CHARACTERISTIC /begin REF_MEASUREMENT /end REF_MEASUREMENT /end GROUP
/begin GROUP SnsrOffsLrng.SnsrOffsLrngHwAgOffsLim.Val "MICROSAR RTE" /begin SUB_GROUP /end SUB_GROUP /begin FUNCTION_LIST /end FUNCTION_LIST /begin REF_CHARACTERISTIC SnsrOffsLrng.SnsrOffsLrngHwAgOffsLim.Val /end REF_CHARACTERISTIC /begin REF_MEASUREMENT /end REF_MEASUREMENT /end GROUP
/begin GROUP SnsrOffsLrng.SnsrOffsLrngHwTqLrngEna.Logl "MICROSAR RTE" /begin SUB_GROUP /end SUB_GROUP /begin FUNCTION_LIST /end FUNCTION_LIST /begin REF_CHARACTERISTIC SnsrOffsLrng.SnsrOffsLrngHwTqLrngEna.Logl /end REF_CHARACTERISTIC /begin REF_MEASUREMENT /end REF_MEASUREMENT /end GROUP
/begin GROUP SnsrOffsLrng.SnsrOffsLrngHwTqLrngEnaTiThd.Val "MICROSAR RTE" /begin SUB_GROUP /end SUB_GROUP /begin FUNCTION_LIST /end FUNCTION_LIST /begin REF_CHARACTERISTIC SnsrOffsLrng.SnsrOffsLrngHwTqLrngEnaTiThd.Val /end REF_CHARACTERISTIC /begin REF_MEASUREMENT /end REF_MEASUREMENT /end GROUP
/begin GROUP SnsrOffsLrng.SnsrOffsLrngHwTqLrngHwAgDbnd.Val "MICROSAR RTE" /begin SUB_GROUP /end SUB_GROUP /begin FUNCTION_LIST /end FUNCTION_LIST /begin REF_CHARACTERISTIC SnsrOffsLrng.SnsrOffsLrngHwTqLrngHwAgDbnd.Val /end REF_CHARACTERISTIC /begin REF_MEASUREMENT /end REF_MEASUREMENT /end GROUP
/begin GROUP SnsrOffsLrng.SnsrOffsLrngHwTqLrngHwAgThd.Val "MICROSAR RTE" /begin SUB_GROUP /end SUB_GROUP /begin FUNCTION_LIST /end FUNCTION_LIST /begin REF_CHARACTERISTIC SnsrOffsLrng.SnsrOffsLrngHwTqLrngHwAgThd.Val /end REF_CHARACTERISTIC /begin REF_MEASUREMENT /end REF_MEASUREMENT /end GROUP
/begin GROUP SnsrOffsLrng.SnsrOffsLrngHwTqLrngHwTqThd.Val "MICROSAR RTE" /begin SUB_GROUP /end SUB_GROUP /begin FUNCTION_LIST /end FUNCTION_LIST /begin REF_CHARACTERISTIC SnsrOffsLrng.SnsrOffsLrngHwTqLrngHwTqThd.Val /end REF_CHARACTERISTIC /begin REF_MEASUREMENT /end REF_MEASUREMENT /end GROUP
/begin GROUP SnsrOffsLrng.SnsrOffsLrngHwTqLrngHwTqZeroOffsThd.Val "MICROSAR RTE" /begin SUB_GROUP /end SUB_GROUP /begin FUNCTION_LIST /end FUNCTION_LIST /begin REF_CHARACTERISTIC SnsrOffsLrng.SnsrOffsLrngHwTqLrngHwTqZeroOffsThd.Val /end REF_CHARACTERISTIC /begin REF_MEASUREMENT /end REF_MEASUREMENT /end GROUP
/begin GROUP SnsrOffsLrng.SnsrOffsLrngHwTqLrngHwVelThd.Val "MICROSAR RTE" /begin SUB_GROUP /end SUB_GROUP /begin FUNCTION_LIST /end FUNCTION_LIST /begin REF_CHARACTERISTIC SnsrOffsLrng.SnsrOffsLrngHwTqLrngHwVelThd.Val /end REF_CHARACTERISTIC /begin REF_MEASUREMENT /end REF_MEASUREMENT /end GROUP
/begin GROUP SnsrOffsLrng.SnsrOffsLrngHwTqLrngMeasTi.Val "MICROSAR RTE" /begin SUB_GROUP /end SUB_GROUP /begin FUNCTION_LIST /end FUNCTION_LIST /begin REF_CHARACTERISTIC SnsrOffsLrng.SnsrOffsLrngHwTqLrngMeasTi.Val /end REF_CHARACTERISTIC /begin REF_MEASUREMENT /end REF_MEASUREMENT /end GROUP
/begin GROUP SnsrOffsLrng.SnsrOffsLrngHwTqLrngMeasTiScar.Val "MICROSAR RTE" /begin SUB_GROUP /end SUB_GROUP /begin FUNCTION_LIST /end FUNCTION_LIST /begin REF_CHARACTERISTIC SnsrOffsLrng.SnsrOffsLrngHwTqLrngMeasTiScar.Val /end REF_CHARACTERISTIC /begin REF_MEASUREMENT /end REF_MEASUREMENT /end GROUP
/begin GROUP SnsrOffsLrng.SnsrOffsLrngHwTqLrngSampleImbThd1.Val "MICROSAR RTE" /begin SUB_GROUP /end SUB_GROUP /begin FUNCTION_LIST /end FUNCTION_LIST /begin REF_CHARACTERISTIC SnsrOffsLrng.SnsrOffsLrngHwTqLrngSampleImbThd1.Val /end REF_CHARACTERISTIC /begin REF_MEASUREMENT /end REF_MEASUREMENT /end GROUP
/begin GROUP SnsrOffsLrng.SnsrOffsLrngHwTqLrngSampleImbThd2.Val "MICROSAR RTE" /begin SUB_GROUP /end SUB_GROUP /begin FUNCTION_LIST /end FUNCTION_LIST /begin REF_CHARACTERISTIC SnsrOffsLrng.SnsrOffsLrngHwTqLrngSampleImbThd2.Val /end REF_CHARACTERISTIC /begin REF_MEASUREMENT /end REF_MEASUREMENT /end GROUP
/begin GROUP SnsrOffsLrng.SnsrOffsLrngHwTqLrngSampleThd1.Val "MICROSAR RTE" /begin SUB_GROUP /end SUB_GROUP /begin FUNCTION_LIST /end FUNCTION_LIST /begin REF_CHARACTERISTIC SnsrOffsLrng.SnsrOffsLrngHwTqLrngSampleThd1.Val /end REF_CHARACTERISTIC /begin REF_MEASUREMENT /end REF_MEASUREMENT /end GROUP
/begin GROUP SnsrOffsLrng.SnsrOffsLrngHwTqLrngSampleThd2.Val "MICROSAR RTE" /begin SUB_GROUP /end SUB_GROUP /begin FUNCTION_LIST /end FUNCTION_LIST /begin REF_CHARACTERISTIC SnsrOffsLrng.SnsrOffsLrngHwTqLrngSampleThd2.Val /end REF_CHARACTERISTIC /begin REF_MEASUREMENT /end REF_MEASUREMENT /end GROUP
/begin GROUP SnsrOffsLrng.SnsrOffsLrngHwTqLrngTiWghtCoeff.Val "MICROSAR RTE" /begin SUB_GROUP /end SUB_GROUP /begin FUNCTION_LIST /end FUNCTION_LIST /begin REF_CHARACTERISTIC SnsrOffsLrng.SnsrOffsLrngHwTqLrngTiWghtCoeff.Val /end REF_CHARACTERISTIC /begin REF_MEASUREMENT /end REF_MEASUREMENT /end GROUP
/begin GROUP SnsrOffsLrng.SnsrOffsLrngHwTqLrngVehSpdThd.Val "MICROSAR RTE" /begin SUB_GROUP /end SUB_GROUP /begin FUNCTION_LIST /end FUNCTION_LIST /begin REF_CHARACTERISTIC SnsrOffsLrng.SnsrOffsLrngHwTqLrngVehSpdThd.Val /end REF_CHARACTERISTIC /begin REF_MEASUREMENT /end REF_MEASUREMENT /end GROUP
/begin GROUP SnsrOffsLrng.SnsrOffsLrngHwTqOffsLim.Val "MICROSAR RTE" /begin SUB_GROUP /end SUB_GROUP /begin FUNCTION_LIST /end FUNCTION_LIST /begin REF_CHARACTERISTIC SnsrOffsLrng.SnsrOffsLrngHwTqOffsLim.Val /end REF_CHARACTERISTIC /begin REF_MEASUREMENT /end REF_MEASUREMENT /end GROUP
/begin GROUP SnsrOffsLrng.SnsrOffsLrngHwVelFilFrq.Val "MICROSAR RTE" /begin SUB_GROUP /end SUB_GROUP /begin FUNCTION_LIST /end FUNCTION_LIST /begin REF_CHARACTERISTIC SnsrOffsLrng.SnsrOffsLrngHwVelFilFrq.Val /end REF_CHARACTERISTIC /begin REF_MEASUREMENT /end REF_MEASUREMENT /end GROUP
/begin GROUP SnsrOffsLrng.SnsrOffsLrngSampleCntForHwTqLrngRst.Val "MICROSAR RTE" /begin SUB_GROUP /end SUB_GROUP /begin FUNCTION_LIST /end FUNCTION_LIST /begin REF_CHARACTERISTIC SnsrOffsLrng.SnsrOffsLrngSampleCntForHwTqLrngRst.Val /end REF_CHARACTERISTIC /begin REF_MEASUREMENT /end REF_MEASUREMENT /end GROUP
/begin GROUP SnsrOffsLrng.SnsrOffsLrngTqAndAgFilFrq.Val "MICROSAR RTE" /begin SUB_GROUP /end SUB_GROUP /begin FUNCTION_LIST /end FUNCTION_LIST /begin REF_CHARACTERISTIC SnsrOffsLrng.SnsrOffsLrngTqAndAgFilFrq.Val /end REF_CHARACTERISTIC /begin REF_MEASUREMENT /end REF_MEASUREMENT /end GROUP
/begin GROUP SnsrOffsLrng.SnsrOffsLrngTqInpDetnHwTqFilFrq.Val "MICROSAR RTE" /begin SUB_GROUP /end SUB_GROUP /begin FUNCTION_LIST /end FUNCTION_LIST /begin REF_CHARACTERISTIC SnsrOffsLrng.SnsrOffsLrngTqInpDetnHwTqFilFrq.Val /end REF_CHARACTERISTIC /begin REF_MEASUREMENT /end REF_MEASUREMENT /end GROUP
/begin GROUP SnsrOffsLrng.SnsrOffsLrngTqInpDetnPwrEstimnThd.Val "MICROSAR RTE" /begin SUB_GROUP /end SUB_GROUP /begin FUNCTION_LIST /end FUNCTION_LIST /begin REF_CHARACTERISTIC SnsrOffsLrng.SnsrOffsLrngTqInpDetnPwrEstimnThd.Val /end REF_CHARACTERISTIC /begin REF_MEASUREMENT /end REF_MEASUREMENT /end GROUP
/begin GROUP SnsrOffsLrng.SnsrOffsLrngTqInpDetnSinGenrAmp.Val "MICROSAR RTE" /begin SUB_GROUP /end SUB_GROUP /begin FUNCTION_LIST /end FUNCTION_LIST /begin REF_CHARACTERISTIC SnsrOffsLrng.SnsrOffsLrngTqInpDetnSinGenrAmp.Val /end REF_CHARACTERISTIC /begin REF_MEASUREMENT /end REF_MEASUREMENT /end GROUP
/begin GROUP SnsrOffsLrng.SnsrOffsLrngTqInpDetnSinGenrFrq.Val "MICROSAR RTE" /begin SUB_GROUP /end SUB_GROUP /begin FUNCTION_LIST /end FUNCTION_LIST /begin REF_CHARACTERISTIC SnsrOffsLrng.SnsrOffsLrngTqInpDetnSinGenrFrq.Val /end REF_CHARACTERISTIC /begin REF_MEASUREMENT /end REF_MEASUREMENT /end GROUP
/begin GROUP SnsrOffsLrng.SnsrOffsLrngTqInpDetnStg1FilGain.Val "MICROSAR RTE" /begin SUB_GROUP /end SUB_GROUP /begin FUNCTION_LIST /end FUNCTION_LIST /begin REF_CHARACTERISTIC SnsrOffsLrng.SnsrOffsLrngTqInpDetnStg1FilGain.Val /end REF_CHARACTERISTIC /begin REF_MEASUREMENT /end REF_MEASUREMENT /end GROUP
/begin GROUP SnsrOffsLrng.SnsrOffsLrngTqInpDetnStg1WinSize.Val "MICROSAR RTE" /begin SUB_GROUP /end SUB_GROUP /begin FUNCTION_LIST /end FUNCTION_LIST /begin REF_CHARACTERISTIC SnsrOffsLrng.SnsrOffsLrngTqInpDetnStg1WinSize.Val /end REF_CHARACTERISTIC /begin REF_MEASUREMENT /end REF_MEASUREMENT /end GROUP
/begin GROUP SnsrOffsLrng.SnsrOffsLrngTqInpDetnStg2FilGainCen.Val "MICROSAR RTE" /begin SUB_GROUP /end SUB_GROUP /begin FUNCTION_LIST /end FUNCTION_LIST /begin REF_CHARACTERISTIC SnsrOffsLrng.SnsrOffsLrngTqInpDetnStg2FilGainCen.Val /end REF_CHARACTERISTIC /begin REF_MEASUREMENT /end REF_MEASUREMENT /end GROUP
/begin GROUP SnsrOffsLrng.SnsrOffsLrngTqInpDetnStg2FilGainDwn.Val "MICROSAR RTE" /begin SUB_GROUP /end SUB_GROUP /begin FUNCTION_LIST /end FUNCTION_LIST /begin REF_CHARACTERISTIC SnsrOffsLrng.SnsrOffsLrngTqInpDetnStg2FilGainDwn.Val /end REF_CHARACTERISTIC /begin REF_MEASUREMENT /end REF_MEASUREMENT /end GROUP
/begin GROUP SnsrOffsLrng.SnsrOffsLrngTqInpDetnStg2FilGainUp.Val "MICROSAR RTE" /begin SUB_GROUP /end SUB_GROUP /begin FUNCTION_LIST /end FUNCTION_LIST /begin REF_CHARACTERISTIC SnsrOffsLrng.SnsrOffsLrngTqInpDetnStg2FilGainUp.Val /end REF_CHARACTERISTIC /begin REF_MEASUREMENT /end REF_MEASUREMENT /end GROUP
/begin GROUP SnsrOffsLrng.SnsrOffsLrngTqInpDetnStg2WinSize.Val "MICROSAR RTE" /begin SUB_GROUP /end SUB_GROUP /begin FUNCTION_LIST /end FUNCTION_LIST /begin REF_CHARACTERISTIC SnsrOffsLrng.SnsrOffsLrngTqInpDetnStg2WinSize.Val /end REF_CHARACTERISTIC /begin REF_MEASUREMENT /end REF_MEASUREMENT /end GROUP
/begin GROUP SnsrOffsLrng.SnsrOffsLrngYawACdngFilFrq.Val "MICROSAR RTE" /begin SUB_GROUP /end SUB_GROUP /begin FUNCTION_LIST /end FUNCTION_LIST /begin REF_CHARACTERISTIC SnsrOffsLrng.SnsrOffsLrngYawACdngFilFrq.Val /end REF_CHARACTERISTIC /begin REF_MEASUREMENT /end REF_MEASUREMENT /end GROUP
/begin GROUP SnsrOffsLrng.SnsrOffsLrngYawLrngEna.Logl "MICROSAR RTE" /begin SUB_GROUP /end SUB_GROUP /begin FUNCTION_LIST /end FUNCTION_LIST /begin REF_CHARACTERISTIC SnsrOffsLrng.SnsrOffsLrngYawLrngEna.Logl /end REF_CHARACTERISTIC /begin REF_MEASUREMENT /end REF_MEASUREMENT /end GROUP
/begin GROUP SnsrOffsLrng.SnsrOffsLrngYawLrngHwAgThd.Val "MICROSAR RTE" /begin SUB_GROUP /end SUB_GROUP /begin FUNCTION_LIST /end FUNCTION_LIST /begin REF_CHARACTERISTIC SnsrOffsLrng.SnsrOffsLrngYawLrngHwAgThd.Val /end REF_CHARACTERISTIC /begin REF_MEASUREMENT /end REF_MEASUREMENT /end GROUP
/begin GROUP SnsrOffsLrng.SnsrOffsLrngYawLrngTi.Val "MICROSAR RTE" /begin SUB_GROUP /end SUB_GROUP /begin FUNCTION_LIST /end FUNCTION_LIST /begin REF_CHARACTERISTIC SnsrOffsLrng.SnsrOffsLrngYawLrngTi.Val /end REF_CHARACTERISTIC /begin REF_MEASUREMENT /end REF_MEASUREMENT /end GROUP
/begin GROUP SnsrOffsLrng.SnsrOffsLrngYawLrngYawAThd.Val "MICROSAR RTE" /begin SUB_GROUP /end SUB_GROUP /begin FUNCTION_LIST /end FUNCTION_LIST /begin REF_CHARACTERISTIC SnsrOffsLrng.SnsrOffsLrngYawLrngYawAThd.Val /end REF_CHARACTERISTIC /begin REF_MEASUREMENT /end REF_MEASUREMENT /end GROUP
/begin GROUP SnsrOffsLrng.SnsrOffsLrngYawOffsFrshTiThd.Val "MICROSAR RTE" /begin SUB_GROUP /end SUB_GROUP /begin FUNCTION_LIST /end FUNCTION_LIST /begin REF_CHARACTERISTIC SnsrOffsLrng.SnsrOffsLrngYawOffsFrshTiThd.Val /end REF_CHARACTERISTIC /begin REF_MEASUREMENT /end REF_MEASUREMENT /end GROUP
/begin GROUP SnsrOffsLrng.SnsrOffsLrngYawRateCdngFilFrq.Val "MICROSAR RTE" /begin SUB_GROUP /end SUB_GROUP /begin FUNCTION_LIST /end FUNCTION_LIST /begin REF_CHARACTERISTIC SnsrOffsLrng.SnsrOffsLrngYawRateCdngFilFrq.Val /end REF_CHARACTERISTIC /begin REF_MEASUREMENT /end REF_MEASUREMENT /end GROUP
/begin GROUP SnsrOffsLrng.SnsrOffsLrngYawRateOffsLim.Val "MICROSAR RTE" /begin SUB_GROUP /end SUB_GROUP /begin FUNCTION_LIST /end FUNCTION_LIST /begin REF_CHARACTERISTIC SnsrOffsLrng.SnsrOffsLrngYawRateOffsLim.Val /end REF_CHARACTERISTIC /begin REF_MEASUREMENT /end REF_MEASUREMENT /end GROUP
/begin GROUP SnsrOffsLrng.SysGlbPrmSysTqRat.Val "MICROSAR RTE" /begin SUB_GROUP /end SUB_GROUP /begin FUNCTION_LIST /end FUNCTION_LIST /begin REF_CHARACTERISTIC SnsrOffsLrng.SysGlbPrmSysTqRat.Val /end REF_CHARACTERISTIC /begin REF_MEASUREMENT /end REF_MEASUREMENT /end GROUP
/begin GROUP SnsrOffsLrng.SysTqCdngFil "MICROSAR RTE" /begin SUB_GROUP /end SUB_GROUP /begin FUNCTION_LIST /end FUNCTION_LIST /begin REF_CHARACTERISTIC /end REF_CHARACTERISTIC
 /begin REF_MEASUREMENT SnsrOffsLrng.SysTqCdngFil.FilGain SnsrOffsLrng.SysTqCdngFil.FilSt /end REF_MEASUREMENT
/end GROUP
/begin GROUP SnsrOffsLrng.TqInpDetnEnaTi "MICROSAR RTE" /begin SUB_GROUP /end SUB_GROUP /begin FUNCTION_LIST /end FUNCTION_LIST /begin REF_CHARACTERISTIC /end REF_CHARACTERISTIC /begin REF_MEASUREMENT SnsrOffsLrng.TqInpDetnEnaTi /end REF_MEASUREMENT /end GROUP
/begin GROUP SnsrOffsLrng.TqInpDetnHwTqFil "MICROSAR RTE" /begin SUB_GROUP /end SUB_GROUP /begin FUNCTION_LIST /end FUNCTION_LIST /begin REF_CHARACTERISTIC /end REF_CHARACTERISTIC
 /begin REF_MEASUREMENT SnsrOffsLrng.TqInpDetnHwTqFil.FilGain SnsrOffsLrng.TqInpDetnHwTqFil.FilSt /end REF_MEASUREMENT
/end GROUP
/begin GROUP SnsrOffsLrng.TqInpDetnHwTqPreProc "MICROSAR RTE" /begin SUB_GROUP /end SUB_GROUP /begin FUNCTION_LIST /end FUNCTION_LIST /begin REF_CHARACTERISTIC /end REF_CHARACTERISTIC /begin REF_MEASUREMENT SnsrOffsLrng.TqInpDetnHwTqPreProc /end REF_MEASUREMENT /end GROUP
/begin GROUP SnsrOffsLrng.TqInpDetnPreProcEnaLoop "MICROSAR RTE" /begin SUB_GROUP /end SUB_GROUP /begin FUNCTION_LIST /end FUNCTION_LIST /begin REF_CHARACTERISTIC /end REF_CHARACTERISTIC /begin REF_MEASUREMENT SnsrOffsLrng.TqInpDetnPreProcEnaLoop /end REF_MEASUREMENT /end GROUP
/begin GROUP SnsrOffsLrng.TqInpDetnSinGenrAg "MICROSAR RTE" /begin SUB_GROUP /end SUB_GROUP /begin FUNCTION_LIST /end FUNCTION_LIST /begin REF_CHARACTERISTIC /end REF_CHARACTERISTIC /begin REF_MEASUREMENT SnsrOffsLrng.TqInpDetnSinGenrAg /end REF_MEASUREMENT /end GROUP
/begin GROUP SnsrOffsLrng.TqInpDetnStg1Buf "MICROSAR RTE" /begin SUB_GROUP /end SUB_GROUP /begin FUNCTION_LIST /end FUNCTION_LIST /begin REF_CHARACTERISTIC /end REF_CHARACTERISTIC /begin REF_MEASUREMENT SnsrOffsLrng.TqInpDetnStg1Buf /end REF_MEASUREMENT /end GROUP
/begin GROUP SnsrOffsLrng.TqInpDetnStg1FilSt1 "MICROSAR RTE" /begin SUB_GROUP /end SUB_GROUP /begin FUNCTION_LIST /end FUNCTION_LIST /begin REF_CHARACTERISTIC /end REF_CHARACTERISTIC /begin REF_MEASUREMENT SnsrOffsLrng.TqInpDetnStg1FilSt1 /end REF_MEASUREMENT /end GROUP
/begin GROUP SnsrOffsLrng.TqInpDetnStg1FilSt2 "MICROSAR RTE" /begin SUB_GROUP /end SUB_GROUP /begin FUNCTION_LIST /end FUNCTION_LIST /begin REF_CHARACTERISTIC /end REF_CHARACTERISTIC /begin REF_MEASUREMENT SnsrOffsLrng.TqInpDetnStg1FilSt2 /end REF_MEASUREMENT /end GROUP
/begin GROUP SnsrOffsLrng.TqInpDetnStg1Idx "MICROSAR RTE" /begin SUB_GROUP /end SUB_GROUP /begin FUNCTION_LIST /end FUNCTION_LIST /begin REF_CHARACTERISTIC /end REF_CHARACTERISTIC /begin REF_MEASUREMENT SnsrOffsLrng.TqInpDetnStg1Idx /end REF_MEASUREMENT /end GROUP
/begin GROUP SnsrOffsLrng.TqInpDetnStg2CenFilSt1 "MICROSAR RTE" /begin SUB_GROUP /end SUB_GROUP /begin FUNCTION_LIST /end FUNCTION_LIST /begin REF_CHARACTERISTIC /end REF_CHARACTERISTIC /begin REF_MEASUREMENT SnsrOffsLrng.TqInpDetnStg2CenFilSt1 /end REF_MEASUREMENT /end GROUP
/begin GROUP SnsrOffsLrng.TqInpDetnStg2CenFilSt2 "MICROSAR RTE" /begin SUB_GROUP /end SUB_GROUP /begin FUNCTION_LIST /end FUNCTION_LIST /begin REF_CHARACTERISTIC /end REF_CHARACTERISTIC /begin REF_MEASUREMENT SnsrOffsLrng.TqInpDetnStg2CenFilSt2 /end REF_MEASUREMENT /end GROUP
/begin GROUP SnsrOffsLrng.TqInpDetnStg2DwnFilSt1 "MICROSAR RTE" /begin SUB_GROUP /end SUB_GROUP /begin FUNCTION_LIST /end FUNCTION_LIST /begin REF_CHARACTERISTIC /end REF_CHARACTERISTIC /begin REF_MEASUREMENT SnsrOffsLrng.TqInpDetnStg2DwnFilSt1 /end REF_MEASUREMENT /end GROUP
/begin GROUP SnsrOffsLrng.TqInpDetnStg2DwnFilSt2 "MICROSAR RTE" /begin SUB_GROUP /end SUB_GROUP /begin FUNCTION_LIST /end FUNCTION_LIST /begin REF_CHARACTERISTIC /end REF_CHARACTERISTIC /begin REF_MEASUREMENT SnsrOffsLrng.TqInpDetnStg2DwnFilSt2 /end REF_MEASUREMENT /end GROUP
/begin GROUP SnsrOffsLrng.TqInpDetnStg2UpFilSt1 "MICROSAR RTE" /begin SUB_GROUP /end SUB_GROUP /begin FUNCTION_LIST /end FUNCTION_LIST /begin REF_CHARACTERISTIC /end REF_CHARACTERISTIC /begin REF_MEASUREMENT SnsrOffsLrng.TqInpDetnStg2UpFilSt1 /end REF_MEASUREMENT /end GROUP
/begin GROUP SnsrOffsLrng.TqInpDetnStg2UpFilSt2 "MICROSAR RTE" /begin SUB_GROUP /end SUB_GROUP /begin FUNCTION_LIST /end FUNCTION_LIST /begin REF_CHARACTERISTIC /end REF_CHARACTERISTIC /begin REF_MEASUREMENT SnsrOffsLrng.TqInpDetnStg2UpFilSt2 /end REF_MEASUREMENT /end GROUP
/begin GROUP SnsrOffsLrng.VehSpd.Val "MICROSAR RTE" /begin SUB_GROUP /end SUB_GROUP /begin FUNCTION_LIST /end FUNCTION_LIST /begin REF_CHARACTERISTIC /end REF_CHARACTERISTIC /begin REF_MEASUREMENT SnsrOffsLrng.VehSpd.Val /end REF_MEASUREMENT /end GROUP
/begin GROUP SnsrOffsLrng.VehSpdVld.Logl "MICROSAR RTE" /begin SUB_GROUP /end SUB_GROUP /begin FUNCTION_LIST /end FUNCTION_LIST /begin REF_CHARACTERISTIC /end REF_CHARACTERISTIC /begin REF_MEASUREMENT SnsrOffsLrng.VehSpdVld.Logl /end REF_MEASUREMENT /end GROUP
/begin GROUP SnsrOffsLrng.VehYawRate.Val "MICROSAR RTE" /begin SUB_GROUP /end SUB_GROUP /begin FUNCTION_LIST /end FUNCTION_LIST /begin REF_CHARACTERISTIC /end REF_CHARACTERISTIC /begin REF_MEASUREMENT SnsrOffsLrng.VehYawRate.Val /end REF_MEASUREMENT /end GROUP
/begin GROUP SnsrOffsLrng.VehYawRateLrngStRst "MICROSAR RTE" /begin SUB_GROUP /end SUB_GROUP /begin FUNCTION_LIST /end FUNCTION_LIST /begin REF_CHARACTERISTIC /end REF_CHARACTERISTIC /begin REF_MEASUREMENT SnsrOffsLrng.VehYawRateLrngStRst /end REF_MEASUREMENT /end GROUP
/begin GROUP SnsrOffsLrng.VehYawRateOffs.Val "MICROSAR RTE" /begin SUB_GROUP /end SUB_GROUP /begin FUNCTION_LIST /end FUNCTION_LIST /begin REF_CHARACTERISTIC /end REF_CHARACTERISTIC /begin REF_MEASUREMENT SnsrOffsLrng.VehYawRateOffs.Val /end REF_MEASUREMENT /end GROUP
/begin GROUP SnsrOffsLrng.VehYawRateOffsFrsh "MICROSAR RTE" /begin SUB_GROUP /end SUB_GROUP /begin FUNCTION_LIST /end FUNCTION_LIST /begin REF_CHARACTERISTIC /end REF_CHARACTERISTIC /begin REF_MEASUREMENT SnsrOffsLrng.VehYawRateOffsFrsh /end REF_MEASUREMENT /end GROUP
/begin GROUP SnsrOffsLrng.VehYawRateVld.Logl "MICROSAR RTE" /begin SUB_GROUP /end SUB_GROUP /begin FUNCTION_LIST /end FUNCTION_LIST /begin REF_CHARACTERISTIC /end REF_CHARACTERISTIC /begin REF_MEASUREMENT SnsrOffsLrng.VehYawRateVld.Logl /end REF_MEASUREMENT /end GROUP
/begin GROUP SnsrOffsLrng.YawACdngFil "MICROSAR RTE" /begin SUB_GROUP /end SUB_GROUP /begin FUNCTION_LIST /end FUNCTION_LIST /begin REF_CHARACTERISTIC /end REF_CHARACTERISTIC
 /begin REF_MEASUREMENT SnsrOffsLrng.YawACdngFil.FilGain SnsrOffsLrng.YawACdngFil.FilSt /end REF_MEASUREMENT
/end GROUP
/begin GROUP SnsrOffsLrng.YawCdngFil1 "MICROSAR RTE" /begin SUB_GROUP /end SUB_GROUP /begin FUNCTION_LIST /end FUNCTION_LIST /begin REF_CHARACTERISTIC /end REF_CHARACTERISTIC
 /begin REF_MEASUREMENT SnsrOffsLrng.YawCdngFil1.FilGain SnsrOffsLrng.YawCdngFil1.FilSt /end REF_MEASUREMENT
/end GROUP
/begin GROUP SnsrOffsLrng.YawCdngFil2 "MICROSAR RTE" /begin SUB_GROUP /end SUB_GROUP /begin FUNCTION_LIST /end FUNCTION_LIST /begin REF_CHARACTERISTIC /end REF_CHARACTERISTIC
 /begin REF_MEASUREMENT SnsrOffsLrng.YawCdngFil2.FilGain SnsrOffsLrng.YawCdngFil2.FilSt /end REF_MEASUREMENT
/end GROUP
/begin GROUP SnsrOffsLrng.YawLrngElpdLrngTi "MICROSAR RTE" /begin SUB_GROUP /end SUB_GROUP /begin FUNCTION_LIST /end FUNCTION_LIST /begin REF_CHARACTERISTIC /end REF_CHARACTERISTIC /begin REF_MEASUREMENT SnsrOffsLrng.YawLrngElpdLrngTi /end REF_MEASUREMENT /end GROUP
/begin GROUP SnsrOffsLrng.YawLrngFil1 "MICROSAR RTE" /begin SUB_GROUP /end SUB_GROUP /begin FUNCTION_LIST /end FUNCTION_LIST /begin REF_CHARACTERISTIC /end REF_CHARACTERISTIC
 /begin REF_MEASUREMENT SnsrOffsLrng.YawLrngFil1.FilGain SnsrOffsLrng.YawLrngFil1.FilSt /end REF_MEASUREMENT
/end GROUP
/begin GROUP SnsrOffsLrng.YawLrngFil2 "MICROSAR RTE" /begin SUB_GROUP /end SUB_GROUP /begin FUNCTION_LIST /end FUNCTION_LIST /begin REF_CHARACTERISTIC /end REF_CHARACTERISTIC
 /begin REF_MEASUREMENT SnsrOffsLrng.YawLrngFil2.FilGain SnsrOffsLrng.YawLrngFil2.FilSt /end REF_MEASUREMENT
/end GROUP
/begin GROUP SnsrOffsLrng.YawRatePrev "MICROSAR RTE" /begin SUB_GROUP /end SUB_GROUP /begin FUNCTION_LIST /end FUNCTION_LIST /begin REF_CHARACTERISTIC /end REF_CHARACTERISTIC /begin REF_MEASUREMENT SnsrOffsLrng.YawRatePrev /end REF_MEASUREMENT /end GROUP
/begin GROUP SnsrOffsLrng.dSnsrOffsLrngHwAgFild "MICROSAR RTE" /begin SUB_GROUP /end SUB_GROUP /begin FUNCTION_LIST /end FUNCTION_LIST /begin REF_CHARACTERISTIC /end REF_CHARACTERISTIC /begin REF_MEASUREMENT SnsrOffsLrng.dSnsrOffsLrngHwAgFild /end REF_MEASUREMENT /end GROUP
/begin GROUP SnsrOffsLrng.dSnsrOffsLrngHwAgLrngCdnVld "MICROSAR RTE" /begin SUB_GROUP /end SUB_GROUP /begin FUNCTION_LIST /end FUNCTION_LIST /begin REF_CHARACTERISTIC /end REF_CHARACTERISTIC /begin REF_MEASUREMENT SnsrOffsLrng.dSnsrOffsLrngHwAgLrngCdnVld /end REF_MEASUREMENT /end GROUP
/begin GROUP SnsrOffsLrng.dSnsrOffsLrngHwAgLrngEna "MICROSAR RTE" /begin SUB_GROUP /end SUB_GROUP /begin FUNCTION_LIST /end FUNCTION_LIST /begin REF_CHARACTERISTIC /end REF_CHARACTERISTIC /begin REF_MEASUREMENT SnsrOffsLrng.dSnsrOffsLrngHwAgLrngEna /end REF_MEASUREMENT /end GROUP
/begin GROUP SnsrOffsLrng.dSnsrOffsLrngHwAgLrngRst "MICROSAR RTE" /begin SUB_GROUP /end SUB_GROUP /begin FUNCTION_LIST /end FUNCTION_LIST /begin REF_CHARACTERISTIC /end REF_CHARACTERISTIC /begin REF_MEASUREMENT SnsrOffsLrng.dSnsrOffsLrngHwAgLrngRst /end REF_MEASUREMENT /end GROUP
/begin GROUP SnsrOffsLrng.dSnsrOffsLrngHwAgLrngSysTqLoThd "MICROSAR RTE" /begin SUB_GROUP /end SUB_GROUP /begin FUNCTION_LIST /end FUNCTION_LIST /begin REF_CHARACTERISTIC /end REF_CHARACTERISTIC /begin REF_MEASUREMENT SnsrOffsLrng.dSnsrOffsLrngHwAgLrngSysTqLoThd /end REF_MEASUREMENT /end GROUP
/begin GROUP SnsrOffsLrng.dSnsrOffsLrngHwAgLrngSysTqUpThd "MICROSAR RTE" /begin SUB_GROUP /end SUB_GROUP /begin FUNCTION_LIST /end FUNCTION_LIST /begin REF_CHARACTERISTIC /end REF_CHARACTERISTIC /begin REF_MEASUREMENT SnsrOffsLrng.dSnsrOffsLrngHwAgLrngSysTqUpThd /end REF_MEASUREMENT /end GROUP
/begin GROUP SnsrOffsLrng.dSnsrOffsLrngHwAgLrngSysTqVldt "MICROSAR RTE" /begin SUB_GROUP /end SUB_GROUP /begin FUNCTION_LIST /end FUNCTION_LIST /begin REF_CHARACTERISTIC /end REF_CHARACTERISTIC /begin REF_MEASUREMENT SnsrOffsLrng.dSnsrOffsLrngHwAgLrngSysTqVldt /end REF_MEASUREMENT /end GROUP
/begin GROUP SnsrOffsLrng.dSnsrOffsLrngHwAgLrngTiVldt "MICROSAR RTE" /begin SUB_GROUP /end SUB_GROUP /begin FUNCTION_LIST /end FUNCTION_LIST /begin REF_CHARACTERISTIC /end REF_CHARACTERISTIC /begin REF_MEASUREMENT SnsrOffsLrng.dSnsrOffsLrngHwAgLrngTiVldt /end REF_MEASUREMENT /end GROUP
/begin GROUP SnsrOffsLrng.dSnsrOffsLrngHwTqLrngEna "MICROSAR RTE" /begin SUB_GROUP /end SUB_GROUP /begin FUNCTION_LIST /end FUNCTION_LIST /begin REF_CHARACTERISTIC /end REF_CHARACTERISTIC /begin REF_MEASUREMENT SnsrOffsLrng.dSnsrOffsLrngHwTqLrngEna /end REF_MEASUREMENT /end GROUP
/begin GROUP SnsrOffsLrng.dSnsrOffsLrngHwTqLrngEstimnVldt "MICROSAR RTE" /begin SUB_GROUP /end SUB_GROUP /begin FUNCTION_LIST /end FUNCTION_LIST /begin REF_CHARACTERISTIC /end REF_CHARACTERISTIC /begin REF_MEASUREMENT SnsrOffsLrng.dSnsrOffsLrngHwTqLrngEstimnVldt /end REF_MEASUREMENT /end GROUP
/begin GROUP SnsrOffsLrng.dSnsrOffsLrngHwTqLrngHwAgMeas "MICROSAR RTE" /begin SUB_GROUP /end SUB_GROUP /begin FUNCTION_LIST /end FUNCTION_LIST /begin REF_CHARACTERISTIC /end REF_CHARACTERISTIC /begin REF_MEASUREMENT SnsrOffsLrng.dSnsrOffsLrngHwTqLrngHwAgMeas /end REF_MEASUREMENT /end GROUP
/begin GROUP SnsrOffsLrng.dSnsrOffsLrngHwTqLrngHwTqMeas "MICROSAR RTE" /begin SUB_GROUP /end SUB_GROUP /begin FUNCTION_LIST /end FUNCTION_LIST /begin REF_CHARACTERISTIC /end REF_CHARACTERISTIC /begin REF_MEASUREMENT SnsrOffsLrng.dSnsrOffsLrngHwTqLrngHwTqMeas /end REF_MEASUREMENT /end GROUP
/begin GROUP SnsrOffsLrng.dSnsrOffsLrngHwTqLrngHwTqOffsRaw "MICROSAR RTE" /begin SUB_GROUP /end SUB_GROUP /begin FUNCTION_LIST /end FUNCTION_LIST /begin REF_CHARACTERISTIC /end REF_CHARACTERISTIC /begin REF_MEASUREMENT SnsrOffsLrng.dSnsrOffsLrngHwTqLrngHwTqOffsRaw /end REF_MEASUREMENT /end GROUP
/begin GROUP SnsrOffsLrng.dSnsrOffsLrngHwTqLrngMeasEna "MICROSAR RTE" /begin SUB_GROUP /end SUB_GROUP /begin FUNCTION_LIST /end FUNCTION_LIST /begin REF_CHARACTERISTIC /end REF_CHARACTERISTIC /begin REF_MEASUREMENT SnsrOffsLrng.dSnsrOffsLrngHwTqLrngMeasEna /end REF_MEASUREMENT /end GROUP
/begin GROUP SnsrOffsLrng.dSnsrOffsLrngHwTqLrngSampleCntTot "MICROSAR RTE" /begin SUB_GROUP /end SUB_GROUP /begin FUNCTION_LIST /end FUNCTION_LIST /begin REF_CHARACTERISTIC /end REF_CHARACTERISTIC /begin REF_MEASUREMENT SnsrOffsLrng.dSnsrOffsLrngHwTqLrngSampleCntTot /end REF_MEASUREMENT /end GROUP
/begin GROUP SnsrOffsLrng.dSnsrOffsLrngHwTqLrngSampleImb "MICROSAR RTE" /begin SUB_GROUP /end SUB_GROUP /begin FUNCTION_LIST /end FUNCTION_LIST /begin REF_CHARACTERISTIC /end REF_CHARACTERISTIC /begin REF_MEASUREMENT SnsrOffsLrng.dSnsrOffsLrngHwTqLrngSampleImb /end REF_MEASUREMENT /end GROUP
/begin GROUP SnsrOffsLrng.dSnsrOffsLrngHwTqLrngTqInpPrsnt "MICROSAR RTE" /begin SUB_GROUP /end SUB_GROUP /begin FUNCTION_LIST /end FUNCTION_LIST /begin REF_CHARACTERISTIC /end REF_CHARACTERISTIC /begin REF_MEASUREMENT SnsrOffsLrng.dSnsrOffsLrngHwTqLrngTqInpPrsnt /end REF_MEASUREMENT /end GROUP
/begin GROUP SnsrOffsLrng.dSnsrOffsLrngHwTqLrngTqInpPrsntVld "MICROSAR RTE" /begin SUB_GROUP /end SUB_GROUP /begin FUNCTION_LIST /end FUNCTION_LIST /begin REF_CHARACTERISTIC /end REF_CHARACTERISTIC /begin REF_MEASUREMENT SnsrOffsLrng.dSnsrOffsLrngHwTqLrngTqInpPrsntVld /end REF_MEASUREMENT /end GROUP
/begin GROUP SnsrOffsLrng.dSnsrOffsLrngHwVelFild "MICROSAR RTE" /begin SUB_GROUP /end SUB_GROUP /begin FUNCTION_LIST /end FUNCTION_LIST /begin REF_CHARACTERISTIC /end REF_CHARACTERISTIC /begin REF_MEASUREMENT SnsrOffsLrng.dSnsrOffsLrngHwVelFild /end REF_MEASUREMENT /end GROUP
/begin GROUP SnsrOffsLrng.dSnsrOffsLrngSysTqFild "MICROSAR RTE" /begin SUB_GROUP /end SUB_GROUP /begin FUNCTION_LIST /end FUNCTION_LIST /begin REF_CHARACTERISTIC /end REF_CHARACTERISTIC /begin REF_MEASUREMENT SnsrOffsLrng.dSnsrOffsLrngSysTqFild /end REF_MEASUREMENT /end GROUP
/begin GROUP SnsrOffsLrng.dSnsrOffsLrngTqInpDetnHwTqFild "MICROSAR RTE" /begin SUB_GROUP /end SUB_GROUP /begin FUNCTION_LIST /end FUNCTION_LIST /begin REF_CHARACTERISTIC /end REF_CHARACTERISTIC /begin REF_MEASUREMENT SnsrOffsLrng.dSnsrOffsLrngTqInpDetnHwTqFild /end REF_MEASUREMENT /end GROUP
/begin GROUP SnsrOffsLrng.dSnsrOffsLrngTqInpDetnStg1Outp "MICROSAR RTE" /begin SUB_GROUP /end SUB_GROUP /begin FUNCTION_LIST /end FUNCTION_LIST /begin REF_CHARACTERISTIC /end REF_CHARACTERISTIC /begin REF_MEASUREMENT SnsrOffsLrng.dSnsrOffsLrngTqInpDetnStg1Outp /end REF_MEASUREMENT /end GROUP
/begin GROUP SnsrOffsLrng.dSnsrOffsLrngTqInpPrsntRaw "MICROSAR RTE" /begin SUB_GROUP /end SUB_GROUP /begin FUNCTION_LIST /end FUNCTION_LIST /begin REF_CHARACTERISTIC /end REF_CHARACTERISTIC /begin REF_MEASUREMENT SnsrOffsLrng.dSnsrOffsLrngTqInpPrsntRaw /end REF_MEASUREMENT /end GROUP
/begin GROUP SnsrOffsLrng.dSnsrOffsLrngYawA "MICROSAR RTE" /begin SUB_GROUP /end SUB_GROUP /begin FUNCTION_LIST /end FUNCTION_LIST /begin REF_CHARACTERISTIC /end REF_CHARACTERISTIC /begin REF_MEASUREMENT SnsrOffsLrng.dSnsrOffsLrngYawA /end REF_MEASUREMENT /end GROUP
/begin GROUP SnsrOffsLrng.dSnsrOffsLrngYawLrngBiasEstimnRaw "MICROSAR RTE" /begin SUB_GROUP /end SUB_GROUP /begin FUNCTION_LIST /end FUNCTION_LIST /begin REF_CHARACTERISTIC /end REF_CHARACTERISTIC /begin REF_MEASUREMENT SnsrOffsLrng.dSnsrOffsLrngYawLrngBiasEstimnRaw /end REF_MEASUREMENT /end GROUP
/begin GROUP SnsrOffsLrng.dSnsrOffsLrngYawLrngCdnVld "MICROSAR RTE" /begin SUB_GROUP /end SUB_GROUP /begin FUNCTION_LIST /end FUNCTION_LIST /begin REF_CHARACTERISTIC /end REF_CHARACTERISTIC /begin REF_MEASUREMENT SnsrOffsLrng.dSnsrOffsLrngYawLrngCdnVld /end REF_MEASUREMENT /end GROUP
/begin GROUP SnsrOffsLrng.dSnsrOffsLrngYawLrngEna "MICROSAR RTE" /begin SUB_GROUP /end SUB_GROUP /begin FUNCTION_LIST /end FUNCTION_LIST /begin REF_CHARACTERISTIC /end REF_CHARACTERISTIC /begin REF_MEASUREMENT SnsrOffsLrng.dSnsrOffsLrngYawLrngEna /end REF_MEASUREMENT /end GROUP
/begin GROUP SnsrOffsLrng.dSnsrOffsLrngYawRateFild "MICROSAR RTE" /begin SUB_GROUP /end SUB_GROUP /begin FUNCTION_LIST /end FUNCTION_LIST /begin REF_CHARACTERISTIC /end REF_CHARACTERISTIC /begin REF_MEASUREMENT SnsrOffsLrng.dSnsrOffsLrngYawRateFild /end REF_MEASUREMENT /end GROUP
/begin GROUP SnsrOffsLrng.dSnsrOffsLrngYawRateFildCorrd "MICROSAR RTE" /begin SUB_GROUP /end SUB_GROUP /begin FUNCTION_LIST /end FUNCTION_LIST /begin REF_CHARACTERISTIC /end REF_CHARACTERISTIC /begin REF_MEASUREMENT SnsrOffsLrng.dSnsrOffsLrngYawRateFildCorrd /end REF_MEASUREMENT /end GROUP
/begin GROUP StHlthSigNormn "MICROSAR RTE"
 /begin SUB_GROUP StHlthSigNormn.CalibrationPorts StHlthSigNormn.PerInstanceMemories StHlthSigNormn.ReceiverPorts StHlthSigNormn.SenderPorts /end SUB_GROUP
 /begin FUNCTION_LIST /end FUNCTION_LIST
 /begin REF_CHARACTERISTIC /end REF_CHARACTERISTIC
 /begin REF_MEASUREMENT /end REF_MEASUREMENT
/end GROUP
/begin GROUP StHlthSigNormn.AbsltMotPosABDifStHlth.Val "MICROSAR RTE" /begin SUB_GROUP /end SUB_GROUP /begin FUNCTION_LIST /end FUNCTION_LIST /begin REF_CHARACTERISTIC /end REF_CHARACTERISTIC /begin REF_MEASUREMENT StHlthSigNormn.AbsltMotPosABDifStHlth.Val /end REF_MEASUREMENT /end GROUP
/begin GROUP StHlthSigNormn.AbsltMotPosABDifStHlthSts "MICROSAR RTE" /begin SUB_GROUP /end SUB_GROUP /begin FUNCTION_LIST /end FUNCTION_LIST /begin REF_CHARACTERISTIC /end REF_CHARACTERISTIC /begin REF_MEASUREMENT StHlthSigNormn.AbsltMotPosABDifStHlthSts /end REF_MEASUREMENT /end GROUP
/begin GROUP StHlthSigNormn.AbsltMotPosACDifStHlth.Val "MICROSAR RTE" /begin SUB_GROUP /end SUB_GROUP /begin FUNCTION_LIST /end FUNCTION_LIST /begin REF_CHARACTERISTIC /end REF_CHARACTERISTIC /begin REF_MEASUREMENT StHlthSigNormn.AbsltMotPosACDifStHlth.Val /end REF_MEASUREMENT /end GROUP
/begin GROUP StHlthSigNormn.AbsltMotPosACDifStHlthSts "MICROSAR RTE" /begin SUB_GROUP /end SUB_GROUP /begin FUNCTION_LIST /end FUNCTION_LIST /begin REF_CHARACTERISTIC /end REF_CHARACTERISTIC /begin REF_MEASUREMENT StHlthSigNormn.AbsltMotPosACDifStHlthSts /end REF_MEASUREMENT /end GROUP
/begin GROUP StHlthSigNormn.AbsltMotPosBCDifStHlth.Val "MICROSAR RTE" /begin SUB_GROUP /end SUB_GROUP /begin FUNCTION_LIST /end FUNCTION_LIST /begin REF_CHARACTERISTIC /end REF_CHARACTERISTIC /begin REF_MEASUREMENT StHlthSigNormn.AbsltMotPosBCDifStHlth.Val /end REF_MEASUREMENT /end GROUP
/begin GROUP StHlthSigNormn.AbsltMotPosBCDifStHlthSts "MICROSAR RTE" /begin SUB_GROUP /end SUB_GROUP /begin FUNCTION_LIST /end FUNCTION_LIST /begin REF_CHARACTERISTIC /end REF_CHARACTERISTIC /begin REF_MEASUREMENT StHlthSigNormn.AbsltMotPosBCDifStHlthSts /end REF_MEASUREMENT /end GROUP
/begin GROUP StHlthSigNormn.CalibrationPorts "MICROSAR RTE"
 /begin SUB_GROUP StHlthSigNormn.CurrMeasCorrlnMaxErrCurr.Val StHlthSigNormn.DutyCycThermProtnDutyCycFildThd.Val StHlthSigNormn.EcuTMeasRngDiagcMax.Val StHlthSigNormn.EcuTMeasRngDiagcMin.Val StHlthSigNormn.EotLrngAuthyStrtLrn.Val StHlthSigNormn.HwTqCorrlnChATraSumSetFltThd.Val StHlthSigNormn.HwTqCorrlnChBTraSumSetFltThd.Val StHlthSigNormn.MotDrvDiagcErrThd.Val StHlthSigNormn.StHlthSigNormnAbsltMotPosDifStHlthDiagThd.Val StHlthSigNormn.StHlthSigNormnCurrMotSumStHlthDiagThd.Val StHlthSigNormn.StHlthSigNormnDigTqStHlthDiagThd.Val StHlthSigNormn.StHlthSigNormnDutyCycFltLimThd.Val StHlthSigNormn.StHlthSigNormnHiCtrlrT.Val StHlthSigNormn.StHlthSigNormnIdptSigStHlthSca.Val StHlthSigNormn.StHlthSigNormnLoCtrlrT.Val StHlthSigNormn.StHlthSigNormnMaxFricThd.Val StHlthSigNormn.StHlthSigNormnMinRackTrvlLim.Val StHlthSigNormn.StHlthSigNormnMotPosStHlthDiagThd.Val StHlthSigNormn.StHlthSigNormnMotVelCal.Val StHlthSigNormn.StHlthSigNormnPhaInfoStHlthDiagThd.Val StHlthSigNormn.StHlthSigNormnStHlthCorrlnErr.Val StHlthSigNormn.StHlthSigNormnStHlthCurrMotSum.Val StHlthSigNormn.StHlthSigNormnStHlthPhaInfo.Val StHlthSigNormn.StHlthSigNormnValMaxStHlthErr.Val StHlthSigNormn.StHlthSigNormnValMinStHlthErr.Val StHlthSigNormn.StHlthSigNormnWhlImbRejctnThd.Val StHlthSigNormn.SysGlbPrmMotPoleCnt.Val /end SUB_GROUP
 /begin FUNCTION_LIST /end FUNCTION_LIST
 /begin REF_CHARACTERISTIC /end REF_CHARACTERISTIC
 /begin REF_MEASUREMENT /end REF_MEASUREMENT
/end GROUP
/begin GROUP StHlthSigNormn.CtrlrTRng.Val "MICROSAR RTE" /begin SUB_GROUP /end SUB_GROUP /begin FUNCTION_LIST /end FUNCTION_LIST /begin REF_CHARACTERISTIC /end REF_CHARACTERISTIC /begin REF_MEASUREMENT StHlthSigNormn.CtrlrTRng.Val /end REF_MEASUREMENT /end GROUP
/begin GROUP StHlthSigNormn.CtrlrTStHlth.Val "MICROSAR RTE" /begin SUB_GROUP /end SUB_GROUP /begin FUNCTION_LIST /end FUNCTION_LIST /begin REF_CHARACTERISTIC /end REF_CHARACTERISTIC /begin REF_MEASUREMENT StHlthSigNormn.CtrlrTStHlth.Val /end REF_MEASUREMENT /end GROUP
/begin GROUP StHlthSigNormn.CurrMeasCorrlnMaxErrCurr.Val "MICROSAR RTE" /begin SUB_GROUP /end SUB_GROUP /begin FUNCTION_LIST /end FUNCTION_LIST /begin REF_CHARACTERISTIC StHlthSigNormn.CurrMeasCorrlnMaxErrCurr.Val /end REF_CHARACTERISTIC /begin REF_MEASUREMENT /end REF_MEASUREMENT /end GROUP
/begin GROUP StHlthSigNormn.CurrMotSumABC.Val "MICROSAR RTE" /begin SUB_GROUP /end SUB_GROUP /begin FUNCTION_LIST /end FUNCTION_LIST /begin REF_CHARACTERISTIC /end REF_CHARACTERISTIC /begin REF_MEASUREMENT StHlthSigNormn.CurrMotSumABC.Val /end REF_MEASUREMENT /end GROUP
/begin GROUP StHlthSigNormn.CurrMotSumABCStHlth.Val "MICROSAR RTE" /begin SUB_GROUP /end SUB_GROUP /begin FUNCTION_LIST /end FUNCTION_LIST /begin REF_CHARACTERISTIC /end REF_CHARACTERISTIC /begin REF_MEASUREMENT StHlthSigNormn.CurrMotSumABCStHlth.Val /end REF_MEASUREMENT /end GROUP
/begin GROUP StHlthSigNormn.CurrMotSumABCStHlthSts "MICROSAR RTE" /begin SUB_GROUP /end SUB_GROUP /begin FUNCTION_LIST /end FUNCTION_LIST /begin REF_CHARACTERISTIC /end REF_CHARACTERISTIC /begin REF_MEASUREMENT StHlthSigNormn.CurrMotSumABCStHlthSts /end REF_MEASUREMENT /end GROUP
/begin GROUP StHlthSigNormn.CurrMotSumDEF.Val "MICROSAR RTE" /begin SUB_GROUP /end SUB_GROUP /begin FUNCTION_LIST /end FUNCTION_LIST /begin REF_CHARACTERISTIC /end REF_CHARACTERISTIC /begin REF_MEASUREMENT StHlthSigNormn.CurrMotSumDEF.Val /end REF_MEASUREMENT /end GROUP
/begin GROUP StHlthSigNormn.CurrMotSumDEFStHlth.Val "MICROSAR RTE" /begin SUB_GROUP /end SUB_GROUP /begin FUNCTION_LIST /end FUNCTION_LIST /begin REF_CHARACTERISTIC /end REF_CHARACTERISTIC /begin REF_MEASUREMENT StHlthSigNormn.CurrMotSumDEFStHlth.Val /end REF_MEASUREMENT /end GROUP
/begin GROUP StHlthSigNormn.CurrMotSumDEFStHlthSts "MICROSAR RTE" /begin SUB_GROUP /end SUB_GROUP /begin FUNCTION_LIST /end FUNCTION_LIST /begin REF_CHARACTERISTIC /end REF_CHARACTERISTIC /begin REF_MEASUREMENT StHlthSigNormn.CurrMotSumDEFStHlthSts /end REF_MEASUREMENT /end GROUP
/begin GROUP StHlthSigNormn.DigTqIdptSigStHlth.Val "MICROSAR RTE" /begin SUB_GROUP /end SUB_GROUP /begin FUNCTION_LIST /end FUNCTION_LIST /begin REF_CHARACTERISTIC /end REF_CHARACTERISTIC /begin REF_MEASUREMENT StHlthSigNormn.DigTqIdptSigStHlth.Val /end REF_MEASUREMENT /end GROUP
/begin GROUP StHlthSigNormn.DigTqIdptSigStHlthSts "MICROSAR RTE" /begin SUB_GROUP /end SUB_GROUP /begin FUNCTION_LIST /end FUNCTION_LIST /begin REF_CHARACTERISTIC /end REF_CHARACTERISTIC /begin REF_MEASUREMENT StHlthSigNormn.DigTqIdptSigStHlthSts /end REF_MEASUREMENT /end GROUP
/begin GROUP StHlthSigNormn.DigTqSnsrAStHlth.Val "MICROSAR RTE" /begin SUB_GROUP /end SUB_GROUP /begin FUNCTION_LIST /end FUNCTION_LIST /begin REF_CHARACTERISTIC /end REF_CHARACTERISTIC /begin REF_MEASUREMENT StHlthSigNormn.DigTqSnsrAStHlth.Val /end REF_MEASUREMENT /end GROUP
/begin GROUP StHlthSigNormn.DigTqSnsrAStHlthSts "MICROSAR RTE" /begin SUB_GROUP /end SUB_GROUP /begin FUNCTION_LIST /end FUNCTION_LIST /begin REF_CHARACTERISTIC /end REF_CHARACTERISTIC /begin REF_MEASUREMENT StHlthSigNormn.DigTqSnsrAStHlthSts /end REF_MEASUREMENT /end GROUP
/begin GROUP StHlthSigNormn.DigTqSnsrBStHlth.Val "MICROSAR RTE" /begin SUB_GROUP /end SUB_GROUP /begin FUNCTION_LIST /end FUNCTION_LIST /begin REF_CHARACTERISTIC /end REF_CHARACTERISTIC /begin REF_MEASUREMENT StHlthSigNormn.DigTqSnsrBStHlth.Val /end REF_MEASUREMENT /end GROUP
/begin GROUP StHlthSigNormn.DigTqSnsrBStHlthSts "MICROSAR RTE" /begin SUB_GROUP /end SUB_GROUP /begin FUNCTION_LIST /end FUNCTION_LIST /begin REF_CHARACTERISTIC /end REF_CHARACTERISTIC /begin REF_MEASUREMENT StHlthSigNormn.DigTqSnsrBStHlthSts /end REF_MEASUREMENT /end GROUP
/begin GROUP StHlthSigNormn.DutyCycStHlth.Val "MICROSAR RTE" /begin SUB_GROUP /end SUB_GROUP /begin FUNCTION_LIST /end FUNCTION_LIST /begin REF_CHARACTERISTIC /end REF_CHARACTERISTIC /begin REF_MEASUREMENT StHlthSigNormn.DutyCycStHlth.Val /end REF_MEASUREMENT /end GROUP
/begin GROUP StHlthSigNormn.DutyCycThermProtnDutyCycFildThd.Val "MICROSAR RTE" /begin SUB_GROUP /end SUB_GROUP /begin FUNCTION_LIST /end FUNCTION_LIST /begin REF_CHARACTERISTIC StHlthSigNormn.DutyCycThermProtnDutyCycFildThd.Val /end REF_CHARACTERISTIC /begin REF_MEASUREMENT /end REF_MEASUREMENT /end GROUP
/begin GROUP StHlthSigNormn.DutyCycThermProtnMaxOutp.Val "MICROSAR RTE" /begin SUB_GROUP /end SUB_GROUP /begin FUNCTION_LIST /end FUNCTION_LIST /begin REF_CHARACTERISTIC /end REF_CHARACTERISTIC /begin REF_MEASUREMENT StHlthSigNormn.DutyCycThermProtnMaxOutp.Val /end REF_MEASUREMENT /end GROUP
/begin GROUP StHlthSigNormn.EcuTFild.Val "MICROSAR RTE" /begin SUB_GROUP /end SUB_GROUP /begin FUNCTION_LIST /end FUNCTION_LIST /begin REF_CHARACTERISTIC /end REF_CHARACTERISTIC /begin REF_MEASUREMENT StHlthSigNormn.EcuTFild.Val /end REF_MEASUREMENT /end GROUP
/begin GROUP StHlthSigNormn.EcuTMeasRngDiagcMax.Val "MICROSAR RTE" /begin SUB_GROUP /end SUB_GROUP /begin FUNCTION_LIST /end FUNCTION_LIST /begin REF_CHARACTERISTIC StHlthSigNormn.EcuTMeasRngDiagcMax.Val /end REF_CHARACTERISTIC /begin REF_MEASUREMENT /end REF_MEASUREMENT /end GROUP
/begin GROUP StHlthSigNormn.EcuTMeasRngDiagcMin.Val "MICROSAR RTE" /begin SUB_GROUP /end SUB_GROUP /begin FUNCTION_LIST /end FUNCTION_LIST /begin REF_CHARACTERISTIC StHlthSigNormn.EcuTMeasRngDiagcMin.Val /end REF_CHARACTERISTIC /begin REF_MEASUREMENT /end REF_MEASUREMENT /end GROUP
/begin GROUP StHlthSigNormn.EcuTRngIgnCyc "MICROSAR RTE" /begin SUB_GROUP /end SUB_GROUP /begin FUNCTION_LIST /end FUNCTION_LIST /begin REF_CHARACTERISTIC /end REF_CHARACTERISTIC /begin REF_MEASUREMENT StHlthSigNormn.EcuTRngIgnCyc /end REF_MEASUREMENT /end GROUP
/begin GROUP StHlthSigNormn.EntrEot "MICROSAR RTE" /begin SUB_GROUP /end SUB_GROUP /begin FUNCTION_LIST /end FUNCTION_LIST /begin REF_CHARACTERISTIC /end REF_CHARACTERISTIC /begin REF_MEASUREMENT StHlthSigNormn.EntrEot /end REF_MEASUREMENT /end GROUP
/begin GROUP StHlthSigNormn.EotImpctCntr "MICROSAR RTE" /begin SUB_GROUP /end SUB_GROUP /begin FUNCTION_LIST /end FUNCTION_LIST /begin REF_CHARACTERISTIC /end REF_CHARACTERISTIC /begin REF_MEASUREMENT StHlthSigNormn.EotImpctCntr /end REF_MEASUREMENT /end GROUP
/begin GROUP StHlthSigNormn.EotImpctStHlth.Val "MICROSAR RTE" /begin SUB_GROUP /end SUB_GROUP /begin FUNCTION_LIST /end FUNCTION_LIST /begin REF_CHARACTERISTIC /end REF_CHARACTERISTIC /begin REF_MEASUREMENT StHlthSigNormn.EotImpctStHlth.Val /end REF_MEASUREMENT /end GROUP
/begin GROUP StHlthSigNormn.EotLrngAuthyStrtLrn.Val "MICROSAR RTE" /begin SUB_GROUP /end SUB_GROUP /begin FUNCTION_LIST /end FUNCTION_LIST /begin REF_CHARACTERISTIC StHlthSigNormn.EotLrngAuthyStrtLrn.Val /end REF_CHARACTERISTIC /begin REF_MEASUREMENT /end REF_MEASUREMENT /end GROUP
/begin GROUP StHlthSigNormn.FricEstimnStHlth.Val "MICROSAR RTE" /begin SUB_GROUP /end SUB_GROUP /begin FUNCTION_LIST /end FUNCTION_LIST /begin REF_CHARACTERISTIC /end REF_CHARACTERISTIC /begin REF_MEASUREMENT StHlthSigNormn.FricEstimnStHlth.Val /end REF_MEASUREMENT /end GROUP
/begin GROUP StHlthSigNormn.HwAg.Val "MICROSAR RTE" /begin SUB_GROUP /end SUB_GROUP /begin FUNCTION_LIST /end FUNCTION_LIST /begin REF_CHARACTERISTIC /end REF_CHARACTERISTIC /begin REF_MEASUREMENT StHlthSigNormn.HwAg.Val /end REF_MEASUREMENT /end GROUP
/begin GROUP StHlthSigNormn.HwAgEotCcw.Val "MICROSAR RTE" /begin SUB_GROUP /end SUB_GROUP /begin FUNCTION_LIST /end FUNCTION_LIST /begin REF_CHARACTERISTIC /end REF_CHARACTERISTIC /begin REF_MEASUREMENT StHlthSigNormn.HwAgEotCcw.Val /end REF_MEASUREMENT /end GROUP
/begin GROUP StHlthSigNormn.HwAgEotCw.Val "MICROSAR RTE" /begin SUB_GROUP /end SUB_GROUP /begin FUNCTION_LIST /end FUNCTION_LIST /begin REF_CHARACTERISTIC /end REF_CHARACTERISTIC /begin REF_MEASUREMENT StHlthSigNormn.HwAgEotCw.Val /end REF_MEASUREMENT /end GROUP
/begin GROUP StHlthSigNormn.HwAuthy.Val "MICROSAR RTE" /begin SUB_GROUP /end SUB_GROUP /begin FUNCTION_LIST /end FUNCTION_LIST /begin REF_CHARACTERISTIC /end REF_CHARACTERISTIC /begin REF_MEASUREMENT StHlthSigNormn.HwAuthy.Val /end REF_MEASUREMENT /end GROUP
/begin GROUP StHlthSigNormn.HwTqChACorrlnTraErr.Val "MICROSAR RTE" /begin SUB_GROUP /end SUB_GROUP /begin FUNCTION_LIST /end FUNCTION_LIST /begin REF_CHARACTERISTIC /end REF_CHARACTERISTIC /begin REF_MEASUREMENT StHlthSigNormn.HwTqChACorrlnTraErr.Val /end REF_MEASUREMENT /end GROUP
/begin GROUP StHlthSigNormn.HwTqChBCorrlnTraErr.Val "MICROSAR RTE" /begin SUB_GROUP /end SUB_GROUP /begin FUNCTION_LIST /end FUNCTION_LIST /begin REF_CHARACTERISTIC /end REF_CHARACTERISTIC /begin REF_MEASUREMENT StHlthSigNormn.HwTqChBCorrlnTraErr.Val /end REF_MEASUREMENT /end GROUP
/begin GROUP StHlthSigNormn.HwTqCorrlnChATraSumSetFltThd.Val "MICROSAR RTE" /begin SUB_GROUP /end SUB_GROUP /begin FUNCTION_LIST /end FUNCTION_LIST /begin REF_CHARACTERISTIC StHlthSigNormn.HwTqCorrlnChATraSumSetFltThd.Val /end REF_CHARACTERISTIC /begin REF_MEASUREMENT /end REF_MEASUREMENT /end GROUP
/begin GROUP StHlthSigNormn.HwTqCorrlnChBTraSumSetFltThd.Val "MICROSAR RTE" /begin SUB_GROUP /end SUB_GROUP /begin FUNCTION_LIST /end FUNCTION_LIST /begin REF_CHARACTERISTIC StHlthSigNormn.HwTqCorrlnChBTraSumSetFltThd.Val /end REF_CHARACTERISTIC /begin REF_MEASUREMENT /end REF_MEASUREMENT /end GROUP
/begin GROUP StHlthSigNormn.HwTqIdptSig.Val "MICROSAR RTE" /begin SUB_GROUP /end SUB_GROUP /begin FUNCTION_LIST /end FUNCTION_LIST /begin REF_CHARACTERISTIC /end REF_CHARACTERISTIC /begin REF_MEASUREMENT StHlthSigNormn.HwTqIdptSig.Val /end REF_MEASUREMENT /end GROUP
/begin GROUP StHlthSigNormn.LclRamEccSngBitCntrOutp.Val "MICROSAR RTE" /begin SUB_GROUP /end SUB_GROUP /begin FUNCTION_LIST /end FUNCTION_LIST /begin REF_CHARACTERISTIC /end REF_CHARACTERISTIC /begin REF_MEASUREMENT StHlthSigNormn.LclRamEccSngBitCntrOutp.Val /end REF_MEASUREMENT /end GROUP
/begin GROUP StHlthSigNormn.MaxLrndFric.Val "MICROSAR RTE" /begin SUB_GROUP /end SUB_GROUP /begin FUNCTION_LIST /end FUNCTION_LIST /begin REF_CHARACTERISTIC /end REF_CHARACTERISTIC /begin REF_MEASUREMENT StHlthSigNormn.MaxLrndFric.Val /end REF_MEASUREMENT /end GROUP
/begin GROUP StHlthSigNormn.MotAg2VltgSqd.Val "MICROSAR RTE" /begin SUB_GROUP /end SUB_GROUP /begin FUNCTION_LIST /end FUNCTION_LIST /begin REF_CHARACTERISTIC /end REF_CHARACTERISTIC /begin REF_MEASUREMENT StHlthSigNormn.MotAg2VltgSqd.Val /end REF_MEASUREMENT /end GROUP
/begin GROUP StHlthSigNormn.MotAgABErrTerm.Val "MICROSAR RTE" /begin SUB_GROUP /end SUB_GROUP /begin FUNCTION_LIST /end FUNCTION_LIST /begin REF_CHARACTERISTIC /end REF_CHARACTERISTIC /begin REF_MEASUREMENT StHlthSigNormn.MotAgABErrTerm.Val /end REF_MEASUREMENT /end GROUP
/begin GROUP StHlthSigNormn.MotAgACErrTerm.Val "MICROSAR RTE" /begin SUB_GROUP /end SUB_GROUP /begin FUNCTION_LIST /end FUNCTION_LIST /begin REF_CHARACTERISTIC /end REF_CHARACTERISTIC /begin REF_MEASUREMENT StHlthSigNormn.MotAgACErrTerm.Val /end REF_MEASUREMENT /end GROUP
/begin GROUP StHlthSigNormn.MotAgBCErrTerm.Val "MICROSAR RTE" /begin SUB_GROUP /end SUB_GROUP /begin FUNCTION_LIST /end FUNCTION_LIST /begin REF_CHARACTERISTIC /end REF_CHARACTERISTIC /begin REF_MEASUREMENT StHlthSigNormn.MotAgBCErrTerm.Val /end REF_MEASUREMENT /end GROUP
/begin GROUP StHlthSigNormn.MotAgCorrlnErrThd "MICROSAR RTE" /begin SUB_GROUP /end SUB_GROUP /begin FUNCTION_LIST /end FUNCTION_LIST /begin REF_CHARACTERISTIC /end REF_CHARACTERISTIC /begin REF_MEASUREMENT StHlthSigNormn.MotAgCorrlnErrThd /end REF_MEASUREMENT /end GROUP
/begin GROUP StHlthSigNormn.MotDrvDiagcErrThd.Val "MICROSAR RTE" /begin SUB_GROUP /end SUB_GROUP /begin FUNCTION_LIST /end FUNCTION_LIST /begin REF_CHARACTERISTIC StHlthSigNormn.MotDrvDiagcErrThd.Val /end REF_CHARACTERISTIC /begin REF_MEASUREMENT /end REF_MEASUREMENT /end GROUP
/begin GROUP StHlthSigNormn.MotDrvErrA.Val "MICROSAR RTE" /begin SUB_GROUP /end SUB_GROUP /begin FUNCTION_LIST /end FUNCTION_LIST /begin REF_CHARACTERISTIC /end REF_CHARACTERISTIC /begin REF_MEASUREMENT StHlthSigNormn.MotDrvErrA.Val /end REF_MEASUREMENT /end GROUP
/begin GROUP StHlthSigNormn.MotDrvErrB.Val "MICROSAR RTE" /begin SUB_GROUP /end SUB_GROUP /begin FUNCTION_LIST /end FUNCTION_LIST /begin REF_CHARACTERISTIC /end REF_CHARACTERISTIC /begin REF_MEASUREMENT StHlthSigNormn.MotDrvErrB.Val /end REF_MEASUREMENT /end GROUP
/begin GROUP StHlthSigNormn.MotDrvErrC.Val "MICROSAR RTE" /begin SUB_GROUP /end SUB_GROUP /begin FUNCTION_LIST /end FUNCTION_LIST /begin REF_CHARACTERISTIC /end REF_CHARACTERISTIC /begin REF_MEASUREMENT StHlthSigNormn.MotDrvErrC.Val /end REF_MEASUREMENT /end GROUP
/begin GROUP StHlthSigNormn.MotDrvErrD.Val "MICROSAR RTE" /begin SUB_GROUP /end SUB_GROUP /begin FUNCTION_LIST /end FUNCTION_LIST /begin REF_CHARACTERISTIC /end REF_CHARACTERISTIC /begin REF_MEASUREMENT StHlthSigNormn.MotDrvErrD.Val /end REF_MEASUREMENT /end GROUP
/begin GROUP StHlthSigNormn.MotDrvErrE.Val "MICROSAR RTE" /begin SUB_GROUP /end SUB_GROUP /begin FUNCTION_LIST /end FUNCTION_LIST /begin REF_CHARACTERISTIC /end REF_CHARACTERISTIC /begin REF_MEASUREMENT StHlthSigNormn.MotDrvErrE.Val /end REF_MEASUREMENT /end GROUP
/begin GROUP StHlthSigNormn.MotDrvErrF.Val "MICROSAR RTE" /begin SUB_GROUP /end SUB_GROUP /begin FUNCTION_LIST /end FUNCTION_LIST /begin REF_CHARACTERISTIC /end REF_CHARACTERISTIC /begin REF_MEASUREMENT StHlthSigNormn.MotDrvErrF.Val /end REF_MEASUREMENT /end GROUP
/begin GROUP StHlthSigNormn.MotPosStHlth.Val "MICROSAR RTE" /begin SUB_GROUP /end SUB_GROUP /begin FUNCTION_LIST /end FUNCTION_LIST /begin REF_CHARACTERISTIC /end REF_CHARACTERISTIC /begin REF_MEASUREMENT StHlthSigNormn.MotPosStHlth.Val /end REF_MEASUREMENT /end GROUP
/begin GROUP StHlthSigNormn.MotPosStHlthSts "MICROSAR RTE" /begin SUB_GROUP /end SUB_GROUP /begin FUNCTION_LIST /end FUNCTION_LIST /begin REF_CHARACTERISTIC /end REF_CHARACTERISTIC /begin REF_MEASUREMENT StHlthSigNormn.MotPosStHlthSts /end REF_MEASUREMENT /end GROUP
/begin GROUP StHlthSigNormn.MotVelCrf.Val "MICROSAR RTE" /begin SUB_GROUP /end SUB_GROUP /begin FUNCTION_LIST /end FUNCTION_LIST /begin REF_CHARACTERISTIC /end REF_CHARACTERISTIC /begin REF_MEASUREMENT StHlthSigNormn.MotVelCrf.Val /end REF_MEASUREMENT /end GROUP
/begin GROUP StHlthSigNormn.OutpAssiStHlth.Val "MICROSAR RTE" /begin SUB_GROUP /end SUB_GROUP /begin FUNCTION_LIST /end FUNCTION_LIST /begin REF_CHARACTERISTIC /end REF_CHARACTERISTIC /begin REF_MEASUREMENT StHlthSigNormn.OutpAssiStHlth.Val /end REF_MEASUREMENT /end GROUP
/begin GROUP StHlthSigNormn.PerInstanceMemories "MICROSAR RTE"
 /begin SUB_GROUP StHlthSigNormn.AbsltMotPosABDifStHlthSts StHlthSigNormn.AbsltMotPosACDifStHlthSts StHlthSigNormn.AbsltMotPosBCDifStHlthSts StHlthSigNormn.CurrMotSumABCStHlthSts StHlthSigNormn.CurrMotSumDEFStHlthSts StHlthSigNormn.DigTqIdptSigStHlthSts StHlthSigNormn.DigTqSnsrAStHlthSts StHlthSigNormn.DigTqSnsrBStHlthSts StHlthSigNormn.EcuTRngIgnCyc StHlthSigNormn.EntrEot StHlthSigNormn.EotImpctCntr StHlthSigNormn.MotAgCorrlnErrThd StHlthSigNormn.MotPosStHlthSts StHlthSigNormn.PhaAStHlthSts StHlthSigNormn.PhaBStHlthSts StHlthSigNormn.PhaCStHlthSts StHlthSigNormn.PhaDStHlthSts StHlthSigNormn.PhaEStHlthSts StHlthSigNormn.PhaFStHlthSts StHlthSigNormn.VltgRngIgnCyc /end SUB_GROUP
 /begin FUNCTION_LIST /end FUNCTION_LIST
 /begin REF_CHARACTERISTIC /end REF_CHARACTERISTIC
 /begin REF_MEASUREMENT /end REF_MEASUREMENT
/end GROUP
/begin GROUP StHlthSigNormn.PhaAStHlth.Val "MICROSAR RTE" /begin SUB_GROUP /end SUB_GROUP /begin FUNCTION_LIST /end FUNCTION_LIST /begin REF_CHARACTERISTIC /end REF_CHARACTERISTIC /begin REF_MEASUREMENT StHlthSigNormn.PhaAStHlth.Val /end REF_MEASUREMENT /end GROUP
/begin GROUP StHlthSigNormn.PhaAStHlthSts "MICROSAR RTE" /begin SUB_GROUP /end SUB_GROUP /begin FUNCTION_LIST /end FUNCTION_LIST /begin REF_CHARACTERISTIC /end REF_CHARACTERISTIC /begin REF_MEASUREMENT StHlthSigNormn.PhaAStHlthSts /end REF_MEASUREMENT /end GROUP
/begin GROUP StHlthSigNormn.PhaBStHlth.Val "MICROSAR RTE" /begin SUB_GROUP /end SUB_GROUP /begin FUNCTION_LIST /end FUNCTION_LIST /begin REF_CHARACTERISTIC /end REF_CHARACTERISTIC /begin REF_MEASUREMENT StHlthSigNormn.PhaBStHlth.Val /end REF_MEASUREMENT /end GROUP
/begin GROUP StHlthSigNormn.PhaBStHlthSts "MICROSAR RTE" /begin SUB_GROUP /end SUB_GROUP /begin FUNCTION_LIST /end FUNCTION_LIST /begin REF_CHARACTERISTIC /end REF_CHARACTERISTIC /begin REF_MEASUREMENT StHlthSigNormn.PhaBStHlthSts /end REF_MEASUREMENT /end GROUP
/begin GROUP StHlthSigNormn.PhaCStHlth.Val "MICROSAR RTE" /begin SUB_GROUP /end SUB_GROUP /begin FUNCTION_LIST /end FUNCTION_LIST /begin REF_CHARACTERISTIC /end REF_CHARACTERISTIC /begin REF_MEASUREMENT StHlthSigNormn.PhaCStHlth.Val /end REF_MEASUREMENT /end GROUP
/begin GROUP StHlthSigNormn.PhaCStHlthSts "MICROSAR RTE" /begin SUB_GROUP /end SUB_GROUP /begin FUNCTION_LIST /end FUNCTION_LIST /begin REF_CHARACTERISTIC /end REF_CHARACTERISTIC /begin REF_MEASUREMENT StHlthSigNormn.PhaCStHlthSts /end REF_MEASUREMENT /end GROUP
/begin GROUP StHlthSigNormn.PhaDStHlth.Val "MICROSAR RTE" /begin SUB_GROUP /end SUB_GROUP /begin FUNCTION_LIST /end FUNCTION_LIST /begin REF_CHARACTERISTIC /end REF_CHARACTERISTIC /begin REF_MEASUREMENT StHlthSigNormn.PhaDStHlth.Val /end REF_MEASUREMENT /end GROUP
/begin GROUP StHlthSigNormn.PhaDStHlthSts "MICROSAR RTE" /begin SUB_GROUP /end SUB_GROUP /begin FUNCTION_LIST /end FUNCTION_LIST /begin REF_CHARACTERISTIC /end REF_CHARACTERISTIC /begin REF_MEASUREMENT StHlthSigNormn.PhaDStHlthSts /end REF_MEASUREMENT /end GROUP
/begin GROUP StHlthSigNormn.PhaEStHlth.Val "MICROSAR RTE" /begin SUB_GROUP /end SUB_GROUP /begin FUNCTION_LIST /end FUNCTION_LIST /begin REF_CHARACTERISTIC /end REF_CHARACTERISTIC /begin REF_MEASUREMENT StHlthSigNormn.PhaEStHlth.Val /end REF_MEASUREMENT /end GROUP
/begin GROUP StHlthSigNormn.PhaEStHlthSts "MICROSAR RTE" /begin SUB_GROUP /end SUB_GROUP /begin FUNCTION_LIST /end FUNCTION_LIST /begin REF_CHARACTERISTIC /end REF_CHARACTERISTIC /begin REF_MEASUREMENT StHlthSigNormn.PhaEStHlthSts /end REF_MEASUREMENT /end GROUP
/begin GROUP StHlthSigNormn.PhaFStHlth.Val "MICROSAR RTE" /begin SUB_GROUP /end SUB_GROUP /begin FUNCTION_LIST /end FUNCTION_LIST /begin REF_CHARACTERISTIC /end REF_CHARACTERISTIC /begin REF_MEASUREMENT StHlthSigNormn.PhaFStHlth.Val /end REF_MEASUREMENT /end GROUP
/begin GROUP StHlthSigNormn.PhaFStHlthSts "MICROSAR RTE" /begin SUB_GROUP /end SUB_GROUP /begin FUNCTION_LIST /end FUNCTION_LIST /begin REF_CHARACTERISTIC /end REF_CHARACTERISTIC /begin REF_MEASUREMENT StHlthSigNormn.PhaFStHlthSts /end REF_MEASUREMENT /end GROUP
/begin GROUP StHlthSigNormn.RackLimrEotSig0Avl.Logl "MICROSAR RTE" /begin SUB_GROUP /end SUB_GROUP /begin FUNCTION_LIST /end FUNCTION_LIST /begin REF_CHARACTERISTIC /end REF_CHARACTERISTIC /begin REF_MEASUREMENT StHlthSigNormn.RackLimrEotSig0Avl.Logl /end REF_MEASUREMENT /end GROUP
/begin GROUP StHlthSigNormn.RackLimrEotSig1Avl.Logl "MICROSAR RTE" /begin SUB_GROUP /end SUB_GROUP /begin FUNCTION_LIST /end FUNCTION_LIST /begin REF_CHARACTERISTIC /end REF_CHARACTERISTIC /begin REF_MEASUREMENT StHlthSigNormn.RackLimrEotSig1Avl.Logl /end REF_MEASUREMENT /end GROUP
/begin GROUP StHlthSigNormn.RamEccSngBitCorrnStHlth.Val "MICROSAR RTE" /begin SUB_GROUP /end SUB_GROUP /begin FUNCTION_LIST /end FUNCTION_LIST /begin REF_CHARACTERISTIC /end REF_CHARACTERISTIC /begin REF_MEASUREMENT StHlthSigNormn.RamEccSngBitCorrnStHlth.Val /end REF_MEASUREMENT /end GROUP
/begin GROUP StHlthSigNormn.ReceiverPorts "MICROSAR RTE"
 /begin SUB_GROUP StHlthSigNormn.CurrMotSumABC.Val StHlthSigNormn.CurrMotSumDEF.Val StHlthSigNormn.DutyCycThermProtnMaxOutp.Val StHlthSigNormn.EcuTFild.Val StHlthSigNormn.HwAg.Val StHlthSigNormn.HwAgEotCcw.Val StHlthSigNormn.HwAgEotCw.Val StHlthSigNormn.HwAuthy.Val StHlthSigNormn.HwTqChACorrlnTraErr.Val StHlthSigNormn.HwTqChBCorrlnTraErr.Val StHlthSigNormn.HwTqIdptSig.Val StHlthSigNormn.LclRamEccSngBitCntrOutp.Val StHlthSigNormn.MaxLrndFric.Val StHlthSigNormn.MotAg2VltgSqd.Val StHlthSigNormn.MotAgABErrTerm.Val StHlthSigNormn.MotAgACErrTerm.Val StHlthSigNormn.MotAgBCErrTerm.Val StHlthSigNormn.MotDrvErrA.Val StHlthSigNormn.MotDrvErrB.Val StHlthSigNormn.MotDrvErrC.Val StHlthSigNormn.MotDrvErrD.Val StHlthSigNormn.MotDrvErrE.Val StHlthSigNormn.MotDrvErrF.Val StHlthSigNormn.MotVelCrf.Val StHlthSigNormn.RackLimrEotSig0Avl.Logl StHlthSigNormn.RackLimrEotSig1Avl.Logl StHlthSigNormn.WhlImbRejctnCmd.Val /end SUB_GROUP
 /begin FUNCTION_LIST /end FUNCTION_LIST
 /begin REF_CHARACTERISTIC /end REF_CHARACTERISTIC
 /begin REF_MEASUREMENT /end REF_MEASUREMENT
/end GROUP
/begin GROUP StHlthSigNormn.SenderPorts "MICROSAR RTE"
 /begin SUB_GROUP StHlthSigNormn.AbsltMotPosABDifStHlth.Val StHlthSigNormn.AbsltMotPosACDifStHlth.Val StHlthSigNormn.AbsltMotPosBCDifStHlth.Val StHlthSigNormn.CtrlrTRng.Val StHlthSigNormn.CtrlrTStHlth.Val StHlthSigNormn.CurrMotSumABCStHlth.Val StHlthSigNormn.CurrMotSumDEFStHlth.Val StHlthSigNormn.DigTqIdptSigStHlth.Val StHlthSigNormn.DigTqSnsrAStHlth.Val StHlthSigNormn.DigTqSnsrBStHlth.Val StHlthSigNormn.DutyCycStHlth.Val StHlthSigNormn.EotImpctStHlth.Val StHlthSigNormn.FricEstimnStHlth.Val StHlthSigNormn.MotPosStHlth.Val StHlthSigNormn.OutpAssiStHlth.Val StHlthSigNormn.PhaAStHlth.Val StHlthSigNormn.PhaBStHlth.Val StHlthSigNormn.PhaCStHlth.Val StHlthSigNormn.PhaDStHlth.Val StHlthSigNormn.PhaEStHlth.Val StHlthSigNormn.PhaFStHlth.Val StHlthSigNormn.RamEccSngBitCorrnStHlth.Val StHlthSigNormn.VltgRng.Val StHlthSigNormn.WhlImbMaxCmpStHlth.Val /end SUB_GROUP
 /begin FUNCTION_LIST /end FUNCTION_LIST
 /begin REF_CHARACTERISTIC /end REF_CHARACTERISTIC
 /begin REF_MEASUREMENT /end REF_MEASUREMENT
/end GROUP
/begin GROUP StHlthSigNormn.StHlthSigNormnAbsltMotPosDifStHlthDiagThd.Val "MICROSAR RTE" /begin SUB_GROUP /end SUB_GROUP /begin FUNCTION_LIST /end FUNCTION_LIST
 /begin REF_CHARACTERISTIC StHlthSigNormn.StHlthSigNormnAbsltMotPosDifStHlthDiagThd.Val /end REF_CHARACTERISTIC
 /begin REF_MEASUREMENT /end REF_MEASUREMENT
/end GROUP
/begin GROUP StHlthSigNormn.StHlthSigNormnCurrMotSumStHlthDiagThd.Val "MICROSAR RTE" /begin SUB_GROUP /end SUB_GROUP /begin FUNCTION_LIST /end FUNCTION_LIST /begin REF_CHARACTERISTIC StHlthSigNormn.StHlthSigNormnCurrMotSumStHlthDiagThd.Val /end REF_CHARACTERISTIC /begin REF_MEASUREMENT /end REF_MEASUREMENT /end GROUP
/begin GROUP StHlthSigNormn.StHlthSigNormnDigTqStHlthDiagThd.Val "MICROSAR RTE" /begin SUB_GROUP /end SUB_GROUP /begin FUNCTION_LIST /end FUNCTION_LIST /begin REF_CHARACTERISTIC StHlthSigNormn.StHlthSigNormnDigTqStHlthDiagThd.Val /end REF_CHARACTERISTIC /begin REF_MEASUREMENT /end REF_MEASUREMENT /end GROUP
/begin GROUP StHlthSigNormn.StHlthSigNormnDutyCycFltLimThd.Val "MICROSAR RTE" /begin SUB_GROUP /end SUB_GROUP /begin FUNCTION_LIST /end FUNCTION_LIST /begin REF_CHARACTERISTIC StHlthSigNormn.StHlthSigNormnDutyCycFltLimThd.Val /end REF_CHARACTERISTIC /begin REF_MEASUREMENT /end REF_MEASUREMENT /end GROUP
/begin GROUP StHlthSigNormn.StHlthSigNormnHiCtrlrT.Val "MICROSAR RTE" /begin SUB_GROUP /end SUB_GROUP /begin FUNCTION_LIST /end FUNCTION_LIST /begin REF_CHARACTERISTIC StHlthSigNormn.StHlthSigNormnHiCtrlrT.Val /end REF_CHARACTERISTIC /begin REF_MEASUREMENT /end REF_MEASUREMENT /end GROUP
/begin GROUP StHlthSigNormn.StHlthSigNormnIdptSigStHlthSca.Val "MICROSAR RTE" /begin SUB_GROUP /end SUB_GROUP /begin FUNCTION_LIST /end FUNCTION_LIST /begin REF_CHARACTERISTIC StHlthSigNormn.StHlthSigNormnIdptSigStHlthSca.Val /end REF_CHARACTERISTIC /begin REF_MEASUREMENT /end REF_MEASUREMENT /end GROUP
/begin GROUP StHlthSigNormn.StHlthSigNormnLoCtrlrT.Val "MICROSAR RTE" /begin SUB_GROUP /end SUB_GROUP /begin FUNCTION_LIST /end FUNCTION_LIST /begin REF_CHARACTERISTIC StHlthSigNormn.StHlthSigNormnLoCtrlrT.Val /end REF_CHARACTERISTIC /begin REF_MEASUREMENT /end REF_MEASUREMENT /end GROUP
/begin GROUP StHlthSigNormn.StHlthSigNormnMaxFricThd.Val "MICROSAR RTE" /begin SUB_GROUP /end SUB_GROUP /begin FUNCTION_LIST /end FUNCTION_LIST /begin REF_CHARACTERISTIC StHlthSigNormn.StHlthSigNormnMaxFricThd.Val /end REF_CHARACTERISTIC /begin REF_MEASUREMENT /end REF_MEASUREMENT /end GROUP
/begin GROUP StHlthSigNormn.StHlthSigNormnMinRackTrvlLim.Val "MICROSAR RTE" /begin SUB_GROUP /end SUB_GROUP /begin FUNCTION_LIST /end FUNCTION_LIST /begin REF_CHARACTERISTIC StHlthSigNormn.StHlthSigNormnMinRackTrvlLim.Val /end REF_CHARACTERISTIC /begin REF_MEASUREMENT /end REF_MEASUREMENT /end GROUP
/begin GROUP StHlthSigNormn.StHlthSigNormnMotPosStHlthDiagThd.Val "MICROSAR RTE" /begin SUB_GROUP /end SUB_GROUP /begin FUNCTION_LIST /end FUNCTION_LIST /begin REF_CHARACTERISTIC StHlthSigNormn.StHlthSigNormnMotPosStHlthDiagThd.Val /end REF_CHARACTERISTIC /begin REF_MEASUREMENT /end REF_MEASUREMENT /end GROUP
/begin GROUP StHlthSigNormn.StHlthSigNormnMotVelCal.Val "MICROSAR RTE" /begin SUB_GROUP /end SUB_GROUP /begin FUNCTION_LIST /end FUNCTION_LIST /begin REF_CHARACTERISTIC StHlthSigNormn.StHlthSigNormnMotVelCal.Val /end REF_CHARACTERISTIC /begin REF_MEASUREMENT /end REF_MEASUREMENT /end GROUP
/begin GROUP StHlthSigNormn.StHlthSigNormnPhaInfoStHlthDiagThd.Val "MICROSAR RTE" /begin SUB_GROUP /end SUB_GROUP /begin FUNCTION_LIST /end FUNCTION_LIST /begin REF_CHARACTERISTIC StHlthSigNormn.StHlthSigNormnPhaInfoStHlthDiagThd.Val /end REF_CHARACTERISTIC /begin REF_MEASUREMENT /end REF_MEASUREMENT /end GROUP
/begin GROUP StHlthSigNormn.StHlthSigNormnStHlthCorrlnErr.Val "MICROSAR RTE" /begin SUB_GROUP /end SUB_GROUP /begin FUNCTION_LIST /end FUNCTION_LIST /begin REF_CHARACTERISTIC StHlthSigNormn.StHlthSigNormnStHlthCorrlnErr.Val /end REF_CHARACTERISTIC /begin REF_MEASUREMENT /end REF_MEASUREMENT /end GROUP
/begin GROUP StHlthSigNormn.StHlthSigNormnStHlthCurrMotSum.Val "MICROSAR RTE" /begin SUB_GROUP /end SUB_GROUP /begin FUNCTION_LIST /end FUNCTION_LIST /begin REF_CHARACTERISTIC StHlthSigNormn.StHlthSigNormnStHlthCurrMotSum.Val /end REF_CHARACTERISTIC /begin REF_MEASUREMENT /end REF_MEASUREMENT /end GROUP
/begin GROUP StHlthSigNormn.StHlthSigNormnStHlthPhaInfo.Val "MICROSAR RTE" /begin SUB_GROUP /end SUB_GROUP /begin FUNCTION_LIST /end FUNCTION_LIST /begin REF_CHARACTERISTIC StHlthSigNormn.StHlthSigNormnStHlthPhaInfo.Val /end REF_CHARACTERISTIC /begin REF_MEASUREMENT /end REF_MEASUREMENT /end GROUP
/begin GROUP StHlthSigNormn.StHlthSigNormnValMaxStHlthErr.Val "MICROSAR RTE" /begin SUB_GROUP /end SUB_GROUP /begin FUNCTION_LIST /end FUNCTION_LIST /begin REF_CHARACTERISTIC StHlthSigNormn.StHlthSigNormnValMaxStHlthErr.Val /end REF_CHARACTERISTIC /begin REF_MEASUREMENT /end REF_MEASUREMENT /end GROUP
/begin GROUP StHlthSigNormn.StHlthSigNormnValMinStHlthErr.Val "MICROSAR RTE" /begin SUB_GROUP /end SUB_GROUP /begin FUNCTION_LIST /end FUNCTION_LIST /begin REF_CHARACTERISTIC StHlthSigNormn.StHlthSigNormnValMinStHlthErr.Val /end REF_CHARACTERISTIC /begin REF_MEASUREMENT /end REF_MEASUREMENT /end GROUP
/begin GROUP StHlthSigNormn.StHlthSigNormnWhlImbRejctnThd.Val "MICROSAR RTE" /begin SUB_GROUP /end SUB_GROUP /begin FUNCTION_LIST /end FUNCTION_LIST /begin REF_CHARACTERISTIC StHlthSigNormn.StHlthSigNormnWhlImbRejctnThd.Val /end REF_CHARACTERISTIC /begin REF_MEASUREMENT /end REF_MEASUREMENT /end GROUP
/begin GROUP StHlthSigNormn.SysGlbPrmMotPoleCnt.Val "MICROSAR RTE" /begin SUB_GROUP /end SUB_GROUP /begin FUNCTION_LIST /end FUNCTION_LIST /begin REF_CHARACTERISTIC StHlthSigNormn.SysGlbPrmMotPoleCnt.Val /end REF_CHARACTERISTIC /begin REF_MEASUREMENT /end REF_MEASUREMENT /end GROUP
/begin GROUP StHlthSigNormn.VltgRng.Val "MICROSAR RTE" /begin SUB_GROUP /end SUB_GROUP /begin FUNCTION_LIST /end FUNCTION_LIST /begin REF_CHARACTERISTIC /end REF_CHARACTERISTIC /begin REF_MEASUREMENT StHlthSigNormn.VltgRng.Val /end REF_MEASUREMENT /end GROUP
/begin GROUP StHlthSigNormn.VltgRngIgnCyc "MICROSAR RTE" /begin SUB_GROUP /end SUB_GROUP /begin FUNCTION_LIST /end FUNCTION_LIST /begin REF_CHARACTERISTIC /end REF_CHARACTERISTIC /begin REF_MEASUREMENT StHlthSigNormn.VltgRngIgnCyc /end REF_MEASUREMENT /end GROUP
/begin GROUP StHlthSigNormn.WhlImbMaxCmpStHlth.Val "MICROSAR RTE" /begin SUB_GROUP /end SUB_GROUP /begin FUNCTION_LIST /end FUNCTION_LIST /begin REF_CHARACTERISTIC /end REF_CHARACTERISTIC /begin REF_MEASUREMENT StHlthSigNormn.WhlImbMaxCmpStHlth.Val /end REF_MEASUREMENT /end GROUP
/begin GROUP StHlthSigNormn.WhlImbRejctnCmd.Val "MICROSAR RTE" /begin SUB_GROUP /end SUB_GROUP /begin FUNCTION_LIST /end FUNCTION_LIST /begin REF_CHARACTERISTIC /end REF_CHARACTERISTIC /begin REF_MEASUREMENT StHlthSigNormn.WhlImbRejctnCmd.Val /end REF_MEASUREMENT /end GROUP
/begin GROUP StHlthSigStc "MICROSAR RTE"
 /begin SUB_GROUP StHlthSigStc.PerInstanceMemories StHlthSigStc.ReceiverPorts /end SUB_GROUP
 /begin FUNCTION_LIST /end FUNCTION_LIST
 /begin REF_CHARACTERISTIC /end REF_CHARACTERISTIC
 /begin REF_MEASUREMENT /end REF_MEASUREMENT
/end GROUP
/begin GROUP StHlthSigStc.AbsltMotPosABDifStHlth.Val "MICROSAR RTE" /begin SUB_GROUP /end SUB_GROUP /begin FUNCTION_LIST /end FUNCTION_LIST /begin REF_CHARACTERISTIC /end REF_CHARACTERISTIC /begin REF_MEASUREMENT StHlthSigStc.AbsltMotPosABDifStHlth.Val /end REF_MEASUREMENT /end GROUP
/begin GROUP StHlthSigStc.AbsltMotPosACDifStHlth.Val "MICROSAR RTE" /begin SUB_GROUP /end SUB_GROUP /begin FUNCTION_LIST /end FUNCTION_LIST /begin REF_CHARACTERISTIC /end REF_CHARACTERISTIC /begin REF_MEASUREMENT StHlthSigStc.AbsltMotPosACDifStHlth.Val /end REF_MEASUREMENT /end GROUP
/begin GROUP StHlthSigStc.AbsltMotPosBCDifStHlth.Val "MICROSAR RTE" /begin SUB_GROUP /end SUB_GROUP /begin FUNCTION_LIST /end FUNCTION_LIST /begin REF_CHARACTERISTIC /end REF_CHARACTERISTIC /begin REF_MEASUREMENT StHlthSigStc.AbsltMotPosBCDifStHlth.Val /end REF_MEASUREMENT /end GROUP
/begin GROUP StHlthSigStc.CtrlrTStHlth.Val "MICROSAR RTE" /begin SUB_GROUP /end SUB_GROUP /begin FUNCTION_LIST /end FUNCTION_LIST /begin REF_CHARACTERISTIC /end REF_CHARACTERISTIC /begin REF_MEASUREMENT StHlthSigStc.CtrlrTStHlth.Val /end REF_MEASUREMENT /end GROUP
/begin GROUP StHlthSigStc.CurrMotSumABCStHlth.Val "MICROSAR RTE" /begin SUB_GROUP /end SUB_GROUP /begin FUNCTION_LIST /end FUNCTION_LIST /begin REF_CHARACTERISTIC /end REF_CHARACTERISTIC /begin REF_MEASUREMENT StHlthSigStc.CurrMotSumABCStHlth.Val /end REF_MEASUREMENT /end GROUP
/begin GROUP StHlthSigStc.CurrMotSumDEFStHlth.Val "MICROSAR RTE" /begin SUB_GROUP /end SUB_GROUP /begin FUNCTION_LIST /end FUNCTION_LIST /begin REF_CHARACTERISTIC /end REF_CHARACTERISTIC /begin REF_MEASUREMENT StHlthSigStc.CurrMotSumDEFStHlth.Val /end REF_MEASUREMENT /end GROUP
/begin GROUP StHlthSigStc.DigTqIdptSigStHlth.Val "MICROSAR RTE" /begin SUB_GROUP /end SUB_GROUP /begin FUNCTION_LIST /end FUNCTION_LIST /begin REF_CHARACTERISTIC /end REF_CHARACTERISTIC /begin REF_MEASUREMENT StHlthSigStc.DigTqIdptSigStHlth.Val /end REF_MEASUREMENT /end GROUP
/begin GROUP StHlthSigStc.DigTqSnsrAStHlth.Val "MICROSAR RTE" /begin SUB_GROUP /end SUB_GROUP /begin FUNCTION_LIST /end FUNCTION_LIST /begin REF_CHARACTERISTIC /end REF_CHARACTERISTIC /begin REF_MEASUREMENT StHlthSigStc.DigTqSnsrAStHlth.Val /end REF_MEASUREMENT /end GROUP
/begin GROUP StHlthSigStc.DigTqSnsrBStHlth.Val "MICROSAR RTE" /begin SUB_GROUP /end SUB_GROUP /begin FUNCTION_LIST /end FUNCTION_LIST /begin REF_CHARACTERISTIC /end REF_CHARACTERISTIC /begin REF_MEASUREMENT StHlthSigStc.DigTqSnsrBStHlth.Val /end REF_MEASUREMENT /end GROUP
/begin GROUP StHlthSigStc.DutyCycStHlth.Val "MICROSAR RTE" /begin SUB_GROUP /end SUB_GROUP /begin FUNCTION_LIST /end FUNCTION_LIST /begin REF_CHARACTERISTIC /end REF_CHARACTERISTIC /begin REF_MEASUREMENT StHlthSigStc.DutyCycStHlth.Val /end REF_MEASUREMENT /end GROUP
/begin GROUP StHlthSigStc.EotImpctStHlth.Val "MICROSAR RTE" /begin SUB_GROUP /end SUB_GROUP /begin FUNCTION_LIST /end FUNCTION_LIST /begin REF_CHARACTERISTIC /end REF_CHARACTERISTIC /begin REF_MEASUREMENT StHlthSigStc.EotImpctStHlth.Val /end REF_MEASUREMENT /end GROUP
/begin GROUP StHlthSigStc.FricEstimnStHlth.Val "MICROSAR RTE" /begin SUB_GROUP /end SUB_GROUP /begin FUNCTION_LIST /end FUNCTION_LIST /begin REF_CHARACTERISTIC /end REF_CHARACTERISTIC /begin REF_MEASUREMENT StHlthSigStc.FricEstimnStHlth.Val /end REF_MEASUREMENT /end GROUP
/begin GROUP StHlthSigStc.MotPosStHlth.Val "MICROSAR RTE" /begin SUB_GROUP /end SUB_GROUP /begin FUNCTION_LIST /end FUNCTION_LIST /begin REF_CHARACTERISTIC /end REF_CHARACTERISTIC /begin REF_MEASUREMENT StHlthSigStc.MotPosStHlth.Val /end REF_MEASUREMENT /end GROUP
/begin GROUP StHlthSigStc.OutpAssiStHlth.Val "MICROSAR RTE" /begin SUB_GROUP /end SUB_GROUP /begin FUNCTION_LIST /end FUNCTION_LIST /begin REF_CHARACTERISTIC /end REF_CHARACTERISTIC /begin REF_MEASUREMENT StHlthSigStc.OutpAssiStHlth.Val /end REF_MEASUREMENT /end GROUP
/begin GROUP StHlthSigStc.PerInstanceMemories "MICROSAR RTE" /begin SUB_GROUP StHlthSigStc.SigStcHistDataAry StHlthSigStc.VldNvm /end SUB_GROUP /begin FUNCTION_LIST /end FUNCTION_LIST /begin REF_CHARACTERISTIC /end REF_CHARACTERISTIC /begin REF_MEASUREMENT /end REF_MEASUREMENT /end GROUP
/begin GROUP StHlthSigStc.PhaAStHlth.Val "MICROSAR RTE" /begin SUB_GROUP /end SUB_GROUP /begin FUNCTION_LIST /end FUNCTION_LIST /begin REF_CHARACTERISTIC /end REF_CHARACTERISTIC /begin REF_MEASUREMENT StHlthSigStc.PhaAStHlth.Val /end REF_MEASUREMENT /end GROUP
/begin GROUP StHlthSigStc.PhaBStHlth.Val "MICROSAR RTE" /begin SUB_GROUP /end SUB_GROUP /begin FUNCTION_LIST /end FUNCTION_LIST /begin REF_CHARACTERISTIC /end REF_CHARACTERISTIC /begin REF_MEASUREMENT StHlthSigStc.PhaBStHlth.Val /end REF_MEASUREMENT /end GROUP
/begin GROUP StHlthSigStc.PhaCStHlth.Val "MICROSAR RTE" /begin SUB_GROUP /end SUB_GROUP /begin FUNCTION_LIST /end FUNCTION_LIST /begin REF_CHARACTERISTIC /end REF_CHARACTERISTIC /begin REF_MEASUREMENT StHlthSigStc.PhaCStHlth.Val /end REF_MEASUREMENT /end GROUP
/begin GROUP StHlthSigStc.PhaDStHlth.Val "MICROSAR RTE" /begin SUB_GROUP /end SUB_GROUP /begin FUNCTION_LIST /end FUNCTION_LIST /begin REF_CHARACTERISTIC /end REF_CHARACTERISTIC /begin REF_MEASUREMENT StHlthSigStc.PhaDStHlth.Val /end REF_MEASUREMENT /end GROUP
/begin GROUP StHlthSigStc.PhaEStHlth.Val "MICROSAR RTE" /begin SUB_GROUP /end SUB_GROUP /begin FUNCTION_LIST /end FUNCTION_LIST /begin REF_CHARACTERISTIC /end REF_CHARACTERISTIC /begin REF_MEASUREMENT StHlthSigStc.PhaEStHlth.Val /end REF_MEASUREMENT /end GROUP
/begin GROUP StHlthSigStc.PhaFStHlth.Val "MICROSAR RTE" /begin SUB_GROUP /end SUB_GROUP /begin FUNCTION_LIST /end FUNCTION_LIST /begin REF_CHARACTERISTIC /end REF_CHARACTERISTIC /begin REF_MEASUREMENT StHlthSigStc.PhaFStHlth.Val /end REF_MEASUREMENT /end GROUP
/begin GROUP StHlthSigStc.RamEccSngBitCorrnStHlth.Val "MICROSAR RTE" /begin SUB_GROUP /end SUB_GROUP /begin FUNCTION_LIST /end FUNCTION_LIST /begin REF_CHARACTERISTIC /end REF_CHARACTERISTIC /begin REF_MEASUREMENT StHlthSigStc.RamEccSngBitCorrnStHlth.Val /end REF_MEASUREMENT /end GROUP
/begin GROUP StHlthSigStc.ReceiverPorts "MICROSAR RTE"
 /begin SUB_GROUP StHlthSigStc.AbsltMotPosABDifStHlth.Val StHlthSigStc.AbsltMotPosACDifStHlth.Val StHlthSigStc.AbsltMotPosBCDifStHlth.Val StHlthSigStc.CtrlrTStHlth.Val StHlthSigStc.CurrMotSumABCStHlth.Val StHlthSigStc.CurrMotSumDEFStHlth.Val StHlthSigStc.DigTqIdptSigStHlth.Val StHlthSigStc.DigTqSnsrAStHlth.Val StHlthSigStc.DigTqSnsrBStHlth.Val StHlthSigStc.DutyCycStHlth.Val StHlthSigStc.EotImpctStHlth.Val StHlthSigStc.FricEstimnStHlth.Val StHlthSigStc.MotPosStHlth.Val StHlthSigStc.OutpAssiStHlth.Val StHlthSigStc.PhaAStHlth.Val StHlthSigStc.PhaBStHlth.Val StHlthSigStc.PhaCStHlth.Val StHlthSigStc.PhaDStHlth.Val StHlthSigStc.PhaEStHlth.Val StHlthSigStc.PhaFStHlth.Val StHlthSigStc.RamEccSngBitCorrnStHlth.Val StHlthSigStc.WhlImbMaxCmpStHlth.Val /end SUB_GROUP
 /begin FUNCTION_LIST /end FUNCTION_LIST
 /begin REF_CHARACTERISTIC /end REF_CHARACTERISTIC
 /begin REF_MEASUREMENT /end REF_MEASUREMENT
/end GROUP
/begin GROUP StHlthSigStc.SigStcHistDataAry "MICROSAR RTE" /begin SUB_GROUP /end SUB_GROUP /begin FUNCTION_LIST /end FUNCTION_LIST /begin REF_CHARACTERISTIC /end REF_CHARACTERISTIC /begin REF_MEASUREMENT StHlthSigStc.SigStcHistDataAry /end REF_MEASUREMENT /end GROUP
/begin GROUP StHlthSigStc.VldNvm "MICROSAR RTE" /begin SUB_GROUP /end SUB_GROUP /begin FUNCTION_LIST /end FUNCTION_LIST /begin REF_CHARACTERISTIC /end REF_CHARACTERISTIC /begin REF_MEASUREMENT StHlthSigStc.VldNvm /end REF_MEASUREMENT /end GROUP
/begin GROUP StHlthSigStc.WhlImbMaxCmpStHlth.Val "MICROSAR RTE" /begin SUB_GROUP /end SUB_GROUP /begin FUNCTION_LIST /end FUNCTION_LIST /begin REF_CHARACTERISTIC /end REF_CHARACTERISTIC /begin REF_MEASUREMENT StHlthSigStc.WhlImbMaxCmpStHlth.Val /end REF_MEASUREMENT /end GROUP
/begin GROUP StOutpCtrl "MICROSAR RTE"
 /begin SUB_GROUP StOutpCtrl.PerInstanceMemories StOutpCtrl.ReceiverPorts StOutpCtrl.SenderPorts /end SUB_GROUP
 /begin FUNCTION_LIST /end FUNCTION_LIST
 /begin REF_CHARACTERISTIC /end REF_CHARACTERISTIC
 /begin REF_MEASUREMENT /end REF_MEASUREMENT
/end GROUP
/begin GROUP StOutpCtrl.LoaRateLim.Val "MICROSAR RTE" /begin SUB_GROUP /end SUB_GROUP /begin FUNCTION_LIST /end FUNCTION_LIST /begin REF_CHARACTERISTIC /end REF_CHARACTERISTIC /begin REF_MEASUREMENT StOutpCtrl.LoaRateLim.Val /end REF_MEASUREMENT /end GROUP
/begin GROUP StOutpCtrl.LoaSca.Val "MICROSAR RTE" /begin SUB_GROUP /end SUB_GROUP /begin FUNCTION_LIST /end FUNCTION_LIST /begin REF_CHARACTERISTIC /end REF_CHARACTERISTIC /begin REF_MEASUREMENT StOutpCtrl.LoaSca.Val /end REF_MEASUREMENT /end GROUP
/begin GROUP StOutpCtrl.PerInstanceMemories "MICROSAR RTE"
 /begin SUB_GROUP StOutpCtrl.StOutpCtrlPrevCmdSca StOutpCtrl.StOutpCtrlPrevSrc StOutpCtrl.dStOutpCtrlRateLim StOutpCtrl.dStOutpCtrlTarSca /end SUB_GROUP
 /begin FUNCTION_LIST /end FUNCTION_LIST
 /begin REF_CHARACTERISTIC /end REF_CHARACTERISTIC
 /begin REF_MEASUREMENT /end REF_MEASUREMENT
/end GROUP
/begin GROUP StOutpCtrl.ReceiverPorts "MICROSAR RTE"
 /begin SUB_GROUP StOutpCtrl.LoaRateLim.Val StOutpCtrl.LoaSca.Val StOutpCtrl.SysDiMotTqCmdSca.Val StOutpCtrl.SysDiRampRate.Val StOutpCtrl.SysMotTqCmdRampRateDi.Logl StOutpCtrl.SysOperMotTqCmdSca.Val StOutpCtrl.SysOperRampRate.Val StOutpCtrl.SysStFltOutpReqDi.Logl StOutpCtrl.VehStrtStopMotTqCmdSca.Val StOutpCtrl.VehStrtStopRampRate.Val /end SUB_GROUP
 /begin FUNCTION_LIST /end FUNCTION_LIST
 /begin REF_CHARACTERISTIC /end REF_CHARACTERISTIC
 /begin REF_MEASUREMENT /end REF_MEASUREMENT
/end GROUP
/begin GROUP StOutpCtrl.SenderPorts "MICROSAR RTE" /begin SUB_GROUP StOutpCtrl.SysMotTqCmdSca.Val StOutpCtrl.SysStReqDi.Logl /end SUB_GROUP /begin FUNCTION_LIST /end FUNCTION_LIST /begin REF_CHARACTERISTIC /end REF_CHARACTERISTIC /begin REF_MEASUREMENT /end REF_MEASUREMENT /end GROUP
/begin GROUP StOutpCtrl.StOutpCtrlPrevCmdSca "MICROSAR RTE" /begin SUB_GROUP /end SUB_GROUP /begin FUNCTION_LIST /end FUNCTION_LIST /begin REF_CHARACTERISTIC /end REF_CHARACTERISTIC /begin REF_MEASUREMENT StOutpCtrl.StOutpCtrlPrevCmdSca /end REF_MEASUREMENT /end GROUP
/begin GROUP StOutpCtrl.StOutpCtrlPrevSrc "MICROSAR RTE" /begin SUB_GROUP /end SUB_GROUP /begin FUNCTION_LIST /end FUNCTION_LIST /begin REF_CHARACTERISTIC /end REF_CHARACTERISTIC /begin REF_MEASUREMENT StOutpCtrl.StOutpCtrlPrevSrc /end REF_MEASUREMENT /end GROUP
/begin GROUP StOutpCtrl.SysDiMotTqCmdSca.Val "MICROSAR RTE" /begin SUB_GROUP /end SUB_GROUP /begin FUNCTION_LIST /end FUNCTION_LIST /begin REF_CHARACTERISTIC /end REF_CHARACTERISTIC /begin REF_MEASUREMENT StOutpCtrl.SysDiMotTqCmdSca.Val /end REF_MEASUREMENT /end GROUP
/begin GROUP StOutpCtrl.SysDiRampRate.Val "MICROSAR RTE" /begin SUB_GROUP /end SUB_GROUP /begin FUNCTION_LIST /end FUNCTION_LIST /begin REF_CHARACTERISTIC /end REF_CHARACTERISTIC /begin REF_MEASUREMENT StOutpCtrl.SysDiRampRate.Val /end REF_MEASUREMENT /end GROUP
/begin GROUP StOutpCtrl.SysMotTqCmdRampRateDi.Logl "MICROSAR RTE" /begin SUB_GROUP /end SUB_GROUP /begin FUNCTION_LIST /end FUNCTION_LIST /begin REF_CHARACTERISTIC /end REF_CHARACTERISTIC /begin REF_MEASUREMENT StOutpCtrl.SysMotTqCmdRampRateDi.Logl /end REF_MEASUREMENT /end GROUP
/begin GROUP StOutpCtrl.SysMotTqCmdSca.Val "MICROSAR RTE" /begin SUB_GROUP /end SUB_GROUP /begin FUNCTION_LIST /end FUNCTION_LIST /begin REF_CHARACTERISTIC /end REF_CHARACTERISTIC /begin REF_MEASUREMENT StOutpCtrl.SysMotTqCmdSca.Val /end REF_MEASUREMENT /end GROUP
/begin GROUP StOutpCtrl.SysOperMotTqCmdSca.Val "MICROSAR RTE" /begin SUB_GROUP /end SUB_GROUP /begin FUNCTION_LIST /end FUNCTION_LIST /begin REF_CHARACTERISTIC /end REF_CHARACTERISTIC /begin REF_MEASUREMENT StOutpCtrl.SysOperMotTqCmdSca.Val /end REF_MEASUREMENT /end GROUP
/begin GROUP StOutpCtrl.SysOperRampRate.Val "MICROSAR RTE" /begin SUB_GROUP /end SUB_GROUP /begin FUNCTION_LIST /end FUNCTION_LIST /begin REF_CHARACTERISTIC /end REF_CHARACTERISTIC /begin REF_MEASUREMENT StOutpCtrl.SysOperRampRate.Val /end REF_MEASUREMENT /end GROUP
/begin GROUP StOutpCtrl.SysStFltOutpReqDi.Logl "MICROSAR RTE" /begin SUB_GROUP /end SUB_GROUP /begin FUNCTION_LIST /end FUNCTION_LIST /begin REF_CHARACTERISTIC /end REF_CHARACTERISTIC /begin REF_MEASUREMENT StOutpCtrl.SysStFltOutpReqDi.Logl /end REF_MEASUREMENT /end GROUP
/begin GROUP StOutpCtrl.SysStReqDi.Logl "MICROSAR RTE" /begin SUB_GROUP /end SUB_GROUP /begin FUNCTION_LIST /end FUNCTION_LIST /begin REF_CHARACTERISTIC /end REF_CHARACTERISTIC /begin REF_MEASUREMENT StOutpCtrl.SysStReqDi.Logl /end REF_MEASUREMENT /end GROUP
/begin GROUP StOutpCtrl.VehStrtStopMotTqCmdSca.Val "MICROSAR RTE" /begin SUB_GROUP /end SUB_GROUP /begin FUNCTION_LIST /end FUNCTION_LIST /begin REF_CHARACTERISTIC /end REF_CHARACTERISTIC /begin REF_MEASUREMENT StOutpCtrl.VehStrtStopMotTqCmdSca.Val /end REF_MEASUREMENT /end GROUP
/begin GROUP StOutpCtrl.VehStrtStopRampRate.Val "MICROSAR RTE" /begin SUB_GROUP /end SUB_GROUP /begin FUNCTION_LIST /end FUNCTION_LIST /begin REF_CHARACTERISTIC /end REF_CHARACTERISTIC /begin REF_MEASUREMENT StOutpCtrl.VehStrtStopRampRate.Val /end REF_MEASUREMENT /end GROUP
/begin GROUP StOutpCtrl.dStOutpCtrlRateLim "MICROSAR RTE" /begin SUB_GROUP /end SUB_GROUP /begin FUNCTION_LIST /end FUNCTION_LIST /begin REF_CHARACTERISTIC /end REF_CHARACTERISTIC /begin REF_MEASUREMENT StOutpCtrl.dStOutpCtrlRateLim /end REF_MEASUREMENT /end GROUP
/begin GROUP StOutpCtrl.dStOutpCtrlTarSca "MICROSAR RTE" /begin SUB_GROUP /end SUB_GROUP /begin FUNCTION_LIST /end FUNCTION_LIST /begin REF_CHARACTERISTIC /end REF_CHARACTERISTIC /begin REF_MEASUREMENT StOutpCtrl.dStOutpCtrlTarSca /end REF_MEASUREMENT /end GROUP
/begin GROUP StabyCmp "MICROSAR RTE"
 /begin SUB_GROUP StabyCmp.CalibrationPorts StabyCmp.PerInstanceMemories StabyCmp.ReceiverPorts StabyCmp.SenderPorts /end SUB_GROUP
 /begin FUNCTION_LIST /end FUNCTION_LIST
 /begin REF_CHARACTERISTIC /end REF_CHARACTERISTIC
 /begin REF_MEASUREMENT /end REF_MEASUREMENT
/end GROUP
/begin GROUP StabyCmp.AssiCmd.Val "MICROSAR RTE" /begin SUB_GROUP /end SUB_GROUP /begin FUNCTION_LIST /end FUNCTION_LIST /begin REF_CHARACTERISTIC /end REF_CHARACTERISTIC /begin REF_MEASUREMENT StabyCmp.AssiCmd.Val /end REF_MEASUREMENT /end GROUP
/begin GROUP StabyCmp.AssiCmdBasSca.Val "MICROSAR RTE" /begin SUB_GROUP /end SUB_GROUP /begin FUNCTION_LIST /end FUNCTION_LIST /begin REF_CHARACTERISTIC /end REF_CHARACTERISTIC /begin REF_MEASUREMENT StabyCmp.AssiCmdBasSca.Val /end REF_MEASUREMENT /end GROUP
/begin GROUP StabyCmp.AssiCmdSum.Val "MICROSAR RTE" /begin SUB_GROUP /end SUB_GROUP /begin FUNCTION_LIST /end FUNCTION_LIST /begin REF_CHARACTERISTIC /end REF_CHARACTERISTIC /begin REF_MEASUREMENT StabyCmp.AssiCmdSum.Val /end REF_MEASUREMENT /end GROUP
/begin GROUP StabyCmp.AssiNotch1Fil "MICROSAR RTE" /begin SUB_GROUP /end SUB_GROUP /begin FUNCTION_LIST /end FUNCTION_LIST /begin REF_CHARACTERISTIC /end REF_CHARACTERISTIC
 /begin REF_MEASUREMENT StabyCmp.AssiNotch1Fil.FilSt1 StabyCmp.AssiNotch1Fil.FilSt2 /end REF_MEASUREMENT
/end GROUP
/begin GROUP StabyCmp.AssiNotch2Fil "MICROSAR RTE" /begin SUB_GROUP /end SUB_GROUP /begin FUNCTION_LIST /end FUNCTION_LIST /begin REF_CHARACTERISTIC /end REF_CHARACTERISTIC
 /begin REF_MEASUREMENT StabyCmp.AssiNotch2Fil.FilSt1 StabyCmp.AssiNotch2Fil.FilSt2 /end REF_MEASUREMENT
/end GROUP
/begin GROUP StabyCmp.AssiNotch3Fil "MICROSAR RTE" /begin SUB_GROUP /end SUB_GROUP /begin FUNCTION_LIST /end FUNCTION_LIST /begin REF_CHARACTERISTIC /end REF_CHARACTERISTIC
 /begin REF_MEASUREMENT StabyCmp.AssiNotch3Fil.FilSt1 StabyCmp.AssiNotch3Fil.FilSt2 /end REF_MEASUREMENT
/end GROUP
/begin GROUP StabyCmp.AssiNotch4Fil "MICROSAR RTE" /begin SUB_GROUP /end SUB_GROUP /begin FUNCTION_LIST /end FUNCTION_LIST /begin REF_CHARACTERISTIC /end REF_CHARACTERISTIC
 /begin REF_MEASUREMENT StabyCmp.AssiNotch4Fil.FilSt1 StabyCmp.AssiNotch4Fil.FilSt2 /end REF_MEASUREMENT
/end GROUP
/begin GROUP StabyCmp.AssiPahLimrActv.Val "MICROSAR RTE" /begin SUB_GROUP /end SUB_GROUP /begin FUNCTION_LIST /end FUNCTION_LIST /begin REF_CHARACTERISTIC /end REF_CHARACTERISTIC /begin REF_MEASUREMENT StabyCmp.AssiPahLimrActv.Val /end REF_MEASUREMENT /end GROUP
/begin GROUP StabyCmp.CalibrationPorts "MICROSAR RTE"
 /begin SUB_GROUP StabyCmp.StabyCmpAssiScaBlndX.Ary1D StabyCmp.StabyCmpAssiScaBlndY.Ary1D StabyCmp.StabyCmpHwTqLpFilFrq.Val StabyCmp.StabyCmpNotchFil1Struct.Rec StabyCmp.StabyCmpNotchFil2Struct.Rec StabyCmp.StabyCmpNotchFil3Struct.Rec StabyCmp.StabyCmpNotchFil4Struct.Rec StabyCmp.StabyCmpNotchFilBilnrBlndVehSpd.Ary1D StabyCmp.StabyCmpNotchFilBlnd02Y.Ary2D StabyCmp.StabyCmpNotchFilBlnd04Y.Ary2D StabyCmp.StabyCmpNotchFilBlnd12TqX.Ary2D StabyCmp.StabyCmpNotchFilBlnd12Y.Ary2D StabyCmp.StabyCmpNotchFilBlnd34TqX.Ary2D StabyCmp.StabyCmpNotchFilBlnd34Y.Ary2D /end SUB_GROUP
 /begin FUNCTION_LIST /end FUNCTION_LIST
 /begin REF_CHARACTERISTIC /end REF_CHARACTERISTIC
 /begin REF_MEASUREMENT /end REF_MEASUREMENT
/end GROUP
/begin GROUP StabyCmp.HwTq.Val "MICROSAR RTE" /begin SUB_GROUP /end SUB_GROUP /begin FUNCTION_LIST /end FUNCTION_LIST /begin REF_CHARACTERISTIC /end REF_CHARACTERISTIC /begin REF_MEASUREMENT StabyCmp.HwTq.Val /end REF_MEASUREMENT /end GROUP
/begin GROUP StabyCmp.HwTqLpFil "MICROSAR RTE" /begin SUB_GROUP /end SUB_GROUP /begin FUNCTION_LIST /end FUNCTION_LIST /begin REF_CHARACTERISTIC /end REF_CHARACTERISTIC /begin REF_MEASUREMENT StabyCmp.HwTqLpFil.FilGain StabyCmp.HwTqLpFil.FilSt /end REF_MEASUREMENT /end GROUP
/begin GROUP StabyCmp.PerInstanceMemories "MICROSAR RTE"
 /begin SUB_GROUP StabyCmp.AssiNotch1Fil StabyCmp.AssiNotch2Fil StabyCmp.AssiNotch3Fil StabyCmp.AssiNotch4Fil StabyCmp.HwTqLpFil StabyCmp.dStabyCmpAssiScaCmpBlnd StabyCmp.dStabyCmpNotchFil02Blnd StabyCmp.dStabyCmpNotchFil04Blnd StabyCmp.dStabyCmpNotchFil12Blnd StabyCmp.dStabyCmpNotchFil12Outp StabyCmp.dStabyCmpNotchFil1Outp StabyCmp.dStabyCmpNotchFil2Outp StabyCmp.dStabyCmpNotchFil34Blnd StabyCmp.dStabyCmpNotchFil34Outp StabyCmp.dStabyCmpNotchFil3Outp StabyCmp.dStabyCmpNotchFil4Outp /end SUB_GROUP
 /begin FUNCTION_LIST /end FUNCTION_LIST
 /begin REF_CHARACTERISTIC /end REF_CHARACTERISTIC
 /begin REF_MEASUREMENT /end REF_MEASUREMENT
/end GROUP
/begin GROUP StabyCmp.ReceiverPorts "MICROSAR RTE"
 /begin SUB_GROUP StabyCmp.AssiCmdBasSca.Val StabyCmp.AssiCmdSum.Val StabyCmp.AssiPahLimrActv.Val StabyCmp.HwTq.Val StabyCmp.VehSpd.Val /end SUB_GROUP
 /begin FUNCTION_LIST /end FUNCTION_LIST
 /begin REF_CHARACTERISTIC /end REF_CHARACTERISTIC
 /begin REF_MEASUREMENT /end REF_MEASUREMENT
/end GROUP
/begin GROUP StabyCmp.SenderPorts "MICROSAR RTE" /begin SUB_GROUP StabyCmp.AssiCmd.Val /end SUB_GROUP /begin FUNCTION_LIST /end FUNCTION_LIST /begin REF_CHARACTERISTIC /end REF_CHARACTERISTIC /begin REF_MEASUREMENT /end REF_MEASUREMENT /end GROUP
/begin GROUP StabyCmp.StabyCmpAssiScaBlndX.Ary1D "MICROSAR RTE" /begin SUB_GROUP /end SUB_GROUP /begin FUNCTION_LIST /end FUNCTION_LIST /begin REF_CHARACTERISTIC StabyCmp.StabyCmpAssiScaBlndX.Ary1D /end REF_CHARACTERISTIC /begin REF_MEASUREMENT /end REF_MEASUREMENT /end GROUP
/begin GROUP StabyCmp.StabyCmpAssiScaBlndY.Ary1D "MICROSAR RTE" /begin SUB_GROUP /end SUB_GROUP /begin FUNCTION_LIST /end FUNCTION_LIST /begin REF_CHARACTERISTIC StabyCmp.StabyCmpAssiScaBlndY.Ary1D /end REF_CHARACTERISTIC /begin REF_MEASUREMENT /end REF_MEASUREMENT /end GROUP
/begin GROUP StabyCmp.StabyCmpHwTqLpFilFrq.Val "MICROSAR RTE" /begin SUB_GROUP /end SUB_GROUP /begin FUNCTION_LIST /end FUNCTION_LIST /begin REF_CHARACTERISTIC StabyCmp.StabyCmpHwTqLpFilFrq.Val /end REF_CHARACTERISTIC /begin REF_MEASUREMENT /end REF_MEASUREMENT /end GROUP
/begin GROUP StabyCmp.StabyCmpNotchFil1Struct.Rec "MICROSAR RTE" /begin SUB_GROUP /end SUB_GROUP /begin FUNCTION_LIST /end FUNCTION_LIST
 /begin REF_CHARACTERISTIC StabyCmp.StabyCmpNotchFil1Struct.Rec.FilGainA1 StabyCmp.StabyCmpNotchFil1Struct.Rec.FilGainA2 StabyCmp.StabyCmpNotchFil1Struct.Rec.FilGainB0 StabyCmp.StabyCmpNotchFil1Struct.Rec.FilGainB1 StabyCmp.StabyCmpNotchFil1Struct.Rec.FilGainB2 /end REF_CHARACTERISTIC
 /begin REF_MEASUREMENT /end REF_MEASUREMENT
/end GROUP
/begin GROUP StabyCmp.StabyCmpNotchFil2Struct.Rec "MICROSAR RTE" /begin SUB_GROUP /end SUB_GROUP /begin FUNCTION_LIST /end FUNCTION_LIST
 /begin REF_CHARACTERISTIC StabyCmp.StabyCmpNotchFil2Struct.Rec.FilGainA1 StabyCmp.StabyCmpNotchFil2Struct.Rec.FilGainA2 StabyCmp.StabyCmpNotchFil2Struct.Rec.FilGainB0 StabyCmp.StabyCmpNotchFil2Struct.Rec.FilGainB1 StabyCmp.StabyCmpNotchFil2Struct.Rec.FilGainB2 /end REF_CHARACTERISTIC
 /begin REF_MEASUREMENT /end REF_MEASUREMENT
/end GROUP
/**********************************************************************************************************************
* RECORD_LAYOUT
*********************************************************************************************************************/
/begin RECORD_LAYOUT RTE_RL_UBYTE FNC_VALUES 1 UBYTE ROW_DIR DIRECT /end RECORD_LAYOUT
/begin RECORD_LAYOUT RTE_RL_UWORD FNC_VALUES 1 UWORD ROW_DIR DIRECT /end RECORD_LAYOUT
/begin RECORD_LAYOUT RTE_RL_ULONG FNC_VALUES 1 ULONG ROW_DIR DIRECT /end RECORD_LAYOUT
/begin RECORD_LAYOUT RTE_RL_FLOAT32_IEEE FNC_VALUES 1 FLOAT32_IEEE ROW_DIR DIRECT /end RECORD_LAYOUT
/begin RECORD_LAYOUT RTE_RL_BOOLEAN FNC_VALUES 1 UBYTE ROW_DIR DIRECT /end RECORD_LAYOUT
/**********************************************************************************************************************
* COMPU_METHOD / COMPU_VTAB_RANGE
*********************************************************************************************************************/
/begin COMPU_METHOD RTE_CM_BOOLEAN "" TAB_VERB "%3.1" "" COMPU_TAB_REF RTE_CM_BOOLEAN /end COMPU_METHOD
/begin COMPU_VTAB_RANGE RTE_CM_BOOLEAN "" 2 0 0 "false" 1 255 "true" /end COMPU_VTAB_RANGE
