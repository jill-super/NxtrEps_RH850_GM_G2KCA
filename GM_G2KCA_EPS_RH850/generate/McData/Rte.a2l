/begin CHARACTERISTIC CalRegn03Rt02GroupA.HysCmpFricWhlImbRejctnBlndX.Ary1D "MICROSAR RTE" VAL_BLK 0x0 RTE_RL_UWORD 0 NO_COMPU_METHOD 0 65535 MATRIX_DIM 6 1 1 SYMBOL_LINK "Rte_CalprmRom_CalRegn03Rt02GroupA_DEFAULT_RTE_CALPRM_GROUP.HysCmpFricWhlImbRejctnBlndX_Ary1D" 0 DISPLAY_IDENTIFIER CalRegn03Rt02GroupA.CalibrationPorts.HysCmpFricWhlImbRejctnBlndX.Ary1D /end CHARACTERISTIC
/begin CHARACTERISTIC CalRegn03Rt02GroupA.HysCmpFricWhlImbRejctnBlndY.Ary1D "MICROSAR RTE" VAL_BLK 0x0 RTE_RL_UWORD 0 NO_COMPU_METHOD 0 65535 MATRIX_DIM 6 1 1 SYMBOL_LINK "Rte_CalprmRom_CalRegn03Rt02GroupA_DEFAULT_RTE_CALPRM_GROUP.HysCmpFricWhlImbRejctnBlndY_Ary1D" 0 DISPLAY_IDENTIFIER CalRegn03Rt02GroupA.CalibrationPorts.HysCmpFricWhlImbRejctnBlndY.Ary1D /end CHARACTERISTIC
/begin CHARACTERISTIC CalRegn03Rt02GroupA.HysCmpFricWhlImbRejctnOffY.Ary1D "MICROSAR RTE" VAL_BLK 0x0 RTE_RL_UWORD 0 NO_COMPU_METHOD 0 65535 MATRIX_DIM 12 1 1 SYMBOL_LINK "Rte_CalprmRom_CalRegn03Rt02GroupA_DEFAULT_RTE_CALPRM_GROUP.HysCmpFricWhlImbRejctnOffY_Ary1D" 0 DISPLAY_IDENTIFIER CalRegn03Rt02GroupA.CalibrationPorts.HysCmpFricWhlImbRejctnOffY.Ary1D /end CHARACTERISTIC
/begin CHARACTERISTIC CalRegn03Rt02GroupA.HysCmpFricWhlImbRejctnOnY.Ary1D "MICROSAR RTE" VAL_BLK 0x0 RTE_RL_UWORD 0 NO_COMPU_METHOD 0 65535 MATRIX_DIM 12 1 1 SYMBOL_LINK "Rte_CalprmRom_CalRegn03Rt02GroupA_DEFAULT_RTE_CALPRM_GROUP.HysCmpFricWhlImbRejctnOnY_Ary1D" 0 DISPLAY_IDENTIFIER CalRegn03Rt02GroupA.CalibrationPorts.HysCmpFricWhlImbRejctnOnY.Ary1D /end CHARACTERISTIC
/begin CHARACTERISTIC CalRegn03Rt02GroupA.InertiaCmpVelAssiBasdDampgCoeffX.Ary1D "MICROSAR RTE" VAL_BLK 0x0 RTE_RL_UWORD 0 NO_COMPU_METHOD 0 65535 MATRIX_DIM 10 1 1 SYMBOL_LINK "Rte_CalprmRom_CalRegn03Rt02GroupA_DEFAULT_RTE_CALPRM_GROUP.InertiaCmpVelAssiBasdDampgCoeffX_Ary1D" 0 DISPLAY_IDENTIFIER CalRegn03Rt02GroupA.CalibrationPorts.InertiaCmpVelAssiBasdDampgCoeffX.Ary1D /end CHARACTERISTIC
/begin CHARACTERISTIC CalRegn03Rt02GroupA.InertiaCmpVelAssiBasdDampgRollgY.Ary1D "MICROSAR RTE" VAL_BLK 0x0 RTE_RL_UWORD 0 NO_COMPU_METHOD 0 65535 MATRIX_DIM 10 1 1 SYMBOL_LINK "Rte_CalprmRom_CalRegn03Rt02GroupA_DEFAULT_RTE_CALPRM_GROUP.InertiaCmpVelAssiBasdDampgRollgY_Ary1D" 0 DISPLAY_IDENTIFIER CalRegn03Rt02GroupA.CalibrationPorts.InertiaCmpVelAssiBasdDampgRollgY.Ary1D /end CHARACTERISTIC
/begin CHARACTERISTIC CalRegn03Rt02GroupA.InertiaCmpVelAssiBasdDampgStatY.Ary1D "MICROSAR RTE" VAL_BLK 0x0 RTE_RL_UWORD 0 NO_COMPU_METHOD 0 65535 MATRIX_DIM 10 1 1 SYMBOL_LINK "Rte_CalprmRom_CalRegn03Rt02GroupA_DEFAULT_RTE_CALPRM_GROUP.InertiaCmpVelAssiBasdDampgStatY_Ary1D" 0 DISPLAY_IDENTIFIER CalRegn03Rt02GroupA.CalibrationPorts.InertiaCmpVelAssiBasdDampgStatY.Ary1D /end CHARACTERISTIC
/begin CHARACTERISTIC CalRegn03Rt02GroupA.InertiaCmpVelDampgSpdBlndY.Ary1D "MICROSAR RTE" VAL_BLK 0x0 RTE_RL_UWORD 0 NO_COMPU_METHOD 0 65535 MATRIX_DIM 12 1 1 SYMBOL_LINK "Rte_CalprmRom_CalRegn03Rt02GroupA_DEFAULT_RTE_CALPRM_GROUP.InertiaCmpVelDampgSpdBlndY_Ary1D" 0 DISPLAY_IDENTIFIER CalRegn03Rt02GroupA.CalibrationPorts.InertiaCmpVelDampgSpdBlndY.Ary1D /end CHARACTERISTIC
/begin CHARACTERISTIC CalRegn03Rt02GroupA.InertiaCmpVelNotchBlndY.Ary1D "MICROSAR RTE" VAL_BLK 0x0 RTE_RL_UWORD 0 NO_COMPU_METHOD 0 65535 MATRIX_DIM 12 1 1 SYMBOL_LINK "Rte_CalprmRom_CalRegn03Rt02GroupA_DEFAULT_RTE_CALPRM_GROUP.InertiaCmpVelNotchBlndY_Ary1D" 0 DISPLAY_IDENTIFIER CalRegn03Rt02GroupA.CalibrationPorts.InertiaCmpVelNotchBlndY.Ary1D /end CHARACTERISTIC
/begin CHARACTERISTIC CalRegn03Rt02GroupA.RtnHwAgOffsCalcdX.Ary2D "MICROSAR RTE" VAL_BLK 0x0 RTE_RL_UWORD 0 NO_COMPU_METHOD 0 65535 MATRIX_DIM 16 9 1 SYMBOL_LINK "Rte_CalprmRom_CalRegn03Rt02GroupA_DEFAULT_RTE_CALPRM_GROUP.RtnHwAgOffsCalcdX_Ary2D" 0 DISPLAY_IDENTIFIER CalRegn03Rt02GroupA.CalibrationPorts.RtnHwAgOffsCalcdX.Ary2D /end CHARACTERISTIC
/begin CHARACTERISTIC CalRegn03Rt02GroupA.RtnHwAgOffsCalcdY.Ary2D "MICROSAR RTE" VAL_BLK 0x0 RTE_RL_UWORD 0 NO_COMPU_METHOD 0 65535 MATRIX_DIM 16 9 1 SYMBOL_LINK "Rte_CalprmRom_CalRegn03Rt02GroupA_DEFAULT_RTE_CALPRM_GROUP.RtnHwAgOffsCalcdY_Ary2D" 0 DISPLAY_IDENTIFIER CalRegn03Rt02GroupA.CalibrationPorts.RtnHwAgOffsCalcdY.Ary2D /end CHARACTERISTIC
/begin CHARACTERISTIC CalRegn03Rt02GroupA.RtnScaTqX.Ary2D "MICROSAR RTE" VAL_BLK 0x0 RTE_RL_UWORD 0 NO_COMPU_METHOD 0 65535 MATRIX_DIM 8 9 1 SYMBOL_LINK "Rte_CalprmRom_CalRegn03Rt02GroupA_DEFAULT_RTE_CALPRM_GROUP.RtnScaTqX_Ary2D" 0 DISPLAY_IDENTIFIER CalRegn03Rt02GroupA.CalibrationPorts.RtnScaTqX.Ary2D /end CHARACTERISTIC
/begin CHARACTERISTIC CalRegn03Rt02GroupA.RtnScaTqY.Ary2D "MICROSAR RTE" VAL_BLK 0x0 RTE_RL_UWORD 0 NO_COMPU_METHOD 0 65535 MATRIX_DIM 8 9 1 SYMBOL_LINK "Rte_CalprmRom_CalRegn03Rt02GroupA_DEFAULT_RTE_CALPRM_GROUP.RtnScaTqY_Ary2D" 0 DISPLAY_IDENTIFIER CalRegn03Rt02GroupA.CalibrationPorts.RtnScaTqY.Ary2D /end CHARACTERISTIC
/begin CHARACTERISTIC CalRegn03Rt02GroupA.RtnScaVelX.Ary2D "MICROSAR RTE" VAL_BLK 0x0 RTE_RL_UWORD 0 NO_COMPU_METHOD 0 65535 MATRIX_DIM 4 9 1 SYMBOL_LINK "Rte_CalprmRom_CalRegn03Rt02GroupA_DEFAULT_RTE_CALPRM_GROUP.RtnScaVelX_Ary2D" 0 DISPLAY_IDENTIFIER CalRegn03Rt02GroupA.CalibrationPorts.RtnScaVelX.Ary2D /end CHARACTERISTIC
/begin CHARACTERISTIC CalRegn03Rt02GroupA.RtnScaVelY.Ary2D "MICROSAR RTE" VAL_BLK 0x0 RTE_RL_UWORD 0 NO_COMPU_METHOD 0 65535 MATRIX_DIM 4 9 1 SYMBOL_LINK "Rte_CalprmRom_CalRegn03Rt02GroupA_DEFAULT_RTE_CALPRM_GROUP.RtnScaVelY_Ary2D" 0 DISPLAY_IDENTIFIER CalRegn03Rt02GroupA.CalibrationPorts.RtnScaVelY.Ary2D /end CHARACTERISTIC
/begin CHARACTERISTIC CalRegn03Rt02GroupB.AssiHiFrqTqWhlImbRejctnTqX.Ary2D "MICROSAR RTE" VAL_BLK 0x0 RTE_RL_UWORD 0 NO_COMPU_METHOD 0 65535 MATRIX_DIM 13 12 1 SYMBOL_LINK "Rte_CalprmRom_CalRegn03Rt02GroupB_DEFAULT_RTE_CALPRM_GROUP.AssiHiFrqTqWhlImbRejctnTqX_Ary2D" 0 DISPLAY_IDENTIFIER CalRegn03Rt02GroupB.CalibrationPorts.AssiHiFrqTqWhlImbRejctnTqX.Ary2D /end CHARACTERISTIC
/begin CHARACTERISTIC CalRegn03Rt02GroupB.AssiHiFrqWhlImbRejctnGainY.Ary2D "MICROSAR RTE" VAL_BLK 0x0 RTE_RL_UWORD 0 NO_COMPU_METHOD 0 65535 MATRIX_DIM 13 12 1 SYMBOL_LINK "Rte_CalprmRom_CalRegn03Rt02GroupB_DEFAULT_RTE_CALPRM_GROUP.AssiHiFrqWhlImbRejctnGainY_Ary2D" 0 DISPLAY_IDENTIFIER CalRegn03Rt02GroupB.CalibrationPorts.AssiHiFrqWhlImbRejctnGainY.Ary2D /end CHARACTERISTIC
/begin CHARACTERISTIC CalRegn03Rt02GroupB.AssiHiFrqWhlImbRejtcnBlndX.Ary2D "MICROSAR RTE" VAL_BLK 0x0 RTE_RL_UWORD 0 NO_COMPU_METHOD 0 65535 MATRIX_DIM 5 12 1 SYMBOL_LINK "Rte_CalprmRom_CalRegn03Rt02GroupB_DEFAULT_RTE_CALPRM_GROUP.AssiHiFrqWhlImbRejtcnBlndX_Ary2D" 0 DISPLAY_IDENTIFIER CalRegn03Rt02GroupB.CalibrationPorts.AssiHiFrqWhlImbRejtcnBlndX.Ary2D /end CHARACTERISTIC
/begin CHARACTERISTIC CalRegn03Rt02GroupB.AssiHiFrqWhlImbRejtcnBlndY.Ary2D "MICROSAR RTE" VAL_BLK 0x0 RTE_RL_UWORD 0 NO_COMPU_METHOD 0 65535 MATRIX_DIM 5 12 1 SYMBOL_LINK "Rte_CalprmRom_CalRegn03Rt02GroupB_DEFAULT_RTE_CALPRM_GROUP.AssiHiFrqWhlImbRejtcnBlndY_Ary2D" 0 DISPLAY_IDENTIFIER CalRegn03Rt02GroupB.CalibrationPorts.AssiHiFrqWhlImbRejtcnBlndY.Ary2D /end CHARACTERISTIC
/begin CHARACTERISTIC CalRegn03Rt02GroupB.AssiMotTqWhlImbRejctnMaxX.Ary2D "MICROSAR RTE" VAL_BLK 0x0 RTE_RL_UWORD 0 NO_COMPU_METHOD 0 65535 MATRIX_DIM 20 12 1 SYMBOL_LINK "Rte_CalprmRom_CalRegn03Rt02GroupB_DEFAULT_RTE_CALPRM_GROUP.AssiMotTqWhlImbRejctnMaxX_Ary2D" 0 DISPLAY_IDENTIFIER CalRegn03Rt02GroupB.CalibrationPorts.AssiMotTqWhlImbRejctnMaxX.Ary2D /end CHARACTERISTIC
/begin CHARACTERISTIC CalRegn03Rt02GroupB.AssiMotTqWhlImbRejctnMaxY.Ary2D "MICROSAR RTE" VAL_BLK 0x0 RTE_RL_SWORD 0 NO_COMPU_METHOD -32768 32767 MATRIX_DIM 20 12 1 SYMBOL_LINK "Rte_CalprmRom_CalRegn03Rt02GroupB_DEFAULT_RTE_CALPRM_GROUP.AssiMotTqWhlImbRejctnMaxY_Ary2D" 0 DISPLAY_IDENTIFIER CalRegn03Rt02GroupB.CalibrationPorts.AssiMotTqWhlImbRejctnMaxY.Ary2D /end CHARACTERISTIC
/begin CHARACTERISTIC CalRegn03Rt02GroupB.AssiWhlImbRejctnBlndScaX.Ary2D "MICROSAR RTE" VAL_BLK 0x0 RTE_RL_UWORD 0 NO_COMPU_METHOD 0 65535 MATRIX_DIM 5 12 1 SYMBOL_LINK "Rte_CalprmRom_CalRegn03Rt02GroupB_DEFAULT_RTE_CALPRM_GROUP.AssiWhlImbRejctnBlndScaX_Ary2D" 0 DISPLAY_IDENTIFIER CalRegn03Rt02GroupB.CalibrationPorts.AssiWhlImbRejctnBlndScaX.Ary2D /end CHARACTERISTIC
/begin CHARACTERISTIC CalRegn03Rt02GroupB.AssiWhlImbRejctnBlndScaY.Ary2D "MICROSAR RTE" VAL_BLK 0x0 RTE_RL_UWORD 0 NO_COMPU_METHOD 0 65535 MATRIX_DIM 5 12 1 SYMBOL_LINK "Rte_CalprmRom_CalRegn03Rt02GroupB_DEFAULT_RTE_CALPRM_GROUP.AssiWhlImbRejctnBlndScaY_Ary2D" 0 DISPLAY_IDENTIFIER CalRegn03Rt02GroupB.CalibrationPorts.AssiWhlImbRejctnBlndScaY.Ary2D /end CHARACTERISTIC
/begin CHARACTERISTIC CalRegn03Rt02GroupB.EotProtnDampgVehSpdTbl.Ary1D "MICROSAR RTE" VAL_BLK 0x0 RTE_RL_UWORD 0 NO_COMPU_METHOD 0 65535 MATRIX_DIM 4 1 1 SYMBOL_LINK "Rte_CalprmRom_CalRegn03Rt02GroupB_DEFAULT_RTE_CALPRM_GROUP.EotProtnDampgVehSpdTbl_Ary1D" 0 DISPLAY_IDENTIFIER CalRegn03Rt02GroupB.CalibrationPorts.EotProtnDampgVehSpdTbl.Ary1D /end CHARACTERISTIC
/begin CHARACTERISTIC CalRegn03Rt02GroupB.EotProtnEntrGainVehSpdTbl.Ary1D "MICROSAR RTE" VAL_BLK 0x0 RTE_RL_UWORD 0 NO_COMPU_METHOD 0 65535 MATRIX_DIM 5 1 1 SYMBOL_LINK "Rte_CalprmRom_CalRegn03Rt02GroupB_DEFAULT_RTE_CALPRM_GROUP.EotProtnEntrGainVehSpdTbl_Ary1D" 0 DISPLAY_IDENTIFIER CalRegn03Rt02GroupB.CalibrationPorts.EotProtnEntrGainVehSpdTbl.Ary1D /end CHARACTERISTIC
/begin CHARACTERISTIC CalRegn03Rt02GroupB.EotProtnEntrGainX.Ary2D "MICROSAR RTE" VAL_BLK 0x0 RTE_RL_UWORD 0 NO_COMPU_METHOD 0 65535 MATRIX_DIM 4 5 1 SYMBOL_LINK "Rte_CalprmRom_CalRegn03Rt02GroupB_DEFAULT_RTE_CALPRM_GROUP.EotProtnEntrGainX_Ary2D" 0 DISPLAY_IDENTIFIER CalRegn03Rt02GroupB.CalibrationPorts.EotProtnEntrGainX.Ary2D /end CHARACTERISTIC
/begin CHARACTERISTIC CalRegn03Rt02GroupB.EotProtnEntrGainY.Ary2D "MICROSAR RTE" VAL_BLK 0x0 RTE_RL_UWORD 0 NO_COMPU_METHOD 0 65535 MATRIX_DIM 4 5 1 SYMBOL_LINK "Rte_CalprmRom_CalRegn03Rt02GroupB_DEFAULT_RTE_CALPRM_GROUP.EotProtnEntrGainY_Ary2D" 0 DISPLAY_IDENTIFIER CalRegn03Rt02GroupB.CalibrationPorts.EotProtnEntrGainY.Ary2D /end CHARACTERISTIC
/begin CHARACTERISTIC CalRegn03Rt02GroupB.EotProtnExitDampgY.Ary2D "MICROSAR RTE" VAL_BLK 0x0 RTE_RL_UWORD 0 NO_COMPU_METHOD 0 65535 MATRIX_DIM 2 4 1 SYMBOL_LINK "Rte_CalprmRom_CalRegn03Rt02GroupB_DEFAULT_RTE_CALPRM_GROUP.EotProtnExitDampgY_Ary2D" 0 DISPLAY_IDENTIFIER CalRegn03Rt02GroupB.CalibrationPorts.EotProtnExitDampgY.Ary2D /end CHARACTERISTIC
/begin CHARACTERISTIC CalRegn03Rt02GroupB.EotProtnHwDegDampgX.Ary2D "MICROSAR RTE" VAL_BLK 0x0 RTE_RL_UWORD 0 NO_COMPU_METHOD 0 65535 MATRIX_DIM 2 4 1 SYMBOL_LINK "Rte_CalprmRom_CalRegn03Rt02GroupB_DEFAULT_RTE_CALPRM_GROUP.EotProtnHwDegDampgX_Ary2D" 0 DISPLAY_IDENTIFIER CalRegn03Rt02GroupB.CalibrationPorts.EotProtnHwDegDampgX.Ary2D /end CHARACTERISTIC
/begin CHARACTERISTIC CalRegn03Rt02GroupB.EotProtnNormDampgY.Ary2D "MICROSAR RTE" VAL_BLK 0x0 RTE_RL_UWORD 0 NO_COMPU_METHOD 0 65535 MATRIX_DIM 2 4 1 SYMBOL_LINK "Rte_CalprmRom_CalRegn03Rt02GroupB_DEFAULT_RTE_CALPRM_GROUP.EotProtnNormDampgY_Ary2D" 0 DISPLAY_IDENTIFIER CalRegn03Rt02GroupB.CalibrationPorts.EotProtnNormDampgY.Ary2D /end CHARACTERISTIC
/begin CHARACTERISTIC CalRegn03Rt02GroupB.InertiaCmpVelAssiBasdDampgRollgWhlImbRejctnOnY.Ary1D "MICROSAR RTE" VAL_BLK 0x0 RTE_RL_UWORD 0 NO_COMPU_METHOD 0 65535 MATRIX_DIM 10 1 1 SYMBOL_LINK "Rte_CalprmRom_CalRegn03Rt02GroupB_DEFAULT_RTE_CALPRM_GROUP.InertiaCmpVelAssiBasdDampgRollgWhlImbRejctnOnY_Ary1D" 0 DISPLAY_IDENTIFIER CalRegn03Rt02GroupB.CalibrationPorts.InertiaCmpVelAssiBasdDampgRollgWhlImbRejctnOnY.Ary1D /end CHARACTERISTIC
/begin CHARACTERISTIC CalRegn03Rt03.InertiaCmpVelDampgFilFrq.Ary1D "MICROSAR RTE" VAL_BLK 0x0 RTE_RL_UWORD 0 NO_COMPU_METHOD 0 65535 MATRIX_DIM 12 1 1 SYMBOL_LINK "Rte_CalprmRom_CalRegn03Rt03_DEFAULT_RTE_CALPRM_GROUP.InertiaCmpVelDampgFilFrq_Ary1D" 0 DISPLAY_IDENTIFIER CalRegn03Rt03.CalibrationPorts.InertiaCmpVelDampgFilFrq.Ary1D /end CHARACTERISTIC
/begin CHARACTERISTIC CalRegn03Rt03.InertiaCmpVelDampgFilFrqWhlImbRejctnOn.Ary1D "MICROSAR RTE" VAL_BLK 0x0 RTE_RL_UWORD 0 NO_COMPU_METHOD 0 65535 MATRIX_DIM 12 1 1 SYMBOL_LINK "Rte_CalprmRom_CalRegn03Rt03_DEFAULT_RTE_CALPRM_GROUP.InertiaCmpVelDampgFilFrqWhlImbRejctnOn_Ary1D" 0 DISPLAY_IDENTIFIER CalRegn03Rt03.CalibrationPorts.InertiaCmpVelDampgFilFrqWhlImbRejctnOn.Ary1D /end CHARACTERISTIC
/begin CHARACTERISTIC CalRegn03Rt03GroupA.AssiHiFrqGainY.Ary2D "MICROSAR RTE" VAL_BLK 0x0 RTE_RL_UWORD 0 NO_COMPU_METHOD 0 65535 MATRIX_DIM 13 12 1 SYMBOL_LINK "Rte_CalprmRom_CalRegn03Rt03GroupA_DEFAULT_RTE_CALPRM_GROUP.AssiHiFrqGainY_Ary2D" 0 DISPLAY_IDENTIFIER CalRegn03Rt03GroupA.CalibrationPorts.AssiHiFrqGainY.Ary2D /end CHARACTERISTIC
/begin CHARACTERISTIC CalRegn03Rt03GroupA.AssiHiFrqTqX.Ary2D "MICROSAR RTE" VAL_BLK 0x0 RTE_RL_UWORD 0 NO_COMPU_METHOD 0 65535 MATRIX_DIM 13 12 1 SYMBOL_LINK "Rte_CalprmRom_CalRegn03Rt03GroupA_DEFAULT_RTE_CALPRM_GROUP.AssiHiFrqTqX_Ary2D" 0 DISPLAY_IDENTIFIER CalRegn03Rt03GroupA.CalibrationPorts.AssiHiFrqTqX.Ary2D /end CHARACTERISTIC
/begin CHARACTERISTIC CalRegn03Rt03GroupA.AssiMotTqWhlImbRejctnMinX.Ary2D "MICROSAR RTE" VAL_BLK 0x0 RTE_RL_UWORD 0 NO_COMPU_METHOD 0 65535 MATRIX_DIM 20 12 1 SYMBOL_LINK "Rte_CalprmRom_CalRegn03Rt03GroupA_DEFAULT_RTE_CALPRM_GROUP.AssiMotTqWhlImbRejctnMinX_Ary2D" 0 DISPLAY_IDENTIFIER CalRegn03Rt03GroupA.CalibrationPorts.AssiMotTqWhlImbRejctnMinX.Ary2D /end CHARACTERISTIC
/begin CHARACTERISTIC CalRegn03Rt03GroupA.AssiMotTqWhlImbRejctnMinY.Ary2D "MICROSAR RTE" VAL_BLK 0x0 RTE_RL_SWORD 0 NO_COMPU_METHOD -32768 32767 MATRIX_DIM 20 12 1 SYMBOL_LINK "Rte_CalprmRom_CalRegn03Rt03GroupA_DEFAULT_RTE_CALPRM_GROUP.AssiMotTqWhlImbRejctnMinY_Ary2D" 0 DISPLAY_IDENTIFIER CalRegn03Rt03GroupA.CalibrationPorts.AssiMotTqWhlImbRejctnMinY.Ary2D /end CHARACTERISTIC
/begin CHARACTERISTIC CalRegn03Rt03GroupA.DampgHydCoeff1ScaY.Ary1D "MICROSAR RTE" VAL_BLK 0x0 RTE_RL_UWORD 0 NO_COMPU_METHOD 0 65535 MATRIX_DIM 12 1 1 SYMBOL_LINK "Rte_CalprmRom_CalRegn03Rt03GroupA_DEFAULT_RTE_CALPRM_GROUP.DampgHydCoeff1ScaY_Ary1D" 0 DISPLAY_IDENTIFIER CalRegn03Rt03GroupA.CalibrationPorts.DampgHydCoeff1ScaY.Ary1D /end CHARACTERISTIC
/begin CHARACTERISTIC CalRegn03Rt03GroupA.DampgHydCoeff2ScaY.Ary1D "MICROSAR RTE" VAL_BLK 0x0 RTE_RL_UWORD 0 NO_COMPU_METHOD 0 65535 MATRIX_DIM 12 1 1 SYMBOL_LINK "Rte_CalprmRom_CalRegn03Rt03GroupA_DEFAULT_RTE_CALPRM_GROUP.DampgHydCoeff2ScaY_Ary1D" 0 DISPLAY_IDENTIFIER CalRegn03Rt03GroupA.CalibrationPorts.DampgHydCoeff2ScaY.Ary1D /end CHARACTERISTIC
/begin CHARACTERISTIC CalRegn03Rt03GroupA.DampgHydCoeff3ScaY.Ary1D "MICROSAR RTE" VAL_BLK 0x0 RTE_RL_UWORD 0 NO_COMPU_METHOD 0 65535 MATRIX_DIM 12 1 1 SYMBOL_LINK "Rte_CalprmRom_CalRegn03Rt03GroupA_DEFAULT_RTE_CALPRM_GROUP.DampgHydCoeff3ScaY_Ary1D" 0 DISPLAY_IDENTIFIER CalRegn03Rt03GroupA.CalibrationPorts.DampgHydCoeff3ScaY.Ary1D /end CHARACTERISTIC
/begin CHARACTERISTIC CalRegn03Rt03GroupA.DampgHydCoeff4ScaY.Ary1D "MICROSAR RTE" VAL_BLK 0x0 RTE_RL_UWORD 0 NO_COMPU_METHOD 0 65535 MATRIX_DIM 12 1 1 SYMBOL_LINK "Rte_CalprmRom_CalRegn03Rt03GroupA_DEFAULT_RTE_CALPRM_GROUP.DampgHydCoeff4ScaY_Ary1D" 0 DISPLAY_IDENTIFIER CalRegn03Rt03GroupA.CalibrationPorts.DampgHydCoeff4ScaY.Ary1D /end CHARACTERISTIC
/begin CHARACTERISTIC CalRegn03Rt03GroupA.DampgMotVelX.Ary2D "MICROSAR RTE" VAL_BLK 0x0 RTE_RL_UWORD 0 NO_COMPU_METHOD 0 65535 MATRIX_DIM 13 12 1 SYMBOL_LINK "Rte_CalprmRom_CalRegn03Rt03GroupA_DEFAULT_RTE_CALPRM_GROUP.DampgMotVelX_Ary2D" 0 DISPLAY_IDENTIFIER CalRegn03Rt03GroupA.CalibrationPorts.DampgMotVelX.Ary2D /end CHARACTERISTIC
/begin CHARACTERISTIC CalRegn03Rt03GroupA.DampgMotVelY.Ary2D "MICROSAR RTE" VAL_BLK 0x0 RTE_RL_UWORD 0 NO_COMPU_METHOD 0 65535 MATRIX_DIM 13 12 1 SYMBOL_LINK "Rte_CalprmRom_CalRegn03Rt03GroupA_DEFAULT_RTE_CALPRM_GROUP.DampgMotVelY_Ary2D" 0 DISPLAY_IDENTIFIER CalRegn03Rt03GroupA.CalibrationPorts.DampgMotVelY.Ary2D /end CHARACTERISTIC
/begin CHARACTERISTIC CalRegn03Rt03GroupA.HysCmpFricWhlImbRejctnBlndX.Ary1D "MICROSAR RTE" VAL_BLK 0x0 RTE_RL_UWORD 0 NO_COMPU_METHOD 0 65535 MATRIX_DIM 6 1 1 SYMBOL_LINK "Rte_CalprmRom_CalRegn03Rt03GroupA_DEFAULT_RTE_CALPRM_GROUP.HysCmpFricWhlImbRejctnBlndX_Ary1D" 0 DISPLAY_IDENTIFIER CalRegn03Rt03GroupA.CalibrationPorts.HysCmpFricWhlImbRejctnBlndX.Ary1D /end CHARACTERISTIC
/begin CHARACTERISTIC CalRegn03Rt03GroupA.HysCmpFricWhlImbRejctnBlndY.Ary1D "MICROSAR RTE" VAL_BLK 0x0 RTE_RL_UWORD 0 NO_COMPU_METHOD 0 65535 MATRIX_DIM 6 1 1 SYMBOL_LINK "Rte_CalprmRom_CalRegn03Rt03GroupA_DEFAULT_RTE_CALPRM_GROUP.HysCmpFricWhlImbRejctnBlndY_Ary1D" 0 DISPLAY_IDENTIFIER CalRegn03Rt03GroupA.CalibrationPorts.HysCmpFricWhlImbRejctnBlndY.Ary1D /end CHARACTERISTIC
/begin CHARACTERISTIC CalRegn03Rt03GroupA.HysCmpFricWhlImbRejctnOffY.Ary1D "MICROSAR RTE" VAL_BLK 0x0 RTE_RL_UWORD 0 NO_COMPU_METHOD 0 65535 MATRIX_DIM 12 1 1 SYMBOL_LINK "Rte_CalprmRom_CalRegn03Rt03GroupA_DEFAULT_RTE_CALPRM_GROUP.HysCmpFricWhlImbRejctnOffY_Ary1D" 0 DISPLAY_IDENTIFIER CalRegn03Rt03GroupA.CalibrationPorts.HysCmpFricWhlImbRejctnOffY.Ary1D /end CHARACTERISTIC
/begin CHARACTERISTIC CalRegn03Rt03GroupA.HysCmpFricWhlImbRejctnOnY.Ary1D "MICROSAR RTE" VAL_BLK 0x0 RTE_RL_UWORD 0 NO_COMPU_METHOD 0 65535 MATRIX_DIM 12 1 1 SYMBOL_LINK "Rte_CalprmRom_CalRegn03Rt03GroupA_DEFAULT_RTE_CALPRM_GROUP.HysCmpFricWhlImbRejctnOnY_Ary1D" 0 DISPLAY_IDENTIFIER CalRegn03Rt03GroupA.CalibrationPorts.HysCmpFricWhlImbRejctnOnY.Ary1D /end CHARACTERISTIC
/begin CHARACTERISTIC CalRegn03Rt03GroupA.InertiaCmpVelAssiBasdDampgCoeffX.Ary1D "MICROSAR RTE" VAL_BLK 0x0 RTE_RL_UWORD 0 NO_COMPU_METHOD 0 65535 MATRIX_DIM 10 1 1 SYMBOL_LINK "Rte_CalprmRom_CalRegn03Rt03GroupA_DEFAULT_RTE_CALPRM_GROUP.InertiaCmpVelAssiBasdDampgCoeffX_Ary1D" 0 DISPLAY_IDENTIFIER CalRegn03Rt03GroupA.CalibrationPorts.InertiaCmpVelAssiBasdDampgCoeffX.Ary1D /end CHARACTERISTIC
/begin CHARACTERISTIC CalRegn03Rt03GroupA.InertiaCmpVelAssiBasdDampgRollgY.Ary1D "MICROSAR RTE" VAL_BLK 0x0 RTE_RL_UWORD 0 NO_COMPU_METHOD 0 65535 MATRIX_DIM 10 1 1 SYMBOL_LINK "Rte_CalprmRom_CalRegn03Rt03GroupA_DEFAULT_RTE_CALPRM_GROUP.InertiaCmpVelAssiBasdDampgRollgY_Ary1D" 0 DISPLAY_IDENTIFIER CalRegn03Rt03GroupA.CalibrationPorts.InertiaCmpVelAssiBasdDampgRollgY.Ary1D /end CHARACTERISTIC
/begin CHARACTERISTIC CalRegn03Rt03GroupA.InertiaCmpVelAssiBasdDampgStatY.Ary1D "MICROSAR RTE" VAL_BLK 0x0 RTE_RL_UWORD 0 NO_COMPU_METHOD 0 65535 MATRIX_DIM 10 1 1 SYMBOL_LINK "Rte_CalprmRom_CalRegn03Rt03GroupA_DEFAULT_RTE_CALPRM_GROUP.InertiaCmpVelAssiBasdDampgStatY_Ary1D" 0 DISPLAY_IDENTIFIER CalRegn03Rt03GroupA.CalibrationPorts.InertiaCmpVelAssiBasdDampgStatY.Ary1D /end CHARACTERISTIC
/begin CHARACTERISTIC CalRegn03Rt03GroupA.InertiaCmpVelDampgSpdBlndY.Ary1D "MICROSAR RTE" VAL_BLK 0x0 RTE_RL_UWORD 0 NO_COMPU_METHOD 0 65535 MATRIX_DIM 12 1 1 SYMBOL_LINK "Rte_CalprmRom_CalRegn03Rt03GroupA_DEFAULT_RTE_CALPRM_GROUP.InertiaCmpVelDampgSpdBlndY_Ary1D" 0 DISPLAY_IDENTIFIER CalRegn03Rt03GroupA.CalibrationPorts.InertiaCmpVelDampgSpdBlndY.Ary1D /end CHARACTERISTIC
/begin CHARACTERISTIC CalRegn03Rt03GroupA.InertiaCmpVelNotchBlndY.Ary1D "MICROSAR RTE" VAL_BLK 0x0 RTE_RL_UWORD 0 NO_COMPU_METHOD 0 65535 MATRIX_DIM 12 1 1 SYMBOL_LINK "Rte_CalprmRom_CalRegn03Rt03GroupA_DEFAULT_RTE_CALPRM_GROUP.InertiaCmpVelNotchBlndY_Ary1D" 0 DISPLAY_IDENTIFIER CalRegn03Rt03GroupA.CalibrationPorts.InertiaCmpVelNotchBlndY.Ary1D /end CHARACTERISTIC
/begin CHARACTERISTIC CalRegn03Rt03GroupA.RtnHwAgOffsCalcdX.Ary2D "MICROSAR RTE" VAL_BLK 0x0 RTE_RL_UWORD 0 NO_COMPU_METHOD 0 65535 MATRIX_DIM 16 9 1 SYMBOL_LINK "Rte_CalprmRom_CalRegn03Rt03GroupA_DEFAULT_RTE_CALPRM_GROUP.RtnHwAgOffsCalcdX_Ary2D" 0 DISPLAY_IDENTIFIER CalRegn03Rt03GroupA.CalibrationPorts.RtnHwAgOffsCalcdX.Ary2D /end CHARACTERISTIC
/begin CHARACTERISTIC CalRegn03Rt03GroupA.RtnHwAgOffsCalcdY.Ary2D "MICROSAR RTE" VAL_BLK 0x0 RTE_RL_UWORD 0 NO_COMPU_METHOD 0 65535 MATRIX_DIM 16 9 1 SYMBOL_LINK "Rte_CalprmRom_CalRegn03Rt03GroupA_DEFAULT_RTE_CALPRM_GROUP.RtnHwAgOffsCalcdY_Ary2D" 0 DISPLAY_IDENTIFIER CalRegn03Rt03GroupA.CalibrationPorts.RtnHwAgOffsCalcdY.Ary2D /end CHARACTERISTIC
/begin CHARACTERISTIC CalRegn03Rt03GroupA.RtnScaTqX.Ary2D "MICROSAR RTE" VAL_BLK 0x0 RTE_RL_UWORD 0 NO_COMPU_METHOD 0 65535 MATRIX_DIM 8 9 1 SYMBOL_LINK "Rte_CalprmRom_CalRegn03Rt03GroupA_DEFAULT_RTE_CALPRM_GROUP.RtnScaTqX_Ary2D" 0 DISPLAY_IDENTIFIER CalRegn03Rt03GroupA.CalibrationPorts.RtnScaTqX.Ary2D /end CHARACTERISTIC
/begin CHARACTERISTIC CalRegn03Rt03GroupA.RtnScaTqY.Ary2D "MICROSAR RTE" VAL_BLK 0x0 RTE_RL_UWORD 0 NO_COMPU_METHOD 0 65535 MATRIX_DIM 8 9 1 SYMBOL_LINK "Rte_CalprmRom_CalRegn03Rt03GroupA_DEFAULT_RTE_CALPRM_GROUP.RtnScaTqY_Ary2D" 0 DISPLAY_IDENTIFIER CalRegn03Rt03GroupA.CalibrationPorts.RtnScaTqY.Ary2D /end CHARACTERISTIC
/begin CHARACTERISTIC CalRegn03Rt03GroupA.RtnScaVelX.Ary2D "MICROSAR RTE" VAL_BLK 0x0 RTE_RL_UWORD 0 NO_COMPU_METHOD 0 65535 MATRIX_DIM 4 9 1 SYMBOL_LINK "Rte_CalprmRom_CalRegn03Rt03GroupA_DEFAULT_RTE_CALPRM_GROUP.RtnScaVelX_Ary2D" 0 DISPLAY_IDENTIFIER CalRegn03Rt03GroupA.CalibrationPorts.RtnScaVelX.Ary2D /end CHARACTERISTIC
/begin CHARACTERISTIC CalRegn03Rt03GroupA.RtnScaVelY.Ary2D "MICROSAR RTE" VAL_BLK 0x0 RTE_RL_UWORD 0 NO_COMPU_METHOD 0 65535 MATRIX_DIM 4 9 1 SYMBOL_LINK "Rte_CalprmRom_CalRegn03Rt03GroupA_DEFAULT_RTE_CALPRM_GROUP.RtnScaVelY_Ary2D" 0 DISPLAY_IDENTIFIER CalRegn03Rt03GroupA.CalibrationPorts.RtnScaVelY.Ary2D /end CHARACTERISTIC
/begin CHARACTERISTIC CalRegn03Rt03GroupB.AssiHiFrqTqWhlImbRejctnTqX.Ary2D "MICROSAR RTE" VAL_BLK 0x0 RTE_RL_UWORD 0 NO_COMPU_METHOD 0 65535 MATRIX_DIM 13 12 1 SYMBOL_LINK "Rte_CalprmRom_CalRegn03Rt03GroupB_DEFAULT_RTE_CALPRM_GROUP.AssiHiFrqTqWhlImbRejctnTqX_Ary2D" 0 DISPLAY_IDENTIFIER CalRegn03Rt03GroupB.CalibrationPorts.AssiHiFrqTqWhlImbRejctnTqX.Ary2D /end CHARACTERISTIC
/begin CHARACTERISTIC CalRegn03Rt03GroupB.AssiHiFrqWhlImbRejctnGainY.Ary2D "MICROSAR RTE" VAL_BLK 0x0 RTE_RL_UWORD 0 NO_COMPU_METHOD 0 65535 MATRIX_DIM 13 12 1 SYMBOL_LINK "Rte_CalprmRom_CalRegn03Rt03GroupB_DEFAULT_RTE_CALPRM_GROUP.AssiHiFrqWhlImbRejctnGainY_Ary2D" 0 DISPLAY_IDENTIFIER CalRegn03Rt03GroupB.CalibrationPorts.AssiHiFrqWhlImbRejctnGainY.Ary2D /end CHARACTERISTIC
/begin CHARACTERISTIC CalRegn03Rt03GroupB.AssiHiFrqWhlImbRejtcnBlndX.Ary2D "MICROSAR RTE" VAL_BLK 0x0 RTE_RL_UWORD 0 NO_COMPU_METHOD 0 65535 MATRIX_DIM 5 12 1 SYMBOL_LINK "Rte_CalprmRom_CalRegn03Rt03GroupB_DEFAULT_RTE_CALPRM_GROUP.AssiHiFrqWhlImbRejtcnBlndX_Ary2D" 0 DISPLAY_IDENTIFIER CalRegn03Rt03GroupB.CalibrationPorts.AssiHiFrqWhlImbRejtcnBlndX.Ary2D /end CHARACTERISTIC
/begin CHARACTERISTIC CalRegn03Rt03GroupB.AssiHiFrqWhlImbRejtcnBlndY.Ary2D "MICROSAR RTE" VAL_BLK 0x0 RTE_RL_UWORD 0 NO_COMPU_METHOD 0 65535 MATRIX_DIM 5 12 1 SYMBOL_LINK "Rte_CalprmRom_CalRegn03Rt03GroupB_DEFAULT_RTE_CALPRM_GROUP.AssiHiFrqWhlImbRejtcnBlndY_Ary2D" 0 DISPLAY_IDENTIFIER CalRegn03Rt03GroupB.CalibrationPorts.AssiHiFrqWhlImbRejtcnBlndY.Ary2D /end CHARACTERISTIC
/begin CHARACTERISTIC CalRegn03Rt03GroupB.AssiMotTqWhlImbRejctnMaxX.Ary2D "MICROSAR RTE" VAL_BLK 0x0 RTE_RL_UWORD 0 NO_COMPU_METHOD 0 65535 MATRIX_DIM 20 12 1 SYMBOL_LINK "Rte_CalprmRom_CalRegn03Rt03GroupB_DEFAULT_RTE_CALPRM_GROUP.AssiMotTqWhlImbRejctnMaxX_Ary2D" 0 DISPLAY_IDENTIFIER CalRegn03Rt03GroupB.CalibrationPorts.AssiMotTqWhlImbRejctnMaxX.Ary2D /end CHARACTERISTIC
/begin CHARACTERISTIC CalRegn03Rt03GroupB.AssiMotTqWhlImbRejctnMaxY.Ary2D "MICROSAR RTE" VAL_BLK 0x0 RTE_RL_SWORD 0 NO_COMPU_METHOD -32768 32767 MATRIX_DIM 20 12 1 SYMBOL_LINK "Rte_CalprmRom_CalRegn03Rt03GroupB_DEFAULT_RTE_CALPRM_GROUP.AssiMotTqWhlImbRejctnMaxY_Ary2D" 0 DISPLAY_IDENTIFIER CalRegn03Rt03GroupB.CalibrationPorts.AssiMotTqWhlImbRejctnMaxY.Ary2D /end CHARACTERISTIC
/begin CHARACTERISTIC CalRegn03Rt03GroupB.AssiWhlImbRejctnBlndScaX.Ary2D "MICROSAR RTE" VAL_BLK 0x0 RTE_RL_UWORD 0 NO_COMPU_METHOD 0 65535 MATRIX_DIM 5 12 1 SYMBOL_LINK "Rte_CalprmRom_CalRegn03Rt03GroupB_DEFAULT_RTE_CALPRM_GROUP.AssiWhlImbRejctnBlndScaX_Ary2D" 0 DISPLAY_IDENTIFIER CalRegn03Rt03GroupB.CalibrationPorts.AssiWhlImbRejctnBlndScaX.Ary2D /end CHARACTERISTIC
/begin CHARACTERISTIC CalRegn03Rt03GroupB.AssiWhlImbRejctnBlndScaY.Ary2D "MICROSAR RTE" VAL_BLK 0x0 RTE_RL_UWORD 0 NO_COMPU_METHOD 0 65535 MATRIX_DIM 5 12 1 SYMBOL_LINK "Rte_CalprmRom_CalRegn03Rt03GroupB_DEFAULT_RTE_CALPRM_GROUP.AssiWhlImbRejctnBlndScaY_Ary2D" 0 DISPLAY_IDENTIFIER CalRegn03Rt03GroupB.CalibrationPorts.AssiWhlImbRejctnBlndScaY.Ary2D /end CHARACTERISTIC
/begin CHARACTERISTIC CalRegn03Rt03GroupB.EotProtnDampgVehSpdTbl.Ary1D "MICROSAR RTE" VAL_BLK 0x0 RTE_RL_UWORD 0 NO_COMPU_METHOD 0 65535 MATRIX_DIM 4 1 1 SYMBOL_LINK "Rte_CalprmRom_CalRegn03Rt03GroupB_DEFAULT_RTE_CALPRM_GROUP.EotProtnDampgVehSpdTbl_Ary1D" 0 DISPLAY_IDENTIFIER CalRegn03Rt03GroupB.CalibrationPorts.EotProtnDampgVehSpdTbl.Ary1D /end CHARACTERISTIC
/begin CHARACTERISTIC CalRegn03Rt03GroupB.EotProtnEntrGainVehSpdTbl.Ary1D "MICROSAR RTE" VAL_BLK 0x0 RTE_RL_UWORD 0 NO_COMPU_METHOD 0 65535 MATRIX_DIM 5 1 1 SYMBOL_LINK "Rte_CalprmRom_CalRegn03Rt03GroupB_DEFAULT_RTE_CALPRM_GROUP.EotProtnEntrGainVehSpdTbl_Ary1D" 0 DISPLAY_IDENTIFIER CalRegn03Rt03GroupB.CalibrationPorts.EotProtnEntrGainVehSpdTbl.Ary1D /end CHARACTERISTIC
/begin CHARACTERISTIC CalRegn03Rt03GroupB.EotProtnEntrGainX.Ary2D "MICROSAR RTE" VAL_BLK 0x0 RTE_RL_UWORD 0 NO_COMPU_METHOD 0 65535 MATRIX_DIM 4 5 1 SYMBOL_LINK "Rte_CalprmRom_CalRegn03Rt03GroupB_DEFAULT_RTE_CALPRM_GROUP.EotProtnEntrGainX_Ary2D" 0 DISPLAY_IDENTIFIER CalRegn03Rt03GroupB.CalibrationPorts.EotProtnEntrGainX.Ary2D /end CHARACTERISTIC
/begin CHARACTERISTIC CalRegn03Rt03GroupB.EotProtnEntrGainY.Ary2D "MICROSAR RTE" VAL_BLK 0x0 RTE_RL_UWORD 0 NO_COMPU_METHOD 0 65535 MATRIX_DIM 4 5 1 SYMBOL_LINK "Rte_CalprmRom_CalRegn03Rt03GroupB_DEFAULT_RTE_CALPRM_GROUP.EotProtnEntrGainY_Ary2D" 0 DISPLAY_IDENTIFIER CalRegn03Rt03GroupB.CalibrationPorts.EotProtnEntrGainY.Ary2D /end CHARACTERISTIC
/begin CHARACTERISTIC CalRegn03Rt03GroupB.EotProtnExitDampgY.Ary2D "MICROSAR RTE" VAL_BLK 0x0 RTE_RL_UWORD 0 NO_COMPU_METHOD 0 65535 MATRIX_DIM 2 4 1 SYMBOL_LINK "Rte_CalprmRom_CalRegn03Rt03GroupB_DEFAULT_RTE_CALPRM_GROUP.EotProtnExitDampgY_Ary2D" 0 DISPLAY_IDENTIFIER CalRegn03Rt03GroupB.CalibrationPorts.EotProtnExitDampgY.Ary2D /end CHARACTERISTIC
/begin CHARACTERISTIC CalRegn03Rt03GroupB.EotProtnHwDegDampgX.Ary2D "MICROSAR RTE" VAL_BLK 0x0 RTE_RL_UWORD 0 NO_COMPU_METHOD 0 65535 MATRIX_DIM 2 4 1 SYMBOL_LINK "Rte_CalprmRom_CalRegn03Rt03GroupB_DEFAULT_RTE_CALPRM_GROUP.EotProtnHwDegDampgX_Ary2D" 0 DISPLAY_IDENTIFIER CalRegn03Rt03GroupB.CalibrationPorts.EotProtnHwDegDampgX.Ary2D /end CHARACTERISTIC
/begin CHARACTERISTIC CalRegn03Rt03GroupB.EotProtnNormDampgY.Ary2D "MICROSAR RTE" VAL_BLK 0x0 RTE_RL_UWORD 0 NO_COMPU_METHOD 0 65535 MATRIX_DIM 2 4 1 SYMBOL_LINK "Rte_CalprmRom_CalRegn03Rt03GroupB_DEFAULT_RTE_CALPRM_GROUP.EotProtnNormDampgY_Ary2D" 0 DISPLAY_IDENTIFIER CalRegn03Rt03GroupB.CalibrationPorts.EotProtnNormDampgY.Ary2D /end CHARACTERISTIC
/begin CHARACTERISTIC CalRegn03Rt03GroupB.InertiaCmpVelAssiBasdDampgRollgWhlImbRejctnOnY.Ary1D "MICROSAR RTE" VAL_BLK 0x0 RTE_RL_UWORD 0 NO_COMPU_METHOD 0 65535 MATRIX_DIM 10 1 1 SYMBOL_LINK "Rte_CalprmRom_CalRegn03Rt03GroupB_DEFAULT_RTE_CALPRM_GROUP.InertiaCmpVelAssiBasdDampgRollgWhlImbRejctnOnY_Ary1D" 0 DISPLAY_IDENTIFIER CalRegn03Rt03GroupB.CalibrationPorts.InertiaCmpVelAssiBasdDampgRollgWhlImbRejctnOnY.Ary1D /end CHARACTERISTIC
/begin CHARACTERISTIC CalRegn03Rt04.InertiaCmpVelDampgFilFrq.Ary1D "MICROSAR RTE" VAL_BLK 0x0 RTE_RL_UWORD 0 NO_COMPU_METHOD 0 65535 MATRIX_DIM 12 1 1 SYMBOL_LINK "Rte_CalprmRom_CalRegn03Rt04_DEFAULT_RTE_CALPRM_GROUP.InertiaCmpVelDampgFilFrq_Ary1D" 0 DISPLAY_IDENTIFIER CalRegn03Rt04.CalibrationPorts.InertiaCmpVelDampgFilFrq.Ary1D /end CHARACTERISTIC
/begin CHARACTERISTIC CalRegn03Rt04.InertiaCmpVelDampgFilFrqWhlImbRejctnOn.Ary1D "MICROSAR RTE" VAL_BLK 0x0 RTE_RL_UWORD 0 NO_COMPU_METHOD 0 65535 MATRIX_DIM 12 1 1 SYMBOL_LINK "Rte_CalprmRom_CalRegn03Rt04_DEFAULT_RTE_CALPRM_GROUP.InertiaCmpVelDampgFilFrqWhlImbRejctnOn_Ary1D" 0 DISPLAY_IDENTIFIER CalRegn03Rt04.CalibrationPorts.InertiaCmpVelDampgFilFrqWhlImbRejctnOn.Ary1D /end CHARACTERISTIC
/begin CHARACTERISTIC CalRegn03Rt04GroupA.AssiHiFrqGainY.Ary2D "MICROSAR RTE" VAL_BLK 0x0 RTE_RL_UWORD 0 NO_COMPU_METHOD 0 65535 MATRIX_DIM 13 12 1 SYMBOL_LINK "Rte_CalprmRom_CalRegn03Rt04GroupA_DEFAULT_RTE_CALPRM_GROUP.AssiHiFrqGainY_Ary2D" 0 DISPLAY_IDENTIFIER CalRegn03Rt04GroupA.CalibrationPorts.AssiHiFrqGainY.Ary2D /end CHARACTERISTIC
/begin CHARACTERISTIC CalRegn03Rt04GroupA.AssiHiFrqTqX.Ary2D "MICROSAR RTE" VAL_BLK 0x0 RTE_RL_UWORD 0 NO_COMPU_METHOD 0 65535 MATRIX_DIM 13 12 1 SYMBOL_LINK "Rte_CalprmRom_CalRegn03Rt04GroupA_DEFAULT_RTE_CALPRM_GROUP.AssiHiFrqTqX_Ary2D" 0 DISPLAY_IDENTIFIER CalRegn03Rt04GroupA.CalibrationPorts.AssiHiFrqTqX.Ary2D /end CHARACTERISTIC
/begin CHARACTERISTIC CalRegn03Rt04GroupA.AssiMotTqWhlImbRejctnMinX.Ary2D "MICROSAR RTE" VAL_BLK 0x0 RTE_RL_UWORD 0 NO_COMPU_METHOD 0 65535 MATRIX_DIM 20 12 1 SYMBOL_LINK "Rte_CalprmRom_CalRegn03Rt04GroupA_DEFAULT_RTE_CALPRM_GROUP.AssiMotTqWhlImbRejctnMinX_Ary2D" 0 DISPLAY_IDENTIFIER CalRegn03Rt04GroupA.CalibrationPorts.AssiMotTqWhlImbRejctnMinX.Ary2D /end CHARACTERISTIC
/begin CHARACTERISTIC CalRegn03Rt04GroupA.AssiMotTqWhlImbRejctnMinY.Ary2D "MICROSAR RTE" VAL_BLK 0x0 RTE_RL_SWORD 0 NO_COMPU_METHOD -32768 32767 MATRIX_DIM 20 12 1 SYMBOL_LINK "Rte_CalprmRom_CalRegn03Rt04GroupA_DEFAULT_RTE_CALPRM_GROUP.AssiMotTqWhlImbRejctnMinY_Ary2D" 0 DISPLAY_IDENTIFIER CalRegn03Rt04GroupA.CalibrationPorts.AssiMotTqWhlImbRejctnMinY.Ary2D /end CHARACTERISTIC
/begin CHARACTERISTIC CalRegn03Rt04GroupA.DampgHydCoeff1ScaY.Ary1D "MICROSAR RTE" VAL_BLK 0x0 RTE_RL_UWORD 0 NO_COMPU_METHOD 0 65535 MATRIX_DIM 12 1 1 SYMBOL_LINK "Rte_CalprmRom_CalRegn03Rt04GroupA_DEFAULT_RTE_CALPRM_GROUP.DampgHydCoeff1ScaY_Ary1D" 0 DISPLAY_IDENTIFIER CalRegn03Rt04GroupA.CalibrationPorts.DampgHydCoeff1ScaY.Ary1D /end CHARACTERISTIC
/begin CHARACTERISTIC CalRegn03Rt04GroupA.DampgHydCoeff2ScaY.Ary1D "MICROSAR RTE" VAL_BLK 0x0 RTE_RL_UWORD 0 NO_COMPU_METHOD 0 65535 MATRIX_DIM 12 1 1 SYMBOL_LINK "Rte_CalprmRom_CalRegn03Rt04GroupA_DEFAULT_RTE_CALPRM_GROUP.DampgHydCoeff2ScaY_Ary1D" 0 DISPLAY_IDENTIFIER CalRegn03Rt04GroupA.CalibrationPorts.DampgHydCoeff2ScaY.Ary1D /end CHARACTERISTIC
/begin CHARACTERISTIC CalRegn03Rt04GroupA.DampgHydCoeff3ScaY.Ary1D "MICROSAR RTE" VAL_BLK 0x0 RTE_RL_UWORD 0 NO_COMPU_METHOD 0 65535 MATRIX_DIM 12 1 1 SYMBOL_LINK "Rte_CalprmRom_CalRegn03Rt04GroupA_DEFAULT_RTE_CALPRM_GROUP.DampgHydCoeff3ScaY_Ary1D" 0 DISPLAY_IDENTIFIER CalRegn03Rt04GroupA.CalibrationPorts.DampgHydCoeff3ScaY.Ary1D /end CHARACTERISTIC
/begin CHARACTERISTIC CalRegn03Rt04GroupA.DampgHydCoeff4ScaY.Ary1D "MICROSAR RTE" VAL_BLK 0x0 RTE_RL_UWORD 0 NO_COMPU_METHOD 0 65535 MATRIX_DIM 12 1 1 SYMBOL_LINK "Rte_CalprmRom_CalRegn03Rt04GroupA_DEFAULT_RTE_CALPRM_GROUP.DampgHydCoeff4ScaY_Ary1D" 0 DISPLAY_IDENTIFIER CalRegn03Rt04GroupA.CalibrationPorts.DampgHydCoeff4ScaY.Ary1D /end CHARACTERISTIC
/begin CHARACTERISTIC CalRegn03Rt04GroupA.DampgMotVelX.Ary2D "MICROSAR RTE" VAL_BLK 0x0 RTE_RL_UWORD 0 NO_COMPU_METHOD 0 65535 MATRIX_DIM 13 12 1 SYMBOL_LINK "Rte_CalprmRom_CalRegn03Rt04GroupA_DEFAULT_RTE_CALPRM_GROUP.DampgMotVelX_Ary2D" 0 DISPLAY_IDENTIFIER CalRegn03Rt04GroupA.CalibrationPorts.DampgMotVelX.Ary2D /end CHARACTERISTIC
/begin CHARACTERISTIC CalRegn03Rt04GroupA.DampgMotVelY.Ary2D "MICROSAR RTE" VAL_BLK 0x0 RTE_RL_UWORD 0 NO_COMPU_METHOD 0 65535 MATRIX_DIM 13 12 1 SYMBOL_LINK "Rte_CalprmRom_CalRegn03Rt04GroupA_DEFAULT_RTE_CALPRM_GROUP.DampgMotVelY_Ary2D" 0 DISPLAY_IDENTIFIER CalRegn03Rt04GroupA.CalibrationPorts.DampgMotVelY.Ary2D /end CHARACTERISTIC
/begin CHARACTERISTIC CalRegn03Rt04GroupA.HysCmpFricWhlImbRejctnBlndX.Ary1D "MICROSAR RTE" VAL_BLK 0x0 RTE_RL_UWORD 0 NO_COMPU_METHOD 0 65535 MATRIX_DIM 6 1 1 SYMBOL_LINK "Rte_CalprmRom_CalRegn03Rt04GroupA_DEFAULT_RTE_CALPRM_GROUP.HysCmpFricWhlImbRejctnBlndX_Ary1D" 0 DISPLAY_IDENTIFIER CalRegn03Rt04GroupA.CalibrationPorts.HysCmpFricWhlImbRejctnBlndX.Ary1D /end CHARACTERISTIC
/begin CHARACTERISTIC CalRegn03Rt04GroupA.HysCmpFricWhlImbRejctnBlndY.Ary1D "MICROSAR RTE" VAL_BLK 0x0 RTE_RL_UWORD 0 NO_COMPU_METHOD 0 65535 MATRIX_DIM 6 1 1 SYMBOL_LINK "Rte_CalprmRom_CalRegn03Rt04GroupA_DEFAULT_RTE_CALPRM_GROUP.HysCmpFricWhlImbRejctnBlndY_Ary1D" 0 DISPLAY_IDENTIFIER CalRegn03Rt04GroupA.CalibrationPorts.HysCmpFricWhlImbRejctnBlndY.Ary1D /end CHARACTERISTIC
/begin CHARACTERISTIC CalRegn03Rt04GroupA.HysCmpFricWhlImbRejctnOffY.Ary1D "MICROSAR RTE" VAL_BLK 0x0 RTE_RL_UWORD 0 NO_COMPU_METHOD 0 65535 MATRIX_DIM 12 1 1 SYMBOL_LINK "Rte_CalprmRom_CalRegn03Rt04GroupA_DEFAULT_RTE_CALPRM_GROUP.HysCmpFricWhlImbRejctnOffY_Ary1D" 0 DISPLAY_IDENTIFIER CalRegn03Rt04GroupA.CalibrationPorts.HysCmpFricWhlImbRejctnOffY.Ary1D /end CHARACTERISTIC
/begin CHARACTERISTIC CalRegn03Rt04GroupA.HysCmpFricWhlImbRejctnOnY.Ary1D "MICROSAR RTE" VAL_BLK 0x0 RTE_RL_UWORD 0 NO_COMPU_METHOD 0 65535 MATRIX_DIM 12 1 1 SYMBOL_LINK "Rte_CalprmRom_CalRegn03Rt04GroupA_DEFAULT_RTE_CALPRM_GROUP.HysCmpFricWhlImbRejctnOnY_Ary1D" 0 DISPLAY_IDENTIFIER CalRegn03Rt04GroupA.CalibrationPorts.HysCmpFricWhlImbRejctnOnY.Ary1D /end CHARACTERISTIC
/begin CHARACTERISTIC CalRegn03Rt04GroupA.InertiaCmpVelAssiBasdDampgCoeffX.Ary1D "MICROSAR RTE" VAL_BLK 0x0 RTE_RL_UWORD 0 NO_COMPU_METHOD 0 65535 MATRIX_DIM 10 1 1 SYMBOL_LINK "Rte_CalprmRom_CalRegn03Rt04GroupA_DEFAULT_RTE_CALPRM_GROUP.InertiaCmpVelAssiBasdDampgCoeffX_Ary1D" 0 DISPLAY_IDENTIFIER CalRegn03Rt04GroupA.CalibrationPorts.InertiaCmpVelAssiBasdDampgCoeffX.Ary1D /end CHARACTERISTIC
/begin CHARACTERISTIC CalRegn03Rt04GroupA.InertiaCmpVelAssiBasdDampgRollgY.Ary1D "MICROSAR RTE" VAL_BLK 0x0 RTE_RL_UWORD 0 NO_COMPU_METHOD 0 65535 MATRIX_DIM 10 1 1 SYMBOL_LINK "Rte_CalprmRom_CalRegn03Rt04GroupA_DEFAULT_RTE_CALPRM_GROUP.InertiaCmpVelAssiBasdDampgRollgY_Ary1D" 0 DISPLAY_IDENTIFIER CalRegn03Rt04GroupA.CalibrationPorts.InertiaCmpVelAssiBasdDampgRollgY.Ary1D /end CHARACTERISTIC
/begin CHARACTERISTIC CalRegn03Rt04GroupA.InertiaCmpVelAssiBasdDampgStatY.Ary1D "MICROSAR RTE" VAL_BLK 0x0 RTE_RL_UWORD 0 NO_COMPU_METHOD 0 65535 MATRIX_DIM 10 1 1 SYMBOL_LINK "Rte_CalprmRom_CalRegn03Rt04GroupA_DEFAULT_RTE_CALPRM_GROUP.InertiaCmpVelAssiBasdDampgStatY_Ary1D" 0 DISPLAY_IDENTIFIER CalRegn03Rt04GroupA.CalibrationPorts.InertiaCmpVelAssiBasdDampgStatY.Ary1D /end CHARACTERISTIC
/begin CHARACTERISTIC CalRegn03Rt04GroupA.InertiaCmpVelDampgSpdBlndY.Ary1D "MICROSAR RTE" VAL_BLK 0x0 RTE_RL_UWORD 0 NO_COMPU_METHOD 0 65535 MATRIX_DIM 12 1 1 SYMBOL_LINK "Rte_CalprmRom_CalRegn03Rt04GroupA_DEFAULT_RTE_CALPRM_GROUP.InertiaCmpVelDampgSpdBlndY_Ary1D" 0 DISPLAY_IDENTIFIER CalRegn03Rt04GroupA.CalibrationPorts.InertiaCmpVelDampgSpdBlndY.Ary1D /end CHARACTERISTIC
/begin CHARACTERISTIC CalRegn03Rt04GroupA.InertiaCmpVelNotchBlndY.Ary1D "MICROSAR RTE" VAL_BLK 0x0 RTE_RL_UWORD 0 NO_COMPU_METHOD 0 65535 MATRIX_DIM 12 1 1 SYMBOL_LINK "Rte_CalprmRom_CalRegn03Rt04GroupA_DEFAULT_RTE_CALPRM_GROUP.InertiaCmpVelNotchBlndY_Ary1D" 0 DISPLAY_IDENTIFIER CalRegn03Rt04GroupA.CalibrationPorts.InertiaCmpVelNotchBlndY.Ary1D /end CHARACTERISTIC
/begin CHARACTERISTIC CalRegn03Rt04GroupA.RtnHwAgOffsCalcdX.Ary2D "MICROSAR RTE" VAL_BLK 0x0 RTE_RL_UWORD 0 NO_COMPU_METHOD 0 65535 MATRIX_DIM 16 9 1 SYMBOL_LINK "Rte_CalprmRom_CalRegn03Rt04GroupA_DEFAULT_RTE_CALPRM_GROUP.RtnHwAgOffsCalcdX_Ary2D" 0 DISPLAY_IDENTIFIER CalRegn03Rt04GroupA.CalibrationPorts.RtnHwAgOffsCalcdX.Ary2D /end CHARACTERISTIC
/begin CHARACTERISTIC CalRegn03Rt04GroupA.RtnHwAgOffsCalcdY.Ary2D "MICROSAR RTE" VAL_BLK 0x0 RTE_RL_UWORD 0 NO_COMPU_METHOD 0 65535 MATRIX_DIM 16 9 1 SYMBOL_LINK "Rte_CalprmRom_CalRegn03Rt04GroupA_DEFAULT_RTE_CALPRM_GROUP.RtnHwAgOffsCalcdY_Ary2D" 0 DISPLAY_IDENTIFIER CalRegn03Rt04GroupA.CalibrationPorts.RtnHwAgOffsCalcdY.Ary2D /end CHARACTERISTIC
/begin CHARACTERISTIC CalRegn03Rt04GroupA.RtnScaTqX.Ary2D "MICROSAR RTE" VAL_BLK 0x0 RTE_RL_UWORD 0 NO_COMPU_METHOD 0 65535 MATRIX_DIM 8 9 1 SYMBOL_LINK "Rte_CalprmRom_CalRegn03Rt04GroupA_DEFAULT_RTE_CALPRM_GROUP.RtnScaTqX_Ary2D" 0 DISPLAY_IDENTIFIER CalRegn03Rt04GroupA.CalibrationPorts.RtnScaTqX.Ary2D /end CHARACTERISTIC
/begin CHARACTERISTIC CalRegn03Rt04GroupA.RtnScaTqY.Ary2D "MICROSAR RTE" VAL_BLK 0x0 RTE_RL_UWORD 0 NO_COMPU_METHOD 0 65535 MATRIX_DIM 8 9 1 SYMBOL_LINK "Rte_CalprmRom_CalRegn03Rt04GroupA_DEFAULT_RTE_CALPRM_GROUP.RtnScaTqY_Ary2D" 0 DISPLAY_IDENTIFIER CalRegn03Rt04GroupA.CalibrationPorts.RtnScaTqY.Ary2D /end CHARACTERISTIC
/begin CHARACTERISTIC CalRegn03Rt04GroupA.RtnScaVelX.Ary2D "MICROSAR RTE" VAL_BLK 0x0 RTE_RL_UWORD 0 NO_COMPU_METHOD 0 65535 MATRIX_DIM 4 9 1 SYMBOL_LINK "Rte_CalprmRom_CalRegn03Rt04GroupA_DEFAULT_RTE_CALPRM_GROUP.RtnScaVelX_Ary2D" 0 DISPLAY_IDENTIFIER CalRegn03Rt04GroupA.CalibrationPorts.RtnScaVelX.Ary2D /end CHARACTERISTIC
/begin CHARACTERISTIC CalRegn03Rt04GroupA.RtnScaVelY.Ary2D "MICROSAR RTE" VAL_BLK 0x0 RTE_RL_UWORD 0 NO_COMPU_METHOD 0 65535 MATRIX_DIM 4 9 1 SYMBOL_LINK "Rte_CalprmRom_CalRegn03Rt04GroupA_DEFAULT_RTE_CALPRM_GROUP.RtnScaVelY_Ary2D" 0 DISPLAY_IDENTIFIER CalRegn03Rt04GroupA.CalibrationPorts.RtnScaVelY.Ary2D /end CHARACTERISTIC
/begin CHARACTERISTIC CalRegn03Rt04GroupB.AssiHiFrqTqWhlImbRejctnTqX.Ary2D "MICROSAR RTE" VAL_BLK 0x0 RTE_RL_UWORD 0 NO_COMPU_METHOD 0 65535 MATRIX_DIM 13 12 1 SYMBOL_LINK "Rte_CalprmRom_CalRegn03Rt04GroupB_DEFAULT_RTE_CALPRM_GROUP.AssiHiFrqTqWhlImbRejctnTqX_Ary2D" 0 DISPLAY_IDENTIFIER CalRegn03Rt04GroupB.CalibrationPorts.AssiHiFrqTqWhlImbRejctnTqX.Ary2D /end CHARACTERISTIC
/begin CHARACTERISTIC CalRegn03Rt04GroupB.AssiHiFrqWhlImbRejctnGainY.Ary2D "MICROSAR RTE" VAL_BLK 0x0 RTE_RL_UWORD 0 NO_COMPU_METHOD 0 65535 MATRIX_DIM 13 12 1 SYMBOL_LINK "Rte_CalprmRom_CalRegn03Rt04GroupB_DEFAULT_RTE_CALPRM_GROUP.AssiHiFrqWhlImbRejctnGainY_Ary2D" 0 DISPLAY_IDENTIFIER CalRegn03Rt04GroupB.CalibrationPorts.AssiHiFrqWhlImbRejctnGainY.Ary2D /end CHARACTERISTIC
/begin CHARACTERISTIC CalRegn03Rt04GroupB.AssiHiFrqWhlImbRejtcnBlndX.Ary2D "MICROSAR RTE" VAL_BLK 0x0 RTE_RL_UWORD 0 NO_COMPU_METHOD 0 65535 MATRIX_DIM 5 12 1 SYMBOL_LINK "Rte_CalprmRom_CalRegn03Rt04GroupB_DEFAULT_RTE_CALPRM_GROUP.AssiHiFrqWhlImbRejtcnBlndX_Ary2D" 0 DISPLAY_IDENTIFIER CalRegn03Rt04GroupB.CalibrationPorts.AssiHiFrqWhlImbRejtcnBlndX.Ary2D /end CHARACTERISTIC
/begin CHARACTERISTIC CalRegn03Rt04GroupB.AssiHiFrqWhlImbRejtcnBlndY.Ary2D "MICROSAR RTE" VAL_BLK 0x0 RTE_RL_UWORD 0 NO_COMPU_METHOD 0 65535 MATRIX_DIM 5 12 1 SYMBOL_LINK "Rte_CalprmRom_CalRegn03Rt04GroupB_DEFAULT_RTE_CALPRM_GROUP.AssiHiFrqWhlImbRejtcnBlndY_Ary2D" 0 DISPLAY_IDENTIFIER CalRegn03Rt04GroupB.CalibrationPorts.AssiHiFrqWhlImbRejtcnBlndY.Ary2D /end CHARACTERISTIC
/begin CHARACTERISTIC CalRegn03Rt04GroupB.AssiMotTqWhlImbRejctnMaxX.Ary2D "MICROSAR RTE" VAL_BLK 0x0 RTE_RL_UWORD 0 NO_COMPU_METHOD 0 65535 MATRIX_DIM 20 12 1 SYMBOL_LINK "Rte_CalprmRom_CalRegn03Rt04GroupB_DEFAULT_RTE_CALPRM_GROUP.AssiMotTqWhlImbRejctnMaxX_Ary2D" 0 DISPLAY_IDENTIFIER CalRegn03Rt04GroupB.CalibrationPorts.AssiMotTqWhlImbRejctnMaxX.Ary2D /end CHARACTERISTIC
/begin CHARACTERISTIC CalRegn03Rt04GroupB.AssiMotTqWhlImbRejctnMaxY.Ary2D "MICROSAR RTE" VAL_BLK 0x0 RTE_RL_SWORD 0 NO_COMPU_METHOD -32768 32767 MATRIX_DIM 20 12 1 SYMBOL_LINK "Rte_CalprmRom_CalRegn03Rt04GroupB_DEFAULT_RTE_CALPRM_GROUP.AssiMotTqWhlImbRejctnMaxY_Ary2D" 0 DISPLAY_IDENTIFIER CalRegn03Rt04GroupB.CalibrationPorts.AssiMotTqWhlImbRejctnMaxY.Ary2D /end CHARACTERISTIC
/begin CHARACTERISTIC CalRegn03Rt04GroupB.AssiWhlImbRejctnBlndScaX.Ary2D "MICROSAR RTE" VAL_BLK 0x0 RTE_RL_UWORD 0 NO_COMPU_METHOD 0 65535 MATRIX_DIM 5 12 1 SYMBOL_LINK "Rte_CalprmRom_CalRegn03Rt04GroupB_DEFAULT_RTE_CALPRM_GROUP.AssiWhlImbRejctnBlndScaX_Ary2D" 0 DISPLAY_IDENTIFIER CalRegn03Rt04GroupB.CalibrationPorts.AssiWhlImbRejctnBlndScaX.Ary2D /end CHARACTERISTIC
/begin CHARACTERISTIC CalRegn03Rt04GroupB.AssiWhlImbRejctnBlndScaY.Ary2D "MICROSAR RTE" VAL_BLK 0x0 RTE_RL_UWORD 0 NO_COMPU_METHOD 0 65535 MATRIX_DIM 5 12 1 SYMBOL_LINK "Rte_CalprmRom_CalRegn03Rt04GroupB_DEFAULT_RTE_CALPRM_GROUP.AssiWhlImbRejctnBlndScaY_Ary2D" 0 DISPLAY_IDENTIFIER CalRegn03Rt04GroupB.CalibrationPorts.AssiWhlImbRejctnBlndScaY.Ary2D /end CHARACTERISTIC
/begin CHARACTERISTIC CalRegn03Rt04GroupB.EotProtnDampgVehSpdTbl.Ary1D "MICROSAR RTE" VAL_BLK 0x0 RTE_RL_UWORD 0 NO_COMPU_METHOD 0 65535 MATRIX_DIM 4 1 1 SYMBOL_LINK "Rte_CalprmRom_CalRegn03Rt04GroupB_DEFAULT_RTE_CALPRM_GROUP.EotProtnDampgVehSpdTbl_Ary1D" 0 DISPLAY_IDENTIFIER CalRegn03Rt04GroupB.CalibrationPorts.EotProtnDampgVehSpdTbl.Ary1D /end CHARACTERISTIC
/begin CHARACTERISTIC CalRegn03Rt04GroupB.EotProtnEntrGainVehSpdTbl.Ary1D "MICROSAR RTE" VAL_BLK 0x0 RTE_RL_UWORD 0 NO_COMPU_METHOD 0 65535 MATRIX_DIM 5 1 1 SYMBOL_LINK "Rte_CalprmRom_CalRegn03Rt04GroupB_DEFAULT_RTE_CALPRM_GROUP.EotProtnEntrGainVehSpdTbl_Ary1D" 0 DISPLAY_IDENTIFIER CalRegn03Rt04GroupB.CalibrationPorts.EotProtnEntrGainVehSpdTbl.Ary1D /end CHARACTERISTIC
/begin CHARACTERISTIC CalRegn03Rt04GroupB.EotProtnEntrGainX.Ary2D "MICROSAR RTE" VAL_BLK 0x0 RTE_RL_UWORD 0 NO_COMPU_METHOD 0 65535 MATRIX_DIM 4 5 1 SYMBOL_LINK "Rte_CalprmRom_CalRegn03Rt04GroupB_DEFAULT_RTE_CALPRM_GROUP.EotProtnEntrGainX_Ary2D" 0 DISPLAY_IDENTIFIER CalRegn03Rt04GroupB.CalibrationPorts.EotProtnEntrGainX.Ary2D /end CHARACTERISTIC
/begin CHARACTERISTIC CalRegn03Rt04GroupB.EotProtnEntrGainY.Ary2D "MICROSAR RTE" VAL_BLK 0x0 RTE_RL_UWORD 0 NO_COMPU_METHOD 0 65535 MATRIX_DIM 4 5 1 SYMBOL_LINK "Rte_CalprmRom_CalRegn03Rt04GroupB_DEFAULT_RTE_CALPRM_GROUP.EotProtnEntrGainY_Ary2D" 0 DISPLAY_IDENTIFIER CalRegn03Rt04GroupB.CalibrationPorts.EotProtnEntrGainY.Ary2D /end CHARACTERISTIC
/begin CHARACTERISTIC CalRegn03Rt04GroupB.EotProtnExitDampgY.Ary2D "MICROSAR RTE" VAL_BLK 0x0 RTE_RL_UWORD 0 NO_COMPU_METHOD 0 65535 MATRIX_DIM 2 4 1 SYMBOL_LINK "Rte_CalprmRom_CalRegn03Rt04GroupB_DEFAULT_RTE_CALPRM_GROUP.EotProtnExitDampgY_Ary2D" 0 DISPLAY_IDENTIFIER CalRegn03Rt04GroupB.CalibrationPorts.EotProtnExitDampgY.Ary2D /end CHARACTERISTIC
/begin CHARACTERISTIC CalRegn03Rt04GroupB.EotProtnHwDegDampgX.Ary2D "MICROSAR RTE" VAL_BLK 0x0 RTE_RL_UWORD 0 NO_COMPU_METHOD 0 65535 MATRIX_DIM 2 4 1 SYMBOL_LINK "Rte_CalprmRom_CalRegn03Rt04GroupB_DEFAULT_RTE_CALPRM_GROUP.EotProtnHwDegDampgX_Ary2D" 0 DISPLAY_IDENTIFIER CalRegn03Rt04GroupB.CalibrationPorts.EotProtnHwDegDampgX.Ary2D /end CHARACTERISTIC
/begin CHARACTERISTIC CalRegn03Rt04GroupB.EotProtnNormDampgY.Ary2D "MICROSAR RTE" VAL_BLK 0x0 RTE_RL_UWORD 0 NO_COMPU_METHOD 0 65535 MATRIX_DIM 2 4 1 SYMBOL_LINK "Rte_CalprmRom_CalRegn03Rt04GroupB_DEFAULT_RTE_CALPRM_GROUP.EotProtnNormDampgY_Ary2D" 0 DISPLAY_IDENTIFIER CalRegn03Rt04GroupB.CalibrationPorts.EotProtnNormDampgY.Ary2D /end CHARACTERISTIC
/begin CHARACTERISTIC CalRegn03Rt04GroupB.InertiaCmpVelAssiBasdDampgRollgWhlImbRejctnOnY.Ary1D "MICROSAR RTE" VAL_BLK 0x0 RTE_RL_UWORD 0 NO_COMPU_METHOD 0 65535 MATRIX_DIM 10 1 1 SYMBOL_LINK "Rte_CalprmRom_CalRegn03Rt04GroupB_DEFAULT_RTE_CALPRM_GROUP.InertiaCmpVelAssiBasdDampgRollgWhlImbRejctnOnY_Ary1D" 0 DISPLAY_IDENTIFIER CalRegn03Rt04GroupB.CalibrationPorts.InertiaCmpVelAssiBasdDampgRollgWhlImbRejctnOnY.Ary1D /end CHARACTERISTIC
/begin CHARACTERISTIC CmnMfgSrv.CmnMfgSrvSecuAcsAtmptTiOut.Val "MICROSAR RTE" VALUE 0x0 RTE_RL_UWORD 0 NO_COMPU_METHOD 0 65535 SYMBOL_LINK "Rte_CalprmRom_CalRegn01Cmn_DEFAULT_RTE_CALPRM_GROUP.CmnMfgSrvSecuAcsAtmptTiOut_Val" 0 DISPLAY_IDENTIFIER CmnMfgSrv.CalibrationPorts.CmnMfgSrvSecuAcsAtmptTiOut.Val /end CHARACTERISTIC
/begin CHARACTERISTIC CmnMfgSrv.CmnMfgSrvSecuAcsMaxNrAtmpt.Val "MICROSAR RTE" VALUE 0x0 RTE_RL_UBYTE 0 NO_COMPU_METHOD 0 255 SYMBOL_LINK "Rte_CalprmRom_CalRegn01Cmn_DEFAULT_RTE_CALPRM_GROUP.CmnMfgSrvSecuAcsMaxNrAtmpt_Val" 0 DISPLAY_IDENTIFIER CmnMfgSrv.CalibrationPorts.CmnMfgSrvSecuAcsMaxNrAtmpt.Val /end CHARACTERISTIC
/begin CHARACTERISTIC CmnMfgSrv.NvmIgnCntr_DefaultValue "MICROSAR RTE" VALUE 0x0 RTE_RL_ULONG 0 NO_COMPU_METHOD 0 4294967295 SYMBOL_LINK "Rte_CalprmRom_CmnMfgSrv_DEFAULT_RTE_CDATA_GROUP.NvmIgnCntr_DefaultValue" 0 DISPLAY_IDENTIFIER CmnMfgSrv.CalibrationParameters.NvmIgnCntr_DefaultValue /end CHARACTERISTIC
/begin CHARACTERISTIC CmnMfgSrv.NvmMfgEnaCntr_DefaultValue "MICROSAR RTE" VALUE 0x0 RTE_RL_UBYTE 0 NO_COMPU_METHOD 0 255 SYMBOL_LINK "Rte_CalprmRom_CmnMfgSrv_DEFAULT_RTE_CDATA_GROUP.NvmMfgEnaCntr_DefaultValue" 0 DISPLAY_IDENTIFIER CmnMfgSrv.CalibrationParameters.NvmMfgEnaCntr_DefaultValue /end CHARACTERISTIC
/begin CHARACTERISTIC CmnMfgSrv.NvmNxtrSeedKey_DefaultValue "MICROSAR RTE" VAL_BLK 0x0 RTE_RL_UBYTE 0 NO_COMPU_METHOD 0 255 MATRIX_DIM 10 1 1 SYMBOL_LINK "Rte_CalprmRom_CmnMfgSrv_DEFAULT_RTE_CDATA_GROUP.NvmNxtrSeedKey_DefaultValue" 0 DISPLAY_IDENTIFIER CmnMfgSrv.CalibrationParameters.NvmNxtrSeedKey_DefaultValue /end CHARACTERISTIC
/begin CHARACTERISTIC CmnMfgSrv.SeedKeyDft "MICROSAR RTE" VAL_BLK 0x0 RTE_RL_ULONG 0 NO_COMPU_METHOD 0 4294967295 MATRIX_DIM 2 1 1 SYMBOL_LINK "Rte_CalprmRom_CmnMfgSrv_DEFAULT_RTE_CDATA_GROUP.SeedKeyDft" 0 DISPLAY_IDENTIFIER CmnMfgSrv.CalibrationParameters.SeedKeyDft /end CHARACTERISTIC
/begin CHARACTERISTIC CmplncErr.CmplncErrHwAgNonLinCmplncDepTblY.Ary1D "MICROSAR RTE" VAL_BLK 0x0 RTE_RL_UWORD 0 NO_COMPU_METHOD 0 65535 MATRIX_DIM 6 1 1 SYMBOL_LINK "Rte_CalprmRom_CalRegn01Cmn_DEFAULT_RTE_CALPRM_GROUP.CmplncErrHwAgNonLinCmplncDepTblY_Ary1D" 0 DISPLAY_IDENTIFIER CmplncErr.CalibrationPorts.CmplncErrHwAgNonLinCmplncDepTblY.Ary1D /end CHARACTERISTIC
/begin CHARACTERISTIC CmplncErr.CmplncErrHwAgNonLinCmplncIndTblX.Ary1D "MICROSAR RTE" VAL_BLK 0x0 RTE_RL_UWORD 0 NO_COMPU_METHOD 0 65535 MATRIX_DIM 6 1 1 SYMBOL_LINK "Rte_CalprmRom_CalRegn01Cmn_DEFAULT_RTE_CALPRM_GROUP.CmplncErrHwAgNonLinCmplncIndTblX_Ary1D" 0 DISPLAY_IDENTIFIER CmplncErr.CalibrationPorts.CmplncErrHwAgNonLinCmplncIndTblX.Ary1D /end CHARACTERISTIC
/begin CHARACTERISTIC CmplncErr.CmplncErrMotAgNonLinCmplncDepTblY.Ary1D "MICROSAR RTE" VAL_BLK 0x0 RTE_RL_UWORD 0 NO_COMPU_METHOD 0 65535 MATRIX_DIM 6 1 1 SYMBOL_LINK "Rte_CalprmRom_CalRegn01Cmn_DEFAULT_RTE_CALPRM_GROUP.CmplncErrMotAgNonLinCmplncDepTblY_Ary1D" 0 DISPLAY_IDENTIFIER CmplncErr.CalibrationPorts.CmplncErrMotAgNonLinCmplncDepTblY.Ary1D /end CHARACTERISTIC
/begin CHARACTERISTIC CmplncErr.CmplncErrMotAgNonLinCmplncIndTblX.Ary1D "MICROSAR RTE" VAL_BLK 0x0 RTE_RL_UWORD 0 NO_COMPU_METHOD 0 65535 MATRIX_DIM 6 1 1 SYMBOL_LINK "Rte_CalprmRom_CalRegn01Cmn_DEFAULT_RTE_CALPRM_GROUP.CmplncErrMotAgNonLinCmplncIndTblX_Ary1D" 0 DISPLAY_IDENTIFIER CmplncErr.CalibrationPorts.CmplncErrMotAgNonLinCmplncIndTblX.Ary1D /end CHARACTERISTIC
/begin CHARACTERISTIC CurrMeasCorrln.CurrMeasCorrlnMaxErrCurr.Val "MICROSAR RTE" VALUE 0x0 RTE_RL_FLOAT32_IEEE 0 NO_COMPU_METHOD -3.402823466e+38 3.402823466e+38 SYMBOL_LINK "Rte_CalprmRom_CalRegn01Cmn_DEFAULT_RTE_CALPRM_GROUP.CurrMeasCorrlnMaxErrCurr_Val" 0 DISPLAY_IDENTIFIER CurrMeasCorrln.CalibrationPorts.CurrMeasCorrlnMaxErrCurr.Val /end CHARACTERISTIC
/begin CHARACTERISTIC CurrMeasCorrln.CurrMeasCorrlnMaxStallCntr.Val "MICROSAR RTE" VALUE 0x0 RTE_RL_UBYTE 0 NO_COMPU_METHOD 0 255 SYMBOL_LINK "Rte_CalprmRom_CalRegn01Cmn_DEFAULT_RTE_CALPRM_GROUP.CurrMeasCorrlnMaxStallCntr_Val" 0 DISPLAY_IDENTIFIER CurrMeasCorrln.CalibrationPorts.CurrMeasCorrlnMaxStallCntr.Val /end CHARACTERISTIC
/begin CHARACTERISTIC CurrMeasCorrln.CurrMeasCorrlnNtc0x04DFailStep.Val "MICROSAR RTE" VALUE 0x0 RTE_RL_UWORD 0 NO_COMPU_METHOD 0 65535 SYMBOL_LINK "Rte_CalprmRom_CalRegn01Cmn_DEFAULT_RTE_CALPRM_GROUP.CurrMeasCorrlnNtc0x04DFailStep_Val" 0 DISPLAY_IDENTIFIER CurrMeasCorrln.CalibrationPorts.CurrMeasCorrlnNtc0x04DFailStep.Val /end CHARACTERISTIC
/begin CHARACTERISTIC CurrMeasCorrln.CurrMeasCorrlnNtc0x04DPassStep.Val "MICROSAR RTE" VALUE 0x0 RTE_RL_UWORD 0 NO_COMPU_METHOD 0 65535 SYMBOL_LINK "Rte_CalprmRom_CalRegn01Cmn_DEFAULT_RTE_CALPRM_GROUP.CurrMeasCorrlnNtc0x04DPassStep_Val" 0 DISPLAY_IDENTIFIER CurrMeasCorrln.CalibrationPorts.CurrMeasCorrlnNtc0x04DPassStep.Val /end CHARACTERISTIC
/begin CHARACTERISTIC CurrMeasCorrln.CurrMeasCorrlnNtc0x04EFailStep.Val "MICROSAR RTE" VALUE 0x0 RTE_RL_UWORD 0 NO_COMPU_METHOD 0 65535 SYMBOL_LINK "Rte_CalprmRom_CalRegn01Cmn_DEFAULT_RTE_CALPRM_GROUP.CurrMeasCorrlnNtc0x04EFailStep_Val" 0 DISPLAY_IDENTIFIER CurrMeasCorrln.CalibrationPorts.CurrMeasCorrlnNtc0x04EFailStep.Val /end CHARACTERISTIC
/begin CHARACTERISTIC CurrMeasCorrln.CurrMeasCorrlnNtc0x04EPassStep.Val "MICROSAR RTE" VALUE 0x0 RTE_RL_UWORD 0 NO_COMPU_METHOD 0 65535 SYMBOL_LINK "Rte_CalprmRom_CalRegn01Cmn_DEFAULT_RTE_CALPRM_GROUP.CurrMeasCorrlnNtc0x04EPassStep_Val" 0 DISPLAY_IDENTIFIER CurrMeasCorrln.CalibrationPorts.CurrMeasCorrlnNtc0x04EPassStep.Val /end CHARACTERISTIC
/begin CHARACTERISTIC CurrReasbnDiagc.CurrReasbnDiagcCurrDiagcMotEnvlpTblMax.Val "MICROSAR RTE" VALUE 0x0 RTE_RL_FLOAT32_IEEE 0 NO_COMPU_METHOD -3.402823466e+38 3.402823466e+38 SYMBOL_LINK "Rte_CalRegn01Cmn_CurrReasbnDiagcCurrDiagcMotEnvlpTblMax_Val" 0 DISPLAY_IDENTIFIER CurrReasbnDiagc.CalibrationPorts.CurrReasbnDiagcCurrDiagcMotEnvlpTblMax.Val /end CHARACTERISTIC
/begin CHARACTERISTIC CurrReasbnDiagc.CurrReasbnDiagcCurrDiagcPrimErrThd.Val "MICROSAR RTE" VALUE 0x0 RTE_RL_FLOAT32_IEEE 0 NO_COMPU_METHOD -3.402823466e+38 3.402823466e+38 SYMBOL_LINK "Rte_CalRegn01Cmn_CurrReasbnDiagcCurrDiagcPrimErrThd_Val" 0 DISPLAY_IDENTIFIER CurrReasbnDiagc.CalibrationPorts.CurrReasbnDiagcCurrDiagcPrimErrThd.Val /end CHARACTERISTIC
/begin CHARACTERISTIC CurrReasbnDiagc.CurrReasbnDiagcCurrDiagcSecdryErrThd.Val "MICROSAR RTE" VALUE 0x0 RTE_RL_FLOAT32_IEEE 0 NO_COMPU_METHOD -3.402823466e+38 3.402823466e+38 SYMBOL_LINK "Rte_CalRegn01Cmn_CurrReasbnDiagcCurrDiagcSecdryErrThd_Val" 0 DISPLAY_IDENTIFIER CurrReasbnDiagc.CalibrationPorts.CurrReasbnDiagcCurrDiagcSecdryErrThd.Val /end CHARACTERISTIC
/begin CHARACTERISTIC CurrReasbnDiagc.CurrReasbnDiagcCurrDiagcSecdryTqLimThd.Val "MICROSAR RTE" VALUE 0x0 RTE_RL_FLOAT32_IEEE 0 NO_COMPU_METHOD -3.402823466e+38 3.402823466e+38 SYMBOL_LINK "Rte_CalRegn01Cmn_CurrReasbnDiagcCurrDiagcSecdryTqLimThd_Val" 0 DISPLAY_IDENTIFIER CurrReasbnDiagc.CalibrationPorts.CurrReasbnDiagcCurrDiagcSecdryTqLimThd.Val /end CHARACTERISTIC
/begin CHARACTERISTIC CurrReasbnDiagc.CurrReasbnDiagcDiagFildLim.Val "MICROSAR RTE" VALUE 0x0 RTE_RL_FLOAT32_IEEE 0 NO_COMPU_METHOD -3.402823466e+38 3.402823466e+38 SYMBOL_LINK "Rte_CalRegn01Cmn_CurrReasbnDiagcDiagFildLim_Val" 0 DISPLAY_IDENTIFIER CurrReasbnDiagc.CalibrationPorts.CurrReasbnDiagcDiagFildLim.Val /end CHARACTERISTIC
/begin CHARACTERISTIC CurrReasbnDiagc.CurrReasbnDiagcDiagVltgLpFilEna.Logl "MICROSAR RTE" VALUE 0x0 RTE_RL_BOOLEAN 0 RTE_CM_BOOLEAN 0 255 SYMBOL_LINK "Rte_CalRegn01Cmn_CurrReasbnDiagcDiagVltgLpFilEna_Logl" 0 DISPLAY_IDENTIFIER CurrReasbnDiagc.CalibrationPorts.CurrReasbnDiagcDiagVltgLpFilEna.Logl /end CHARACTERISTIC
/begin CHARACTERISTIC CurrReasbnDiagc.CurrReasbnDiagcDiagVltgLpFilFrq.Val "MICROSAR RTE" VALUE 0x0 RTE_RL_FLOAT32_IEEE 0 NO_COMPU_METHOD -3.402823466e+38 3.402823466e+38 SYMBOL_LINK "Rte_CalRegn01Cmn_CurrReasbnDiagcDiagVltgLpFilFrq_Val" 0 DISPLAY_IDENTIFIER CurrReasbnDiagc.CalibrationPorts.CurrReasbnDiagcDiagVltgLpFilFrq.Val /end CHARACTERISTIC
/begin CHARACTERISTIC CurrReasbnDiagc.CurrReasbnDiagcLpFilSca.Val "MICROSAR RTE" VALUE 0x0 RTE_RL_FLOAT32_IEEE 0 NO_COMPU_METHOD -3.402823466e+38 3.402823466e+38 SYMBOL_LINK "Rte_CalRegn01Cmn_CurrReasbnDiagcLpFilSca_Val" 0 DISPLAY_IDENTIFIER CurrReasbnDiagc.CalibrationPorts.CurrReasbnDiagcLpFilSca.Val /end CHARACTERISTIC
/begin CHARACTERISTIC CurrReasbnDiagc.CurrReasbnDiagcMotVelHiLim.Val "MICROSAR RTE" VALUE 0x0 RTE_RL_FLOAT32_IEEE 0 NO_COMPU_METHOD -3.402823466e+38 3.402823466e+38 SYMBOL_LINK "Rte_CalRegn01Cmn_CurrReasbnDiagcMotVelHiLim_Val" 0 DISPLAY_IDENTIFIER CurrReasbnDiagc.CalibrationPorts.CurrReasbnDiagcMotVelHiLim.Val /end CHARACTERISTIC
/begin CHARACTERISTIC CurrReasbnDiagc.CurrReasbnDiagcMotVelLoLim.Val "MICROSAR RTE" VALUE 0x0 RTE_RL_FLOAT32_IEEE 0 NO_COMPU_METHOD -3.402823466e+38 3.402823466e+38 SYMBOL_LINK "Rte_CalRegn01Cmn_CurrReasbnDiagcMotVelLoLim_Val" 0 DISPLAY_IDENTIFIER CurrReasbnDiagc.CalibrationPorts.CurrReasbnDiagcMotVelLoLim.Val /end CHARACTERISTIC
/begin CHARACTERISTIC CurrReasbnDiagc.CurrReasbnDiagcMotVltgDaxLpFilFrq.Val "MICROSAR RTE" VALUE 0x0 RTE_RL_FLOAT32_IEEE 0 NO_COMPU_METHOD -3.402823466e+38 3.402823466e+38 SYMBOL_LINK "Rte_CalRegn01Cmn_CurrReasbnDiagcMotVltgDaxLpFilFrq_Val" 0 DISPLAY_IDENTIFIER CurrReasbnDiagc.CalibrationPorts.CurrReasbnDiagcMotVltgDaxLpFilFrq.Val /end CHARACTERISTIC
/begin CHARACTERISTIC CurrReasbnDiagc.CurrReasbnDiagcMotVltgQaxDaxFilEna.Logl "MICROSAR RTE" VALUE 0x0 RTE_RL_BOOLEAN 0 RTE_CM_BOOLEAN 0 255 SYMBOL_LINK "Rte_CalRegn01Cmn_CurrReasbnDiagcMotVltgQaxDaxFilEna_Logl" 0 DISPLAY_IDENTIFIER CurrReasbnDiagc.CalibrationPorts.CurrReasbnDiagcMotVltgQaxDaxFilEna.Logl /end CHARACTERISTIC
/begin CHARACTERISTIC CurrReasbnDiagc.CurrReasbnDiagcMotVltgQaxLpFilFrq.Val "MICROSAR RTE" VALUE 0x0 RTE_RL_FLOAT32_IEEE 0 NO_COMPU_METHOD -3.402823466e+38 3.402823466e+38 SYMBOL_LINK "Rte_CalRegn01Cmn_CurrReasbnDiagcMotVltgQaxLpFilFrq_Val" 0 DISPLAY_IDENTIFIER CurrReasbnDiagc.CalibrationPorts.CurrReasbnDiagcMotVltgQaxLpFilFrq.Val /end CHARACTERISTIC
/begin CHARACTERISTIC CurrReasbnDiagc.CurrReasbnDiagcVelLpFilEna.Logl "MICROSAR RTE" VALUE 0x0 RTE_RL_BOOLEAN 0 RTE_CM_BOOLEAN 0 255 SYMBOL_LINK "Rte_CalRegn01Cmn_CurrReasbnDiagcVelLpFilEna_Logl" 0 DISPLAY_IDENTIFIER CurrReasbnDiagc.CalibrationPorts.CurrReasbnDiagcVelLpFilEna.Logl /end CHARACTERISTIC
/begin CHARACTERISTIC CurrReasbnDiagc.CurrReasbnDiagcVelLpFilFrq.Val "MICROSAR RTE" VALUE 0x0 RTE_RL_FLOAT32_IEEE 0 NO_COMPU_METHOD -3.402823466e+38 3.402823466e+38 SYMBOL_LINK "Rte_CalRegn01Cmn_CurrReasbnDiagcVelLpFilFrq_Val" 0 DISPLAY_IDENTIFIER CurrReasbnDiagc.CalibrationPorts.CurrReasbnDiagcVelLpFilFrq.Val /end CHARACTERISTIC
/begin CHARACTERISTIC CurrReasbnDiagc.SysGlbPrmMotPoleCnt.Val "MICROSAR RTE" VALUE 0x0 RTE_RL_UBYTE 0 NO_COMPU_METHOD 0 255 SYMBOL_LINK "Rte_CalRegn01Inin00_SysGlbPrmMotPoleCnt_Val" 0 DISPLAY_IDENTIFIER CurrReasbnDiagc.CalibrationPorts.SysGlbPrmMotPoleCnt.Val /end CHARACTERISTIC
/begin CHARACTERISTIC CustDiagc.DiagcMgrFltResp.Ary1D "MICROSAR RTE" VAL_BLK 0x0 RTE_RL_ULONG 0 NO_COMPU_METHOD 0 4294967295 MATRIX_DIM 512 1 1 SYMBOL_LINK "Rte_CalprmRom_CalRegn02Cmn_DEFAULT_RTE_CALPRM_GROUP.DiagcMgrFltResp_Ary1D" 0 DISPLAY_IDENTIFIER CustDiagc.CalibrationPorts.DiagcMgrFltResp.Ary1D /end CHARACTERISTIC
/begin MEASUREMENT CmnMfgSrv.AssiLnrGain.Val "MICROSAR RTE" FLOAT32_IEEE NO_COMPU_METHOD 0 0 -3.402823466e+38 3.402823466e+38 ECU_ADDRESS 0 SYMBOL_LINK "Rte_CmnMfgSrv_AssiLnrGain_Val" 0 DISPLAY_IDENTIFIER CmnMfgSrv.SenderPorts.AssiLnrGain.Val /end MEASUREMENT
/begin MEASUREMENT CmnMfgSrv.AssiLnrGainEna.Logl "MICROSAR RTE" UBYTE RTE_CM_BOOLEAN 0 0 0 255 ECU_ADDRESS 0 SYMBOL_LINK "Rte_CmnMfgSrv_AssiLnrGainEna_Logl" 0 DISPLAY_IDENTIFIER CmnMfgSrv.SenderPorts.AssiLnrGainEna.Logl /end MEASUREMENT
/begin MEASUREMENT CmnMfgSrv.AssiMechTEstimnDi.Logl "MICROSAR RTE" UBYTE RTE_CM_BOOLEAN 0 0 0 255 ECU_ADDRESS 0 SYMBOL_LINK "Rte_CmnMfgSrv_AssiMechTEstimnDi_Logl" 0 DISPLAY_IDENTIFIER CmnMfgSrv.SenderPorts.AssiMechTEstimnDi.Logl /end MEASUREMENT
/begin MEASUREMENT CmnMfgSrv.CcaHwPartNr "MICROSAR RTE" UBYTE NO_COMPU_METHOD 0 0 0 255 MATRIX_DIM 20 1 1 ECU_ADDRESS 0 SYMBOL_LINK "Rte_CmnMfgSrv_CcaHwPartNr" 0 DISPLAY_IDENTIFIER CmnMfgSrv.PerInstanceMemories.CcaHwPartNr /end MEASUREMENT
/begin MEASUREMENT CmnMfgSrv.CcaSerlNr "MICROSAR RTE" UBYTE NO_COMPU_METHOD 0 0 0 255 MATRIX_DIM 20 1 1 ECU_ADDRESS 0 SYMBOL_LINK "Rte_CmnMfgSrv_CcaSerlNr" 0 DISPLAY_IDENTIFIER CmnMfgSrv.PerInstanceMemories.CcaSerlNr /end MEASUREMENT
/begin MEASUREMENT CmnMfgSrv.DampgCmdBasDi.Logl "MICROSAR RTE" UBYTE RTE_CM_BOOLEAN 0 0 0 255 ECU_ADDRESS 0 SYMBOL_LINK "Rte_CmnMfgSrv_DampgCmdBasDi_Logl" 0 DISPLAY_IDENTIFIER CmnMfgSrv.SenderPorts.DampgCmdBasDi.Logl /end MEASUREMENT
/begin MEASUREMENT CmnMfgSrv.DiAssiMechTEstimn "MICROSAR RTE" UBYTE RTE_CM_BOOLEAN 0 0 0 255 ECU_ADDRESS 0 SYMBOL_LINK "Rte_CmnMfgSrv_DiAssiMechTEstimn" 0 DISPLAY_IDENTIFIER CmnMfgSrv.PerInstanceMemories.DiAssiMechTEstimn /end MEASUREMENT
/begin MEASUREMENT CmnMfgSrv.DiDampg "MICROSAR RTE" UBYTE RTE_CM_BOOLEAN 0 0 0 255 ECU_ADDRESS 0 SYMBOL_LINK "Rte_CmnMfgSrv_DiDampg" 0 DISPLAY_IDENTIFIER CmnMfgSrv.PerInstanceMemories.DiDampg /end MEASUREMENT
/begin MEASUREMENT CmnMfgSrv.DiDutyCycThermProtn "MICROSAR RTE" UBYTE RTE_CM_BOOLEAN 0 0 0 255 ECU_ADDRESS 0 SYMBOL_LINK "Rte_CmnMfgSrv_DiDutyCycThermProtn" 0 DISPLAY_IDENTIFIER CmnMfgSrv.PerInstanceMemories.DiDutyCycThermProtn /end MEASUREMENT
/begin MEASUREMENT CmnMfgSrv.DiEotProtn "MICROSAR RTE" UBYTE RTE_CM_BOOLEAN 0 0 0 255 ECU_ADDRESS 0 SYMBOL_LINK "Rte_CmnMfgSrv_DiEotProtn" 0 DISPLAY_IDENTIFIER CmnMfgSrv.PerInstanceMemories.DiEotProtn /end MEASUREMENT
/begin MEASUREMENT CmnMfgSrv.DiHysCmp "MICROSAR RTE" UBYTE RTE_CM_BOOLEAN 0 0 0 255 ECU_ADDRESS 0 SYMBOL_LINK "Rte_CmnMfgSrv_DiHysCmp" 0 DISPLAY_IDENTIFIER CmnMfgSrv.PerInstanceMemories.DiHysCmp /end MEASUREMENT
/begin MEASUREMENT CmnMfgSrv.DiInertiaCmp "MICROSAR RTE" UBYTE RTE_CM_BOOLEAN 0 0 0 255 ECU_ADDRESS 0 SYMBOL_LINK "Rte_CmnMfgSrv_DiInertiaCmp" 0 DISPLAY_IDENTIFIER CmnMfgSrv.PerInstanceMemories.DiInertiaCmp /end MEASUREMENT
/begin MEASUREMENT CmnMfgSrv.DiLoaSca "MICROSAR RTE" UBYTE RTE_CM_BOOLEAN 0 0 0 255 ECU_ADDRESS 0 SYMBOL_LINK "Rte_CmnMfgSrv_DiLoaSca" 0 DISPLAY_IDENTIFIER CmnMfgSrv.PerInstanceMemories.DiLoaSca /end MEASUREMENT
/begin MEASUREMENT CmnMfgSrv.DiPullCmpActvCmd "MICROSAR RTE" UBYTE RTE_CM_BOOLEAN 0 0 0 255 ECU_ADDRESS 0 SYMBOL_LINK "Rte_CmnMfgSrv_DiPullCmpActvCmd" 0 DISPLAY_IDENTIFIER CmnMfgSrv.PerInstanceMemories.DiPullCmpActvCmd /end MEASUREMENT
/begin MEASUREMENT CmnMfgSrv.DiPullCmpActvLrng "MICROSAR RTE" UBYTE RTE_CM_BOOLEAN 0 0 0 255 ECU_ADDRESS 0 SYMBOL_LINK "Rte_CmnMfgSrv_DiPullCmpActvLrng" 0 DISPLAY_IDENTIFIER CmnMfgSrv.PerInstanceMemories.DiPullCmpActvLrng /end MEASUREMENT
/begin MEASUREMENT CmnMfgSrv.DiRestore "MICROSAR RTE" UBYTE NO_COMPU_METHOD 0 0 0 255 MATRIX_DIM 8 1 1 ECU_ADDRESS 0 SYMBOL_LINK "Rte_CmnMfgSrv_DiRestore" 0 DISPLAY_IDENTIFIER CmnMfgSrv.PerInstanceMemories.DiRestore /end MEASUREMENT
/begin MEASUREMENT CmnMfgSrv.DiRtn "MICROSAR RTE" UBYTE RTE_CM_BOOLEAN 0 0 0 255 ECU_ADDRESS 0 SYMBOL_LINK "Rte_CmnMfgSrv_DiRtn" 0 DISPLAY_IDENTIFIER CmnMfgSrv.PerInstanceMemories.DiRtn /end MEASUREMENT
/begin MEASUREMENT CmnMfgSrv.DiStallMotTqLim "MICROSAR RTE" UBYTE RTE_CM_BOOLEAN 0 0 0 255 ECU_ADDRESS 0 SYMBOL_LINK "Rte_CmnMfgSrv_DiStallMotTqLim" 0 DISPLAY_IDENTIFIER CmnMfgSrv.PerInstanceMemories.DiStallMotTqLim /end MEASUREMENT
/begin MEASUREMENT CmnMfgSrv.DiSysFricLrng "MICROSAR RTE" UBYTE RTE_CM_BOOLEAN 0 0 0 255 ECU_ADDRESS 0 SYMBOL_LINK "Rte_CmnMfgSrv_DiSysFricLrng" 0 DISPLAY_IDENTIFIER CmnMfgSrv.PerInstanceMemories.DiSysFricLrng /end MEASUREMENT
/begin MEASUREMENT CmnMfgSrv.DiSysMotTqCmdRampRate "MICROSAR RTE" UBYTE RTE_CM_BOOLEAN 0 0 0 255 ECU_ADDRESS 0 SYMBOL_LINK "Rte_CmnMfgSrv_DiSysMotTqCmdRampRate" 0 DISPLAY_IDENTIFIER CmnMfgSrv.PerInstanceMemories.DiSysMotTqCmdRampRate /end MEASUREMENT
/begin MEASUREMENT CmnMfgSrv.DutyCycThermProtnDi.Logl "MICROSAR RTE" UBYTE RTE_CM_BOOLEAN 0 0 0 255 ECU_ADDRESS 0 SYMBOL_LINK "Rte_CmnMfgSrv_DutyCycThermProtnDi_Logl" 0 DISPLAY_IDENTIFIER CmnMfgSrv.SenderPorts.DutyCycThermProtnDi.Logl /end MEASUREMENT
/begin MEASUREMENT CmnMfgSrv.EotProtnDi.Logl "MICROSAR RTE" UBYTE RTE_CM_BOOLEAN 0 0 0 255 ECU_ADDRESS 0 SYMBOL_LINK "Rte_CmnMfgSrv_EotProtnDi_Logl" 0 DISPLAY_IDENTIFIER CmnMfgSrv.SenderPorts.EotProtnDi.Logl /end MEASUREMENT
/begin MEASUREMENT CmnMfgSrv.EpsSysSerlNr "MICROSAR RTE" UBYTE NO_COMPU_METHOD 0 0 0 255 MATRIX_DIM 20 1 1 ECU_ADDRESS 0 SYMBOL_LINK "Rte_CmnMfgSrv_EpsSysSerlNr" 0 DISPLAY_IDENTIFIER CmnMfgSrv.PerInstanceMemories.EpsSysSerlNr /end MEASUREMENT
/begin MEASUREMENT CmnMfgSrv.FricLrngDi.Logl "MICROSAR RTE" UBYTE RTE_CM_BOOLEAN 0 0 0 255 ECU_ADDRESS 0 SYMBOL_LINK "Rte_CmnMfgSrv_FricLrngDi_Logl" 0 DISPLAY_IDENTIFIER CmnMfgSrv.SenderPorts.FricLrngDi.Logl /end MEASUREMENT
/begin MEASUREMENT CmnMfgSrv.HysCmpCmdDi.Logl "MICROSAR RTE" UBYTE RTE_CM_BOOLEAN 0 0 0 255 ECU_ADDRESS 0 SYMBOL_LINK "Rte_CmnMfgSrv_HysCmpCmdDi_Logl" 0 DISPLAY_IDENTIFIER CmnMfgSrv.SenderPorts.HysCmpCmdDi.Logl /end MEASUREMENT
/begin MEASUREMENT CmnMfgSrv.IgnCntr "MICROSAR RTE" ULONG NO_COMPU_METHOD 0 0 0 4294967295 ECU_ADDRESS 0 SYMBOL_LINK "Rte_CmnMfgSrv_IgnCntr" 0 DISPLAY_IDENTIFIER CmnMfgSrv.PerInstanceMemories.IgnCntr /end MEASUREMENT
/begin MEASUREMENT CmnMfgSrv.IgnCntr.Val "MICROSAR RTE" ULONG NO_COMPU_METHOD 0 0 0 4294967295 ECU_ADDRESS 0 SYMBOL_LINK "Rte_CmnMfgSrv_IgnCntr_Val" 0 DISPLAY_IDENTIFIER CmnMfgSrv.SenderPorts.IgnCntr.Val /end MEASUREMENT
/begin MEASUREMENT CmnMfgSrv.InertiaCmpVelCmdDi.Logl "MICROSAR RTE" UBYTE RTE_CM_BOOLEAN 0 0 0 255 ECU_ADDRESS 0 SYMBOL_LINK "Rte_CmnMfgSrv_InertiaCmpVelCmdDi_Logl" 0 DISPLAY_IDENTIFIER CmnMfgSrv.SenderPorts.InertiaCmpVelCmdDi.Logl /end MEASUREMENT
/begin MEASUREMENT CmnMfgSrv.LoaScaDi.Logl "MICROSAR RTE" UBYTE RTE_CM_BOOLEAN 0 0 0 255 ECU_ADDRESS 0 SYMBOL_LINK "Rte_CmnMfgSrv_LoaScaDi_Logl" 0 DISPLAY_IDENTIFIER CmnMfgSrv.SenderPorts.LoaScaDi.Logl /end MEASUREMENT
/begin MEASUREMENT CmnMfgSrv.MfgDiagcInhb "MICROSAR RTE" UBYTE RTE_CM_BOOLEAN 0 0 0 255 ECU_ADDRESS 0 SYMBOL_LINK "Rte_CmnMfgSrv_MfgDiagcInhb" 0 DISPLAY_IDENTIFIER CmnMfgSrv.PerInstanceMemories.MfgDiagcInhb /end MEASUREMENT
/begin MEASUREMENT CmnMfgSrv.MfgDiagcInhb.Logl "MICROSAR RTE" UBYTE RTE_CM_BOOLEAN 0 0 0 255 ECU_ADDRESS 0 SYMBOL_LINK "Rte_CmnMfgSrv_MfgDiagcInhb_Logl" 0 DISPLAY_IDENTIFIER CmnMfgSrv.SenderPorts.MfgDiagcInhb.Logl /end MEASUREMENT
/begin MEASUREMENT CmnMfgSrv.MfgTmpBuf0 "MICROSAR RTE" UBYTE NO_COMPU_METHOD 0 0 0 255 MATRIX_DIM 16 1 1 ECU_ADDRESS 0 SYMBOL_LINK "Rte_CmnMfgSrv_MfgTmpBuf0" 0 DISPLAY_IDENTIFIER CmnMfgSrv.PerInstanceMemories.MfgTmpBuf0 /end MEASUREMENT
/begin MEASUREMENT CmnMfgSrv.MfgTmpBuf1 "MICROSAR RTE" UBYTE NO_COMPU_METHOD 0 0 0 255 MATRIX_DIM 16 1 1 ECU_ADDRESS 0 SYMBOL_LINK "Rte_CmnMfgSrv_MfgTmpBuf1" 0 DISPLAY_IDENTIFIER CmnMfgSrv.PerInstanceMemories.MfgTmpBuf1 /end MEASUREMENT
/begin MEASUREMENT CmnMfgSrv.MfgTmpBuf2 "MICROSAR RTE" UBYTE NO_COMPU_METHOD 0 0 0 255 MATRIX_DIM 16 1 1 ECU_ADDRESS 0 SYMBOL_LINK "Rte_CmnMfgSrv_MfgTmpBuf2" 0 DISPLAY_IDENTIFIER CmnMfgSrv.PerInstanceMemories.MfgTmpBuf2 /end MEASUREMENT
/begin MEASUREMENT CmnMfgSrv.MfgTmpBuf3 "MICROSAR RTE" UBYTE NO_COMPU_METHOD 0 0 0 255 MATRIX_DIM 16 1 1 ECU_ADDRESS 0 SYMBOL_LINK "Rte_CmnMfgSrv_MfgTmpBuf3" 0 DISPLAY_IDENTIFIER CmnMfgSrv.PerInstanceMemories.MfgTmpBuf3 /end MEASUREMENT
/begin MEASUREMENT CmnMfgSrv.MfgTmpBuf4 "MICROSAR RTE" UBYTE NO_COMPU_METHOD 0 0 0 255 MATRIX_DIM 16 1 1 ECU_ADDRESS 0 SYMBOL_LINK "Rte_CmnMfgSrv_MfgTmpBuf4" 0 DISPLAY_IDENTIFIER CmnMfgSrv.PerInstanceMemories.MfgTmpBuf4 /end MEASUREMENT
/begin MEASUREMENT CmnMfgSrv.NxtrMfgEnaCntr "MICROSAR RTE" UBYTE NO_COMPU_METHOD 0 0 0 255 ECU_ADDRESS 0 SYMBOL_LINK "Rte_CmnMfgSrv_NxtrMfgEnaCntr" 0 DISPLAY_IDENTIFIER CmnMfgSrv.PerInstanceMemories.NxtrMfgEnaCntr /end MEASUREMENT
/begin MEASUREMENT CmnMfgSrv.PullCmpCmdDi.Logl "MICROSAR RTE" UBYTE RTE_CM_BOOLEAN 0 0 0 255 ECU_ADDRESS 0 SYMBOL_LINK "Rte_CmnMfgSrv_PullCmpCmdDi_Logl" 0 DISPLAY_IDENTIFIER CmnMfgSrv.SenderPorts.PullCmpCmdDi.Logl /end MEASUREMENT
/begin MEASUREMENT CmnMfgSrv.PullCmpLrngDi.Logl "MICROSAR RTE" UBYTE RTE_CM_BOOLEAN 0 0 0 255 ECU_ADDRESS 0 SYMBOL_LINK "Rte_CmnMfgSrv_PullCmpLrngDi_Logl" 0 DISPLAY_IDENTIFIER CmnMfgSrv.SenderPorts.PullCmpLrngDi.Logl /end MEASUREMENT
/begin MEASUREMENT CmnMfgSrv.RtnCmdDi.Logl "MICROSAR RTE" UBYTE RTE_CM_BOOLEAN 0 0 0 255 ECU_ADDRESS 0 SYMBOL_LINK "Rte_CmnMfgSrv_RtnCmdDi_Logl" 0 DISPLAY_IDENTIFIER CmnMfgSrv.SenderPorts.RtnCmdDi.Logl /end MEASUREMENT
/begin MEASUREMENT CmnMfgSrv.SecuAcsAtmptCntr "MICROSAR RTE" UBYTE NO_COMPU_METHOD 0 0 0 255 ECU_ADDRESS 0 SYMBOL_LINK "Rte_CmnMfgSrv_SecuAcsAtmptCntr" 0 DISPLAY_IDENTIFIER CmnMfgSrv.PerInstanceMemories.SecuAcsAtmptCntr /end MEASUREMENT
/begin MEASUREMENT CmnMfgSrv.SecuAcsAtmptTmr "MICROSAR RTE" ULONG NO_COMPU_METHOD 0 0 0 4294967295 ECU_ADDRESS 0 SYMBOL_LINK "Rte_CmnMfgSrv_SecuAcsAtmptTmr" 0 DISPLAY_IDENTIFIER CmnMfgSrv.PerInstanceMemories.SecuAcsAtmptTmr /end MEASUREMENT
/begin MEASUREMENT CmnMfgSrv.SecuAcsSeedReqCmpl "MICROSAR RTE" UBYTE RTE_CM_BOOLEAN 0 0 0 255 ECU_ADDRESS 0 SYMBOL_LINK "Rte_CmnMfgSrv_SecuAcsSeedReqCmpl" 0 DISPLAY_IDENTIFIER CmnMfgSrv.PerInstanceMemories.SecuAcsSeedReqCmpl /end MEASUREMENT
/begin MEASUREMENT CmnMfgSrv.SecuAcsUnlckd "MICROSAR RTE" UBYTE RTE_CM_BOOLEAN 0 0 0 255 ECU_ADDRESS 0 SYMBOL_LINK "Rte_CmnMfgSrv_SecuAcsUnlckd" 0 DISPLAY_IDENTIFIER CmnMfgSrv.PerInstanceMemories.SecuAcsUnlckd /end MEASUREMENT
/begin MEASUREMENT CmnMfgSrv.SeedKey "MICROSAR RTE" ULONG NO_COMPU_METHOD 0 0 0 4294967295 MATRIX_DIM 2 1 1 ECU_ADDRESS 0 SYMBOL_LINK "Rte_CmnMfgSrv_SeedKey" 0 DISPLAY_IDENTIFIER CmnMfgSrv.PerInstanceMemories.SeedKey /end MEASUREMENT
/begin MEASUREMENT CmnMfgSrv.SessionCurr "MICROSAR RTE" UBYTE NO_COMPU_METHOD 0 0 0 255 ECU_ADDRESS 0 SYMBOL_LINK "Rte_CmnMfgSrv_SessionCurr" 0 DISPLAY_IDENTIFIER CmnMfgSrv.PerInstanceMemories.SessionCurr /end MEASUREMENT
/begin MEASUREMENT CmnMfgSrv.SessionTiOut "MICROSAR RTE" ULONG NO_COMPU_METHOD 0 0 0 4294967295 ECU_ADDRESS 0 SYMBOL_LINK "Rte_CmnMfgSrv_SessionTiOut" 0 DISPLAY_IDENTIFIER CmnMfgSrv.PerInstanceMemories.SessionTiOut /end MEASUREMENT
/begin MEASUREMENT CmnMfgSrv.StallMotTqLimDi.Logl "MICROSAR RTE" UBYTE RTE_CM_BOOLEAN 0 0 0 255 ECU_ADDRESS 0 SYMBOL_LINK "Rte_CmnMfgSrv_StallMotTqLimDi_Logl" 0 DISPLAY_IDENTIFIER CmnMfgSrv.SenderPorts.StallMotTqLimDi.Logl /end MEASUREMENT
/begin MEASUREMENT CmnMfgSrv.SysMotTqCmdRampRateDi.Logl "MICROSAR RTE" UBYTE RTE_CM_BOOLEAN 0 0 0 255 ECU_ADDRESS 0 SYMBOL_LINK "Rte_CmnMfgSrv_SysMotTqCmdRampRateDi_Logl" 0 DISPLAY_IDENTIFIER CmnMfgSrv.SenderPorts.SysMotTqCmdRampRateDi.Logl /end MEASUREMENT
/begin MEASUREMENT CmnMfgSrv.SysSt.Val "MICROSAR RTE" UBYTE RTE_CM_ENUM_SysSt1 0 0 0 255 ECU_ADDRESS 0 SYMBOL_LINK "Rte_SysStMod_SysSt_Val" 0 DISPLAY_IDENTIFIER CmnMfgSrv.ReceiverPorts.SysSt.Val /end MEASUREMENT
/begin MEASUREMENT CmnMfgSrv.SysStReqEnaOvrd "MICROSAR RTE" UBYTE RTE_CM_BOOLEAN 0 0 0 255 ECU_ADDRESS 0 SYMBOL_LINK "Rte_CmnMfgSrv_SysStReqEnaOvrd" 0 DISPLAY_IDENTIFIER CmnMfgSrv.PerInstanceMemories.SysStReqEnaOvrd /end MEASUREMENT
/begin MEASUREMENT CmnMfgSrv.SysStReqEnaOvrd.Logl "MICROSAR RTE" UBYTE RTE_CM_BOOLEAN 0 0 0 255 ECU_ADDRESS 0 SYMBOL_LINK "Rte_CmnMfgSrv_SysStReqEnaOvrd_Logl" 0 DISPLAY_IDENTIFIER CmnMfgSrv.SenderPorts.SysStReqEnaOvrd.Logl /end MEASUREMENT
/begin MEASUREMENT CmnMfgSrv.VehSpdOvrd.Val "MICROSAR RTE" FLOAT32_IEEE NO_COMPU_METHOD 0 0 -3.402823466e+38 3.402823466e+38 ECU_ADDRESS 0 SYMBOL_LINK "Rte_CmnMfgSrv_VehSpdOvrd_Val" 0 DISPLAY_IDENTIFIER CmnMfgSrv.SenderPorts.VehSpdOvrd.Val /end MEASUREMENT
/begin MEASUREMENT CmnMfgSrv.VehSpdOvrdEna.Logl "MICROSAR RTE" UBYTE RTE_CM_BOOLEAN 0 0 0 255 ECU_ADDRESS 0 SYMBOL_LINK "Rte_CmnMfgSrv_VehSpdOvrdEna_Logl" 0 DISPLAY_IDENTIFIER CmnMfgSrv.SenderPorts.VehSpdOvrdEna.Logl /end MEASUREMENT
/begin MEASUREMENT CmnMfgSrvIf.DataBuf "MICROSAR RTE" UBYTE NO_COMPU_METHOD 0 0 0 255 MATRIX_DIM 65535 1 1 ECU_ADDRESS 0 SYMBOL_LINK "Rte_CmnMfgSrvIf_DataBuf" 0 DISPLAY_IDENTIFIER CmnMfgSrvIf.PerInstanceMemories.DataBuf /end MEASUREMENT
/begin MEASUREMENT CmplncErr.CmplncErrMotToPinion.Val "MICROSAR RTE" FLOAT32_IEEE NO_COMPU_METHOD 0 0 -3.402823466e+38 3.402823466e+38 ECU_ADDRESS 0 SYMBOL_LINK "Rte_CmplncErr_CmplncErrMotToPinion_Val" 0 DISPLAY_IDENTIFIER CmplncErr.SenderPorts.CmplncErrMotToPinion.Val /end MEASUREMENT
/begin MEASUREMENT CmplncErr.CmplncErrPinionToHw.Val "MICROSAR RTE" FLOAT32_IEEE NO_COMPU_METHOD 0 0 -3.402823466e+38 3.402823466e+38 ECU_ADDRESS 0 SYMBOL_LINK "Rte_CmplncErr_CmplncErrPinionToHw_Val" 0 DISPLAY_IDENTIFIER CmplncErr.SenderPorts.CmplncErrPinionToHw.Val /end MEASUREMENT
/begin MEASUREMENT CmplncErr.HwTq.Val "MICROSAR RTE" FLOAT32_IEEE NO_COMPU_METHOD 0 0 -3.402823466e+38 3.402823466e+38 ECU_ADDRESS 0 SYMBOL_LINK "Rte_Swp_HwTqSwp_Val" 0 DISPLAY_IDENTIFIER CmplncErr.ReceiverPorts.HwTq.Val /end MEASUREMENT
/begin MEASUREMENT CmplncErr.MotTqCmdCrf.Val "MICROSAR RTE" FLOAT32_IEEE NO_COMPU_METHOD 0 0 -3.402823466e+38 3.402823466e+38 ECU_ADDRESS 0 SYMBOL_LINK "Rte_MotTqTranlDampg_MotTqCmdCrfDampd_Val" 0 DISPLAY_IDENTIFIER CmplncErr.ReceiverPorts.MotTqCmdCrf.Val /end MEASUREMENT
/begin MEASUREMENT CurrMeasCorrln.CurrMeasCorrlnSens0RollgCntPrev "MICROSAR RTE" UBYTE NO_COMPU_METHOD 0 0 0 255 ECU_ADDRESS 0 SYMBOL_LINK "Rte_CurrMeasCorrln_CurrMeasCorrlnSens0RollgCntPrev" 0 DISPLAY_IDENTIFIER CurrMeasCorrln.PerInstanceMemories.CurrMeasCorrlnSens0RollgCntPrev /end MEASUREMENT
/begin MEASUREMENT CurrMeasCorrln.CurrMeasCorrlnSens0StallCntPrev "MICROSAR RTE" UBYTE NO_COMPU_METHOD 0 0 0 255 ECU_ADDRESS 0 SYMBOL_LINK "Rte_CurrMeasCorrln_CurrMeasCorrlnSens0StallCntPrev" 0 DISPLAY_IDENTIFIER CurrMeasCorrln.PerInstanceMemories.CurrMeasCorrlnSens0StallCntPrev /end MEASUREMENT
/begin MEASUREMENT CurrMeasCorrln.CurrMeasCorrlnSens1RollgCntPrev "MICROSAR RTE" UBYTE NO_COMPU_METHOD 0 0 0 255 ECU_ADDRESS 0 SYMBOL_LINK "Rte_CurrMeasCorrln_CurrMeasCorrlnSens1RollgCntPrev" 0 DISPLAY_IDENTIFIER CurrMeasCorrln.PerInstanceMemories.CurrMeasCorrlnSens1RollgCntPrev /end MEASUREMENT
/begin MEASUREMENT CurrMeasCorrln.CurrMeasCorrlnSens1StallCntPrev "MICROSAR RTE" UBYTE NO_COMPU_METHOD 0 0 0 255 ECU_ADDRESS 0 SYMBOL_LINK "Rte_CurrMeasCorrln_CurrMeasCorrlnSens1StallCntPrev" 0 DISPLAY_IDENTIFIER CurrMeasCorrln.PerInstanceMemories.CurrMeasCorrlnSens1StallCntPrev /end MEASUREMENT
/begin MEASUREMENT CurrMeasCorrln.CurrMeasCorrlnSts.Val "MICROSAR RTE" UBYTE NO_COMPU_METHOD 0 0 0 255 ECU_ADDRESS 0 SYMBOL_LINK "Rte_CurrMeasCorrln_CurrMeasCorrlnSts_Val" 0 DISPLAY_IDENTIFIER CurrMeasCorrln.SenderPorts.CurrMeasCorrlnSts.Val /end MEASUREMENT
/begin MEASUREMENT CurrMeasCorrln.CurrMeasIdptSig.Val "MICROSAR RTE" UBYTE NO_COMPU_METHOD 0 0 0 255 ECU_ADDRESS 0 SYMBOL_LINK "Rte_CurrMeasCorrln_CurrMeasIdptSig_Val" 0 DISPLAY_IDENTIFIER CurrMeasCorrln.SenderPorts.CurrMeasIdptSig.Val /end MEASUREMENT
/begin MEASUREMENT CurrMeasCorrln.CurrMotSumABC.Val "MICROSAR RTE" FLOAT32_IEEE NO_COMPU_METHOD 0 0 -3.402823466e+38 3.402823466e+38 ECU_ADDRESS 0 SYMBOL_LINK "Rte_CurrMeasCorrln_CurrMotSumABC_Val" 0 DISPLAY_IDENTIFIER CurrMeasCorrln.SenderPorts.CurrMotSumABC.Val /end MEASUREMENT
/begin MEASUREMENT CurrMeasCorrln.CurrMotSumDEF.Val "MICROSAR RTE" FLOAT32_IEEE NO_COMPU_METHOD 0 0 -3.402823466e+38 3.402823466e+38 ECU_ADDRESS 0 SYMBOL_LINK "Rte_CurrMeasCorrln_CurrMotSumDEF_Val" 0 DISPLAY_IDENTIFIER CurrMeasCorrln.SenderPorts.CurrMotSumDEF.Val /end MEASUREMENT
/begin MEASUREMENT CurrMeasCorrln.DiagcStsIvtr1Inactv.Logl "MICROSAR RTE" UBYTE RTE_CM_BOOLEAN 0 0 0 255 ECU_ADDRESS 0 SYMBOL_LINK "Rte_DiagcMgr_DiagcStsIvtr1Inactv_Logl" 0 DISPLAY_IDENTIFIER CurrMeasCorrln.ReceiverPorts.DiagcStsIvtr1Inactv.Logl /end MEASUREMENT
/begin MEASUREMENT CurrMeasCorrln.DiagcStsIvtr2Inactv.Logl "MICROSAR RTE" UBYTE RTE_CM_BOOLEAN 0 0 0 255 ECU_ADDRESS 0 SYMBOL_LINK "Rte_DiagcMgr_DiagcStsIvtr2Inactv_Logl" 0 DISPLAY_IDENTIFIER CurrMeasCorrln.ReceiverPorts.DiagcStsIvtr2Inactv.Logl /end MEASUREMENT
/begin MEASUREMENT CurrMeasCorrln.MotCurrCorrdA.Val "MICROSAR RTE" FLOAT32_IEEE NO_COMPU_METHOD 0 0 -3.402823466e+38 3.402823466e+38 ECU_ADDRESS 0 SYMBOL_LINK "Rte_CDD_MotCtrlMgr_MotCurrCorrdA_Val" 0 DISPLAY_IDENTIFIER CurrMeasCorrln.ReceiverPorts.MotCurrCorrdA.Val /end MEASUREMENT
/begin MEASUREMENT CurrMeasCorrln.MotCurrCorrdB.Val "MICROSAR RTE" FLOAT32_IEEE NO_COMPU_METHOD 0 0 -3.402823466e+38 3.402823466e+38 ECU_ADDRESS 0 SYMBOL_LINK "Rte_CDD_MotCtrlMgr_MotCurrCorrdB_Val" 0 DISPLAY_IDENTIFIER CurrMeasCorrln.ReceiverPorts.MotCurrCorrdB.Val /end MEASUREMENT
/begin MEASUREMENT CurrMeasCorrln.MotCurrCorrdC.Val "MICROSAR RTE" FLOAT32_IEEE NO_COMPU_METHOD 0 0 -3.402823466e+38 3.402823466e+38 ECU_ADDRESS 0 SYMBOL_LINK "Rte_CDD_MotCtrlMgr_MotCurrCorrdC_Val" 0 DISPLAY_IDENTIFIER CurrMeasCorrln.ReceiverPorts.MotCurrCorrdC.Val /end MEASUREMENT
/begin MEASUREMENT CurrMeasCorrln.MotCurrCorrdD.Val "MICROSAR RTE" FLOAT32_IEEE NO_COMPU_METHOD 0 0 -3.402823466e+38 3.402823466e+38 ECU_ADDRESS 0 SYMBOL_LINK "Rte_CDD_MotCtrlMgr_MotCurrCorrdD_Val" 0 DISPLAY_IDENTIFIER CurrMeasCorrln.ReceiverPorts.MotCurrCorrdD.Val /end MEASUREMENT
/begin MEASUREMENT CurrMeasCorrln.MotCurrCorrdE.Val "MICROSAR RTE" FLOAT32_IEEE NO_COMPU_METHOD 0 0 -3.402823466e+38 3.402823466e+38 ECU_ADDRESS 0 SYMBOL_LINK "Rte_CDD_MotCtrlMgr_MotCurrCorrdE_Val" 0 DISPLAY_IDENTIFIER CurrMeasCorrln.ReceiverPorts.MotCurrCorrdE.Val /end MEASUREMENT
/begin MEASUREMENT CurrMeasCorrln.MotCurrCorrdF.Val "MICROSAR RTE" FLOAT32_IEEE NO_COMPU_METHOD 0 0 -3.402823466e+38 3.402823466e+38 ECU_ADDRESS 0 SYMBOL_LINK "Rte_CDD_MotCtrlMgr_MotCurrCorrdF_Val" 0 DISPLAY_IDENTIFIER CurrMeasCorrln.ReceiverPorts.MotCurrCorrdF.Val /end MEASUREMENT
/begin MEASUREMENT CurrMeasCorrln.MotCurrEolCalSt.Val "MICROSAR RTE" UBYTE RTE_CM_ENUM_MotCurrEolCalSt2 0 0 0 255 ECU_ADDRESS 0 SYMBOL_LINK "Rte_CDD_CurrMeas_MotCurrEolCalSt_Val" 0 DISPLAY_IDENTIFIER CurrMeasCorrln.ReceiverPorts.MotCurrEolCalSt.Val /end MEASUREMENT
/begin MEASUREMENT CurrMeasCorrln.MotCurrQlfr1.Val "MICROSAR RTE" UBYTE RTE_CM_ENUM_SigQlfr1 0 0 0 255 ECU_ADDRESS 0 SYMBOL_LINK "Rte_CDD_CurrMeas_MotCurrQlfr1_Val" 0 DISPLAY_IDENTIFIER CurrMeasCorrln.ReceiverPorts.MotCurrQlfr1.Val /end MEASUREMENT
/begin MEASUREMENT CurrMeasCorrln.MotCurrQlfr2.Val "MICROSAR RTE" UBYTE RTE_CM_ENUM_SigQlfr1 0 0 0 255 ECU_ADDRESS 0 SYMBOL_LINK "Rte_CDD_CurrMeas_MotCurrQlfr2_Val" 0 DISPLAY_IDENTIFIER CurrMeasCorrln.ReceiverPorts.MotCurrQlfr2.Val /end MEASUREMENT
/begin MEASUREMENT CurrMeasCorrln.MotCurrRollgCntr1.Val "MICROSAR RTE" UBYTE NO_COMPU_METHOD 0 0 0 255 ECU_ADDRESS 0 SYMBOL_LINK "Rte_CDD_MotCtrlMgr_MotCurrRollgCntr1_Val" 0 DISPLAY_IDENTIFIER CurrMeasCorrln.ReceiverPorts.MotCurrRollgCntr1.Val /end MEASUREMENT
/begin MEASUREMENT CurrMeasCorrln.MotCurrRollgCntr2.Val "MICROSAR RTE" UBYTE NO_COMPU_METHOD 0 0 0 255 ECU_ADDRESS 0 SYMBOL_LINK "Rte_CDD_MotCtrlMgr_MotCurrRollgCntr2_Val" 0 DISPLAY_IDENTIFIER CurrMeasCorrln.ReceiverPorts.MotCurrRollgCntr2.Val /end MEASUREMENT
/begin MEASUREMENT CurrMeasCorrln.SysSt.Val "MICROSAR RTE" UBYTE RTE_CM_ENUM_SysSt1 0 0 0 255 ECU_ADDRESS 0 SYMBOL_LINK "Rte_SysStMod_SysSt_Val" 0 DISPLAY_IDENTIFIER CurrMeasCorrln.ReceiverPorts.SysSt.Val /end MEASUREMENT
/begin MEASUREMENT CurrReasbnDiagc.CurrReasbnMotVelLpFil.FilGain "MICROSAR RTE" FLOAT32_IEEE NO_COMPU_METHOD 0 0 -3.402823466e+38 3.402823466e+38 ECU_ADDRESS 0 SYMBOL_LINK "Rte_CurrReasbnDiagc_CurrReasbnMotVelLpFil.FilGain" 0 DISPLAY_IDENTIFIER CurrReasbnDiagc.PerInstanceMemories.CurrReasbnMotVelLpFil.FilGain /end MEASUREMENT
/begin MEASUREMENT CurrReasbnDiagc.CurrReasbnMotVelLpFil.FilSt "MICROSAR RTE" FLOAT32_IEEE NO_COMPU_METHOD 0 0 -3.402823466e+38 3.402823466e+38 ECU_ADDRESS 0 SYMBOL_LINK "Rte_CurrReasbnDiagc_CurrReasbnMotVelLpFil.FilSt" 0 DISPLAY_IDENTIFIER CurrReasbnDiagc.PerInstanceMemories.CurrReasbnMotVelLpFil.FilSt /end MEASUREMENT
/begin MEASUREMENT CurrReasbnDiagc.DiagVltgLpFil.FilGain "MICROSAR RTE" FLOAT32_IEEE NO_COMPU_METHOD 0 0 -3.402823466e+38 3.402823466e+38 ECU_ADDRESS 0 SYMBOL_LINK "Rte_CurrReasbnDiagc_DiagVltgLpFil.FilGain" 0 DISPLAY_IDENTIFIER CurrReasbnDiagc.PerInstanceMemories.DiagVltgLpFil.FilGain /end MEASUREMENT
/begin MEASUREMENT CurrReasbnDiagc.DiagVltgLpFil.FilSt "MICROSAR RTE" FLOAT32_IEEE NO_COMPU_METHOD 0 0 -3.402823466e+38 3.402823466e+38 ECU_ADDRESS 0 SYMBOL_LINK "Rte_CurrReasbnDiagc_DiagVltgLpFil.FilSt" 0 DISPLAY_IDENTIFIER CurrReasbnDiagc.PerInstanceMemories.DiagVltgLpFil.FilSt /end MEASUREMENT
/begin MEASUREMENT CurrReasbnDiagc.MotAgElec.Val "MICROSAR RTE" UWORD NO_COMPU_METHOD 0 0 0 65535 ECU_ADDRESS 0 SYMBOL_LINK "Rte_CurrReasbnDiagc_MotAgElec_Val" 0 DISPLAY_IDENTIFIER CurrReasbnDiagc.ReceiverPorts.MotAgElec.Val /end MEASUREMENT
/begin MEASUREMENT CurrReasbnDiagc.MotTqCmdLimrMin.Val "MICROSAR RTE" FLOAT32_IEEE NO_COMPU_METHOD 0 0 -3.402823466e+38 3.402823466e+38 ECU_ADDRESS 0 SYMBOL_LINK "Rte_AssiSumLim_MotTqCmd_Val" 0 DISPLAY_IDENTIFIER CurrReasbnDiagc.ReceiverPorts.MotTqCmdLimrMin.Val /end MEASUREMENT
/begin MEASUREMENT CurrReasbnDiagc.MotVelMrf.Val "MICROSAR RTE" FLOAT32_IEEE NO_COMPU_METHOD 0 0 -3.402823466e+38 3.402823466e+38 ECU_ADDRESS 0 SYMBOL_LINK "Rte_CDD_MotVel_MotVelMrf_Val" 0 DISPLAY_IDENTIFIER CurrReasbnDiagc.ReceiverPorts.MotVelMrf.Val /end MEASUREMENT
/begin MEASUREMENT CurrReasbnDiagc.MotVltgDaxFfStat.Val "MICROSAR RTE" FLOAT32_IEEE NO_COMPU_METHOD 0 0 -3.402823466e+38 3.402823466e+38 ECU_ADDRESS 0 SYMBOL_LINK "Rte_MotRefMdl_MotVltgDaxFfStat_Val" 0 DISPLAY_IDENTIFIER CurrReasbnDiagc.ReceiverPorts.MotVltgDaxFfStat.Val /end MEASUREMENT
/begin MEASUREMENT CurrReasbnDiagc.MotVltgDaxFild.Val "MICROSAR RTE" FLOAT32_IEEE NO_COMPU_METHOD 0 0 -3.402823466e+38 3.402823466e+38 ECU_ADDRESS 0 SYMBOL_LINK "Rte_CDD_MotCtrlMgr_MotVltgDaxFild_Val" 0 DISPLAY_IDENTIFIER CurrReasbnDiagc.ReceiverPorts.MotVltgDaxFild.Val /end MEASUREMENT
/begin MEASUREMENT CurrReasbnDiagc.MotVltgDaxLpFil.FilGain "MICROSAR RTE" FLOAT32_IEEE NO_COMPU_METHOD 0 0 -3.402823466e+38 3.402823466e+38 ECU_ADDRESS 0 SYMBOL_LINK "Rte_CurrReasbnDiagc_MotVltgDaxLpFil.FilGain" 0 DISPLAY_IDENTIFIER CurrReasbnDiagc.PerInstanceMemories.MotVltgDaxLpFil.FilGain /end MEASUREMENT
/begin MEASUREMENT CurrReasbnDiagc.MotVltgDaxLpFil.FilSt "MICROSAR RTE" FLOAT32_IEEE NO_COMPU_METHOD 0 0 -3.402823466e+38 3.402823466e+38 ECU_ADDRESS 0 SYMBOL_LINK "Rte_CurrReasbnDiagc_MotVltgDaxLpFil.FilSt" 0 DISPLAY_IDENTIFIER CurrReasbnDiagc.PerInstanceMemories.MotVltgDaxLpFil.FilSt /end MEASUREMENT
/begin MEASUREMENT CurrReasbnDiagc.MotVltgDiagFildInp1Prev "MICROSAR RTE" FLOAT32_IEEE NO_COMPU_METHOD 0 0 -3.402823466e+38 3.402823466e+38 ECU_ADDRESS 0 SYMBOL_LINK "Rte_CurrReasbnDiagc_MotVltgDiagFildInp1Prev" 0 DISPLAY_IDENTIFIER CurrReasbnDiagc.PerInstanceMemories.MotVltgDiagFildInp1Prev /end MEASUREMENT
/begin MEASUREMENT CurrReasbnDiagc.MotVltgDiagFildInp2Prev "MICROSAR RTE" FLOAT32_IEEE NO_COMPU_METHOD 0 0 -3.402823466e+38 3.402823466e+38 ECU_ADDRESS 0 SYMBOL_LINK "Rte_CurrReasbnDiagc_MotVltgDiagFildInp2Prev" 0 DISPLAY_IDENTIFIER CurrReasbnDiagc.PerInstanceMemories.MotVltgDiagFildInp2Prev /end MEASUREMENT
/begin MEASUREMENT CurrReasbnDiagc.MotVltgDiagFildOutp1Prev "MICROSAR RTE" FLOAT32_IEEE NO_COMPU_METHOD 0 0 -3.402823466e+38 3.402823466e+38 ECU_ADDRESS 0 SYMBOL_LINK "Rte_CurrReasbnDiagc_MotVltgDiagFildOutp1Prev" 0 DISPLAY_IDENTIFIER CurrReasbnDiagc.PerInstanceMemories.MotVltgDiagFildOutp1Prev /end MEASUREMENT
/begin MEASUREMENT CurrReasbnDiagc.MotVltgDiagFildOutp2Prev "MICROSAR RTE" FLOAT32_IEEE NO_COMPU_METHOD 0 0 -3.402823466e+38 3.402823466e+38 ECU_ADDRESS 0 SYMBOL_LINK "Rte_CurrReasbnDiagc_MotVltgDiagFildOutp2Prev" 0 DISPLAY_IDENTIFIER CurrReasbnDiagc.PerInstanceMemories.MotVltgDiagFildOutp2Prev /end MEASUREMENT
/begin MEASUREMENT CurrReasbnDiagc.MotVltgQaxFfStat.Val "MICROSAR RTE" FLOAT32_IEEE NO_COMPU_METHOD 0 0 -3.402823466e+38 3.402823466e+38 ECU_ADDRESS 0 SYMBOL_LINK "Rte_MotRefMdl_MotVltgQaxFfStat_Val" 0 DISPLAY_IDENTIFIER CurrReasbnDiagc.ReceiverPorts.MotVltgQaxFfStat.Val /end MEASUREMENT
/begin MEASUREMENT CurrReasbnDiagc.MotVltgQaxFild.Val "MICROSAR RTE" FLOAT32_IEEE NO_COMPU_METHOD 0 0 -3.402823466e+38 3.402823466e+38 ECU_ADDRESS 0 SYMBOL_LINK "Rte_CDD_MotCtrlMgr_MotVltgQaxFild_Val" 0 DISPLAY_IDENTIFIER CurrReasbnDiagc.ReceiverPorts.MotVltgQaxFild.Val /end MEASUREMENT
/begin MEASUREMENT CurrReasbnDiagc.MotVltgQaxLpFil.FilGain "MICROSAR RTE" FLOAT32_IEEE NO_COMPU_METHOD 0 0 -3.402823466e+38 3.402823466e+38 ECU_ADDRESS 0 SYMBOL_LINK "Rte_CurrReasbnDiagc_MotVltgQaxLpFil.FilGain" 0 DISPLAY_IDENTIFIER CurrReasbnDiagc.PerInstanceMemories.MotVltgQaxLpFil.FilGain /end MEASUREMENT
/begin MEASUREMENT CurrReasbnDiagc.MotVltgQaxLpFil.FilSt "MICROSAR RTE" FLOAT32_IEEE NO_COMPU_METHOD 0 0 -3.402823466e+38 3.402823466e+38 ECU_ADDRESS 0 SYMBOL_LINK "Rte_CurrReasbnDiagc_MotVltgQaxLpFil.FilSt" 0 DISPLAY_IDENTIFIER CurrReasbnDiagc.PerInstanceMemories.MotVltgQaxLpFil.FilSt /end MEASUREMENT
/begin MEASUREMENT CurrReasbnDiagc.SysMotTqCmdSca.Val "MICROSAR RTE" FLOAT32_IEEE NO_COMPU_METHOD 0 0 -3.402823466e+38 3.402823466e+38 ECU_ADDRESS 0 SYMBOL_LINK "Rte_StOutpCtrl_SysMotTqCmdSca_Val" 0 DISPLAY_IDENTIFIER CurrReasbnDiagc.ReceiverPorts.SysMotTqCmdSca.Val /end MEASUREMENT
/begin MEASUREMENT CurrReasbnDiagc.dCurrReasbnDiagcMotVltgAFild "MICROSAR RTE" FLOAT32_IEEE NO_COMPU_METHOD 0 0 -3.402823466e+38 3.402823466e+38 ECU_ADDRESS 0 SYMBOL_LINK "Rte_CurrReasbnDiagc_dCurrReasbnDiagcMotVltgAFild" 0 DISPLAY_IDENTIFIER CurrReasbnDiagc.PerInstanceMemories.dCurrReasbnDiagcMotVltgAFild /end MEASUREMENT
/begin MEASUREMENT CurrReasbnDiagc.dCurrReasbnDiagcMotVltgBFild "MICROSAR RTE" FLOAT32_IEEE NO_COMPU_METHOD 0 0 -3.402823466e+38 3.402823466e+38 ECU_ADDRESS 0 SYMBOL_LINK "Rte_CurrReasbnDiagc_dCurrReasbnDiagcMotVltgBFild" 0 DISPLAY_IDENTIFIER CurrReasbnDiagc.PerInstanceMemories.dCurrReasbnDiagcMotVltgBFild /end MEASUREMENT
/begin MEASUREMENT CurrReasbnDiagc.dCurrReasbnDiagcMotVltgDaxDif "MICROSAR RTE" FLOAT32_IEEE NO_COMPU_METHOD 0 0 -3.402823466e+38 3.402823466e+38 ECU_ADDRESS 0 SYMBOL_LINK "Rte_CurrReasbnDiagc_dCurrReasbnDiagcMotVltgDaxDif" 0 DISPLAY_IDENTIFIER CurrReasbnDiagc.PerInstanceMemories.dCurrReasbnDiagcMotVltgDaxDif /end MEASUREMENT
/begin MEASUREMENT CurrReasbnDiagc.dCurrReasbnDiagcMotVltgDiagFild "MICROSAR RTE" FLOAT32_IEEE NO_COMPU_METHOD 0 0 -3.402823466e+38 3.402823466e+38 ECU_ADDRESS 0 SYMBOL_LINK "Rte_CurrReasbnDiagc_dCurrReasbnDiagcMotVltgDiagFild" 0 DISPLAY_IDENTIFIER CurrReasbnDiagc.PerInstanceMemories.dCurrReasbnDiagcMotVltgDiagFild /end MEASUREMENT
/begin MEASUREMENT CurrReasbnDiagc.dCurrReasbnDiagcMotVltgDiagFildLimd "MICROSAR RTE" FLOAT32_IEEE NO_COMPU_METHOD 0 0 -3.402823466e+38 3.402823466e+38 ECU_ADDRESS 0 SYMBOL_LINK "Rte_CurrReasbnDiagc_dCurrReasbnDiagcMotVltgDiagFildLimd" 0 DISPLAY_IDENTIFIER CurrReasbnDiagc.PerInstanceMemories.dCurrReasbnDiagcMotVltgDiagFildLimd /end MEASUREMENT
/begin MEASUREMENT CurrReasbnDiagc.dCurrReasbnDiagcMotVltgDiagSecdryFild "MICROSAR RTE" FLOAT32_IEEE NO_COMPU_METHOD 0 0 -3.402823466e+38 3.402823466e+38 ECU_ADDRESS 0 SYMBOL_LINK "Rte_CurrReasbnDiagc_dCurrReasbnDiagcMotVltgDiagSecdryFild" 0 DISPLAY_IDENTIFIER CurrReasbnDiagc.PerInstanceMemories.dCurrReasbnDiagcMotVltgDiagSecdryFild /end MEASUREMENT
/begin MEASUREMENT CurrReasbnDiagc.dCurrReasbnDiagcMotVltgQaxDif "MICROSAR RTE" FLOAT32_IEEE NO_COMPU_METHOD 0 0 -3.402823466e+38 3.402823466e+38 ECU_ADDRESS 0 SYMBOL_LINK "Rte_CurrReasbnDiagc_dCurrReasbnDiagcMotVltgQaxDif" 0 DISPLAY_IDENTIFIER CurrReasbnDiagc.PerInstanceMemories.dCurrReasbnDiagcMotVltgQaxDif /end MEASUREMENT
/begin MEASUREMENT CurrReasbnDiagc.dCurrReasbnDiagcVelLpFild "MICROSAR RTE" FLOAT32_IEEE NO_COMPU_METHOD 0 0 -3.402823466e+38 3.402823466e+38 ECU_ADDRESS 0 SYMBOL_LINK "Rte_CurrReasbnDiagc_dCurrReasbnDiagcVelLpFild" 0 DISPLAY_IDENTIFIER CurrReasbnDiagc.PerInstanceMemories.dCurrReasbnDiagcVelLpFild /end MEASUREMENT
/begin MEASUREMENT CustDiagc.ApaSt.Val "MICROSAR RTE" UBYTE NO_COMPU_METHOD 0 0 0 255 ECU_ADDRESS 0 SYMBOL_LINK "Rte_GmOvrlStMgr_ApaSt_Val" 0 DISPLAY_IDENTIFIER CustDiagc.ReceiverPorts.ApaSt.Val /end MEASUREMENT
/begin MEASUREMENT CustDiagc.BattVltg.Val "MICROSAR RTE" FLOAT32_IEEE NO_COMPU_METHOD 0 0 -3.402823466e+38 3.402823466e+38 ECU_ADDRESS 0 SYMBOL_LINK "Rte_CDD_GmG2kcaMcuCfg_BattVltg_Val" 0 DISPLAY_IDENTIFIER CustDiagc.ReceiverPorts.BattVltg.Val /end MEASUREMENT
/begin MEASUREMENT CustDiagc.CpidActv "MICROSAR RTE" UBYTE RTE_CM_BOOLEAN 0 0 0 255 ECU_ADDRESS 0 SYMBOL_LINK "Rte_CustDiagc_CpidActv" 0 DISPLAY_IDENTIFIER CustDiagc.PerInstanceMemories.CpidActv /end MEASUREMENT
/begin MEASUREMENT CustDiagc.CtrlrTRng.Val "MICROSAR RTE" UBYTE NO_COMPU_METHOD 0 0 0 255 ECU_ADDRESS 0 SYMBOL_LINK "Rte_StHlthSigNormn_CtrlrTRng_Val" 0 DISPLAY_IDENTIFIER CustDiagc.ReceiverPorts.CtrlrTRng.Val /end MEASUREMENT
/begin MEASUREMENT CustDiagc.CustDiagcCtrlPidKeyAtmptCntr "MICROSAR RTE" UBYTE NO_COMPU_METHOD 0 0 0 255 ECU_ADDRESS 0 SYMBOL_LINK "Rte_CustDiagc_CustDiagcCtrlPidKeyAtmptCntr" 0 DISPLAY_IDENTIFIER CustDiagc.PerInstanceMemories.CustDiagcCtrlPidKeyAtmptCntr /end MEASUREMENT
/begin MEASUREMENT CustDiagc.CustDiagcCtrlPidSeedKeyTmr "MICROSAR RTE" ULONG NO_COMPU_METHOD 0 0 0 4294967295 ECU_ADDRESS 0 SYMBOL_LINK "Rte_CustDiagc_CustDiagcCtrlPidSeedKeyTmr" 0 DISPLAY_IDENTIFIER CustDiagc.PerInstanceMemories.CustDiagcCtrlPidSeedKeyTmr /end MEASUREMENT
/begin MEASUREMENT CustDiagc.CustDiagcCtrlPidSeedReqd "MICROSAR RTE" UBYTE RTE_CM_BOOLEAN 0 0 0 255 ECU_ADDRESS 0 SYMBOL_LINK "Rte_CustDiagc_CustDiagcCtrlPidSeedReqd" 0 DISPLAY_IDENTIFIER CustDiagc.PerInstanceMemories.CustDiagcCtrlPidSeedReqd /end MEASUREMENT
/begin MEASUREMENT CustDiagc.CustDiagcCtrlPidSeedTmrActvd "MICROSAR RTE" UBYTE RTE_CM_BOOLEAN 0 0 0 255 ECU_ADDRESS 0 SYMBOL_LINK "Rte_CustDiagc_CustDiagcCtrlPidSeedTmrActvd" 0 DISPLAY_IDENTIFIER CustDiagc.PerInstanceMemories.CustDiagcCtrlPidSeedTmrActvd /end MEASUREMENT
/begin MEASUREMENT CustDiagc.CustDiagcProgmSessionKeyAtmptCntr "MICROSAR RTE" UBYTE NO_COMPU_METHOD 0 0 0 255 ECU_ADDRESS 0 SYMBOL_LINK "Rte_CustDiagc_CustDiagcProgmSessionKeyAtmptCntr" 0 DISPLAY_IDENTIFIER CustDiagc.PerInstanceMemories.CustDiagcProgmSessionKeyAtmptCntr /end MEASUREMENT
/begin MEASUREMENT CustDiagc.CustDiagcProgmSessionSeedKeyTmr "MICROSAR RTE" ULONG NO_COMPU_METHOD 0 0 0 4294967295 ECU_ADDRESS 0 SYMBOL_LINK "Rte_CustDiagc_CustDiagcProgmSessionSeedKeyTmr" 0 DISPLAY_IDENTIFIER CustDiagc.PerInstanceMemories.CustDiagcProgmSessionSeedKeyTmr /end MEASUREMENT
/begin MEASUREMENT CustDiagc.CustDiagcProgmSessionSeedReqd "MICROSAR RTE" UBYTE RTE_CM_BOOLEAN 0 0 0 255 ECU_ADDRESS 0 SYMBOL_LINK "Rte_CustDiagc_CustDiagcProgmSessionSeedReqd" 0 DISPLAY_IDENTIFIER CustDiagc.PerInstanceMemories.CustDiagcProgmSessionSeedReqd /end MEASUREMENT
/begin MEASUREMENT CustDiagc.CustDiagcProgmSessionSeedTmrActvd "MICROSAR RTE" UBYTE RTE_CM_BOOLEAN 0 0 0 255 ECU_ADDRESS 0 SYMBOL_LINK "Rte_CustDiagc_CustDiagcProgmSessionSeedTmrActvd" 0 DISPLAY_IDENTIFIER CustDiagc.PerInstanceMemories.CustDiagcProgmSessionSeedTmrActvd /end MEASUREMENT
/begin MEASUREMENT CustDiagc.DesRtIdx.Val "MICROSAR RTE" UBYTE NO_COMPU_METHOD 0 0 0 255 ECU_ADDRESS 0 SYMBOL_LINK "Rte_GmMsg232BusHiSpd_DesRtIdx_Val" 0 DISPLAY_IDENTIFIER CustDiagc.ReceiverPorts.DesRtIdx.Val /end MEASUREMENT
/begin MEASUREMENT CustDiagc.DtcNr "MICROSAR RTE" ULONG NO_COMPU_METHOD 0 0 0 4294967295 ECU_ADDRESS 0 SYMBOL_LINK "Rte_CustDiagc_DtcNr" 0 DISPLAY_IDENTIFIER CustDiagc.PerInstanceMemories.DtcNr /end MEASUREMENT
/begin GROUP CalRegn03Rt02GroupA.HysCmpFricWhlImbRejctnBlndX.Ary1D "MICROSAR RTE" /begin SUB_GROUP /end SUB_GROUP /begin FUNCTION_LIST /end FUNCTION_LIST /begin REF_CHARACTERISTIC CalRegn03Rt02GroupA.HysCmpFricWhlImbRejctnBlndX.Ary1D /end REF_CHARACTERISTIC /begin REF_MEASUREMENT /end REF_MEASUREMENT /end GROUP
/begin GROUP CalRegn03Rt02GroupA.HysCmpFricWhlImbRejctnBlndY.Ary1D "MICROSAR RTE" /begin SUB_GROUP /end SUB_GROUP /begin FUNCTION_LIST /end FUNCTION_LIST /begin REF_CHARACTERISTIC CalRegn03Rt02GroupA.HysCmpFricWhlImbRejctnBlndY.Ary1D /end REF_CHARACTERISTIC /begin REF_MEASUREMENT /end REF_MEASUREMENT /end GROUP
/begin GROUP CalRegn03Rt02GroupA.HysCmpFricWhlImbRejctnOffY.Ary1D "MICROSAR RTE" /begin SUB_GROUP /end SUB_GROUP /begin FUNCTION_LIST /end FUNCTION_LIST /begin REF_CHARACTERISTIC CalRegn03Rt02GroupA.HysCmpFricWhlImbRejctnOffY.Ary1D /end REF_CHARACTERISTIC /begin REF_MEASUREMENT /end REF_MEASUREMENT /end GROUP
/begin GROUP CalRegn03Rt02GroupA.HysCmpFricWhlImbRejctnOnY.Ary1D "MICROSAR RTE" /begin SUB_GROUP /end SUB_GROUP /begin FUNCTION_LIST /end FUNCTION_LIST /begin REF_CHARACTERISTIC CalRegn03Rt02GroupA.HysCmpFricWhlImbRejctnOnY.Ary1D /end REF_CHARACTERISTIC /begin REF_MEASUREMENT /end REF_MEASUREMENT /end GROUP
/begin GROUP CalRegn03Rt02GroupA.InertiaCmpVelAssiBasdDampgCoeffX.Ary1D "MICROSAR RTE" /begin SUB_GROUP /end SUB_GROUP /begin FUNCTION_LIST /end FUNCTION_LIST /begin REF_CHARACTERISTIC CalRegn03Rt02GroupA.InertiaCmpVelAssiBasdDampgCoeffX.Ary1D /end REF_CHARACTERISTIC /begin REF_MEASUREMENT /end REF_MEASUREMENT /end GROUP
/begin GROUP CalRegn03Rt02GroupA.InertiaCmpVelAssiBasdDampgRollgY.Ary1D "MICROSAR RTE" /begin SUB_GROUP /end SUB_GROUP /begin FUNCTION_LIST /end FUNCTION_LIST /begin REF_CHARACTERISTIC CalRegn03Rt02GroupA.InertiaCmpVelAssiBasdDampgRollgY.Ary1D /end REF_CHARACTERISTIC /begin REF_MEASUREMENT /end REF_MEASUREMENT /end GROUP
/begin GROUP CalRegn03Rt02GroupA.InertiaCmpVelAssiBasdDampgStatY.Ary1D "MICROSAR RTE" /begin SUB_GROUP /end SUB_GROUP /begin FUNCTION_LIST /end FUNCTION_LIST /begin REF_CHARACTERISTIC CalRegn03Rt02GroupA.InertiaCmpVelAssiBasdDampgStatY.Ary1D /end REF_CHARACTERISTIC /begin REF_MEASUREMENT /end REF_MEASUREMENT /end GROUP
/begin GROUP CalRegn03Rt02GroupA.InertiaCmpVelDampgSpdBlndY.Ary1D "MICROSAR RTE" /begin SUB_GROUP /end SUB_GROUP /begin FUNCTION_LIST /end FUNCTION_LIST /begin REF_CHARACTERISTIC CalRegn03Rt02GroupA.InertiaCmpVelDampgSpdBlndY.Ary1D /end REF_CHARACTERISTIC /begin REF_MEASUREMENT /end REF_MEASUREMENT /end GROUP
/begin GROUP CalRegn03Rt02GroupA.InertiaCmpVelNotchBlndY.Ary1D "MICROSAR RTE" /begin SUB_GROUP /end SUB_GROUP /begin FUNCTION_LIST /end FUNCTION_LIST /begin REF_CHARACTERISTIC CalRegn03Rt02GroupA.InertiaCmpVelNotchBlndY.Ary1D /end REF_CHARACTERISTIC /begin REF_MEASUREMENT /end REF_MEASUREMENT /end GROUP
/begin GROUP CalRegn03Rt02GroupA.RtnHwAgOffsCalcdX.Ary2D "MICROSAR RTE" /begin SUB_GROUP /end SUB_GROUP /begin FUNCTION_LIST /end FUNCTION_LIST /begin REF_CHARACTERISTIC CalRegn03Rt02GroupA.RtnHwAgOffsCalcdX.Ary2D /end REF_CHARACTERISTIC /begin REF_MEASUREMENT /end REF_MEASUREMENT /end GROUP
/begin GROUP CalRegn03Rt02GroupA.RtnHwAgOffsCalcdY.Ary2D "MICROSAR RTE" /begin SUB_GROUP /end SUB_GROUP /begin FUNCTION_LIST /end FUNCTION_LIST /begin REF_CHARACTERISTIC CalRegn03Rt02GroupA.RtnHwAgOffsCalcdY.Ary2D /end REF_CHARACTERISTIC /begin REF_MEASUREMENT /end REF_MEASUREMENT /end GROUP
/begin GROUP CalRegn03Rt02GroupA.RtnScaTqX.Ary2D "MICROSAR RTE" /begin SUB_GROUP /end SUB_GROUP /begin FUNCTION_LIST /end FUNCTION_LIST /begin REF_CHARACTERISTIC CalRegn03Rt02GroupA.RtnScaTqX.Ary2D /end REF_CHARACTERISTIC /begin REF_MEASUREMENT /end REF_MEASUREMENT /end GROUP
/begin GROUP CalRegn03Rt02GroupA.RtnScaTqY.Ary2D "MICROSAR RTE" /begin SUB_GROUP /end SUB_GROUP /begin FUNCTION_LIST /end FUNCTION_LIST /begin REF_CHARACTERISTIC CalRegn03Rt02GroupA.RtnScaTqY.Ary2D /end REF_CHARACTERISTIC /begin REF_MEASUREMENT /end REF_MEASUREMENT /end GROUP
/begin GROUP CalRegn03Rt02GroupA.RtnScaVelX.Ary2D "MICROSAR RTE" /begin SUB_GROUP /end SUB_GROUP /begin FUNCTION_LIST /end FUNCTION_LIST /begin REF_CHARACTERISTIC CalRegn03Rt02GroupA.RtnScaVelX.Ary2D /end REF_CHARACTERISTIC /begin REF_MEASUREMENT /end REF_MEASUREMENT /end GROUP
/begin GROUP CalRegn03Rt02GroupA.RtnScaVelY.Ary2D "MICROSAR RTE" /begin SUB_GROUP /end SUB_GROUP /begin FUNCTION_LIST /end FUNCTION_LIST /begin REF_CHARACTERISTIC CalRegn03Rt02GroupA.RtnScaVelY.Ary2D /end REF_CHARACTERISTIC /begin REF_MEASUREMENT /end REF_MEASUREMENT /end GROUP
/begin GROUP CalRegn03Rt02GroupB "MICROSAR RTE" /begin SUB_GROUP CalRegn03Rt02GroupB.CalibrationPorts /end SUB_GROUP /begin FUNCTION_LIST /end FUNCTION_LIST /begin REF_CHARACTERISTIC /end REF_CHARACTERISTIC /begin REF_MEASUREMENT /end REF_MEASUREMENT /end GROUP
/begin GROUP CalRegn03Rt02GroupB.AssiHiFrqTqWhlImbRejctnTqX.Ary2D "MICROSAR RTE" /begin SUB_GROUP /end SUB_GROUP /begin FUNCTION_LIST /end FUNCTION_LIST /begin REF_CHARACTERISTIC CalRegn03Rt02GroupB.AssiHiFrqTqWhlImbRejctnTqX.Ary2D /end REF_CHARACTERISTIC /begin REF_MEASUREMENT /end REF_MEASUREMENT /end GROUP
/begin GROUP CalRegn03Rt02GroupB.AssiHiFrqWhlImbRejctnGainY.Ary2D "MICROSAR RTE" /begin SUB_GROUP /end SUB_GROUP /begin FUNCTION_LIST /end FUNCTION_LIST /begin REF_CHARACTERISTIC CalRegn03Rt02GroupB.AssiHiFrqWhlImbRejctnGainY.Ary2D /end REF_CHARACTERISTIC /begin REF_MEASUREMENT /end REF_MEASUREMENT /end GROUP
/begin GROUP CalRegn03Rt02GroupB.AssiHiFrqWhlImbRejtcnBlndX.Ary2D "MICROSAR RTE" /begin SUB_GROUP /end SUB_GROUP /begin FUNCTION_LIST /end FUNCTION_LIST /begin REF_CHARACTERISTIC CalRegn03Rt02GroupB.AssiHiFrqWhlImbRejtcnBlndX.Ary2D /end REF_CHARACTERISTIC /begin REF_MEASUREMENT /end REF_MEASUREMENT /end GROUP
/begin GROUP CalRegn03Rt02GroupB.AssiHiFrqWhlImbRejtcnBlndY.Ary2D "MICROSAR RTE" /begin SUB_GROUP /end SUB_GROUP /begin FUNCTION_LIST /end FUNCTION_LIST /begin REF_CHARACTERISTIC CalRegn03Rt02GroupB.AssiHiFrqWhlImbRejtcnBlndY.Ary2D /end REF_CHARACTERISTIC /begin REF_MEASUREMENT /end REF_MEASUREMENT /end GROUP
/begin GROUP CalRegn03Rt02GroupB.AssiMotTqWhlImbRejctnMaxX.Ary2D "MICROSAR RTE" /begin SUB_GROUP /end SUB_GROUP /begin FUNCTION_LIST /end FUNCTION_LIST /begin REF_CHARACTERISTIC CalRegn03Rt02GroupB.AssiMotTqWhlImbRejctnMaxX.Ary2D /end REF_CHARACTERISTIC /begin REF_MEASUREMENT /end REF_MEASUREMENT /end GROUP
/begin GROUP CalRegn03Rt02GroupB.AssiMotTqWhlImbRejctnMaxY.Ary2D "MICROSAR RTE" /begin SUB_GROUP /end SUB_GROUP /begin FUNCTION_LIST /end FUNCTION_LIST /begin REF_CHARACTERISTIC CalRegn03Rt02GroupB.AssiMotTqWhlImbRejctnMaxY.Ary2D /end REF_CHARACTERISTIC /begin REF_MEASUREMENT /end REF_MEASUREMENT /end GROUP
/begin GROUP CalRegn03Rt02GroupB.AssiWhlImbRejctnBlndScaX.Ary2D "MICROSAR RTE" /begin SUB_GROUP /end SUB_GROUP /begin FUNCTION_LIST /end FUNCTION_LIST /begin REF_CHARACTERISTIC CalRegn03Rt02GroupB.AssiWhlImbRejctnBlndScaX.Ary2D /end REF_CHARACTERISTIC /begin REF_MEASUREMENT /end REF_MEASUREMENT /end GROUP
/begin GROUP CalRegn03Rt02GroupB.AssiWhlImbRejctnBlndScaY.Ary2D "MICROSAR RTE" /begin SUB_GROUP /end SUB_GROUP /begin FUNCTION_LIST /end FUNCTION_LIST /begin REF_CHARACTERISTIC CalRegn03Rt02GroupB.AssiWhlImbRejctnBlndScaY.Ary2D /end REF_CHARACTERISTIC /begin REF_MEASUREMENT /end REF_MEASUREMENT /end GROUP
/begin GROUP CalRegn03Rt02GroupB.CalibrationPorts "MICROSAR RTE"
 /begin SUB_GROUP CalRegn03Rt02GroupB.AssiHiFrqTqWhlImbRejctnTqX.Ary2D CalRegn03Rt02GroupB.AssiHiFrqWhlImbRejctnGainY.Ary2D CalRegn03Rt02GroupB.AssiHiFrqWhlImbRejtcnBlndX.Ary2D CalRegn03Rt02GroupB.AssiHiFrqWhlImbRejtcnBlndY.Ary2D CalRegn03Rt02GroupB.AssiMotTqWhlImbRejctnMaxX.Ary2D CalRegn03Rt02GroupB.AssiMotTqWhlImbRejctnMaxY.Ary2D CalRegn03Rt02GroupB.AssiWhlImbRejctnBlndScaX.Ary2D CalRegn03Rt02GroupB.AssiWhlImbRejctnBlndScaY.Ary2D CalRegn03Rt02GroupB.EotProtnDampgVehSpdTbl.Ary1D CalRegn03Rt02GroupB.EotProtnEntrGainVehSpdTbl.Ary1D CalRegn03Rt02GroupB.EotProtnEntrGainX.Ary2D CalRegn03Rt02GroupB.EotProtnEntrGainY.Ary2D CalRegn03Rt02GroupB.EotProtnExitDampgY.Ary2D CalRegn03Rt02GroupB.EotProtnHwDegDampgX.Ary2D CalRegn03Rt02GroupB.EotProtnNormDampgY.Ary2D CalRegn03Rt02GroupB.InertiaCmpVelAssiBasdDampgRollgWhlImbRejctnOnY.Ary1D /end SUB_GROUP
 /begin FUNCTION_LIST /end FUNCTION_LIST
 /begin REF_CHARACTERISTIC /end REF_CHARACTERISTIC
 /begin REF_MEASUREMENT /end REF_MEASUREMENT
/end GROUP
/begin GROUP CalRegn03Rt02GroupB.EotProtnDampgVehSpdTbl.Ary1D "MICROSAR RTE" /begin SUB_GROUP /end SUB_GROUP /begin FUNCTION_LIST /end FUNCTION_LIST /begin REF_CHARACTERISTIC CalRegn03Rt02GroupB.EotProtnDampgVehSpdTbl.Ary1D /end REF_CHARACTERISTIC /begin REF_MEASUREMENT /end REF_MEASUREMENT /end GROUP
/begin GROUP CalRegn03Rt02GroupB.EotProtnEntrGainVehSpdTbl.Ary1D "MICROSAR RTE" /begin SUB_GROUP /end SUB_GROUP /begin FUNCTION_LIST /end FUNCTION_LIST /begin REF_CHARACTERISTIC CalRegn03Rt02GroupB.EotProtnEntrGainVehSpdTbl.Ary1D /end REF_CHARACTERISTIC /begin REF_MEASUREMENT /end REF_MEASUREMENT /end GROUP
/begin GROUP CalRegn03Rt02GroupB.EotProtnEntrGainX.Ary2D "MICROSAR RTE" /begin SUB_GROUP /end SUB_GROUP /begin FUNCTION_LIST /end FUNCTION_LIST /begin REF_CHARACTERISTIC CalRegn03Rt02GroupB.EotProtnEntrGainX.Ary2D /end REF_CHARACTERISTIC /begin REF_MEASUREMENT /end REF_MEASUREMENT /end GROUP
/begin GROUP CalRegn03Rt02GroupB.EotProtnEntrGainY.Ary2D "MICROSAR RTE" /begin SUB_GROUP /end SUB_GROUP /begin FUNCTION_LIST /end FUNCTION_LIST /begin REF_CHARACTERISTIC CalRegn03Rt02GroupB.EotProtnEntrGainY.Ary2D /end REF_CHARACTERISTIC /begin REF_MEASUREMENT /end REF_MEASUREMENT /end GROUP
/begin GROUP CalRegn03Rt02GroupB.EotProtnExitDampgY.Ary2D "MICROSAR RTE" /begin SUB_GROUP /end SUB_GROUP /begin FUNCTION_LIST /end FUNCTION_LIST /begin REF_CHARACTERISTIC CalRegn03Rt02GroupB.EotProtnExitDampgY.Ary2D /end REF_CHARACTERISTIC /begin REF_MEASUREMENT /end REF_MEASUREMENT /end GROUP
/begin GROUP CalRegn03Rt02GroupB.EotProtnHwDegDampgX.Ary2D "MICROSAR RTE" /begin SUB_GROUP /end SUB_GROUP /begin FUNCTION_LIST /end FUNCTION_LIST /begin REF_CHARACTERISTIC CalRegn03Rt02GroupB.EotProtnHwDegDampgX.Ary2D /end REF_CHARACTERISTIC /begin REF_MEASUREMENT /end REF_MEASUREMENT /end GROUP
/begin GROUP CalRegn03Rt02GroupB.EotProtnNormDampgY.Ary2D "MICROSAR RTE" /begin SUB_GROUP /end SUB_GROUP /begin FUNCTION_LIST /end FUNCTION_LIST /begin REF_CHARACTERISTIC CalRegn03Rt02GroupB.EotProtnNormDampgY.Ary2D /end REF_CHARACTERISTIC /begin REF_MEASUREMENT /end REF_MEASUREMENT /end GROUP
/begin GROUP CalRegn03Rt02GroupB.InertiaCmpVelAssiBasdDampgRollgWhlImbRejctnOnY.Ary1D "MICROSAR RTE" /begin SUB_GROUP /end SUB_GROUP /begin FUNCTION_LIST /end FUNCTION_LIST
 /begin REF_CHARACTERISTIC CalRegn03Rt02GroupB.InertiaCmpVelAssiBasdDampgRollgWhlImbRejctnOnY.Ary1D /end REF_CHARACTERISTIC
 /begin REF_MEASUREMENT /end REF_MEASUREMENT
/end GROUP
/begin GROUP CalRegn03Rt03 "MICROSAR RTE" /begin SUB_GROUP CalRegn03Rt03.CalibrationPorts /end SUB_GROUP /begin FUNCTION_LIST /end FUNCTION_LIST /begin REF_CHARACTERISTIC /end REF_CHARACTERISTIC /begin REF_MEASUREMENT /end REF_MEASUREMENT /end GROUP
/begin GROUP CalRegn03Rt03.CalibrationPorts "MICROSAR RTE"
 /begin SUB_GROUP CalRegn03Rt03.InertiaCmpVelDampgFilFrq.Ary1D CalRegn03Rt03.InertiaCmpVelDampgFilFrqWhlImbRejctnOn.Ary1D /end SUB_GROUP
 /begin FUNCTION_LIST /end FUNCTION_LIST
 /begin REF_CHARACTERISTIC /end REF_CHARACTERISTIC
 /begin REF_MEASUREMENT /end REF_MEASUREMENT
/end GROUP
/begin GROUP CalRegn03Rt03.InertiaCmpVelDampgFilFrq.Ary1D "MICROSAR RTE" /begin SUB_GROUP /end SUB_GROUP /begin FUNCTION_LIST /end FUNCTION_LIST /begin REF_CHARACTERISTIC CalRegn03Rt03.InertiaCmpVelDampgFilFrq.Ary1D /end REF_CHARACTERISTIC /begin REF_MEASUREMENT /end REF_MEASUREMENT /end GROUP
/begin GROUP CalRegn03Rt03.InertiaCmpVelDampgFilFrqWhlImbRejctnOn.Ary1D "MICROSAR RTE" /begin SUB_GROUP /end SUB_GROUP /begin FUNCTION_LIST /end FUNCTION_LIST /begin REF_CHARACTERISTIC CalRegn03Rt03.InertiaCmpVelDampgFilFrqWhlImbRejctnOn.Ary1D /end REF_CHARACTERISTIC /begin REF_MEASUREMENT /end REF_MEASUREMENT /end GROUP
/begin GROUP CalRegn03Rt03GroupA "MICROSAR RTE" /begin SUB_GROUP CalRegn03Rt03GroupA.CalibrationPorts /end SUB_GROUP /begin FUNCTION_LIST /end FUNCTION_LIST /begin REF_CHARACTERISTIC /end REF_CHARACTERISTIC /begin REF_MEASUREMENT /end REF_MEASUREMENT /end GROUP
/begin GROUP CalRegn03Rt03GroupA.AssiHiFrqGainY.Ary2D "MICROSAR RTE" /begin SUB_GROUP /end SUB_GROUP /begin FUNCTION_LIST /end FUNCTION_LIST /begin REF_CHARACTERISTIC CalRegn03Rt03GroupA.AssiHiFrqGainY.Ary2D /end REF_CHARACTERISTIC /begin REF_MEASUREMENT /end REF_MEASUREMENT /end GROUP
/begin GROUP CalRegn03Rt03GroupA.AssiHiFrqTqX.Ary2D "MICROSAR RTE" /begin SUB_GROUP /end SUB_GROUP /begin FUNCTION_LIST /end FUNCTION_LIST /begin REF_CHARACTERISTIC CalRegn03Rt03GroupA.AssiHiFrqTqX.Ary2D /end REF_CHARACTERISTIC /begin REF_MEASUREMENT /end REF_MEASUREMENT /end GROUP
/begin GROUP CalRegn03Rt03GroupA.AssiMotTqWhlImbRejctnMinX.Ary2D "MICROSAR RTE" /begin SUB_GROUP /end SUB_GROUP /begin FUNCTION_LIST /end FUNCTION_LIST /begin REF_CHARACTERISTIC CalRegn03Rt03GroupA.AssiMotTqWhlImbRejctnMinX.Ary2D /end REF_CHARACTERISTIC /begin REF_MEASUREMENT /end REF_MEASUREMENT /end GROUP
/begin GROUP CalRegn03Rt03GroupA.AssiMotTqWhlImbRejctnMinY.Ary2D "MICROSAR RTE" /begin SUB_GROUP /end SUB_GROUP /begin FUNCTION_LIST /end FUNCTION_LIST /begin REF_CHARACTERISTIC CalRegn03Rt03GroupA.AssiMotTqWhlImbRejctnMinY.Ary2D /end REF_CHARACTERISTIC /begin REF_MEASUREMENT /end REF_MEASUREMENT /end GROUP
/begin GROUP CalRegn03Rt03GroupA.CalibrationPorts "MICROSAR RTE"
 /begin SUB_GROUP CalRegn03Rt03GroupA.AssiHiFrqGainY.Ary2D CalRegn03Rt03GroupA.AssiHiFrqTqX.Ary2D CalRegn03Rt03GroupA.AssiMotTqWhlImbRejctnMinX.Ary2D CalRegn03Rt03GroupA.AssiMotTqWhlImbRejctnMinY.Ary2D CalRegn03Rt03GroupA.DampgHydCoeff1ScaY.Ary1D CalRegn03Rt03GroupA.DampgHydCoeff2ScaY.Ary1D CalRegn03Rt03GroupA.DampgHydCoeff3ScaY.Ary1D CalRegn03Rt03GroupA.DampgHydCoeff4ScaY.Ary1D CalRegn03Rt03GroupA.DampgMotVelX.Ary2D CalRegn03Rt03GroupA.DampgMotVelY.Ary2D CalRegn03Rt03GroupA.HysCmpFricWhlImbRejctnBlndX.Ary1D CalRegn03Rt03GroupA.HysCmpFricWhlImbRejctnBlndY.Ary1D CalRegn03Rt03GroupA.HysCmpFricWhlImbRejctnOffY.Ary1D CalRegn03Rt03GroupA.HysCmpFricWhlImbRejctnOnY.Ary1D CalRegn03Rt03GroupA.InertiaCmpVelAssiBasdDampgCoeffX.Ary1D CalRegn03Rt03GroupA.InertiaCmpVelAssiBasdDampgRollgY.Ary1D CalRegn03Rt03GroupA.InertiaCmpVelAssiBasdDampgStatY.Ary1D CalRegn03Rt03GroupA.InertiaCmpVelDampgSpdBlndY.Ary1D CalRegn03Rt03GroupA.InertiaCmpVelNotchBlndY.Ary1D CalRegn03Rt03GroupA.RtnHwAgOffsCalcdX.Ary2D CalRegn03Rt03GroupA.RtnHwAgOffsCalcdY.Ary2D CalRegn03Rt03GroupA.RtnScaTqX.Ary2D CalRegn03Rt03GroupA.RtnScaTqY.Ary2D CalRegn03Rt03GroupA.RtnScaVelX.Ary2D CalRegn03Rt03GroupA.RtnScaVelY.Ary2D /end SUB_GROUP
 /begin FUNCTION_LIST /end FUNCTION_LIST
 /begin REF_CHARACTERISTIC /end REF_CHARACTERISTIC
 /begin REF_MEASUREMENT /end REF_MEASUREMENT
/end GROUP
/begin GROUP CalRegn03Rt03GroupA.DampgHydCoeff1ScaY.Ary1D "MICROSAR RTE" /begin SUB_GROUP /end SUB_GROUP /begin FUNCTION_LIST /end FUNCTION_LIST /begin REF_CHARACTERISTIC CalRegn03Rt03GroupA.DampgHydCoeff1ScaY.Ary1D /end REF_CHARACTERISTIC /begin REF_MEASUREMENT /end REF_MEASUREMENT /end GROUP
/begin GROUP CalRegn03Rt03GroupA.DampgHydCoeff2ScaY.Ary1D "MICROSAR RTE" /begin SUB_GROUP /end SUB_GROUP /begin FUNCTION_LIST /end FUNCTION_LIST /begin REF_CHARACTERISTIC CalRegn03Rt03GroupA.DampgHydCoeff2ScaY.Ary1D /end REF_CHARACTERISTIC /begin REF_MEASUREMENT /end REF_MEASUREMENT /end GROUP
/begin GROUP CalRegn03Rt03GroupA.DampgHydCoeff3ScaY.Ary1D "MICROSAR RTE" /begin SUB_GROUP /end SUB_GROUP /begin FUNCTION_LIST /end FUNCTION_LIST /begin REF_CHARACTERISTIC CalRegn03Rt03GroupA.DampgHydCoeff3ScaY.Ary1D /end REF_CHARACTERISTIC /begin REF_MEASUREMENT /end REF_MEASUREMENT /end GROUP
/begin GROUP CalRegn03Rt03GroupA.DampgHydCoeff4ScaY.Ary1D "MICROSAR RTE" /begin SUB_GROUP /end SUB_GROUP /begin FUNCTION_LIST /end FUNCTION_LIST /begin REF_CHARACTERISTIC CalRegn03Rt03GroupA.DampgHydCoeff4ScaY.Ary1D /end REF_CHARACTERISTIC /begin REF_MEASUREMENT /end REF_MEASUREMENT /end GROUP
/begin GROUP CalRegn03Rt03GroupA.DampgMotVelX.Ary2D "MICROSAR RTE" /begin SUB_GROUP /end SUB_GROUP /begin FUNCTION_LIST /end FUNCTION_LIST /begin REF_CHARACTERISTIC CalRegn03Rt03GroupA.DampgMotVelX.Ary2D /end REF_CHARACTERISTIC /begin REF_MEASUREMENT /end REF_MEASUREMENT /end GROUP
/begin GROUP CalRegn03Rt03GroupA.DampgMotVelY.Ary2D "MICROSAR RTE" /begin SUB_GROUP /end SUB_GROUP /begin FUNCTION_LIST /end FUNCTION_LIST /begin REF_CHARACTERISTIC CalRegn03Rt03GroupA.DampgMotVelY.Ary2D /end REF_CHARACTERISTIC /begin REF_MEASUREMENT /end REF_MEASUREMENT /end GROUP
/begin GROUP CalRegn03Rt03GroupA.HysCmpFricWhlImbRejctnBlndX.Ary1D "MICROSAR RTE" /begin SUB_GROUP /end SUB_GROUP /begin FUNCTION_LIST /end FUNCTION_LIST /begin REF_CHARACTERISTIC CalRegn03Rt03GroupA.HysCmpFricWhlImbRejctnBlndX.Ary1D /end REF_CHARACTERISTIC /begin REF_MEASUREMENT /end REF_MEASUREMENT /end GROUP
/begin GROUP CalRegn03Rt03GroupA.HysCmpFricWhlImbRejctnBlndY.Ary1D "MICROSAR RTE" /begin SUB_GROUP /end SUB_GROUP /begin FUNCTION_LIST /end FUNCTION_LIST /begin REF_CHARACTERISTIC CalRegn03Rt03GroupA.HysCmpFricWhlImbRejctnBlndY.Ary1D /end REF_CHARACTERISTIC /begin REF_MEASUREMENT /end REF_MEASUREMENT /end GROUP
/begin GROUP CalRegn03Rt03GroupA.HysCmpFricWhlImbRejctnOffY.Ary1D "MICROSAR RTE" /begin SUB_GROUP /end SUB_GROUP /begin FUNCTION_LIST /end FUNCTION_LIST /begin REF_CHARACTERISTIC CalRegn03Rt03GroupA.HysCmpFricWhlImbRejctnOffY.Ary1D /end REF_CHARACTERISTIC /begin REF_MEASUREMENT /end REF_MEASUREMENT /end GROUP
/begin GROUP CalRegn03Rt03GroupA.HysCmpFricWhlImbRejctnOnY.Ary1D "MICROSAR RTE" /begin SUB_GROUP /end SUB_GROUP /begin FUNCTION_LIST /end FUNCTION_LIST /begin REF_CHARACTERISTIC CalRegn03Rt03GroupA.HysCmpFricWhlImbRejctnOnY.Ary1D /end REF_CHARACTERISTIC /begin REF_MEASUREMENT /end REF_MEASUREMENT /end GROUP
/begin GROUP CalRegn03Rt03GroupA.InertiaCmpVelAssiBasdDampgCoeffX.Ary1D "MICROSAR RTE" /begin SUB_GROUP /end SUB_GROUP /begin FUNCTION_LIST /end FUNCTION_LIST /begin REF_CHARACTERISTIC CalRegn03Rt03GroupA.InertiaCmpVelAssiBasdDampgCoeffX.Ary1D /end REF_CHARACTERISTIC /begin REF_MEASUREMENT /end REF_MEASUREMENT /end GROUP
/begin GROUP CalRegn03Rt03GroupA.InertiaCmpVelAssiBasdDampgRollgY.Ary1D "MICROSAR RTE" /begin SUB_GROUP /end SUB_GROUP /begin FUNCTION_LIST /end FUNCTION_LIST /begin REF_CHARACTERISTIC CalRegn03Rt03GroupA.InertiaCmpVelAssiBasdDampgRollgY.Ary1D /end REF_CHARACTERISTIC /begin REF_MEASUREMENT /end REF_MEASUREMENT /end GROUP
/begin GROUP CalRegn03Rt03GroupA.InertiaCmpVelAssiBasdDampgStatY.Ary1D "MICROSAR RTE" /begin SUB_GROUP /end SUB_GROUP /begin FUNCTION_LIST /end FUNCTION_LIST /begin REF_CHARACTERISTIC CalRegn03Rt03GroupA.InertiaCmpVelAssiBasdDampgStatY.Ary1D /end REF_CHARACTERISTIC /begin REF_MEASUREMENT /end REF_MEASUREMENT /end GROUP
/begin GROUP CalRegn03Rt03GroupA.InertiaCmpVelDampgSpdBlndY.Ary1D "MICROSAR RTE" /begin SUB_GROUP /end SUB_GROUP /begin FUNCTION_LIST /end FUNCTION_LIST /begin REF_CHARACTERISTIC CalRegn03Rt03GroupA.InertiaCmpVelDampgSpdBlndY.Ary1D /end REF_CHARACTERISTIC /begin REF_MEASUREMENT /end REF_MEASUREMENT /end GROUP
/begin GROUP CalRegn03Rt03GroupA.InertiaCmpVelNotchBlndY.Ary1D "MICROSAR RTE" /begin SUB_GROUP /end SUB_GROUP /begin FUNCTION_LIST /end FUNCTION_LIST /begin REF_CHARACTERISTIC CalRegn03Rt03GroupA.InertiaCmpVelNotchBlndY.Ary1D /end REF_CHARACTERISTIC /begin REF_MEASUREMENT /end REF_MEASUREMENT /end GROUP
/begin GROUP CalRegn03Rt03GroupA.RtnHwAgOffsCalcdX.Ary2D "MICROSAR RTE" /begin SUB_GROUP /end SUB_GROUP /begin FUNCTION_LIST /end FUNCTION_LIST /begin REF_CHARACTERISTIC CalRegn03Rt03GroupA.RtnHwAgOffsCalcdX.Ary2D /end REF_CHARACTERISTIC /begin REF_MEASUREMENT /end REF_MEASUREMENT /end GROUP
/begin GROUP CalRegn03Rt03GroupA.RtnHwAgOffsCalcdY.Ary2D "MICROSAR RTE" /begin SUB_GROUP /end SUB_GROUP /begin FUNCTION_LIST /end FUNCTION_LIST /begin REF_CHARACTERISTIC CalRegn03Rt03GroupA.RtnHwAgOffsCalcdY.Ary2D /end REF_CHARACTERISTIC /begin REF_MEASUREMENT /end REF_MEASUREMENT /end GROUP
/begin GROUP CalRegn03Rt03GroupA.RtnScaTqX.Ary2D "MICROSAR RTE" /begin SUB_GROUP /end SUB_GROUP /begin FUNCTION_LIST /end FUNCTION_LIST /begin REF_CHARACTERISTIC CalRegn03Rt03GroupA.RtnScaTqX.Ary2D /end REF_CHARACTERISTIC /begin REF_MEASUREMENT /end REF_MEASUREMENT /end GROUP
/begin GROUP CalRegn03Rt03GroupA.RtnScaTqY.Ary2D "MICROSAR RTE" /begin SUB_GROUP /end SUB_GROUP /begin FUNCTION_LIST /end FUNCTION_LIST /begin REF_CHARACTERISTIC CalRegn03Rt03GroupA.RtnScaTqY.Ary2D /end REF_CHARACTERISTIC /begin REF_MEASUREMENT /end REF_MEASUREMENT /end GROUP
/begin GROUP CalRegn03Rt03GroupA.RtnScaVelX.Ary2D "MICROSAR RTE" /begin SUB_GROUP /end SUB_GROUP /begin FUNCTION_LIST /end FUNCTION_LIST /begin REF_CHARACTERISTIC CalRegn03Rt03GroupA.RtnScaVelX.Ary2D /end REF_CHARACTERISTIC /begin REF_MEASUREMENT /end REF_MEASUREMENT /end GROUP
/begin GROUP CalRegn03Rt03GroupA.RtnScaVelY.Ary2D "MICROSAR RTE" /begin SUB_GROUP /end SUB_GROUP /begin FUNCTION_LIST /end FUNCTION_LIST /begin REF_CHARACTERISTIC CalRegn03Rt03GroupA.RtnScaVelY.Ary2D /end REF_CHARACTERISTIC /begin REF_MEASUREMENT /end REF_MEASUREMENT /end GROUP
/begin GROUP CalRegn03Rt03GroupB "MICROSAR RTE" /begin SUB_GROUP CalRegn03Rt03GroupB.CalibrationPorts /end SUB_GROUP /begin FUNCTION_LIST /end FUNCTION_LIST /begin REF_CHARACTERISTIC /end REF_CHARACTERISTIC /begin REF_MEASUREMENT /end REF_MEASUREMENT /end GROUP
/begin GROUP CalRegn03Rt03GroupB.AssiHiFrqTqWhlImbRejctnTqX.Ary2D "MICROSAR RTE" /begin SUB_GROUP /end SUB_GROUP /begin FUNCTION_LIST /end FUNCTION_LIST /begin REF_CHARACTERISTIC CalRegn03Rt03GroupB.AssiHiFrqTqWhlImbRejctnTqX.Ary2D /end REF_CHARACTERISTIC /begin REF_MEASUREMENT /end REF_MEASUREMENT /end GROUP
/begin GROUP CalRegn03Rt03GroupB.AssiHiFrqWhlImbRejctnGainY.Ary2D "MICROSAR RTE" /begin SUB_GROUP /end SUB_GROUP /begin FUNCTION_LIST /end FUNCTION_LIST /begin REF_CHARACTERISTIC CalRegn03Rt03GroupB.AssiHiFrqWhlImbRejctnGainY.Ary2D /end REF_CHARACTERISTIC /begin REF_MEASUREMENT /end REF_MEASUREMENT /end GROUP
/begin GROUP CalRegn03Rt03GroupB.AssiHiFrqWhlImbRejtcnBlndX.Ary2D "MICROSAR RTE" /begin SUB_GROUP /end SUB_GROUP /begin FUNCTION_LIST /end FUNCTION_LIST /begin REF_CHARACTERISTIC CalRegn03Rt03GroupB.AssiHiFrqWhlImbRejtcnBlndX.Ary2D /end REF_CHARACTERISTIC /begin REF_MEASUREMENT /end REF_MEASUREMENT /end GROUP
/begin GROUP CalRegn03Rt03GroupB.AssiHiFrqWhlImbRejtcnBlndY.Ary2D "MICROSAR RTE" /begin SUB_GROUP /end SUB_GROUP /begin FUNCTION_LIST /end FUNCTION_LIST /begin REF_CHARACTERISTIC CalRegn03Rt03GroupB.AssiHiFrqWhlImbRejtcnBlndY.Ary2D /end REF_CHARACTERISTIC /begin REF_MEASUREMENT /end REF_MEASUREMENT /end GROUP
/begin GROUP CalRegn03Rt03GroupB.AssiMotTqWhlImbRejctnMaxX.Ary2D "MICROSAR RTE" /begin SUB_GROUP /end SUB_GROUP /begin FUNCTION_LIST /end FUNCTION_LIST /begin REF_CHARACTERISTIC CalRegn03Rt03GroupB.AssiMotTqWhlImbRejctnMaxX.Ary2D /end REF_CHARACTERISTIC /begin REF_MEASUREMENT /end REF_MEASUREMENT /end GROUP
/begin GROUP CalRegn03Rt03GroupB.AssiMotTqWhlImbRejctnMaxY.Ary2D "MICROSAR RTE" /begin SUB_GROUP /end SUB_GROUP /begin FUNCTION_LIST /end FUNCTION_LIST /begin REF_CHARACTERISTIC CalRegn03Rt03GroupB.AssiMotTqWhlImbRejctnMaxY.Ary2D /end REF_CHARACTERISTIC /begin REF_MEASUREMENT /end REF_MEASUREMENT /end GROUP
/begin GROUP CalRegn03Rt03GroupB.AssiWhlImbRejctnBlndScaX.Ary2D "MICROSAR RTE" /begin SUB_GROUP /end SUB_GROUP /begin FUNCTION_LIST /end FUNCTION_LIST /begin REF_CHARACTERISTIC CalRegn03Rt03GroupB.AssiWhlImbRejctnBlndScaX.Ary2D /end REF_CHARACTERISTIC /begin REF_MEASUREMENT /end REF_MEASUREMENT /end GROUP
/begin GROUP CalRegn03Rt03GroupB.AssiWhlImbRejctnBlndScaY.Ary2D "MICROSAR RTE" /begin SUB_GROUP /end SUB_GROUP /begin FUNCTION_LIST /end FUNCTION_LIST /begin REF_CHARACTERISTIC CalRegn03Rt03GroupB.AssiWhlImbRejctnBlndScaY.Ary2D /end REF_CHARACTERISTIC /begin REF_MEASUREMENT /end REF_MEASUREMENT /end GROUP
/begin GROUP CalRegn03Rt03GroupB.CalibrationPorts "MICROSAR RTE"
 /begin SUB_GROUP CalRegn03Rt03GroupB.AssiHiFrqTqWhlImbRejctnTqX.Ary2D CalRegn03Rt03GroupB.AssiHiFrqWhlImbRejctnGainY.Ary2D CalRegn03Rt03GroupB.AssiHiFrqWhlImbRejtcnBlndX.Ary2D CalRegn03Rt03GroupB.AssiHiFrqWhlImbRejtcnBlndY.Ary2D CalRegn03Rt03GroupB.AssiMotTqWhlImbRejctnMaxX.Ary2D CalRegn03Rt03GroupB.AssiMotTqWhlImbRejctnMaxY.Ary2D CalRegn03Rt03GroupB.AssiWhlImbRejctnBlndScaX.Ary2D CalRegn03Rt03GroupB.AssiWhlImbRejctnBlndScaY.Ary2D CalRegn03Rt03GroupB.EotProtnDampgVehSpdTbl.Ary1D CalRegn03Rt03GroupB.EotProtnEntrGainVehSpdTbl.Ary1D CalRegn03Rt03GroupB.EotProtnEntrGainX.Ary2D CalRegn03Rt03GroupB.EotProtnEntrGainY.Ary2D CalRegn03Rt03GroupB.EotProtnExitDampgY.Ary2D CalRegn03Rt03GroupB.EotProtnHwDegDampgX.Ary2D CalRegn03Rt03GroupB.EotProtnNormDampgY.Ary2D CalRegn03Rt03GroupB.InertiaCmpVelAssiBasdDampgRollgWhlImbRejctnOnY.Ary1D /end SUB_GROUP
 /begin FUNCTION_LIST /end FUNCTION_LIST
 /begin REF_CHARACTERISTIC /end REF_CHARACTERISTIC
 /begin REF_MEASUREMENT /end REF_MEASUREMENT
/end GROUP
/begin GROUP CalRegn03Rt03GroupB.EotProtnDampgVehSpdTbl.Ary1D "MICROSAR RTE" /begin SUB_GROUP /end SUB_GROUP /begin FUNCTION_LIST /end FUNCTION_LIST /begin REF_CHARACTERISTIC CalRegn03Rt03GroupB.EotProtnDampgVehSpdTbl.Ary1D /end REF_CHARACTERISTIC /begin REF_MEASUREMENT /end REF_MEASUREMENT /end GROUP
/begin GROUP CalRegn03Rt03GroupB.EotProtnEntrGainVehSpdTbl.Ary1D "MICROSAR RTE" /begin SUB_GROUP /end SUB_GROUP /begin FUNCTION_LIST /end FUNCTION_LIST /begin REF_CHARACTERISTIC CalRegn03Rt03GroupB.EotProtnEntrGainVehSpdTbl.Ary1D /end REF_CHARACTERISTIC /begin REF_MEASUREMENT /end REF_MEASUREMENT /end GROUP
/begin GROUP CalRegn03Rt03GroupB.EotProtnEntrGainX.Ary2D "MICROSAR RTE" /begin SUB_GROUP /end SUB_GROUP /begin FUNCTION_LIST /end FUNCTION_LIST /begin REF_CHARACTERISTIC CalRegn03Rt03GroupB.EotProtnEntrGainX.Ary2D /end REF_CHARACTERISTIC /begin REF_MEASUREMENT /end REF_MEASUREMENT /end GROUP
/begin GROUP CalRegn03Rt03GroupB.EotProtnEntrGainY.Ary2D "MICROSAR RTE" /begin SUB_GROUP /end SUB_GROUP /begin FUNCTION_LIST /end FUNCTION_LIST /begin REF_CHARACTERISTIC CalRegn03Rt03GroupB.EotProtnEntrGainY.Ary2D /end REF_CHARACTERISTIC /begin REF_MEASUREMENT /end REF_MEASUREMENT /end GROUP
/begin GROUP CalRegn03Rt03GroupB.EotProtnExitDampgY.Ary2D "MICROSAR RTE" /begin SUB_GROUP /end SUB_GROUP /begin FUNCTION_LIST /end FUNCTION_LIST /begin REF_CHARACTERISTIC CalRegn03Rt03GroupB.EotProtnExitDampgY.Ary2D /end REF_CHARACTERISTIC /begin REF_MEASUREMENT /end REF_MEASUREMENT /end GROUP
/begin GROUP CalRegn03Rt03GroupB.EotProtnHwDegDampgX.Ary2D "MICROSAR RTE" /begin SUB_GROUP /end SUB_GROUP /begin FUNCTION_LIST /end FUNCTION_LIST /begin REF_CHARACTERISTIC CalRegn03Rt03GroupB.EotProtnHwDegDampgX.Ary2D /end REF_CHARACTERISTIC /begin REF_MEASUREMENT /end REF_MEASUREMENT /end GROUP
/begin GROUP CalRegn03Rt03GroupB.EotProtnNormDampgY.Ary2D "MICROSAR RTE" /begin SUB_GROUP /end SUB_GROUP /begin FUNCTION_LIST /end FUNCTION_LIST /begin REF_CHARACTERISTIC CalRegn03Rt03GroupB.EotProtnNormDampgY.Ary2D /end REF_CHARACTERISTIC /begin REF_MEASUREMENT /end REF_MEASUREMENT /end GROUP
/begin GROUP CalRegn03Rt03GroupB.InertiaCmpVelAssiBasdDampgRollgWhlImbRejctnOnY.Ary1D "MICROSAR RTE" /begin SUB_GROUP /end SUB_GROUP /begin FUNCTION_LIST /end FUNCTION_LIST
 /begin REF_CHARACTERISTIC CalRegn03Rt03GroupB.InertiaCmpVelAssiBasdDampgRollgWhlImbRejctnOnY.Ary1D /end REF_CHARACTERISTIC
 /begin REF_MEASUREMENT /end REF_MEASUREMENT
/end GROUP
/begin GROUP CalRegn03Rt04 "MICROSAR RTE" /begin SUB_GROUP CalRegn03Rt04.CalibrationPorts /end SUB_GROUP /begin FUNCTION_LIST /end FUNCTION_LIST /begin REF_CHARACTERISTIC /end REF_CHARACTERISTIC /begin REF_MEASUREMENT /end REF_MEASUREMENT /end GROUP
/begin GROUP CalRegn03Rt04.CalibrationPorts "MICROSAR RTE"
 /begin SUB_GROUP CalRegn03Rt04.InertiaCmpVelDampgFilFrq.Ary1D CalRegn03Rt04.InertiaCmpVelDampgFilFrqWhlImbRejctnOn.Ary1D /end SUB_GROUP
 /begin FUNCTION_LIST /end FUNCTION_LIST
 /begin REF_CHARACTERISTIC /end REF_CHARACTERISTIC
 /begin REF_MEASUREMENT /end REF_MEASUREMENT
/end GROUP
/begin GROUP CalRegn03Rt04.InertiaCmpVelDampgFilFrq.Ary1D "MICROSAR RTE" /begin SUB_GROUP /end SUB_GROUP /begin FUNCTION_LIST /end FUNCTION_LIST /begin REF_CHARACTERISTIC CalRegn03Rt04.InertiaCmpVelDampgFilFrq.Ary1D /end REF_CHARACTERISTIC /begin REF_MEASUREMENT /end REF_MEASUREMENT /end GROUP
/begin GROUP CalRegn03Rt04.InertiaCmpVelDampgFilFrqWhlImbRejctnOn.Ary1D "MICROSAR RTE" /begin SUB_GROUP /end SUB_GROUP /begin FUNCTION_LIST /end FUNCTION_LIST /begin REF_CHARACTERISTIC CalRegn03Rt04.InertiaCmpVelDampgFilFrqWhlImbRejctnOn.Ary1D /end REF_CHARACTERISTIC /begin REF_MEASUREMENT /end REF_MEASUREMENT /end GROUP
/begin GROUP CalRegn03Rt04GroupA "MICROSAR RTE" /begin SUB_GROUP CalRegn03Rt04GroupA.CalibrationPorts /end SUB_GROUP /begin FUNCTION_LIST /end FUNCTION_LIST /begin REF_CHARACTERISTIC /end REF_CHARACTERISTIC /begin REF_MEASUREMENT /end REF_MEASUREMENT /end GROUP
/begin GROUP CalRegn03Rt04GroupA.AssiHiFrqGainY.Ary2D "MICROSAR RTE" /begin SUB_GROUP /end SUB_GROUP /begin FUNCTION_LIST /end FUNCTION_LIST /begin REF_CHARACTERISTIC CalRegn03Rt04GroupA.AssiHiFrqGainY.Ary2D /end REF_CHARACTERISTIC /begin REF_MEASUREMENT /end REF_MEASUREMENT /end GROUP
/begin GROUP CalRegn03Rt04GroupA.AssiHiFrqTqX.Ary2D "MICROSAR RTE" /begin SUB_GROUP /end SUB_GROUP /begin FUNCTION_LIST /end FUNCTION_LIST /begin REF_CHARACTERISTIC CalRegn03Rt04GroupA.AssiHiFrqTqX.Ary2D /end REF_CHARACTERISTIC /begin REF_MEASUREMENT /end REF_MEASUREMENT /end GROUP
/begin GROUP CalRegn03Rt04GroupA.AssiMotTqWhlImbRejctnMinX.Ary2D "MICROSAR RTE" /begin SUB_GROUP /end SUB_GROUP /begin FUNCTION_LIST /end FUNCTION_LIST /begin REF_CHARACTERISTIC CalRegn03Rt04GroupA.AssiMotTqWhlImbRejctnMinX.Ary2D /end REF_CHARACTERISTIC /begin REF_MEASUREMENT /end REF_MEASUREMENT /end GROUP
/begin GROUP CalRegn03Rt04GroupA.AssiMotTqWhlImbRejctnMinY.Ary2D "MICROSAR RTE" /begin SUB_GROUP /end SUB_GROUP /begin FUNCTION_LIST /end FUNCTION_LIST /begin REF_CHARACTERISTIC CalRegn03Rt04GroupA.AssiMotTqWhlImbRejctnMinY.Ary2D /end REF_CHARACTERISTIC /begin REF_MEASUREMENT /end REF_MEASUREMENT /end GROUP
/begin GROUP CalRegn03Rt04GroupA.CalibrationPorts "MICROSAR RTE"
 /begin SUB_GROUP CalRegn03Rt04GroupA.AssiHiFrqGainY.Ary2D CalRegn03Rt04GroupA.AssiHiFrqTqX.Ary2D CalRegn03Rt04GroupA.AssiMotTqWhlImbRejctnMinX.Ary2D CalRegn03Rt04GroupA.AssiMotTqWhlImbRejctnMinY.Ary2D CalRegn03Rt04GroupA.DampgHydCoeff1ScaY.Ary1D CalRegn03Rt04GroupA.DampgHydCoeff2ScaY.Ary1D CalRegn03Rt04GroupA.DampgHydCoeff3ScaY.Ary1D CalRegn03Rt04GroupA.DampgHydCoeff4ScaY.Ary1D CalRegn03Rt04GroupA.DampgMotVelX.Ary2D CalRegn03Rt04GroupA.DampgMotVelY.Ary2D CalRegn03Rt04GroupA.HysCmpFricWhlImbRejctnBlndX.Ary1D CalRegn03Rt04GroupA.HysCmpFricWhlImbRejctnBlndY.Ary1D CalRegn03Rt04GroupA.HysCmpFricWhlImbRejctnOffY.Ary1D CalRegn03Rt04GroupA.HysCmpFricWhlImbRejctnOnY.Ary1D CalRegn03Rt04GroupA.InertiaCmpVelAssiBasdDampgCoeffX.Ary1D CalRegn03Rt04GroupA.InertiaCmpVelAssiBasdDampgRollgY.Ary1D CalRegn03Rt04GroupA.InertiaCmpVelAssiBasdDampgStatY.Ary1D CalRegn03Rt04GroupA.InertiaCmpVelDampgSpdBlndY.Ary1D CalRegn03Rt04GroupA.InertiaCmpVelNotchBlndY.Ary1D CalRegn03Rt04GroupA.RtnHwAgOffsCalcdX.Ary2D CalRegn03Rt04GroupA.RtnHwAgOffsCalcdY.Ary2D CalRegn03Rt04GroupA.RtnScaTqX.Ary2D CalRegn03Rt04GroupA.RtnScaTqY.Ary2D CalRegn03Rt04GroupA.RtnScaVelX.Ary2D CalRegn03Rt04GroupA.RtnScaVelY.Ary2D /end SUB_GROUP
 /begin FUNCTION_LIST /end FUNCTION_LIST
 /begin REF_CHARACTERISTIC /end REF_CHARACTERISTIC
 /begin REF_MEASUREMENT /end REF_MEASUREMENT
/end GROUP
/begin GROUP CalRegn03Rt04GroupA.DampgHydCoeff1ScaY.Ary1D "MICROSAR RTE" /begin SUB_GROUP /end SUB_GROUP /begin FUNCTION_LIST /end FUNCTION_LIST /begin REF_CHARACTERISTIC CalRegn03Rt04GroupA.DampgHydCoeff1ScaY.Ary1D /end REF_CHARACTERISTIC /begin REF_MEASUREMENT /end REF_MEASUREMENT /end GROUP
/begin GROUP CalRegn03Rt04GroupA.DampgHydCoeff2ScaY.Ary1D "MICROSAR RTE" /begin SUB_GROUP /end SUB_GROUP /begin FUNCTION_LIST /end FUNCTION_LIST /begin REF_CHARACTERISTIC CalRegn03Rt04GroupA.DampgHydCoeff2ScaY.Ary1D /end REF_CHARACTERISTIC /begin REF_MEASUREMENT /end REF_MEASUREMENT /end GROUP
/begin GROUP CalRegn03Rt04GroupA.DampgHydCoeff3ScaY.Ary1D "MICROSAR RTE" /begin SUB_GROUP /end SUB_GROUP /begin FUNCTION_LIST /end FUNCTION_LIST /begin REF_CHARACTERISTIC CalRegn03Rt04GroupA.DampgHydCoeff3ScaY.Ary1D /end REF_CHARACTERISTIC /begin REF_MEASUREMENT /end REF_MEASUREMENT /end GROUP
/begin GROUP CalRegn03Rt04GroupA.DampgHydCoeff4ScaY.Ary1D "MICROSAR RTE" /begin SUB_GROUP /end SUB_GROUP /begin FUNCTION_LIST /end FUNCTION_LIST /begin REF_CHARACTERISTIC CalRegn03Rt04GroupA.DampgHydCoeff4ScaY.Ary1D /end REF_CHARACTERISTIC /begin REF_MEASUREMENT /end REF_MEASUREMENT /end GROUP
/begin GROUP CalRegn03Rt04GroupA.DampgMotVelX.Ary2D "MICROSAR RTE" /begin SUB_GROUP /end SUB_GROUP /begin FUNCTION_LIST /end FUNCTION_LIST /begin REF_CHARACTERISTIC CalRegn03Rt04GroupA.DampgMotVelX.Ary2D /end REF_CHARACTERISTIC /begin REF_MEASUREMENT /end REF_MEASUREMENT /end GROUP
/begin GROUP CalRegn03Rt04GroupA.DampgMotVelY.Ary2D "MICROSAR RTE" /begin SUB_GROUP /end SUB_GROUP /begin FUNCTION_LIST /end FUNCTION_LIST /begin REF_CHARACTERISTIC CalRegn03Rt04GroupA.DampgMotVelY.Ary2D /end REF_CHARACTERISTIC /begin REF_MEASUREMENT /end REF_MEASUREMENT /end GROUP
/begin GROUP CalRegn03Rt04GroupA.HysCmpFricWhlImbRejctnBlndX.Ary1D "MICROSAR RTE" /begin SUB_GROUP /end SUB_GROUP /begin FUNCTION_LIST /end FUNCTION_LIST /begin REF_CHARACTERISTIC CalRegn03Rt04GroupA.HysCmpFricWhlImbRejctnBlndX.Ary1D /end REF_CHARACTERISTIC /begin REF_MEASUREMENT /end REF_MEASUREMENT /end GROUP
/begin GROUP CalRegn03Rt04GroupA.HysCmpFricWhlImbRejctnBlndY.Ary1D "MICROSAR RTE" /begin SUB_GROUP /end SUB_GROUP /begin FUNCTION_LIST /end FUNCTION_LIST /begin REF_CHARACTERISTIC CalRegn03Rt04GroupA.HysCmpFricWhlImbRejctnBlndY.Ary1D /end REF_CHARACTERISTIC /begin REF_MEASUREMENT /end REF_MEASUREMENT /end GROUP
/begin GROUP CalRegn03Rt04GroupA.HysCmpFricWhlImbRejctnOffY.Ary1D "MICROSAR RTE" /begin SUB_GROUP /end SUB_GROUP /begin FUNCTION_LIST /end FUNCTION_LIST /begin REF_CHARACTERISTIC CalRegn03Rt04GroupA.HysCmpFricWhlImbRejctnOffY.Ary1D /end REF_CHARACTERISTIC /begin REF_MEASUREMENT /end REF_MEASUREMENT /end GROUP
/begin GROUP CalRegn03Rt04GroupA.HysCmpFricWhlImbRejctnOnY.Ary1D "MICROSAR RTE" /begin SUB_GROUP /end SUB_GROUP /begin FUNCTION_LIST /end FUNCTION_LIST /begin REF_CHARACTERISTIC CalRegn03Rt04GroupA.HysCmpFricWhlImbRejctnOnY.Ary1D /end REF_CHARACTERISTIC /begin REF_MEASUREMENT /end REF_MEASUREMENT /end GROUP
/begin GROUP CalRegn03Rt04GroupA.InertiaCmpVelAssiBasdDampgCoeffX.Ary1D "MICROSAR RTE" /begin SUB_GROUP /end SUB_GROUP /begin FUNCTION_LIST /end FUNCTION_LIST /begin REF_CHARACTERISTIC CalRegn03Rt04GroupA.InertiaCmpVelAssiBasdDampgCoeffX.Ary1D /end REF_CHARACTERISTIC /begin REF_MEASUREMENT /end REF_MEASUREMENT /end GROUP
/begin GROUP CalRegn03Rt04GroupA.InertiaCmpVelAssiBasdDampgRollgY.Ary1D "MICROSAR RTE" /begin SUB_GROUP /end SUB_GROUP /begin FUNCTION_LIST /end FUNCTION_LIST /begin REF_CHARACTERISTIC CalRegn03Rt04GroupA.InertiaCmpVelAssiBasdDampgRollgY.Ary1D /end REF_CHARACTERISTIC /begin REF_MEASUREMENT /end REF_MEASUREMENT /end GROUP
/begin GROUP CalRegn03Rt04GroupA.InertiaCmpVelAssiBasdDampgStatY.Ary1D "MICROSAR RTE" /begin SUB_GROUP /end SUB_GROUP /begin FUNCTION_LIST /end FUNCTION_LIST /begin REF_CHARACTERISTIC CalRegn03Rt04GroupA.InertiaCmpVelAssiBasdDampgStatY.Ary1D /end REF_CHARACTERISTIC /begin REF_MEASUREMENT /end REF_MEASUREMENT /end GROUP
/begin GROUP CalRegn03Rt04GroupA.InertiaCmpVelDampgSpdBlndY.Ary1D "MICROSAR RTE" /begin SUB_GROUP /end SUB_GROUP /begin FUNCTION_LIST /end FUNCTION_LIST /begin REF_CHARACTERISTIC CalRegn03Rt04GroupA.InertiaCmpVelDampgSpdBlndY.Ary1D /end REF_CHARACTERISTIC /begin REF_MEASUREMENT /end REF_MEASUREMENT /end GROUP
/begin GROUP CalRegn03Rt04GroupA.InertiaCmpVelNotchBlndY.Ary1D "MICROSAR RTE" /begin SUB_GROUP /end SUB_GROUP /begin FUNCTION_LIST /end FUNCTION_LIST /begin REF_CHARACTERISTIC CalRegn03Rt04GroupA.InertiaCmpVelNotchBlndY.Ary1D /end REF_CHARACTERISTIC /begin REF_MEASUREMENT /end REF_MEASUREMENT /end GROUP
/begin GROUP CalRegn03Rt04GroupA.RtnHwAgOffsCalcdX.Ary2D "MICROSAR RTE" /begin SUB_GROUP /end SUB_GROUP /begin FUNCTION_LIST /end FUNCTION_LIST /begin REF_CHARACTERISTIC CalRegn03Rt04GroupA.RtnHwAgOffsCalcdX.Ary2D /end REF_CHARACTERISTIC /begin REF_MEASUREMENT /end REF_MEASUREMENT /end GROUP
/begin GROUP CalRegn03Rt04GroupA.RtnHwAgOffsCalcdY.Ary2D "MICROSAR RTE" /begin SUB_GROUP /end SUB_GROUP /begin FUNCTION_LIST /end FUNCTION_LIST /begin REF_CHARACTERISTIC CalRegn03Rt04GroupA.RtnHwAgOffsCalcdY.Ary2D /end REF_CHARACTERISTIC /begin REF_MEASUREMENT /end REF_MEASUREMENT /end GROUP
/begin GROUP CalRegn03Rt04GroupA.RtnScaTqX.Ary2D "MICROSAR RTE" /begin SUB_GROUP /end SUB_GROUP /begin FUNCTION_LIST /end FUNCTION_LIST /begin REF_CHARACTERISTIC CalRegn03Rt04GroupA.RtnScaTqX.Ary2D /end REF_CHARACTERISTIC /begin REF_MEASUREMENT /end REF_MEASUREMENT /end GROUP
/begin GROUP CalRegn03Rt04GroupA.RtnScaTqY.Ary2D "MICROSAR RTE" /begin SUB_GROUP /end SUB_GROUP /begin FUNCTION_LIST /end FUNCTION_LIST /begin REF_CHARACTERISTIC CalRegn03Rt04GroupA.RtnScaTqY.Ary2D /end REF_CHARACTERISTIC /begin REF_MEASUREMENT /end REF_MEASUREMENT /end GROUP
/begin GROUP CalRegn03Rt04GroupA.RtnScaVelX.Ary2D "MICROSAR RTE" /begin SUB_GROUP /end SUB_GROUP /begin FUNCTION_LIST /end FUNCTION_LIST /begin REF_CHARACTERISTIC CalRegn03Rt04GroupA.RtnScaVelX.Ary2D /end REF_CHARACTERISTIC /begin REF_MEASUREMENT /end REF_MEASUREMENT /end GROUP
/begin GROUP CalRegn03Rt04GroupA.RtnScaVelY.Ary2D "MICROSAR RTE" /begin SUB_GROUP /end SUB_GROUP /begin FUNCTION_LIST /end FUNCTION_LIST /begin REF_CHARACTERISTIC CalRegn03Rt04GroupA.RtnScaVelY.Ary2D /end REF_CHARACTERISTIC /begin REF_MEASUREMENT /end REF_MEASUREMENT /end GROUP
/begin GROUP CalRegn03Rt04GroupB "MICROSAR RTE" /begin SUB_GROUP CalRegn03Rt04GroupB.CalibrationPorts /end SUB_GROUP /begin FUNCTION_LIST /end FUNCTION_LIST /begin REF_CHARACTERISTIC /end REF_CHARACTERISTIC /begin REF_MEASUREMENT /end REF_MEASUREMENT /end GROUP
/begin GROUP CalRegn03Rt04GroupB.AssiHiFrqTqWhlImbRejctnTqX.Ary2D "MICROSAR RTE" /begin SUB_GROUP /end SUB_GROUP /begin FUNCTION_LIST /end FUNCTION_LIST /begin REF_CHARACTERISTIC CalRegn03Rt04GroupB.AssiHiFrqTqWhlImbRejctnTqX.Ary2D /end REF_CHARACTERISTIC /begin REF_MEASUREMENT /end REF_MEASUREMENT /end GROUP
/begin GROUP CalRegn03Rt04GroupB.AssiHiFrqWhlImbRejctnGainY.Ary2D "MICROSAR RTE" /begin SUB_GROUP /end SUB_GROUP /begin FUNCTION_LIST /end FUNCTION_LIST /begin REF_CHARACTERISTIC CalRegn03Rt04GroupB.AssiHiFrqWhlImbRejctnGainY.Ary2D /end REF_CHARACTERISTIC /begin REF_MEASUREMENT /end REF_MEASUREMENT /end GROUP
/begin GROUP CalRegn03Rt04GroupB.AssiHiFrqWhlImbRejtcnBlndX.Ary2D "MICROSAR RTE" /begin SUB_GROUP /end SUB_GROUP /begin FUNCTION_LIST /end FUNCTION_LIST /begin REF_CHARACTERISTIC CalRegn03Rt04GroupB.AssiHiFrqWhlImbRejtcnBlndX.Ary2D /end REF_CHARACTERISTIC /begin REF_MEASUREMENT /end REF_MEASUREMENT /end GROUP
/begin GROUP CalRegn03Rt04GroupB.AssiHiFrqWhlImbRejtcnBlndY.Ary2D "MICROSAR RTE" /begin SUB_GROUP /end SUB_GROUP /begin FUNCTION_LIST /end FUNCTION_LIST /begin REF_CHARACTERISTIC CalRegn03Rt04GroupB.AssiHiFrqWhlImbRejtcnBlndY.Ary2D /end REF_CHARACTERISTIC /begin REF_MEASUREMENT /end REF_MEASUREMENT /end GROUP
/begin GROUP CalRegn03Rt04GroupB.AssiMotTqWhlImbRejctnMaxX.Ary2D "MICROSAR RTE" /begin SUB_GROUP /end SUB_GROUP /begin FUNCTION_LIST /end FUNCTION_LIST /begin REF_CHARACTERISTIC CalRegn03Rt04GroupB.AssiMotTqWhlImbRejctnMaxX.Ary2D /end REF_CHARACTERISTIC /begin REF_MEASUREMENT /end REF_MEASUREMENT /end GROUP
/begin GROUP CalRegn03Rt04GroupB.AssiMotTqWhlImbRejctnMaxY.Ary2D "MICROSAR RTE" /begin SUB_GROUP /end SUB_GROUP /begin FUNCTION_LIST /end FUNCTION_LIST /begin REF_CHARACTERISTIC CalRegn03Rt04GroupB.AssiMotTqWhlImbRejctnMaxY.Ary2D /end REF_CHARACTERISTIC /begin REF_MEASUREMENT /end REF_MEASUREMENT /end GROUP
/begin GROUP CalRegn03Rt04GroupB.AssiWhlImbRejctnBlndScaX.Ary2D "MICROSAR RTE" /begin SUB_GROUP /end SUB_GROUP /begin FUNCTION_LIST /end FUNCTION_LIST /begin REF_CHARACTERISTIC CalRegn03Rt04GroupB.AssiWhlImbRejctnBlndScaX.Ary2D /end REF_CHARACTERISTIC /begin REF_MEASUREMENT /end REF_MEASUREMENT /end GROUP
/begin GROUP CalRegn03Rt04GroupB.AssiWhlImbRejctnBlndScaY.Ary2D "MICROSAR RTE" /begin SUB_GROUP /end SUB_GROUP /begin FUNCTION_LIST /end FUNCTION_LIST /begin REF_CHARACTERISTIC CalRegn03Rt04GroupB.AssiWhlImbRejctnBlndScaY.Ary2D /end REF_CHARACTERISTIC /begin REF_MEASUREMENT /end REF_MEASUREMENT /end GROUP
/begin GROUP CalRegn03Rt04GroupB.CalibrationPorts "MICROSAR RTE"
 /begin SUB_GROUP CalRegn03Rt04GroupB.AssiHiFrqTqWhlImbRejctnTqX.Ary2D CalRegn03Rt04GroupB.AssiHiFrqWhlImbRejctnGainY.Ary2D CalRegn03Rt04GroupB.AssiHiFrqWhlImbRejtcnBlndX.Ary2D CalRegn03Rt04GroupB.AssiHiFrqWhlImbRejtcnBlndY.Ary2D CalRegn03Rt04GroupB.AssiMotTqWhlImbRejctnMaxX.Ary2D CalRegn03Rt04GroupB.AssiMotTqWhlImbRejctnMaxY.Ary2D CalRegn03Rt04GroupB.AssiWhlImbRejctnBlndScaX.Ary2D CalRegn03Rt04GroupB.AssiWhlImbRejctnBlndScaY.Ary2D CalRegn03Rt04GroupB.EotProtnDampgVehSpdTbl.Ary1D CalRegn03Rt04GroupB.EotProtnEntrGainVehSpdTbl.Ary1D CalRegn03Rt04GroupB.EotProtnEntrGainX.Ary2D CalRegn03Rt04GroupB.EotProtnEntrGainY.Ary2D CalRegn03Rt04GroupB.EotProtnExitDampgY.Ary2D CalRegn03Rt04GroupB.EotProtnHwDegDampgX.Ary2D CalRegn03Rt04GroupB.EotProtnNormDampgY.Ary2D CalRegn03Rt04GroupB.InertiaCmpVelAssiBasdDampgRollgWhlImbRejctnOnY.Ary1D /end SUB_GROUP
 /begin FUNCTION_LIST /end FUNCTION_LIST
 /begin REF_CHARACTERISTIC /end REF_CHARACTERISTIC
 /begin REF_MEASUREMENT /end REF_MEASUREMENT
/end GROUP
/begin GROUP CalRegn03Rt04GroupB.EotProtnDampgVehSpdTbl.Ary1D "MICROSAR RTE" /begin SUB_GROUP /end SUB_GROUP /begin FUNCTION_LIST /end FUNCTION_LIST /begin REF_CHARACTERISTIC CalRegn03Rt04GroupB.EotProtnDampgVehSpdTbl.Ary1D /end REF_CHARACTERISTIC /begin REF_MEASUREMENT /end REF_MEASUREMENT /end GROUP
/begin GROUP CalRegn03Rt04GroupB.EotProtnEntrGainVehSpdTbl.Ary1D "MICROSAR RTE" /begin SUB_GROUP /end SUB_GROUP /begin FUNCTION_LIST /end FUNCTION_LIST /begin REF_CHARACTERISTIC CalRegn03Rt04GroupB.EotProtnEntrGainVehSpdTbl.Ary1D /end REF_CHARACTERISTIC /begin REF_MEASUREMENT /end REF_MEASUREMENT /end GROUP
/begin GROUP CalRegn03Rt04GroupB.EotProtnEntrGainX.Ary2D "MICROSAR RTE" /begin SUB_GROUP /end SUB_GROUP /begin FUNCTION_LIST /end FUNCTION_LIST /begin REF_CHARACTERISTIC CalRegn03Rt04GroupB.EotProtnEntrGainX.Ary2D /end REF_CHARACTERISTIC /begin REF_MEASUREMENT /end REF_MEASUREMENT /end GROUP
/begin GROUP CalRegn03Rt04GroupB.EotProtnEntrGainY.Ary2D "MICROSAR RTE" /begin SUB_GROUP /end SUB_GROUP /begin FUNCTION_LIST /end FUNCTION_LIST /begin REF_CHARACTERISTIC CalRegn03Rt04GroupB.EotProtnEntrGainY.Ary2D /end REF_CHARACTERISTIC /begin REF_MEASUREMENT /end REF_MEASUREMENT /end GROUP
/begin GROUP CalRegn03Rt04GroupB.EotProtnExitDampgY.Ary2D "MICROSAR RTE" /begin SUB_GROUP /end SUB_GROUP /begin FUNCTION_LIST /end FUNCTION_LIST /begin REF_CHARACTERISTIC CalRegn03Rt04GroupB.EotProtnExitDampgY.Ary2D /end REF_CHARACTERISTIC /begin REF_MEASUREMENT /end REF_MEASUREMENT /end GROUP
/begin GROUP CalRegn03Rt04GroupB.EotProtnHwDegDampgX.Ary2D "MICROSAR RTE" /begin SUB_GROUP /end SUB_GROUP /begin FUNCTION_LIST /end FUNCTION_LIST /begin REF_CHARACTERISTIC CalRegn03Rt04GroupB.EotProtnHwDegDampgX.Ary2D /end REF_CHARACTERISTIC /begin REF_MEASUREMENT /end REF_MEASUREMENT /end GROUP
/begin GROUP CalRegn03Rt04GroupB.EotProtnNormDampgY.Ary2D "MICROSAR RTE" /begin SUB_GROUP /end SUB_GROUP /begin FUNCTION_LIST /end FUNCTION_LIST /begin REF_CHARACTERISTIC CalRegn03Rt04GroupB.EotProtnNormDampgY.Ary2D /end REF_CHARACTERISTIC /begin REF_MEASUREMENT /end REF_MEASUREMENT /end GROUP
/begin GROUP CalRegn03Rt04GroupB.InertiaCmpVelAssiBasdDampgRollgWhlImbRejctnOnY.Ary1D "MICROSAR RTE" /begin SUB_GROUP /end SUB_GROUP /begin FUNCTION_LIST /end FUNCTION_LIST
 /begin REF_CHARACTERISTIC CalRegn03Rt04GroupB.InertiaCmpVelAssiBasdDampgRollgWhlImbRejctnOnY.Ary1D /end REF_CHARACTERISTIC
 /begin REF_MEASUREMENT /end REF_MEASUREMENT
/end GROUP
/begin GROUP CmnMfgSrv "MICROSAR RTE"
 /begin SUB_GROUP CmnMfgSrv.CalibrationParameters CmnMfgSrv.CalibrationPorts CmnMfgSrv.PerInstanceMemories CmnMfgSrv.ReceiverPorts CmnMfgSrv.SenderPorts /end SUB_GROUP
 /begin FUNCTION_LIST /end FUNCTION_LIST
 /begin REF_CHARACTERISTIC /end REF_CHARACTERISTIC
 /begin REF_MEASUREMENT /end REF_MEASUREMENT
/end GROUP
/begin GROUP CmnMfgSrv.AssiLnrGain.Val "MICROSAR RTE" /begin SUB_GROUP /end SUB_GROUP /begin FUNCTION_LIST /end FUNCTION_LIST /begin REF_CHARACTERISTIC /end REF_CHARACTERISTIC /begin REF_MEASUREMENT CmnMfgSrv.AssiLnrGain.Val /end REF_MEASUREMENT /end GROUP
/begin GROUP CmnMfgSrv.AssiLnrGainEna.Logl "MICROSAR RTE" /begin SUB_GROUP /end SUB_GROUP /begin FUNCTION_LIST /end FUNCTION_LIST /begin REF_CHARACTERISTIC /end REF_CHARACTERISTIC /begin REF_MEASUREMENT CmnMfgSrv.AssiLnrGainEna.Logl /end REF_MEASUREMENT /end GROUP
/begin GROUP CmnMfgSrv.AssiMechTEstimnDi.Logl "MICROSAR RTE" /begin SUB_GROUP /end SUB_GROUP /begin FUNCTION_LIST /end FUNCTION_LIST /begin REF_CHARACTERISTIC /end REF_CHARACTERISTIC /begin REF_MEASUREMENT CmnMfgSrv.AssiMechTEstimnDi.Logl /end REF_MEASUREMENT /end GROUP
/begin GROUP CmnMfgSrv.CalibrationParameters "MICROSAR RTE"
 /begin SUB_GROUP CmnMfgSrv.NvmIgnCntr_DefaultValue CmnMfgSrv.NvmMfgEnaCntr_DefaultValue CmnMfgSrv.NvmNxtrSeedKey_DefaultValue CmnMfgSrv.SeedKeyDft /end SUB_GROUP
 /begin FUNCTION_LIST /end FUNCTION_LIST
 /begin REF_CHARACTERISTIC /end REF_CHARACTERISTIC
 /begin REF_MEASUREMENT /end REF_MEASUREMENT
/end GROUP
/begin GROUP CmnMfgSrv.CalibrationPorts "MICROSAR RTE"
 /begin SUB_GROUP CmnMfgSrv.CmnMfgSrvSecuAcsAtmptTiOut.Val CmnMfgSrv.CmnMfgSrvSecuAcsMaxNrAtmpt.Val /end SUB_GROUP
 /begin FUNCTION_LIST /end FUNCTION_LIST
 /begin REF_CHARACTERISTIC /end REF_CHARACTERISTIC
 /begin REF_MEASUREMENT /end REF_MEASUREMENT
/end GROUP
/begin GROUP CmnMfgSrv.CcaHwPartNr "MICROSAR RTE" /begin SUB_GROUP /end SUB_GROUP /begin FUNCTION_LIST /end FUNCTION_LIST /begin REF_CHARACTERISTIC /end REF_CHARACTERISTIC /begin REF_MEASUREMENT CmnMfgSrv.CcaHwPartNr /end REF_MEASUREMENT /end GROUP
/begin GROUP CmnMfgSrv.CcaSerlNr "MICROSAR RTE" /begin SUB_GROUP /end SUB_GROUP /begin FUNCTION_LIST /end FUNCTION_LIST /begin REF_CHARACTERISTIC /end REF_CHARACTERISTIC /begin REF_MEASUREMENT CmnMfgSrv.CcaSerlNr /end REF_MEASUREMENT /end GROUP
/begin GROUP CmnMfgSrv.CmnMfgSrvSecuAcsAtmptTiOut.Val "MICROSAR RTE" /begin SUB_GROUP /end SUB_GROUP /begin FUNCTION_LIST /end FUNCTION_LIST /begin REF_CHARACTERISTIC CmnMfgSrv.CmnMfgSrvSecuAcsAtmptTiOut.Val /end REF_CHARACTERISTIC /begin REF_MEASUREMENT /end REF_MEASUREMENT /end GROUP
/begin GROUP CmnMfgSrv.CmnMfgSrvSecuAcsMaxNrAtmpt.Val "MICROSAR RTE" /begin SUB_GROUP /end SUB_GROUP /begin FUNCTION_LIST /end FUNCTION_LIST /begin REF_CHARACTERISTIC CmnMfgSrv.CmnMfgSrvSecuAcsMaxNrAtmpt.Val /end REF_CHARACTERISTIC /begin REF_MEASUREMENT /end REF_MEASUREMENT /end GROUP
/begin GROUP CmnMfgSrv.DampgCmdBasDi.Logl "MICROSAR RTE" /begin SUB_GROUP /end SUB_GROUP /begin FUNCTION_LIST /end FUNCTION_LIST /begin REF_CHARACTERISTIC /end REF_CHARACTERISTIC /begin REF_MEASUREMENT CmnMfgSrv.DampgCmdBasDi.Logl /end REF_MEASUREMENT /end GROUP
/begin GROUP CmnMfgSrv.DiAssiMechTEstimn "MICROSAR RTE" /begin SUB_GROUP /end SUB_GROUP /begin FUNCTION_LIST /end FUNCTION_LIST /begin REF_CHARACTERISTIC /end REF_CHARACTERISTIC /begin REF_MEASUREMENT CmnMfgSrv.DiAssiMechTEstimn /end REF_MEASUREMENT /end GROUP
/begin GROUP CmnMfgSrv.DiDampg "MICROSAR RTE" /begin SUB_GROUP /end SUB_GROUP /begin FUNCTION_LIST /end FUNCTION_LIST /begin REF_CHARACTERISTIC /end REF_CHARACTERISTIC /begin REF_MEASUREMENT CmnMfgSrv.DiDampg /end REF_MEASUREMENT /end GROUP
/begin GROUP CmnMfgSrv.DiDutyCycThermProtn "MICROSAR RTE" /begin SUB_GROUP /end SUB_GROUP /begin FUNCTION_LIST /end FUNCTION_LIST /begin REF_CHARACTERISTIC /end REF_CHARACTERISTIC /begin REF_MEASUREMENT CmnMfgSrv.DiDutyCycThermProtn /end REF_MEASUREMENT /end GROUP
/begin GROUP CmnMfgSrv.DiEotProtn "MICROSAR RTE" /begin SUB_GROUP /end SUB_GROUP /begin FUNCTION_LIST /end FUNCTION_LIST /begin REF_CHARACTERISTIC /end REF_CHARACTERISTIC /begin REF_MEASUREMENT CmnMfgSrv.DiEotProtn /end REF_MEASUREMENT /end GROUP
/begin GROUP CmnMfgSrv.DiHysCmp "MICROSAR RTE" /begin SUB_GROUP /end SUB_GROUP /begin FUNCTION_LIST /end FUNCTION_LIST /begin REF_CHARACTERISTIC /end REF_CHARACTERISTIC /begin REF_MEASUREMENT CmnMfgSrv.DiHysCmp /end REF_MEASUREMENT /end GROUP
/begin GROUP CmnMfgSrv.DiInertiaCmp "MICROSAR RTE" /begin SUB_GROUP /end SUB_GROUP /begin FUNCTION_LIST /end FUNCTION_LIST /begin REF_CHARACTERISTIC /end REF_CHARACTERISTIC /begin REF_MEASUREMENT CmnMfgSrv.DiInertiaCmp /end REF_MEASUREMENT /end GROUP
/begin GROUP CmnMfgSrv.DiLoaSca "MICROSAR RTE" /begin SUB_GROUP /end SUB_GROUP /begin FUNCTION_LIST /end FUNCTION_LIST /begin REF_CHARACTERISTIC /end REF_CHARACTERISTIC /begin REF_MEASUREMENT CmnMfgSrv.DiLoaSca /end REF_MEASUREMENT /end GROUP
/begin GROUP CmnMfgSrv.DiPullCmpActvCmd "MICROSAR RTE" /begin SUB_GROUP /end SUB_GROUP /begin FUNCTION_LIST /end FUNCTION_LIST /begin REF_CHARACTERISTIC /end REF_CHARACTERISTIC /begin REF_MEASUREMENT CmnMfgSrv.DiPullCmpActvCmd /end REF_MEASUREMENT /end GROUP
/begin GROUP CmnMfgSrv.DiPullCmpActvLrng "MICROSAR RTE" /begin SUB_GROUP /end SUB_GROUP /begin FUNCTION_LIST /end FUNCTION_LIST /begin REF_CHARACTERISTIC /end REF_CHARACTERISTIC /begin REF_MEASUREMENT CmnMfgSrv.DiPullCmpActvLrng /end REF_MEASUREMENT /end GROUP
/begin GROUP CmnMfgSrv.DiRestore "MICROSAR RTE" /begin SUB_GROUP /end SUB_GROUP /begin FUNCTION_LIST /end FUNCTION_LIST /begin REF_CHARACTERISTIC /end REF_CHARACTERISTIC /begin REF_MEASUREMENT CmnMfgSrv.DiRestore /end REF_MEASUREMENT /end GROUP
/begin GROUP CmnMfgSrv.DiRtn "MICROSAR RTE" /begin SUB_GROUP /end SUB_GROUP /begin FUNCTION_LIST /end FUNCTION_LIST /begin REF_CHARACTERISTIC /end REF_CHARACTERISTIC /begin REF_MEASUREMENT CmnMfgSrv.DiRtn /end REF_MEASUREMENT /end GROUP
/begin GROUP CmnMfgSrv.DiStallMotTqLim "MICROSAR RTE" /begin SUB_GROUP /end SUB_GROUP /begin FUNCTION_LIST /end FUNCTION_LIST /begin REF_CHARACTERISTIC /end REF_CHARACTERISTIC /begin REF_MEASUREMENT CmnMfgSrv.DiStallMotTqLim /end REF_MEASUREMENT /end GROUP
/begin GROUP CmnMfgSrv.DiSysFricLrng "MICROSAR RTE" /begin SUB_GROUP /end SUB_GROUP /begin FUNCTION_LIST /end FUNCTION_LIST /begin REF_CHARACTERISTIC /end REF_CHARACTERISTIC /begin REF_MEASUREMENT CmnMfgSrv.DiSysFricLrng /end REF_MEASUREMENT /end GROUP
/begin GROUP CmnMfgSrv.DiSysMotTqCmdRampRate "MICROSAR RTE" /begin SUB_GROUP /end SUB_GROUP /begin FUNCTION_LIST /end FUNCTION_LIST /begin REF_CHARACTERISTIC /end REF_CHARACTERISTIC /begin REF_MEASUREMENT CmnMfgSrv.DiSysMotTqCmdRampRate /end REF_MEASUREMENT /end GROUP
/begin GROUP CmnMfgSrv.DutyCycThermProtnDi.Logl "MICROSAR RTE" /begin SUB_GROUP /end SUB_GROUP /begin FUNCTION_LIST /end FUNCTION_LIST /begin REF_CHARACTERISTIC /end REF_CHARACTERISTIC /begin REF_MEASUREMENT CmnMfgSrv.DutyCycThermProtnDi.Logl /end REF_MEASUREMENT /end GROUP
/begin GROUP CmnMfgSrv.EotProtnDi.Logl "MICROSAR RTE" /begin SUB_GROUP /end SUB_GROUP /begin FUNCTION_LIST /end FUNCTION_LIST /begin REF_CHARACTERISTIC /end REF_CHARACTERISTIC /begin REF_MEASUREMENT CmnMfgSrv.EotProtnDi.Logl /end REF_MEASUREMENT /end GROUP
/begin GROUP CmnMfgSrv.EpsSysSerlNr "MICROSAR RTE" /begin SUB_GROUP /end SUB_GROUP /begin FUNCTION_LIST /end FUNCTION_LIST /begin REF_CHARACTERISTIC /end REF_CHARACTERISTIC /begin REF_MEASUREMENT CmnMfgSrv.EpsSysSerlNr /end REF_MEASUREMENT /end GROUP
/begin GROUP CmnMfgSrv.FricLrngDi.Logl "MICROSAR RTE" /begin SUB_GROUP /end SUB_GROUP /begin FUNCTION_LIST /end FUNCTION_LIST /begin REF_CHARACTERISTIC /end REF_CHARACTERISTIC /begin REF_MEASUREMENT CmnMfgSrv.FricLrngDi.Logl /end REF_MEASUREMENT /end GROUP
/begin GROUP CmnMfgSrv.HysCmpCmdDi.Logl "MICROSAR RTE" /begin SUB_GROUP /end SUB_GROUP /begin FUNCTION_LIST /end FUNCTION_LIST /begin REF_CHARACTERISTIC /end REF_CHARACTERISTIC /begin REF_MEASUREMENT CmnMfgSrv.HysCmpCmdDi.Logl /end REF_MEASUREMENT /end GROUP
/begin GROUP CmnMfgSrv.IgnCntr "MICROSAR RTE" /begin SUB_GROUP /end SUB_GROUP /begin FUNCTION_LIST /end FUNCTION_LIST /begin REF_CHARACTERISTIC /end REF_CHARACTERISTIC /begin REF_MEASUREMENT CmnMfgSrv.IgnCntr /end REF_MEASUREMENT /end GROUP
/begin GROUP CmnMfgSrv.IgnCntr.Val "MICROSAR RTE" /begin SUB_GROUP /end SUB_GROUP /begin FUNCTION_LIST /end FUNCTION_LIST /begin REF_CHARACTERISTIC /end REF_CHARACTERISTIC /begin REF_MEASUREMENT CmnMfgSrv.IgnCntr.Val /end REF_MEASUREMENT /end GROUP
/begin GROUP CmnMfgSrv.InertiaCmpVelCmdDi.Logl "MICROSAR RTE" /begin SUB_GROUP /end SUB_GROUP /begin FUNCTION_LIST /end FUNCTION_LIST /begin REF_CHARACTERISTIC /end REF_CHARACTERISTIC /begin REF_MEASUREMENT CmnMfgSrv.InertiaCmpVelCmdDi.Logl /end REF_MEASUREMENT /end GROUP
/begin GROUP CmnMfgSrv.LoaScaDi.Logl "MICROSAR RTE" /begin SUB_GROUP /end SUB_GROUP /begin FUNCTION_LIST /end FUNCTION_LIST /begin REF_CHARACTERISTIC /end REF_CHARACTERISTIC /begin REF_MEASUREMENT CmnMfgSrv.LoaScaDi.Logl /end REF_MEASUREMENT /end GROUP
/begin GROUP CmnMfgSrv.MfgDiagcInhb "MICROSAR RTE" /begin SUB_GROUP /end SUB_GROUP /begin FUNCTION_LIST /end FUNCTION_LIST /begin REF_CHARACTERISTIC /end REF_CHARACTERISTIC /begin REF_MEASUREMENT CmnMfgSrv.MfgDiagcInhb /end REF_MEASUREMENT /end GROUP
/begin GROUP CmnMfgSrv.MfgDiagcInhb.Logl "MICROSAR RTE" /begin SUB_GROUP /end SUB_GROUP /begin FUNCTION_LIST /end FUNCTION_LIST /begin REF_CHARACTERISTIC /end REF_CHARACTERISTIC /begin REF_MEASUREMENT CmnMfgSrv.MfgDiagcInhb.Logl /end REF_MEASUREMENT /end GROUP
/begin GROUP CmnMfgSrv.MfgTmpBuf0 "MICROSAR RTE" /begin SUB_GROUP /end SUB_GROUP /begin FUNCTION_LIST /end FUNCTION_LIST /begin REF_CHARACTERISTIC /end REF_CHARACTERISTIC /begin REF_MEASUREMENT CmnMfgSrv.MfgTmpBuf0 /end REF_MEASUREMENT /end GROUP
/begin GROUP CmnMfgSrv.MfgTmpBuf1 "MICROSAR RTE" /begin SUB_GROUP /end SUB_GROUP /begin FUNCTION_LIST /end FUNCTION_LIST /begin REF_CHARACTERISTIC /end REF_CHARACTERISTIC /begin REF_MEASUREMENT CmnMfgSrv.MfgTmpBuf1 /end REF_MEASUREMENT /end GROUP
/begin GROUP CmnMfgSrv.MfgTmpBuf2 "MICROSAR RTE" /begin SUB_GROUP /end SUB_GROUP /begin FUNCTION_LIST /end FUNCTION_LIST /begin REF_CHARACTERISTIC /end REF_CHARACTERISTIC /begin REF_MEASUREMENT CmnMfgSrv.MfgTmpBuf2 /end REF_MEASUREMENT /end GROUP
/begin GROUP CmnMfgSrv.MfgTmpBuf3 "MICROSAR RTE" /begin SUB_GROUP /end SUB_GROUP /begin FUNCTION_LIST /end FUNCTION_LIST /begin REF_CHARACTERISTIC /end REF_CHARACTERISTIC /begin REF_MEASUREMENT CmnMfgSrv.MfgTmpBuf3 /end REF_MEASUREMENT /end GROUP
/begin GROUP CmnMfgSrv.MfgTmpBuf4 "MICROSAR RTE" /begin SUB_GROUP /end SUB_GROUP /begin FUNCTION_LIST /end FUNCTION_LIST /begin REF_CHARACTERISTIC /end REF_CHARACTERISTIC /begin REF_MEASUREMENT CmnMfgSrv.MfgTmpBuf4 /end REF_MEASUREMENT /end GROUP
/begin GROUP CmnMfgSrv.NvmIgnCntr_DefaultValue "MICROSAR RTE" /begin SUB_GROUP /end SUB_GROUP /begin FUNCTION_LIST /end FUNCTION_LIST /begin REF_CHARACTERISTIC CmnMfgSrv.NvmIgnCntr_DefaultValue /end REF_CHARACTERISTIC /begin REF_MEASUREMENT /end REF_MEASUREMENT /end GROUP
/begin GROUP CmnMfgSrv.NvmMfgEnaCntr_DefaultValue "MICROSAR RTE" /begin SUB_GROUP /end SUB_GROUP /begin FUNCTION_LIST /end FUNCTION_LIST /begin REF_CHARACTERISTIC CmnMfgSrv.NvmMfgEnaCntr_DefaultValue /end REF_CHARACTERISTIC /begin REF_MEASUREMENT /end REF_MEASUREMENT /end GROUP
/begin GROUP CmnMfgSrv.NvmNxtrSeedKey_DefaultValue "MICROSAR RTE" /begin SUB_GROUP /end SUB_GROUP /begin FUNCTION_LIST /end FUNCTION_LIST /begin REF_CHARACTERISTIC CmnMfgSrv.NvmNxtrSeedKey_DefaultValue /end REF_CHARACTERISTIC /begin REF_MEASUREMENT /end REF_MEASUREMENT /end GROUP
/begin GROUP CmnMfgSrv.NxtrMfgEnaCntr "MICROSAR RTE" /begin SUB_GROUP /end SUB_GROUP /begin FUNCTION_LIST /end FUNCTION_LIST /begin REF_CHARACTERISTIC /end REF_CHARACTERISTIC /begin REF_MEASUREMENT CmnMfgSrv.NxtrMfgEnaCntr /end REF_MEASUREMENT /end GROUP
/begin GROUP CmnMfgSrv.PerInstanceMemories "MICROSAR RTE"
 /begin SUB_GROUP CmnMfgSrv.CcaHwPartNr CmnMfgSrv.CcaSerlNr CmnMfgSrv.DiAssiMechTEstimn CmnMfgSrv.DiDampg CmnMfgSrv.DiDutyCycThermProtn CmnMfgSrv.DiEotProtn CmnMfgSrv.DiHysCmp CmnMfgSrv.DiInertiaCmp CmnMfgSrv.DiLoaSca CmnMfgSrv.DiPullCmpActvCmd CmnMfgSrv.DiPullCmpActvLrng CmnMfgSrv.DiRestore CmnMfgSrv.DiRtn CmnMfgSrv.DiStallMotTqLim CmnMfgSrv.DiSysFricLrng CmnMfgSrv.DiSysMotTqCmdRampRate CmnMfgSrv.EpsSysSerlNr CmnMfgSrv.IgnCntr CmnMfgSrv.MfgDiagcInhb CmnMfgSrv.MfgTmpBuf0 CmnMfgSrv.MfgTmpBuf1 CmnMfgSrv.MfgTmpBuf2 CmnMfgSrv.MfgTmpBuf3 CmnMfgSrv.MfgTmpBuf4 CmnMfgSrv.NxtrMfgEnaCntr CmnMfgSrv.SecuAcsAtmptCntr CmnMfgSrv.SecuAcsAtmptTmr CmnMfgSrv.SecuAcsSeedReqCmpl CmnMfgSrv.SecuAcsUnlckd CmnMfgSrv.SeedKey CmnMfgSrv.SessionCurr CmnMfgSrv.SessionTiOut CmnMfgSrv.SysStReqEnaOvrd /end SUB_GROUP
 /begin FUNCTION_LIST /end FUNCTION_LIST
 /begin REF_CHARACTERISTIC /end REF_CHARACTERISTIC
 /begin REF_MEASUREMENT /end REF_MEASUREMENT
/end GROUP
/begin GROUP CmnMfgSrv.PullCmpCmdDi.Logl "MICROSAR RTE" /begin SUB_GROUP /end SUB_GROUP /begin FUNCTION_LIST /end FUNCTION_LIST /begin REF_CHARACTERISTIC /end REF_CHARACTERISTIC /begin REF_MEASUREMENT CmnMfgSrv.PullCmpCmdDi.Logl /end REF_MEASUREMENT /end GROUP
/begin GROUP CmnMfgSrv.PullCmpLrngDi.Logl "MICROSAR RTE" /begin SUB_GROUP /end SUB_GROUP /begin FUNCTION_LIST /end FUNCTION_LIST /begin REF_CHARACTERISTIC /end REF_CHARACTERISTIC /begin REF_MEASUREMENT CmnMfgSrv.PullCmpLrngDi.Logl /end REF_MEASUREMENT /end GROUP
/begin GROUP CmnMfgSrv.ReceiverPorts "MICROSAR RTE" /begin SUB_GROUP CmnMfgSrv.SysSt.Val /end SUB_GROUP /begin FUNCTION_LIST /end FUNCTION_LIST /begin REF_CHARACTERISTIC /end REF_CHARACTERISTIC /begin REF_MEASUREMENT /end REF_MEASUREMENT /end GROUP
/begin GROUP CmnMfgSrv.RtnCmdDi.Logl "MICROSAR RTE" /begin SUB_GROUP /end SUB_GROUP /begin FUNCTION_LIST /end FUNCTION_LIST /begin REF_CHARACTERISTIC /end REF_CHARACTERISTIC /begin REF_MEASUREMENT CmnMfgSrv.RtnCmdDi.Logl /end REF_MEASUREMENT /end GROUP
/begin GROUP CmnMfgSrv.SecuAcsAtmptCntr "MICROSAR RTE" /begin SUB_GROUP /end SUB_GROUP /begin FUNCTION_LIST /end FUNCTION_LIST /begin REF_CHARACTERISTIC /end REF_CHARACTERISTIC /begin REF_MEASUREMENT CmnMfgSrv.SecuAcsAtmptCntr /end REF_MEASUREMENT /end GROUP
/begin GROUP CmnMfgSrv.SecuAcsAtmptTmr "MICROSAR RTE" /begin SUB_GROUP /end SUB_GROUP /begin FUNCTION_LIST /end FUNCTION_LIST /begin REF_CHARACTERISTIC /end REF_CHARACTERISTIC /begin REF_MEASUREMENT CmnMfgSrv.SecuAcsAtmptTmr /end REF_MEASUREMENT /end GROUP
/begin GROUP CmnMfgSrv.SecuAcsSeedReqCmpl "MICROSAR RTE" /begin SUB_GROUP /end SUB_GROUP /begin FUNCTION_LIST /end FUNCTION_LIST /begin REF_CHARACTERISTIC /end REF_CHARACTERISTIC /begin REF_MEASUREMENT CmnMfgSrv.SecuAcsSeedReqCmpl /end REF_MEASUREMENT /end GROUP
/begin GROUP CmnMfgSrv.SecuAcsUnlckd "MICROSAR RTE" /begin SUB_GROUP /end SUB_GROUP /begin FUNCTION_LIST /end FUNCTION_LIST /begin REF_CHARACTERISTIC /end REF_CHARACTERISTIC /begin REF_MEASUREMENT CmnMfgSrv.SecuAcsUnlckd /end REF_MEASUREMENT /end GROUP
/begin GROUP CmnMfgSrv.SeedKey "MICROSAR RTE" /begin SUB_GROUP /end SUB_GROUP /begin FUNCTION_LIST /end FUNCTION_LIST /begin REF_CHARACTERISTIC /end REF_CHARACTERISTIC /begin REF_MEASUREMENT CmnMfgSrv.SeedKey /end REF_MEASUREMENT /end GROUP
/begin GROUP CmnMfgSrv.SeedKeyDft "MICROSAR RTE" /begin SUB_GROUP /end SUB_GROUP /begin FUNCTION_LIST /end FUNCTION_LIST /begin REF_CHARACTERISTIC CmnMfgSrv.SeedKeyDft /end REF_CHARACTERISTIC /begin REF_MEASUREMENT /end REF_MEASUREMENT /end GROUP
/begin GROUP CmnMfgSrv.SenderPorts "MICROSAR RTE"
 /begin SUB_GROUP CmnMfgSrv.AssiLnrGain.Val CmnMfgSrv.AssiLnrGainEna.Logl CmnMfgSrv.AssiMechTEstimnDi.Logl CmnMfgSrv.DampgCmdBasDi.Logl CmnMfgSrv.DutyCycThermProtnDi.Logl CmnMfgSrv.EotProtnDi.Logl CmnMfgSrv.FricLrngDi.Logl CmnMfgSrv.HysCmpCmdDi.Logl CmnMfgSrv.IgnCntr.Val CmnMfgSrv.InertiaCmpVelCmdDi.Logl CmnMfgSrv.LoaScaDi.Logl CmnMfgSrv.MfgDiagcInhb.Logl CmnMfgSrv.PullCmpCmdDi.Logl CmnMfgSrv.PullCmpLrngDi.Logl CmnMfgSrv.RtnCmdDi.Logl CmnMfgSrv.StallMotTqLimDi.Logl CmnMfgSrv.SysMotTqCmdRampRateDi.Logl CmnMfgSrv.SysStReqEnaOvrd.Logl CmnMfgSrv.VehSpdOvrd.Val CmnMfgSrv.VehSpdOvrdEna.Logl /end SUB_GROUP
 /begin FUNCTION_LIST /end FUNCTION_LIST
 /begin REF_CHARACTERISTIC /end REF_CHARACTERISTIC
 /begin REF_MEASUREMENT /end REF_MEASUREMENT
/end GROUP
/begin GROUP CmnMfgSrv.SessionCurr "MICROSAR RTE" /begin SUB_GROUP /end SUB_GROUP /begin FUNCTION_LIST /end FUNCTION_LIST /begin REF_CHARACTERISTIC /end REF_CHARACTERISTIC /begin REF_MEASUREMENT CmnMfgSrv.SessionCurr /end REF_MEASUREMENT /end GROUP
/begin GROUP CmnMfgSrv.SessionTiOut "MICROSAR RTE" /begin SUB_GROUP /end SUB_GROUP /begin FUNCTION_LIST /end FUNCTION_LIST /begin REF_CHARACTERISTIC /end REF_CHARACTERISTIC /begin REF_MEASUREMENT CmnMfgSrv.SessionTiOut /end REF_MEASUREMENT /end GROUP
/begin GROUP CmnMfgSrv.StallMotTqLimDi.Logl "MICROSAR RTE" /begin SUB_GROUP /end SUB_GROUP /begin FUNCTION_LIST /end FUNCTION_LIST /begin REF_CHARACTERISTIC /end REF_CHARACTERISTIC /begin REF_MEASUREMENT CmnMfgSrv.StallMotTqLimDi.Logl /end REF_MEASUREMENT /end GROUP
/begin GROUP CmnMfgSrv.SysMotTqCmdRampRateDi.Logl "MICROSAR RTE" /begin SUB_GROUP /end SUB_GROUP /begin FUNCTION_LIST /end FUNCTION_LIST /begin REF_CHARACTERISTIC /end REF_CHARACTERISTIC /begin REF_MEASUREMENT CmnMfgSrv.SysMotTqCmdRampRateDi.Logl /end REF_MEASUREMENT /end GROUP
/begin GROUP CmnMfgSrv.SysSt.Val "MICROSAR RTE" /begin SUB_GROUP /end SUB_GROUP /begin FUNCTION_LIST /end FUNCTION_LIST /begin REF_CHARACTERISTIC /end REF_CHARACTERISTIC /begin REF_MEASUREMENT CmnMfgSrv.SysSt.Val /end REF_MEASUREMENT /end GROUP
/begin GROUP CmnMfgSrv.SysStReqEnaOvrd "MICROSAR RTE" /begin SUB_GROUP /end SUB_GROUP /begin FUNCTION_LIST /end FUNCTION_LIST /begin REF_CHARACTERISTIC /end REF_CHARACTERISTIC /begin REF_MEASUREMENT CmnMfgSrv.SysStReqEnaOvrd /end REF_MEASUREMENT /end GROUP
/begin GROUP CmnMfgSrv.SysStReqEnaOvrd.Logl "MICROSAR RTE" /begin SUB_GROUP /end SUB_GROUP /begin FUNCTION_LIST /end FUNCTION_LIST /begin REF_CHARACTERISTIC /end REF_CHARACTERISTIC /begin REF_MEASUREMENT CmnMfgSrv.SysStReqEnaOvrd.Logl /end REF_MEASUREMENT /end GROUP
/begin GROUP CmnMfgSrv.VehSpdOvrd.Val "MICROSAR RTE" /begin SUB_GROUP /end SUB_GROUP /begin FUNCTION_LIST /end FUNCTION_LIST /begin REF_CHARACTERISTIC /end REF_CHARACTERISTIC /begin REF_MEASUREMENT CmnMfgSrv.VehSpdOvrd.Val /end REF_MEASUREMENT /end GROUP
/begin GROUP CmnMfgSrv.VehSpdOvrdEna.Logl "MICROSAR RTE" /begin SUB_GROUP /end SUB_GROUP /begin FUNCTION_LIST /end FUNCTION_LIST /begin REF_CHARACTERISTIC /end REF_CHARACTERISTIC /begin REF_MEASUREMENT CmnMfgSrv.VehSpdOvrdEna.Logl /end REF_MEASUREMENT /end GROUP
/begin GROUP CmnMfgSrvIf "MICROSAR RTE" /begin SUB_GROUP CmnMfgSrvIf.PerInstanceMemories /end SUB_GROUP /begin FUNCTION_LIST /end FUNCTION_LIST /begin REF_CHARACTERISTIC /end REF_CHARACTERISTIC /begin REF_MEASUREMENT /end REF_MEASUREMENT /end GROUP
/begin GROUP CmnMfgSrvIf.DataBuf "MICROSAR RTE" /begin SUB_GROUP /end SUB_GROUP /begin FUNCTION_LIST /end FUNCTION_LIST /begin REF_CHARACTERISTIC /end REF_CHARACTERISTIC /begin REF_MEASUREMENT CmnMfgSrvIf.DataBuf /end REF_MEASUREMENT /end GROUP
/begin GROUP CmnMfgSrvIf.PerInstanceMemories "MICROSAR RTE" /begin SUB_GROUP CmnMfgSrvIf.DataBuf /end SUB_GROUP /begin FUNCTION_LIST /end FUNCTION_LIST /begin REF_CHARACTERISTIC /end REF_CHARACTERISTIC /begin REF_MEASUREMENT /end REF_MEASUREMENT /end GROUP
/begin GROUP CmplncErr "MICROSAR RTE"
 /begin SUB_GROUP CmplncErr.CalibrationPorts CmplncErr.ReceiverPorts CmplncErr.SenderPorts /end SUB_GROUP
 /begin FUNCTION_LIST /end FUNCTION_LIST
 /begin REF_CHARACTERISTIC /end REF_CHARACTERISTIC
 /begin REF_MEASUREMENT /end REF_MEASUREMENT
/end GROUP
/begin GROUP CmplncErr.CalibrationPorts "MICROSAR RTE"
 /begin SUB_GROUP CmplncErr.CmplncErrHwAgNonLinCmplncDepTblY.Ary1D CmplncErr.CmplncErrHwAgNonLinCmplncIndTblX.Ary1D CmplncErr.CmplncErrMotAgNonLinCmplncDepTblY.Ary1D CmplncErr.CmplncErrMotAgNonLinCmplncIndTblX.Ary1D /end SUB_GROUP
 /begin FUNCTION_LIST /end FUNCTION_LIST
 /begin REF_CHARACTERISTIC /end REF_CHARACTERISTIC
 /begin REF_MEASUREMENT /end REF_MEASUREMENT
/end GROUP
/begin GROUP CmplncErr.CmplncErrHwAgNonLinCmplncDepTblY.Ary1D "MICROSAR RTE" /begin SUB_GROUP /end SUB_GROUP /begin FUNCTION_LIST /end FUNCTION_LIST /begin REF_CHARACTERISTIC CmplncErr.CmplncErrHwAgNonLinCmplncDepTblY.Ary1D /end REF_CHARACTERISTIC /begin REF_MEASUREMENT /end REF_MEASUREMENT /end GROUP
/begin GROUP CmplncErr.CmplncErrHwAgNonLinCmplncIndTblX.Ary1D "MICROSAR RTE" /begin SUB_GROUP /end SUB_GROUP /begin FUNCTION_LIST /end FUNCTION_LIST /begin REF_CHARACTERISTIC CmplncErr.CmplncErrHwAgNonLinCmplncIndTblX.Ary1D /end REF_CHARACTERISTIC /begin REF_MEASUREMENT /end REF_MEASUREMENT /end GROUP
/begin GROUP CmplncErr.CmplncErrMotAgNonLinCmplncDepTblY.Ary1D "MICROSAR RTE" /begin SUB_GROUP /end SUB_GROUP /begin FUNCTION_LIST /end FUNCTION_LIST /begin REF_CHARACTERISTIC CmplncErr.CmplncErrMotAgNonLinCmplncDepTblY.Ary1D /end REF_CHARACTERISTIC /begin REF_MEASUREMENT /end REF_MEASUREMENT /end GROUP
/begin GROUP CmplncErr.CmplncErrMotAgNonLinCmplncIndTblX.Ary1D "MICROSAR RTE" /begin SUB_GROUP /end SUB_GROUP /begin FUNCTION_LIST /end FUNCTION_LIST /begin REF_CHARACTERISTIC CmplncErr.CmplncErrMotAgNonLinCmplncIndTblX.Ary1D /end REF_CHARACTERISTIC /begin REF_MEASUREMENT /end REF_MEASUREMENT /end GROUP
/begin GROUP CmplncErr.CmplncErrMotToPinion.Val "MICROSAR RTE" /begin SUB_GROUP /end SUB_GROUP /begin FUNCTION_LIST /end FUNCTION_LIST /begin REF_CHARACTERISTIC /end REF_CHARACTERISTIC /begin REF_MEASUREMENT CmplncErr.CmplncErrMotToPinion.Val /end REF_MEASUREMENT /end GROUP
/begin GROUP CmplncErr.CmplncErrPinionToHw.Val "MICROSAR RTE" /begin SUB_GROUP /end SUB_GROUP /begin FUNCTION_LIST /end FUNCTION_LIST /begin REF_CHARACTERISTIC /end REF_CHARACTERISTIC /begin REF_MEASUREMENT CmplncErr.CmplncErrPinionToHw.Val /end REF_MEASUREMENT /end GROUP
/begin GROUP CmplncErr.HwTq.Val "MICROSAR RTE" /begin SUB_GROUP /end SUB_GROUP /begin FUNCTION_LIST /end FUNCTION_LIST /begin REF_CHARACTERISTIC /end REF_CHARACTERISTIC /begin REF_MEASUREMENT CmplncErr.HwTq.Val /end REF_MEASUREMENT /end GROUP
/begin GROUP CmplncErr.MotTqCmdCrf.Val "MICROSAR RTE" /begin SUB_GROUP /end SUB_GROUP /begin FUNCTION_LIST /end FUNCTION_LIST /begin REF_CHARACTERISTIC /end REF_CHARACTERISTIC /begin REF_MEASUREMENT CmplncErr.MotTqCmdCrf.Val /end REF_MEASUREMENT /end GROUP
/begin GROUP CmplncErr.ReceiverPorts "MICROSAR RTE" /begin SUB_GROUP CmplncErr.HwTq.Val CmplncErr.MotTqCmdCrf.Val /end SUB_GROUP /begin FUNCTION_LIST /end FUNCTION_LIST /begin REF_CHARACTERISTIC /end REF_CHARACTERISTIC /begin REF_MEASUREMENT /end REF_MEASUREMENT /end GROUP
/begin GROUP CmplncErr.SenderPorts "MICROSAR RTE"
 /begin SUB_GROUP CmplncErr.CmplncErrMotToPinion.Val CmplncErr.CmplncErrPinionToHw.Val /end SUB_GROUP
 /begin FUNCTION_LIST /end FUNCTION_LIST
 /begin REF_CHARACTERISTIC /end REF_CHARACTERISTIC
 /begin REF_MEASUREMENT /end REF_MEASUREMENT
/end GROUP
/begin GROUP CurrMeasCorrln "MICROSAR RTE"
 /begin SUB_GROUP CurrMeasCorrln.CalibrationPorts CurrMeasCorrln.PerInstanceMemories CurrMeasCorrln.ReceiverPorts CurrMeasCorrln.SenderPorts /end SUB_GROUP
 /begin FUNCTION_LIST /end FUNCTION_LIST
 /begin REF_CHARACTERISTIC /end REF_CHARACTERISTIC
 /begin REF_MEASUREMENT /end REF_MEASUREMENT
/end GROUP
/begin GROUP CurrMeasCorrln.CalibrationPorts "MICROSAR RTE"
 /begin SUB_GROUP CurrMeasCorrln.CurrMeasCorrlnMaxErrCurr.Val CurrMeasCorrln.CurrMeasCorrlnMaxStallCntr.Val CurrMeasCorrln.CurrMeasCorrlnNtc0x04DFailStep.Val CurrMeasCorrln.CurrMeasCorrlnNtc0x04DPassStep.Val CurrMeasCorrln.CurrMeasCorrlnNtc0x04EFailStep.Val CurrMeasCorrln.CurrMeasCorrlnNtc0x04EPassStep.Val /end SUB_GROUP
 /begin FUNCTION_LIST /end FUNCTION_LIST
 /begin REF_CHARACTERISTIC /end REF_CHARACTERISTIC
 /begin REF_MEASUREMENT /end REF_MEASUREMENT
/end GROUP
/begin GROUP CurrMeasCorrln.CurrMeasCorrlnMaxErrCurr.Val "MICROSAR RTE" /begin SUB_GROUP /end SUB_GROUP /begin FUNCTION_LIST /end FUNCTION_LIST /begin REF_CHARACTERISTIC CurrMeasCorrln.CurrMeasCorrlnMaxErrCurr.Val /end REF_CHARACTERISTIC /begin REF_MEASUREMENT /end REF_MEASUREMENT /end GROUP
/begin GROUP CurrMeasCorrln.CurrMeasCorrlnMaxStallCntr.Val "MICROSAR RTE" /begin SUB_GROUP /end SUB_GROUP /begin FUNCTION_LIST /end FUNCTION_LIST /begin REF_CHARACTERISTIC CurrMeasCorrln.CurrMeasCorrlnMaxStallCntr.Val /end REF_CHARACTERISTIC /begin REF_MEASUREMENT /end REF_MEASUREMENT /end GROUP
/begin GROUP CurrMeasCorrln.CurrMeasCorrlnNtc0x04DFailStep.Val "MICROSAR RTE" /begin SUB_GROUP /end SUB_GROUP /begin FUNCTION_LIST /end FUNCTION_LIST /begin REF_CHARACTERISTIC CurrMeasCorrln.CurrMeasCorrlnNtc0x04DFailStep.Val /end REF_CHARACTERISTIC /begin REF_MEASUREMENT /end REF_MEASUREMENT /end GROUP
/begin GROUP CurrMeasCorrln.CurrMeasCorrlnNtc0x04DPassStep.Val "MICROSAR RTE" /begin SUB_GROUP /end SUB_GROUP /begin FUNCTION_LIST /end FUNCTION_LIST /begin REF_CHARACTERISTIC CurrMeasCorrln.CurrMeasCorrlnNtc0x04DPassStep.Val /end REF_CHARACTERISTIC /begin REF_MEASUREMENT /end REF_MEASUREMENT /end GROUP
/begin GROUP CurrMeasCorrln.CurrMeasCorrlnNtc0x04EFailStep.Val "MICROSAR RTE" /begin SUB_GROUP /end SUB_GROUP /begin FUNCTION_LIST /end FUNCTION_LIST /begin REF_CHARACTERISTIC CurrMeasCorrln.CurrMeasCorrlnNtc0x04EFailStep.Val /end REF_CHARACTERISTIC /begin REF_MEASUREMENT /end REF_MEASUREMENT /end GROUP
/begin GROUP CurrMeasCorrln.CurrMeasCorrlnNtc0x04EPassStep.Val "MICROSAR RTE" /begin SUB_GROUP /end SUB_GROUP /begin FUNCTION_LIST /end FUNCTION_LIST /begin REF_CHARACTERISTIC CurrMeasCorrln.CurrMeasCorrlnNtc0x04EPassStep.Val /end REF_CHARACTERISTIC /begin REF_MEASUREMENT /end REF_MEASUREMENT /end GROUP
/begin GROUP CurrMeasCorrln.CurrMeasCorrlnSens0RollgCntPrev "MICROSAR RTE" /begin SUB_GROUP /end SUB_GROUP /begin FUNCTION_LIST /end FUNCTION_LIST /begin REF_CHARACTERISTIC /end REF_CHARACTERISTIC /begin REF_MEASUREMENT CurrMeasCorrln.CurrMeasCorrlnSens0RollgCntPrev /end REF_MEASUREMENT /end GROUP
/begin GROUP CurrMeasCorrln.CurrMeasCorrlnSens0StallCntPrev "MICROSAR RTE" /begin SUB_GROUP /end SUB_GROUP /begin FUNCTION_LIST /end FUNCTION_LIST /begin REF_CHARACTERISTIC /end REF_CHARACTERISTIC /begin REF_MEASUREMENT CurrMeasCorrln.CurrMeasCorrlnSens0StallCntPrev /end REF_MEASUREMENT /end GROUP
/begin GROUP CurrMeasCorrln.CurrMeasCorrlnSens1RollgCntPrev "MICROSAR RTE" /begin SUB_GROUP /end SUB_GROUP /begin FUNCTION_LIST /end FUNCTION_LIST /begin REF_CHARACTERISTIC /end REF_CHARACTERISTIC /begin REF_MEASUREMENT CurrMeasCorrln.CurrMeasCorrlnSens1RollgCntPrev /end REF_MEASUREMENT /end GROUP
/begin GROUP CurrMeasCorrln.CurrMeasCorrlnSens1StallCntPrev "MICROSAR RTE" /begin SUB_GROUP /end SUB_GROUP /begin FUNCTION_LIST /end FUNCTION_LIST /begin REF_CHARACTERISTIC /end REF_CHARACTERISTIC /begin REF_MEASUREMENT CurrMeasCorrln.CurrMeasCorrlnSens1StallCntPrev /end REF_MEASUREMENT /end GROUP
/begin GROUP CurrMeasCorrln.CurrMeasCorrlnSts.Val "MICROSAR RTE" /begin SUB_GROUP /end SUB_GROUP /begin FUNCTION_LIST /end FUNCTION_LIST /begin REF_CHARACTERISTIC /end REF_CHARACTERISTIC /begin REF_MEASUREMENT CurrMeasCorrln.CurrMeasCorrlnSts.Val /end REF_MEASUREMENT /end GROUP
/begin GROUP CurrMeasCorrln.CurrMeasIdptSig.Val "MICROSAR RTE" /begin SUB_GROUP /end SUB_GROUP /begin FUNCTION_LIST /end FUNCTION_LIST /begin REF_CHARACTERISTIC /end REF_CHARACTERISTIC /begin REF_MEASUREMENT CurrMeasCorrln.CurrMeasIdptSig.Val /end REF_MEASUREMENT /end GROUP
/begin GROUP CurrMeasCorrln.CurrMotSumABC.Val "MICROSAR RTE" /begin SUB_GROUP /end SUB_GROUP /begin FUNCTION_LIST /end FUNCTION_LIST /begin REF_CHARACTERISTIC /end REF_CHARACTERISTIC /begin REF_MEASUREMENT CurrMeasCorrln.CurrMotSumABC.Val /end REF_MEASUREMENT /end GROUP
/begin GROUP CurrMeasCorrln.CurrMotSumDEF.Val "MICROSAR RTE" /begin SUB_GROUP /end SUB_GROUP /begin FUNCTION_LIST /end FUNCTION_LIST /begin REF_CHARACTERISTIC /end REF_CHARACTERISTIC /begin REF_MEASUREMENT CurrMeasCorrln.CurrMotSumDEF.Val /end REF_MEASUREMENT /end GROUP
/begin GROUP CurrMeasCorrln.DiagcStsIvtr1Inactv.Logl "MICROSAR RTE" /begin SUB_GROUP /end SUB_GROUP /begin FUNCTION_LIST /end FUNCTION_LIST /begin REF_CHARACTERISTIC /end REF_CHARACTERISTIC /begin REF_MEASUREMENT CurrMeasCorrln.DiagcStsIvtr1Inactv.Logl /end REF_MEASUREMENT /end GROUP
/begin GROUP CurrMeasCorrln.DiagcStsIvtr2Inactv.Logl "MICROSAR RTE" /begin SUB_GROUP /end SUB_GROUP /begin FUNCTION_LIST /end FUNCTION_LIST /begin REF_CHARACTERISTIC /end REF_CHARACTERISTIC /begin REF_MEASUREMENT CurrMeasCorrln.DiagcStsIvtr2Inactv.Logl /end REF_MEASUREMENT /end GROUP
/begin GROUP CurrMeasCorrln.MotCurrCorrdA.Val "MICROSAR RTE" /begin SUB_GROUP /end SUB_GROUP /begin FUNCTION_LIST /end FUNCTION_LIST /begin REF_CHARACTERISTIC /end REF_CHARACTERISTIC /begin REF_MEASUREMENT CurrMeasCorrln.MotCurrCorrdA.Val /end REF_MEASUREMENT /end GROUP
/begin GROUP CurrMeasCorrln.MotCurrCorrdB.Val "MICROSAR RTE" /begin SUB_GROUP /end SUB_GROUP /begin FUNCTION_LIST /end FUNCTION_LIST /begin REF_CHARACTERISTIC /end REF_CHARACTERISTIC /begin REF_MEASUREMENT CurrMeasCorrln.MotCurrCorrdB.Val /end REF_MEASUREMENT /end GROUP
/begin GROUP CurrMeasCorrln.MotCurrCorrdC.Val "MICROSAR RTE" /begin SUB_GROUP /end SUB_GROUP /begin FUNCTION_LIST /end FUNCTION_LIST /begin REF_CHARACTERISTIC /end REF_CHARACTERISTIC /begin REF_MEASUREMENT CurrMeasCorrln.MotCurrCorrdC.Val /end REF_MEASUREMENT /end GROUP
/begin GROUP CurrMeasCorrln.MotCurrCorrdD.Val "MICROSAR RTE" /begin SUB_GROUP /end SUB_GROUP /begin FUNCTION_LIST /end FUNCTION_LIST /begin REF_CHARACTERISTIC /end REF_CHARACTERISTIC /begin REF_MEASUREMENT CurrMeasCorrln.MotCurrCorrdD.Val /end REF_MEASUREMENT /end GROUP
/begin GROUP CurrMeasCorrln.MotCurrCorrdE.Val "MICROSAR RTE" /begin SUB_GROUP /end SUB_GROUP /begin FUNCTION_LIST /end FUNCTION_LIST /begin REF_CHARACTERISTIC /end REF_CHARACTERISTIC /begin REF_MEASUREMENT CurrMeasCorrln.MotCurrCorrdE.Val /end REF_MEASUREMENT /end GROUP
/begin GROUP CurrMeasCorrln.MotCurrCorrdF.Val "MICROSAR RTE" /begin SUB_GROUP /end SUB_GROUP /begin FUNCTION_LIST /end FUNCTION_LIST /begin REF_CHARACTERISTIC /end REF_CHARACTERISTIC /begin REF_MEASUREMENT CurrMeasCorrln.MotCurrCorrdF.Val /end REF_MEASUREMENT /end GROUP
/begin GROUP CurrMeasCorrln.MotCurrEolCalSt.Val "MICROSAR RTE" /begin SUB_GROUP /end SUB_GROUP /begin FUNCTION_LIST /end FUNCTION_LIST /begin REF_CHARACTERISTIC /end REF_CHARACTERISTIC /begin REF_MEASUREMENT CurrMeasCorrln.MotCurrEolCalSt.Val /end REF_MEASUREMENT /end GROUP
/begin GROUP CurrMeasCorrln.MotCurrQlfr1.Val "MICROSAR RTE" /begin SUB_GROUP /end SUB_GROUP /begin FUNCTION_LIST /end FUNCTION_LIST /begin REF_CHARACTERISTIC /end REF_CHARACTERISTIC /begin REF_MEASUREMENT CurrMeasCorrln.MotCurrQlfr1.Val /end REF_MEASUREMENT /end GROUP
/begin GROUP CurrMeasCorrln.MotCurrQlfr2.Val "MICROSAR RTE" /begin SUB_GROUP /end SUB_GROUP /begin FUNCTION_LIST /end FUNCTION_LIST /begin REF_CHARACTERISTIC /end REF_CHARACTERISTIC /begin REF_MEASUREMENT CurrMeasCorrln.MotCurrQlfr2.Val /end REF_MEASUREMENT /end GROUP
/begin GROUP CurrMeasCorrln.MotCurrRollgCntr1.Val "MICROSAR RTE" /begin SUB_GROUP /end SUB_GROUP /begin FUNCTION_LIST /end FUNCTION_LIST /begin REF_CHARACTERISTIC /end REF_CHARACTERISTIC /begin REF_MEASUREMENT CurrMeasCorrln.MotCurrRollgCntr1.Val /end REF_MEASUREMENT /end GROUP
/begin GROUP CurrMeasCorrln.MotCurrRollgCntr2.Val "MICROSAR RTE" /begin SUB_GROUP /end SUB_GROUP /begin FUNCTION_LIST /end FUNCTION_LIST /begin REF_CHARACTERISTIC /end REF_CHARACTERISTIC /begin REF_MEASUREMENT CurrMeasCorrln.MotCurrRollgCntr2.Val /end REF_MEASUREMENT /end GROUP
/begin GROUP CurrMeasCorrln.PerInstanceMemories "MICROSAR RTE"
 /begin SUB_GROUP CurrMeasCorrln.CurrMeasCorrlnSens0RollgCntPrev CurrMeasCorrln.CurrMeasCorrlnSens0StallCntPrev CurrMeasCorrln.CurrMeasCorrlnSens1RollgCntPrev CurrMeasCorrln.CurrMeasCorrlnSens1StallCntPrev /end SUB_GROUP
 /begin FUNCTION_LIST /end FUNCTION_LIST
 /begin REF_CHARACTERISTIC /end REF_CHARACTERISTIC
 /begin REF_MEASUREMENT /end REF_MEASUREMENT
/end GROUP
/begin GROUP CurrMeasCorrln.ReceiverPorts "MICROSAR RTE"
 /begin SUB_GROUP CurrMeasCorrln.DiagcStsIvtr1Inactv.Logl CurrMeasCorrln.DiagcStsIvtr2Inactv.Logl CurrMeasCorrln.MotCurrCorrdA.Val CurrMeasCorrln.MotCurrCorrdB.Val CurrMeasCorrln.MotCurrCorrdC.Val CurrMeasCorrln.MotCurrCorrdD.Val CurrMeasCorrln.MotCurrCorrdE.Val CurrMeasCorrln.MotCurrCorrdF.Val CurrMeasCorrln.MotCurrEolCalSt.Val CurrMeasCorrln.MotCurrQlfr1.Val CurrMeasCorrln.MotCurrQlfr2.Val CurrMeasCorrln.MotCurrRollgCntr1.Val CurrMeasCorrln.MotCurrRollgCntr2.Val CurrMeasCorrln.SysSt.Val /end SUB_GROUP
 /begin FUNCTION_LIST /end FUNCTION_LIST
 /begin REF_CHARACTERISTIC /end REF_CHARACTERISTIC
 /begin REF_MEASUREMENT /end REF_MEASUREMENT
/end GROUP
/begin GROUP CurrMeasCorrln.SenderPorts "MICROSAR RTE"
 /begin SUB_GROUP CurrMeasCorrln.CurrMeasCorrlnSts.Val CurrMeasCorrln.CurrMeasIdptSig.Val CurrMeasCorrln.CurrMotSumABC.Val CurrMeasCorrln.CurrMotSumDEF.Val /end SUB_GROUP
 /begin FUNCTION_LIST /end FUNCTION_LIST
 /begin REF_CHARACTERISTIC /end REF_CHARACTERISTIC
 /begin REF_MEASUREMENT /end REF_MEASUREMENT
/end GROUP
/begin GROUP CurrMeasCorrln.SysSt.Val "MICROSAR RTE" /begin SUB_GROUP /end SUB_GROUP /begin FUNCTION_LIST /end FUNCTION_LIST /begin REF_CHARACTERISTIC /end REF_CHARACTERISTIC /begin REF_MEASUREMENT CurrMeasCorrln.SysSt.Val /end REF_MEASUREMENT /end GROUP
/begin GROUP CurrReasbnDiagc "MICROSAR RTE"
 /begin SUB_GROUP CurrReasbnDiagc.CalibrationPorts CurrReasbnDiagc.PerInstanceMemories CurrReasbnDiagc.ReceiverPorts /end SUB_GROUP
 /begin FUNCTION_LIST /end FUNCTION_LIST
 /begin REF_CHARACTERISTIC /end REF_CHARACTERISTIC
 /begin REF_MEASUREMENT /end REF_MEASUREMENT
/end GROUP
/begin GROUP CurrReasbnDiagc.CalibrationPorts "MICROSAR RTE"
 /begin SUB_GROUP CurrReasbnDiagc.CurrReasbnDiagcCurrDiagcMotEnvlpTblMax.Val CurrReasbnDiagc.CurrReasbnDiagcCurrDiagcPrimErrThd.Val CurrReasbnDiagc.CurrReasbnDiagcCurrDiagcSecdryErrThd.Val CurrReasbnDiagc.CurrReasbnDiagcCurrDiagcSecdryTqLimThd.Val CurrReasbnDiagc.CurrReasbnDiagcDiagFildLim.Val CurrReasbnDiagc.CurrReasbnDiagcDiagVltgLpFilEna.Logl CurrReasbnDiagc.CurrReasbnDiagcDiagVltgLpFilFrq.Val CurrReasbnDiagc.CurrReasbnDiagcLpFilSca.Val CurrReasbnDiagc.CurrReasbnDiagcMotVelHiLim.Val CurrReasbnDiagc.CurrReasbnDiagcMotVelLoLim.Val CurrReasbnDiagc.CurrReasbnDiagcMotVltgDaxLpFilFrq.Val CurrReasbnDiagc.CurrReasbnDiagcMotVltgQaxDaxFilEna.Logl CurrReasbnDiagc.CurrReasbnDiagcMotVltgQaxLpFilFrq.Val CurrReasbnDiagc.CurrReasbnDiagcVelLpFilEna.Logl CurrReasbnDiagc.CurrReasbnDiagcVelLpFilFrq.Val CurrReasbnDiagc.SysGlbPrmMotPoleCnt.Val /end SUB_GROUP
 /begin FUNCTION_LIST /end FUNCTION_LIST
 /begin REF_CHARACTERISTIC /end REF_CHARACTERISTIC
 /begin REF_MEASUREMENT /end REF_MEASUREMENT
/end GROUP
/begin GROUP CurrReasbnDiagc.CurrReasbnDiagcCurrDiagcMotEnvlpTblMax.Val "MICROSAR RTE" /begin SUB_GROUP /end SUB_GROUP /begin FUNCTION_LIST /end FUNCTION_LIST /begin REF_CHARACTERISTIC CurrReasbnDiagc.CurrReasbnDiagcCurrDiagcMotEnvlpTblMax.Val /end REF_CHARACTERISTIC /begin REF_MEASUREMENT /end REF_MEASUREMENT /end GROUP
/begin GROUP CurrReasbnDiagc.CurrReasbnDiagcCurrDiagcPrimErrThd.Val "MICROSAR RTE" /begin SUB_GROUP /end SUB_GROUP /begin FUNCTION_LIST /end FUNCTION_LIST /begin REF_CHARACTERISTIC CurrReasbnDiagc.CurrReasbnDiagcCurrDiagcPrimErrThd.Val /end REF_CHARACTERISTIC /begin REF_MEASUREMENT /end REF_MEASUREMENT /end GROUP
/begin GROUP CurrReasbnDiagc.CurrReasbnDiagcCurrDiagcSecdryErrThd.Val "MICROSAR RTE" /begin SUB_GROUP /end SUB_GROUP /begin FUNCTION_LIST /end FUNCTION_LIST /begin REF_CHARACTERISTIC CurrReasbnDiagc.CurrReasbnDiagcCurrDiagcSecdryErrThd.Val /end REF_CHARACTERISTIC /begin REF_MEASUREMENT /end REF_MEASUREMENT /end GROUP
/begin GROUP CurrReasbnDiagc.CurrReasbnDiagcCurrDiagcSecdryTqLimThd.Val "MICROSAR RTE" /begin SUB_GROUP /end SUB_GROUP /begin FUNCTION_LIST /end FUNCTION_LIST /begin REF_CHARACTERISTIC CurrReasbnDiagc.CurrReasbnDiagcCurrDiagcSecdryTqLimThd.Val /end REF_CHARACTERISTIC /begin REF_MEASUREMENT /end REF_MEASUREMENT /end GROUP
/begin GROUP CurrReasbnDiagc.CurrReasbnDiagcDiagFildLim.Val "MICROSAR RTE" /begin SUB_GROUP /end SUB_GROUP /begin FUNCTION_LIST /end FUNCTION_LIST /begin REF_CHARACTERISTIC CurrReasbnDiagc.CurrReasbnDiagcDiagFildLim.Val /end REF_CHARACTERISTIC /begin REF_MEASUREMENT /end REF_MEASUREMENT /end GROUP
/begin GROUP CurrReasbnDiagc.CurrReasbnDiagcDiagVltgLpFilEna.Logl "MICROSAR RTE" /begin SUB_GROUP /end SUB_GROUP /begin FUNCTION_LIST /end FUNCTION_LIST /begin REF_CHARACTERISTIC CurrReasbnDiagc.CurrReasbnDiagcDiagVltgLpFilEna.Logl /end REF_CHARACTERISTIC /begin REF_MEASUREMENT /end REF_MEASUREMENT /end GROUP
/begin GROUP CurrReasbnDiagc.CurrReasbnDiagcDiagVltgLpFilFrq.Val "MICROSAR RTE" /begin SUB_GROUP /end SUB_GROUP /begin FUNCTION_LIST /end FUNCTION_LIST /begin REF_CHARACTERISTIC CurrReasbnDiagc.CurrReasbnDiagcDiagVltgLpFilFrq.Val /end REF_CHARACTERISTIC /begin REF_MEASUREMENT /end REF_MEASUREMENT /end GROUP
/begin GROUP CurrReasbnDiagc.CurrReasbnDiagcLpFilSca.Val "MICROSAR RTE" /begin SUB_GROUP /end SUB_GROUP /begin FUNCTION_LIST /end FUNCTION_LIST /begin REF_CHARACTERISTIC CurrReasbnDiagc.CurrReasbnDiagcLpFilSca.Val /end REF_CHARACTERISTIC /begin REF_MEASUREMENT /end REF_MEASUREMENT /end GROUP
/begin GROUP CurrReasbnDiagc.CurrReasbnDiagcMotVelHiLim.Val "MICROSAR RTE" /begin SUB_GROUP /end SUB_GROUP /begin FUNCTION_LIST /end FUNCTION_LIST /begin REF_CHARACTERISTIC CurrReasbnDiagc.CurrReasbnDiagcMotVelHiLim.Val /end REF_CHARACTERISTIC /begin REF_MEASUREMENT /end REF_MEASUREMENT /end GROUP
/begin GROUP CurrReasbnDiagc.CurrReasbnDiagcMotVelLoLim.Val "MICROSAR RTE" /begin SUB_GROUP /end SUB_GROUP /begin FUNCTION_LIST /end FUNCTION_LIST /begin REF_CHARACTERISTIC CurrReasbnDiagc.CurrReasbnDiagcMotVelLoLim.Val /end REF_CHARACTERISTIC /begin REF_MEASUREMENT /end REF_MEASUREMENT /end GROUP
/begin GROUP CurrReasbnDiagc.CurrReasbnDiagcMotVltgDaxLpFilFrq.Val "MICROSAR RTE" /begin SUB_GROUP /end SUB_GROUP /begin FUNCTION_LIST /end FUNCTION_LIST /begin REF_CHARACTERISTIC CurrReasbnDiagc.CurrReasbnDiagcMotVltgDaxLpFilFrq.Val /end REF_CHARACTERISTIC /begin REF_MEASUREMENT /end REF_MEASUREMENT /end GROUP
/begin GROUP CurrReasbnDiagc.CurrReasbnDiagcMotVltgQaxDaxFilEna.Logl "MICROSAR RTE" /begin SUB_GROUP /end SUB_GROUP /begin FUNCTION_LIST /end FUNCTION_LIST /begin REF_CHARACTERISTIC CurrReasbnDiagc.CurrReasbnDiagcMotVltgQaxDaxFilEna.Logl /end REF_CHARACTERISTIC /begin REF_MEASUREMENT /end REF_MEASUREMENT /end GROUP
/begin GROUP CurrReasbnDiagc.CurrReasbnDiagcMotVltgQaxLpFilFrq.Val "MICROSAR RTE" /begin SUB_GROUP /end SUB_GROUP /begin FUNCTION_LIST /end FUNCTION_LIST /begin REF_CHARACTERISTIC CurrReasbnDiagc.CurrReasbnDiagcMotVltgQaxLpFilFrq.Val /end REF_CHARACTERISTIC /begin REF_MEASUREMENT /end REF_MEASUREMENT /end GROUP
/begin GROUP CurrReasbnDiagc.CurrReasbnDiagcVelLpFilEna.Logl "MICROSAR RTE" /begin SUB_GROUP /end SUB_GROUP /begin FUNCTION_LIST /end FUNCTION_LIST /begin REF_CHARACTERISTIC CurrReasbnDiagc.CurrReasbnDiagcVelLpFilEna.Logl /end REF_CHARACTERISTIC /begin REF_MEASUREMENT /end REF_MEASUREMENT /end GROUP
/begin GROUP CurrReasbnDiagc.CurrReasbnDiagcVelLpFilFrq.Val "MICROSAR RTE" /begin SUB_GROUP /end SUB_GROUP /begin FUNCTION_LIST /end FUNCTION_LIST /begin REF_CHARACTERISTIC CurrReasbnDiagc.CurrReasbnDiagcVelLpFilFrq.Val /end REF_CHARACTERISTIC /begin REF_MEASUREMENT /end REF_MEASUREMENT /end GROUP
/begin GROUP CurrReasbnDiagc.CurrReasbnMotVelLpFil "MICROSAR RTE" /begin SUB_GROUP /end SUB_GROUP /begin FUNCTION_LIST /end FUNCTION_LIST /begin REF_CHARACTERISTIC /end REF_CHARACTERISTIC
 /begin REF_MEASUREMENT CurrReasbnDiagc.CurrReasbnMotVelLpFil.FilGain CurrReasbnDiagc.CurrReasbnMotVelLpFil.FilSt /end REF_MEASUREMENT
/end GROUP
/begin GROUP CurrReasbnDiagc.DiagVltgLpFil "MICROSAR RTE" /begin SUB_GROUP /end SUB_GROUP /begin FUNCTION_LIST /end FUNCTION_LIST /begin REF_CHARACTERISTIC /end REF_CHARACTERISTIC
 /begin REF_MEASUREMENT CurrReasbnDiagc.DiagVltgLpFil.FilGain CurrReasbnDiagc.DiagVltgLpFil.FilSt /end REF_MEASUREMENT
/end GROUP
/begin GROUP CurrReasbnDiagc.MotAgElec.Val "MICROSAR RTE" /begin SUB_GROUP /end SUB_GROUP /begin FUNCTION_LIST /end FUNCTION_LIST /begin REF_CHARACTERISTIC /end REF_CHARACTERISTIC /begin REF_MEASUREMENT CurrReasbnDiagc.MotAgElec.Val /end REF_MEASUREMENT /end GROUP
/begin GROUP CurrReasbnDiagc.MotTqCmdLimrMin.Val "MICROSAR RTE" /begin SUB_GROUP /end SUB_GROUP /begin FUNCTION_LIST /end FUNCTION_LIST /begin REF_CHARACTERISTIC /end REF_CHARACTERISTIC /begin REF_MEASUREMENT CurrReasbnDiagc.MotTqCmdLimrMin.Val /end REF_MEASUREMENT /end GROUP
/begin GROUP CurrReasbnDiagc.MotVelMrf.Val "MICROSAR RTE" /begin SUB_GROUP /end SUB_GROUP /begin FUNCTION_LIST /end FUNCTION_LIST /begin REF_CHARACTERISTIC /end REF_CHARACTERISTIC /begin REF_MEASUREMENT CurrReasbnDiagc.MotVelMrf.Val /end REF_MEASUREMENT /end GROUP
/begin GROUP CurrReasbnDiagc.MotVltgDaxFfStat.Val "MICROSAR RTE" /begin SUB_GROUP /end SUB_GROUP /begin FUNCTION_LIST /end FUNCTION_LIST /begin REF_CHARACTERISTIC /end REF_CHARACTERISTIC /begin REF_MEASUREMENT CurrReasbnDiagc.MotVltgDaxFfStat.Val /end REF_MEASUREMENT /end GROUP
/begin GROUP CurrReasbnDiagc.MotVltgDaxFild.Val "MICROSAR RTE" /begin SUB_GROUP /end SUB_GROUP /begin FUNCTION_LIST /end FUNCTION_LIST /begin REF_CHARACTERISTIC /end REF_CHARACTERISTIC /begin REF_MEASUREMENT CurrReasbnDiagc.MotVltgDaxFild.Val /end REF_MEASUREMENT /end GROUP
/begin GROUP CurrReasbnDiagc.MotVltgDaxLpFil "MICROSAR RTE" /begin SUB_GROUP /end SUB_GROUP /begin FUNCTION_LIST /end FUNCTION_LIST /begin REF_CHARACTERISTIC /end REF_CHARACTERISTIC
 /begin REF_MEASUREMENT CurrReasbnDiagc.MotVltgDaxLpFil.FilGain CurrReasbnDiagc.MotVltgDaxLpFil.FilSt /end REF_MEASUREMENT
/end GROUP
/begin GROUP CurrReasbnDiagc.MotVltgDiagFildInp1Prev "MICROSAR RTE" /begin SUB_GROUP /end SUB_GROUP /begin FUNCTION_LIST /end FUNCTION_LIST /begin REF_CHARACTERISTIC /end REF_CHARACTERISTIC /begin REF_MEASUREMENT CurrReasbnDiagc.MotVltgDiagFildInp1Prev /end REF_MEASUREMENT /end GROUP
/begin GROUP CurrReasbnDiagc.MotVltgDiagFildInp2Prev "MICROSAR RTE" /begin SUB_GROUP /end SUB_GROUP /begin FUNCTION_LIST /end FUNCTION_LIST /begin REF_CHARACTERISTIC /end REF_CHARACTERISTIC /begin REF_MEASUREMENT CurrReasbnDiagc.MotVltgDiagFildInp2Prev /end REF_MEASUREMENT /end GROUP
/begin GROUP CurrReasbnDiagc.MotVltgDiagFildOutp1Prev "MICROSAR RTE" /begin SUB_GROUP /end SUB_GROUP /begin FUNCTION_LIST /end FUNCTION_LIST /begin REF_CHARACTERISTIC /end REF_CHARACTERISTIC /begin REF_MEASUREMENT CurrReasbnDiagc.MotVltgDiagFildOutp1Prev /end REF_MEASUREMENT /end GROUP
/begin GROUP CurrReasbnDiagc.MotVltgDiagFildOutp2Prev "MICROSAR RTE" /begin SUB_GROUP /end SUB_GROUP /begin FUNCTION_LIST /end FUNCTION_LIST /begin REF_CHARACTERISTIC /end REF_CHARACTERISTIC /begin REF_MEASUREMENT CurrReasbnDiagc.MotVltgDiagFildOutp2Prev /end REF_MEASUREMENT /end GROUP
/begin GROUP CurrReasbnDiagc.MotVltgQaxFfStat.Val "MICROSAR RTE" /begin SUB_GROUP /end SUB_GROUP /begin FUNCTION_LIST /end FUNCTION_LIST /begin REF_CHARACTERISTIC /end REF_CHARACTERISTIC /begin REF_MEASUREMENT CurrReasbnDiagc.MotVltgQaxFfStat.Val /end REF_MEASUREMENT /end GROUP
/begin GROUP CurrReasbnDiagc.MotVltgQaxFild.Val "MICROSAR RTE" /begin SUB_GROUP /end SUB_GROUP /begin FUNCTION_LIST /end FUNCTION_LIST /begin REF_CHARACTERISTIC /end REF_CHARACTERISTIC /begin REF_MEASUREMENT CurrReasbnDiagc.MotVltgQaxFild.Val /end REF_MEASUREMENT /end GROUP
/begin GROUP CurrReasbnDiagc.MotVltgQaxLpFil "MICROSAR RTE" /begin SUB_GROUP /end SUB_GROUP /begin FUNCTION_LIST /end FUNCTION_LIST /begin REF_CHARACTERISTIC /end REF_CHARACTERISTIC
 /begin REF_MEASUREMENT CurrReasbnDiagc.MotVltgQaxLpFil.FilGain CurrReasbnDiagc.MotVltgQaxLpFil.FilSt /end REF_MEASUREMENT
/end GROUP
/begin GROUP CurrReasbnDiagc.PerInstanceMemories "MICROSAR RTE"
 /begin SUB_GROUP CurrReasbnDiagc.CurrReasbnMotVelLpFil CurrReasbnDiagc.DiagVltgLpFil CurrReasbnDiagc.MotVltgDaxLpFil CurrReasbnDiagc.MotVltgDiagFildInp1Prev CurrReasbnDiagc.MotVltgDiagFildInp2Prev CurrReasbnDiagc.MotVltgDiagFildOutp1Prev CurrReasbnDiagc.MotVltgDiagFildOutp2Prev CurrReasbnDiagc.MotVltgQaxLpFil CurrReasbnDiagc.dCurrReasbnDiagcMotVltgAFild CurrReasbnDiagc.dCurrReasbnDiagcMotVltgBFild CurrReasbnDiagc.dCurrReasbnDiagcMotVltgDaxDif CurrReasbnDiagc.dCurrReasbnDiagcMotVltgDiagFild CurrReasbnDiagc.dCurrReasbnDiagcMotVltgDiagFildLimd CurrReasbnDiagc.dCurrReasbnDiagcMotVltgDiagSecdryFild CurrReasbnDiagc.dCurrReasbnDiagcMotVltgQaxDif CurrReasbnDiagc.dCurrReasbnDiagcVelLpFild /end SUB_GROUP
 /begin FUNCTION_LIST /end FUNCTION_LIST
 /begin REF_CHARACTERISTIC /end REF_CHARACTERISTIC
 /begin REF_MEASUREMENT /end REF_MEASUREMENT
/end GROUP
/begin GROUP CurrReasbnDiagc.ReceiverPorts "MICROSAR RTE"
 /begin SUB_GROUP CurrReasbnDiagc.MotAgElec.Val CurrReasbnDiagc.MotTqCmdLimrMin.Val CurrReasbnDiagc.MotVelMrf.Val CurrReasbnDiagc.MotVltgDaxFfStat.Val CurrReasbnDiagc.MotVltgDaxFild.Val CurrReasbnDiagc.MotVltgQaxFfStat.Val CurrReasbnDiagc.MotVltgQaxFild.Val CurrReasbnDiagc.SysMotTqCmdSca.Val /end SUB_GROUP
 /begin FUNCTION_LIST /end FUNCTION_LIST
 /begin REF_CHARACTERISTIC /end REF_CHARACTERISTIC
 /begin REF_MEASUREMENT /end REF_MEASUREMENT
/end GROUP
/begin GROUP CurrReasbnDiagc.SysGlbPrmMotPoleCnt.Val "MICROSAR RTE" /begin SUB_GROUP /end SUB_GROUP /begin FUNCTION_LIST /end FUNCTION_LIST /begin REF_CHARACTERISTIC CurrReasbnDiagc.SysGlbPrmMotPoleCnt.Val /end REF_CHARACTERISTIC /begin REF_MEASUREMENT /end REF_MEASUREMENT /end GROUP
/begin GROUP CurrReasbnDiagc.SysMotTqCmdSca.Val "MICROSAR RTE" /begin SUB_GROUP /end SUB_GROUP /begin FUNCTION_LIST /end FUNCTION_LIST /begin REF_CHARACTERISTIC /end REF_CHARACTERISTIC /begin REF_MEASUREMENT CurrReasbnDiagc.SysMotTqCmdSca.Val /end REF_MEASUREMENT /end GROUP
/begin GROUP CurrReasbnDiagc.dCurrReasbnDiagcMotVltgAFild "MICROSAR RTE" /begin SUB_GROUP /end SUB_GROUP /begin FUNCTION_LIST /end FUNCTION_LIST /begin REF_CHARACTERISTIC /end REF_CHARACTERISTIC /begin REF_MEASUREMENT CurrReasbnDiagc.dCurrReasbnDiagcMotVltgAFild /end REF_MEASUREMENT /end GROUP
/begin GROUP CurrReasbnDiagc.dCurrReasbnDiagcMotVltgBFild "MICROSAR RTE" /begin SUB_GROUP /end SUB_GROUP /begin FUNCTION_LIST /end FUNCTION_LIST /begin REF_CHARACTERISTIC /end REF_CHARACTERISTIC /begin REF_MEASUREMENT CurrReasbnDiagc.dCurrReasbnDiagcMotVltgBFild /end REF_MEASUREMENT /end GROUP
/begin GROUP CurrReasbnDiagc.dCurrReasbnDiagcMotVltgDaxDif "MICROSAR RTE" /begin SUB_GROUP /end SUB_GROUP /begin FUNCTION_LIST /end FUNCTION_LIST /begin REF_CHARACTERISTIC /end REF_CHARACTERISTIC /begin REF_MEASUREMENT CurrReasbnDiagc.dCurrReasbnDiagcMotVltgDaxDif /end REF_MEASUREMENT /end GROUP
/begin GROUP CurrReasbnDiagc.dCurrReasbnDiagcMotVltgDiagFild "MICROSAR RTE" /begin SUB_GROUP /end SUB_GROUP /begin FUNCTION_LIST /end FUNCTION_LIST /begin REF_CHARACTERISTIC /end REF_CHARACTERISTIC /begin REF_MEASUREMENT CurrReasbnDiagc.dCurrReasbnDiagcMotVltgDiagFild /end REF_MEASUREMENT /end GROUP
/begin GROUP CurrReasbnDiagc.dCurrReasbnDiagcMotVltgDiagFildLimd "MICROSAR RTE" /begin SUB_GROUP /end SUB_GROUP /begin FUNCTION_LIST /end FUNCTION_LIST /begin REF_CHARACTERISTIC /end REF_CHARACTERISTIC /begin REF_MEASUREMENT CurrReasbnDiagc.dCurrReasbnDiagcMotVltgDiagFildLimd /end REF_MEASUREMENT /end GROUP
/begin GROUP CurrReasbnDiagc.dCurrReasbnDiagcMotVltgDiagSecdryFild "MICROSAR RTE" /begin SUB_GROUP /end SUB_GROUP /begin FUNCTION_LIST /end FUNCTION_LIST /begin REF_CHARACTERISTIC /end REF_CHARACTERISTIC /begin REF_MEASUREMENT CurrReasbnDiagc.dCurrReasbnDiagcMotVltgDiagSecdryFild /end REF_MEASUREMENT /end GROUP
/begin GROUP CurrReasbnDiagc.dCurrReasbnDiagcMotVltgQaxDif "MICROSAR RTE" /begin SUB_GROUP /end SUB_GROUP /begin FUNCTION_LIST /end FUNCTION_LIST /begin REF_CHARACTERISTIC /end REF_CHARACTERISTIC /begin REF_MEASUREMENT CurrReasbnDiagc.dCurrReasbnDiagcMotVltgQaxDif /end REF_MEASUREMENT /end GROUP
/begin GROUP CurrReasbnDiagc.dCurrReasbnDiagcVelLpFild "MICROSAR RTE" /begin SUB_GROUP /end SUB_GROUP /begin FUNCTION_LIST /end FUNCTION_LIST /begin REF_CHARACTERISTIC /end REF_CHARACTERISTIC /begin REF_MEASUREMENT CurrReasbnDiagc.dCurrReasbnDiagcVelLpFild /end REF_MEASUREMENT /end GROUP
/begin GROUP CustDiagc "MICROSAR RTE"
 /begin SUB_GROUP CustDiagc.CalibrationPorts CustDiagc.PerInstanceMemories CustDiagc.ReceiverPorts CustDiagc.SenderPorts /end SUB_GROUP
 /begin FUNCTION_LIST /end FUNCTION_LIST
 /begin REF_CHARACTERISTIC /end REF_CHARACTERISTIC
 /begin REF_MEASUREMENT /end REF_MEASUREMENT
/end GROUP
/begin GROUP CustDiagc.ApaSt.Val "MICROSAR RTE" /begin SUB_GROUP /end SUB_GROUP /begin FUNCTION_LIST /end FUNCTION_LIST /begin REF_CHARACTERISTIC /end REF_CHARACTERISTIC /begin REF_MEASUREMENT CustDiagc.ApaSt.Val /end REF_MEASUREMENT /end GROUP
/begin GROUP CustDiagc.BattVltg.Val "MICROSAR RTE" /begin SUB_GROUP /end SUB_GROUP /begin FUNCTION_LIST /end FUNCTION_LIST /begin REF_CHARACTERISTIC /end REF_CHARACTERISTIC /begin REF_MEASUREMENT CustDiagc.BattVltg.Val /end REF_MEASUREMENT /end GROUP
/begin GROUP CustDiagc.CalibrationPorts "MICROSAR RTE"
 /begin SUB_GROUP CustDiagc.DiagcMgrFltResp.Ary1D CustDiagc.EotLrngRackTrvlMin.Val CustDiagc.GmOvrlStMgrApaMfgEna.Logl CustDiagc.GmOvrlStMgrEscMfgEna.Logl CustDiagc.GmOvrlStMgrLkaMfgEna.Logl CustDiagc.GmStrtStopEna.Logl /end SUB_GROUP
 /begin FUNCTION_LIST /end FUNCTION_LIST
 /begin REF_CHARACTERISTIC /end REF_CHARACTERISTIC
 /begin REF_MEASUREMENT /end REF_MEASUREMENT
/end GROUP
/begin GROUP CustDiagc.CpidActv "MICROSAR RTE" /begin SUB_GROUP /end SUB_GROUP /begin FUNCTION_LIST /end FUNCTION_LIST /begin REF_CHARACTERISTIC /end REF_CHARACTERISTIC /begin REF_MEASUREMENT CustDiagc.CpidActv /end REF_MEASUREMENT /end GROUP
/begin GROUP CustDiagc.CtrlrTRng.Val "MICROSAR RTE" /begin SUB_GROUP /end SUB_GROUP /begin FUNCTION_LIST /end FUNCTION_LIST /begin REF_CHARACTERISTIC /end REF_CHARACTERISTIC /begin REF_MEASUREMENT CustDiagc.CtrlrTRng.Val /end REF_MEASUREMENT /end GROUP
/begin GROUP CustDiagc.CustDiagcCtrlPidKeyAtmptCntr "MICROSAR RTE" /begin SUB_GROUP /end SUB_GROUP /begin FUNCTION_LIST /end FUNCTION_LIST /begin REF_CHARACTERISTIC /end REF_CHARACTERISTIC /begin REF_MEASUREMENT CustDiagc.CustDiagcCtrlPidKeyAtmptCntr /end REF_MEASUREMENT /end GROUP
/begin GROUP CustDiagc.CustDiagcCtrlPidSeedKeyTmr "MICROSAR RTE" /begin SUB_GROUP /end SUB_GROUP /begin FUNCTION_LIST /end FUNCTION_LIST /begin REF_CHARACTERISTIC /end REF_CHARACTERISTIC /begin REF_MEASUREMENT CustDiagc.CustDiagcCtrlPidSeedKeyTmr /end REF_MEASUREMENT /end GROUP
/begin GROUP CustDiagc.CustDiagcCtrlPidSeedReqd "MICROSAR RTE" /begin SUB_GROUP /end SUB_GROUP /begin FUNCTION_LIST /end FUNCTION_LIST /begin REF_CHARACTERISTIC /end REF_CHARACTERISTIC /begin REF_MEASUREMENT CustDiagc.CustDiagcCtrlPidSeedReqd /end REF_MEASUREMENT /end GROUP
/begin GROUP CustDiagc.CustDiagcCtrlPidSeedTmrActvd "MICROSAR RTE" /begin SUB_GROUP /end SUB_GROUP /begin FUNCTION_LIST /end FUNCTION_LIST /begin REF_CHARACTERISTIC /end REF_CHARACTERISTIC /begin REF_MEASUREMENT CustDiagc.CustDiagcCtrlPidSeedTmrActvd /end REF_MEASUREMENT /end GROUP
/begin GROUP CustDiagc.CustDiagcProgmSessionKeyAtmptCntr "MICROSAR RTE" /begin SUB_GROUP /end SUB_GROUP /begin FUNCTION_LIST /end FUNCTION_LIST /begin REF_CHARACTERISTIC /end REF_CHARACTERISTIC /begin REF_MEASUREMENT CustDiagc.CustDiagcProgmSessionKeyAtmptCntr /end REF_MEASUREMENT /end GROUP
/begin GROUP CustDiagc.CustDiagcProgmSessionSeedKeyTmr "MICROSAR RTE" /begin SUB_GROUP /end SUB_GROUP /begin FUNCTION_LIST /end FUNCTION_LIST /begin REF_CHARACTERISTIC /end REF_CHARACTERISTIC /begin REF_MEASUREMENT CustDiagc.CustDiagcProgmSessionSeedKeyTmr /end REF_MEASUREMENT /end GROUP
/begin GROUP CustDiagc.CustDiagcProgmSessionSeedReqd "MICROSAR RTE" /begin SUB_GROUP /end SUB_GROUP /begin FUNCTION_LIST /end FUNCTION_LIST /begin REF_CHARACTERISTIC /end REF_CHARACTERISTIC /begin REF_MEASUREMENT CustDiagc.CustDiagcProgmSessionSeedReqd /end REF_MEASUREMENT /end GROUP
/begin GROUP CustDiagc.CustDiagcProgmSessionSeedTmrActvd "MICROSAR RTE" /begin SUB_GROUP /end SUB_GROUP /begin FUNCTION_LIST /end FUNCTION_LIST /begin REF_CHARACTERISTIC /end REF_CHARACTERISTIC /begin REF_MEASUREMENT CustDiagc.CustDiagcProgmSessionSeedTmrActvd /end REF_MEASUREMENT /end GROUP
/begin GROUP CustDiagc.DesRtIdx.Val "MICROSAR RTE" /begin SUB_GROUP /end SUB_GROUP /begin FUNCTION_LIST /end FUNCTION_LIST /begin REF_CHARACTERISTIC /end REF_CHARACTERISTIC /begin REF_MEASUREMENT CustDiagc.DesRtIdx.Val /end REF_MEASUREMENT /end GROUP
/begin GROUP CustDiagc.DiagcMgrFltResp.Ary1D "MICROSAR RTE" /begin SUB_GROUP /end SUB_GROUP /begin FUNCTION_LIST /end FUNCTION_LIST /begin REF_CHARACTERISTIC CustDiagc.DiagcMgrFltResp.Ary1D /end REF_CHARACTERISTIC /begin REF_MEASUREMENT /end REF_MEASUREMENT /end GROUP
/begin GROUP CustDiagc.DtcNr "MICROSAR RTE" /begin SUB_GROUP /end SUB_GROUP /begin FUNCTION_LIST /end FUNCTION_LIST /begin REF_CHARACTERISTIC /end REF_CHARACTERISTIC /begin REF_MEASUREMENT CustDiagc.DtcNr /end REF_MEASUREMENT /end GROUP
/**********************************************************************************************************************
* RECORD_LAYOUT
*********************************************************************************************************************/
/begin RECORD_LAYOUT RTE_RL_UBYTE FNC_VALUES 1 UBYTE ROW_DIR DIRECT /end RECORD_LAYOUT
/begin RECORD_LAYOUT RTE_RL_UWORD FNC_VALUES 1 UWORD ROW_DIR DIRECT /end RECORD_LAYOUT
/begin RECORD_LAYOUT RTE_RL_ULONG FNC_VALUES 1 ULONG ROW_DIR DIRECT /end RECORD_LAYOUT
/begin RECORD_LAYOUT RTE_RL_SWORD FNC_VALUES 1 SWORD ROW_DIR DIRECT /end RECORD_LAYOUT
/begin RECORD_LAYOUT RTE_RL_FLOAT32_IEEE FNC_VALUES 1 FLOAT32_IEEE ROW_DIR DIRECT /end RECORD_LAYOUT
/begin RECORD_LAYOUT RTE_RL_BOOLEAN FNC_VALUES 1 UBYTE ROW_DIR DIRECT /end RECORD_LAYOUT
/**********************************************************************************************************************
* COMPU_METHOD / COMPU_VTAB_RANGE
*********************************************************************************************************************/
/begin COMPU_METHOD RTE_CM_BOOLEAN "" TAB_VERB "%3.1" "" COMPU_TAB_REF RTE_CM_BOOLEAN /end COMPU_METHOD
/begin COMPU_VTAB_RANGE RTE_CM_BOOLEAN "" 2 0 0 "false" 1 255 "true" /end COMPU_VTAB_RANGE
/begin COMPU_METHOD RTE_CM_ENUM_SysSt1 "" TAB_VERB "%.1" "" COMPU_TAB_REF RTE_CM_ENUM_SysSt1 /end COMPU_METHOD
/begin COMPU_VTAB_RANGE RTE_CM_ENUM_SysSt1 "" 4 0 0 "SYSST_DI" 1 1 "SYSST_OFF" 2 2 "SYSST_ENA" 3 3 "SYSST_WRMININ" /end COMPU_VTAB_RANGE
/begin COMPU_METHOD RTE_CM_ENUM_SigQlfr1 "" TAB_VERB "%.1" "" COMPU_TAB_REF RTE_CM_ENUM_SigQlfr1 /end COMPU_METHOD
/begin COMPU_VTAB_RANGE RTE_CM_ENUM_SigQlfr1 "" 3 0 0 "SIGQLFR_NORES" 1 1 "SIGQLFR_PASSD" 2 2 "SIGQLFR_FAILD" /end COMPU_VTAB_RANGE
/begin COMPU_METHOD RTE_CM_ENUM_MotCurrEolCalSt2 "" TAB_VERB "%.1" "" COMPU_TAB_REF RTE_CM_ENUM_MotCurrEolCalSt2 /end COMPU_METHOD
/begin COMPU_VTAB_RANGE RTE_CM_ENUM_MotCurrEolCalSt2 "" 9 0 0 "MCECS_OFFSCMDSTRT" 1 1 "MCECS_OFFSCMDHI" 2 2 "MCECS_OFFSCMDLO" 3 3 "MCECS_OFFSCMDZERO" 4 4 "MCECS_OFFSCMDEND" 5 5 "MCECS_GAINCMDAD" 6 6 "MCECS_GAINCMDBE" 7 7 "MCECS_GAINCMDCF" 8 8 "MCECS_CMDSAFEST" /end COMPU_VTAB_RANGE
