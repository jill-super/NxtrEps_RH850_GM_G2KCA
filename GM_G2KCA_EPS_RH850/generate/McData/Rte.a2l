/**********************************************************************************************************************
* COPYRIGHT
* Copyright (c) 2006-2015 by Vector Informatik GmbH. All rights reserved.
* This software is copyright protected and proprietary to Vector Informatik GmbH.
* Vector Informatik GmbH grants to you only those rights as set out in the license conditions.
* All other rights remain with Vector Informatik GmbH.
* FILE DESCRIPTION
* File: Rte.a2l
* Config: EPS.dpa
* ECU-Project: EPS
* Generator: MICROSAR RTE Generator Version 4.8.0
* RTE Core Version 1.8.0
* License: Unlimited license CBD1400351 for Nexteer Automotive Corporation
* Description: MICROSAR RTE A2L file
*********************************************************************************************************************/
/**********************************************************************************************************************
* CHARACTERISTIC
*********************************************************************************************************************/
/begin CHARACTERISTIC Assi.AssiMotTqWhlImbRejctnMaxX.Ary2D "MICROSAR RTE" VAL_BLK 0x0 RTE_RL_UWORD 0 RTE_CM_Tq6 0 0 MATRIX_DIM 20 12 1 SYMBOL_LINK "Rte_CalprmRom_CalRegn03Rt00GroupB_DEFAULT_RTE_CALPRM_GROUP.AssiMotTqWhlImbRejctnMaxX_Ary2D" 0 DISPLAY_IDENTIFIER Assi.CalibrationPorts.AssiMotTqWhlImbRejctnMaxX.Ary2D /end CHARACTERISTIC
/begin CHARACTERISTIC Assi.AssiMotTqWhlImbRejctnMaxY.Ary2D "MICROSAR RTE" VAL_BLK 0x0 RTE_RL_SWORD 0 RTE_CM_Tq11 0 0 MATRIX_DIM 20 12 1 SYMBOL_LINK "Rte_CalprmRom_CalRegn03Rt00GroupB_DEFAULT_RTE_CALPRM_GROUP.AssiMotTqWhlImbRejctnMaxY_Ary2D" 0 DISPLAY_IDENTIFIER Assi.CalibrationPorts.AssiMotTqWhlImbRejctnMaxY.Ary2D /end CHARACTERISTIC
/begin CHARACTERISTIC Assi.AssiMotTqWhlImbRejctnMinX.Ary2D "MICROSAR RTE" VAL_BLK 0x0 RTE_RL_UWORD 0 RTE_CM_Tq6 0 0 MATRIX_DIM 20 12 1 SYMBOL_LINK "Rte_CalprmRom_CalRegn03Rt00GroupA_DEFAULT_RTE_CALPRM_GROUP.AssiMotTqWhlImbRejctnMinX_Ary2D" 0 DISPLAY_IDENTIFIER Assi.CalibrationPorts.AssiMotTqWhlImbRejctnMinX.Ary2D /end CHARACTERISTIC
/begin CHARACTERISTIC Assi.AssiMotTqWhlImbRejctnMinY.Ary2D "MICROSAR RTE" VAL_BLK 0x0 RTE_RL_SWORD 0 RTE_CM_Tq11 0 0 MATRIX_DIM 20 12 1 SYMBOL_LINK "Rte_CalprmRom_CalRegn03Rt00GroupA_DEFAULT_RTE_CALPRM_GROUP.AssiMotTqWhlImbRejctnMinY_Ary2D" 0 DISPLAY_IDENTIFIER Assi.CalibrationPorts.AssiMotTqWhlImbRejctnMinY.Ary2D /end CHARACTERISTIC
/begin CHARACTERISTIC Assi.AssiThermScaX.Ary1D "MICROSAR RTE" VAL_BLK 0x0 RTE_RL_UWORD 0 NO_COMPU_METHOD 0.0 200.0 MATRIX_DIM 2 1 1 SYMBOL_LINK "Rte_CalprmRom_CalRegn03CmnGroupA_DEFAULT_RTE_CALPRM_GROUP.AssiThermScaX_Ary1D" 0 DISPLAY_IDENTIFIER Assi.CalibrationPorts.AssiThermScaX.Ary1D /end CHARACTERISTIC
/begin CHARACTERISTIC Assi.AssiThermScaY.Ary1D "MICROSAR RTE" VAL_BLK 0x0 RTE_RL_UWORD 0 RTE_CM_Uls4 0 0 MATRIX_DIM 2 1 1 SYMBOL_LINK "Rte_CalprmRom_CalRegn03CmnGroupA_DEFAULT_RTE_CALPRM_GROUP.AssiThermScaY_Ary1D" 0 DISPLAY_IDENTIFIER Assi.CalibrationPorts.AssiThermScaY.Ary1D /end CHARACTERISTIC
/begin CHARACTERISTIC Assi.AssiWhlImbRejctnBlndScaX.Ary2D "MICROSAR RTE" VAL_BLK 0x0 RTE_RL_UWORD 0 RTE_CM_Tq12 0 0 MATRIX_DIM 5 12 1 SYMBOL_LINK "Rte_CalprmRom_CalRegn03Rt00GroupB_DEFAULT_RTE_CALPRM_GROUP.AssiWhlImbRejctnBlndScaX_Ary2D" 0 DISPLAY_IDENTIFIER Assi.CalibrationPorts.AssiWhlImbRejctnBlndScaX.Ary2D /end CHARACTERISTIC
/begin CHARACTERISTIC Assi.AssiWhlImbRejctnBlndScaY.Ary2D "MICROSAR RTE" VAL_BLK 0x0 RTE_RL_UWORD 0 RTE_CM_Uls4 0 0 MATRIX_DIM 5 12 1 SYMBOL_LINK "Rte_CalprmRom_CalRegn03Rt00GroupB_DEFAULT_RTE_CALPRM_GROUP.AssiWhlImbRejctnBlndScaY_Ary2D" 0 DISPLAY_IDENTIFIER Assi.CalibrationPorts.AssiWhlImbRejctnBlndScaY.Ary2D /end CHARACTERISTIC
/begin CHARACTERISTIC Assi.SysGlbPrmVehSpd.Ary1D "MICROSAR RTE" VAL_BLK 0x0 RTE_RL_UWORD 0 RTE_CM_Spd2 0 0 MATRIX_DIM 12 1 1 SYMBOL_LINK "Rte_CalprmRom_CalRegn01Cmn_DEFAULT_RTE_CALPRM_GROUP.SysGlbPrmVehSpdBilnrSeln_Ary1D" 0 DISPLAY_IDENTIFIER Assi.CalibrationPorts.SysGlbPrmVehSpd.Ary1D /end CHARACTERISTIC
/begin CHARACTERISTIC Assi.SysGlbPrmVehSpdBilnrSeln.Ary1D "MICROSAR RTE" VAL_BLK 0x0 RTE_RL_UWORD 0 RTE_CM_Spd2 0 0 MATRIX_DIM 12 1 1 SYMBOL_LINK "Rte_CalprmRom_CalRegn01Cmn_DEFAULT_RTE_CALPRM_GROUP.SysGlbPrmVehSpdBilnrSeln_Ary1D" 0 DISPLAY_IDENTIFIER Assi.CalibrationPorts.SysGlbPrmVehSpdBilnrSeln.Ary1D /end CHARACTERISTIC
/begin CHARACTERISTIC AssiHiFrq.AssiHiFrqGainY.Ary2D "MICROSAR RTE" VAL_BLK 0x0 RTE_RL_UWORD 0 NO_COMPU_METHOD 0 65535 MATRIX_DIM 13 12 1 SYMBOL_LINK "Rte_CalprmRom_CalRegn03Rt00GroupA_DEFAULT_RTE_CALPRM_GROUP.AssiHiFrqGainY_Ary2D" 0 DISPLAY_IDENTIFIER AssiHiFrq.CalibrationPorts.AssiHiFrqGainY.Ary2D /end CHARACTERISTIC
/begin CHARACTERISTIC AssiHiFrq.AssiHiFrqHpFilFrqY.Ary1D "MICROSAR RTE" VAL_BLK 0x0 RTE_RL_UWORD 0 NO_COMPU_METHOD 0 65535 MATRIX_DIM 12 1 1 SYMBOL_LINK "Rte_CalprmRom_CalRegn03Cmn_DEFAULT_RTE_CALPRM_GROUP.AssiHiFrqHpFilFrqY_Ary1D" 0 DISPLAY_IDENTIFIER AssiHiFrq.CalibrationPorts.AssiHiFrqHpFilFrqY.Ary1D /end CHARACTERISTIC
/begin CHARACTERISTIC AssiHiFrq.AssiHiFrqTqWhlImbRejctnTqX.Ary2D "MICROSAR RTE" VAL_BLK 0x0 RTE_RL_UWORD 0 NO_COMPU_METHOD 0 65535 MATRIX_DIM 13 12 1 SYMBOL_LINK "Rte_CalprmRom_CalRegn03Rt00GroupB_DEFAULT_RTE_CALPRM_GROUP.AssiHiFrqTqWhlImbRejctnTqX_Ary2D" 0 DISPLAY_IDENTIFIER AssiHiFrq.CalibrationPorts.AssiHiFrqTqWhlImbRejctnTqX.Ary2D /end CHARACTERISTIC
/begin CHARACTERISTIC AssiHiFrq.AssiHiFrqTqX.Ary2D "MICROSAR RTE" VAL_BLK 0x0 RTE_RL_UWORD 0 NO_COMPU_METHOD 0 65535 MATRIX_DIM 13 12 1 SYMBOL_LINK "Rte_CalprmRom_CalRegn03Rt00GroupA_DEFAULT_RTE_CALPRM_GROUP.AssiHiFrqTqX_Ary2D" 0 DISPLAY_IDENTIFIER AssiHiFrq.CalibrationPorts.AssiHiFrqTqX.Ary2D /end CHARACTERISTIC
/begin CHARACTERISTIC AssiHiFrq.AssiHiFrqWhlImbRejctnGainY.Ary2D "MICROSAR RTE" VAL_BLK 0x0 RTE_RL_UWORD 0 NO_COMPU_METHOD 0 65535 MATRIX_DIM 13 12 1 SYMBOL_LINK "Rte_CalprmRom_CalRegn03Rt00GroupB_DEFAULT_RTE_CALPRM_GROUP.AssiHiFrqWhlImbRejctnGainY_Ary2D" 0 DISPLAY_IDENTIFIER AssiHiFrq.CalibrationPorts.AssiHiFrqWhlImbRejctnGainY.Ary2D /end CHARACTERISTIC
/begin CHARACTERISTIC AssiHiFrq.AssiHiFrqWhlImbRejtcnBlndX.Ary2D "MICROSAR RTE" VAL_BLK 0x0 RTE_RL_UWORD 0 NO_COMPU_METHOD 0 65535 MATRIX_DIM 5 12 1 SYMBOL_LINK "Rte_CalprmRom_CalRegn03Rt00GroupB_DEFAULT_RTE_CALPRM_GROUP.AssiHiFrqWhlImbRejtcnBlndX_Ary2D" 0 DISPLAY_IDENTIFIER AssiHiFrq.CalibrationPorts.AssiHiFrqWhlImbRejtcnBlndX.Ary2D /end CHARACTERISTIC
/begin CHARACTERISTIC AssiHiFrq.AssiHiFrqWhlImbRejtcnBlndY.Ary2D "MICROSAR RTE" VAL_BLK 0x0 RTE_RL_UWORD 0 NO_COMPU_METHOD 0 65535 MATRIX_DIM 5 12 1 SYMBOL_LINK "Rte_CalprmRom_CalRegn03Rt00GroupB_DEFAULT_RTE_CALPRM_GROUP.AssiHiFrqWhlImbRejtcnBlndY_Ary2D" 0 DISPLAY_IDENTIFIER AssiHiFrq.CalibrationPorts.AssiHiFrqWhlImbRejtcnBlndY.Ary2D /end CHARACTERISTIC
/begin CHARACTERISTIC AssiHiFrq.SysGlbPrmVehSpdBilnrSeln.Ary1D "MICROSAR RTE" VAL_BLK 0x0 RTE_RL_UWORD 0 NO_COMPU_METHOD 0 65535 MATRIX_DIM 12 1 1 SYMBOL_LINK "Rte_CalprmRom_CalRegn01Cmn_DEFAULT_RTE_CALPRM_GROUP.SysGlbPrmVehSpdBilnrSeln_Ary1D" 0 DISPLAY_IDENTIFIER AssiHiFrq.CalibrationPorts.SysGlbPrmVehSpdBilnrSeln.Ary1D /end CHARACTERISTIC
/begin CHARACTERISTIC AssiPahFwl.AssiPahFwlCmdSplitLpFilFrq.Val "MICROSAR RTE" VALUE 0x0 RTE_RL_FLOAT32_IEEE 0 NO_COMPU_METHOD -3.402823466e+38 3.402823466e+38 SYMBOL_LINK "Rte_CalprmRom_CalRegn01Inin00_DEFAULT_RTE_CALPRM_GROUP.AssiPahFwlCmdSplitLpFilFrq_Val" 0 DISPLAY_IDENTIFIER AssiPahFwl.CalibrationPorts.AssiPahFwlCmdSplitLpFilFrq.Val /end CHARACTERISTIC
/begin CHARACTERISTIC AssiPahFwl.AssiPahFwlDftAssiX.Ary1D "MICROSAR RTE" VAL_BLK 0x0 RTE_RL_UWORD 0 NO_COMPU_METHOD 0 65535 MATRIX_DIM 20 1 1 SYMBOL_LINK "Rte_CalprmRom_CalRegn01Inin00_DEFAULT_RTE_CALPRM_GROUP.AssiPahFwlDftAssiX_Ary1D" 0 DISPLAY_IDENTIFIER AssiPahFwl.CalibrationPorts.AssiPahFwlDftAssiX.Ary1D /end CHARACTERISTIC
/begin CHARACTERISTIC AssiPahFwl.AssiPahFwlDftAssiY.Ary1D "MICROSAR RTE" VAL_BLK 0x0 RTE_RL_SWORD 0 NO_COMPU_METHOD -32768 32767 MATRIX_DIM 20 1 1 SYMBOL_LINK "Rte_CalprmRom_CalRegn01Inin00_DEFAULT_RTE_CALPRM_GROUP.AssiPahFwlDftAssiY_Ary1D" 0 DISPLAY_IDENTIFIER AssiPahFwl.CalibrationPorts.AssiPahFwlDftAssiY.Ary1D /end CHARACTERISTIC
/begin CHARACTERISTIC AssiPahFwl.AssiPahFwlDiRcvr.Logl "MICROSAR RTE" VALUE 0x0 RTE_RL_BOOLEAN 0 RTE_CM_BOOLEAN 0 255 SYMBOL_LINK "Rte_CalprmRom_CalRegn01Cmn_DEFAULT_RTE_CALPRM_GROUP.AssiPahFwlDiRcvr_Logl" 0 DISPLAY_IDENTIFIER AssiPahFwl.CalibrationPorts.AssiPahFwlDiRcvr.Logl /end CHARACTERISTIC
/begin CHARACTERISTIC AssiPahFwl.AssiPahFwlFwlActvLpFilFrq.Val "MICROSAR RTE" VALUE 0x0 RTE_RL_FLOAT32_IEEE 0 NO_COMPU_METHOD -3.402823466e+38 3.402823466e+38 SYMBOL_LINK "Rte_CalprmRom_CalRegn01Inin00_DEFAULT_RTE_CALPRM_GROUP.AssiPahFwlFwlActvLpFilFrq_Val" 0 DISPLAY_IDENTIFIER AssiPahFwl.CalibrationPorts.AssiPahFwlFwlActvLpFilFrq.Val /end CHARACTERISTIC
/begin CHARACTERISTIC AssiPahFwl.AssiPahFwlHiFrqUpprLimY.Ary2D "MICROSAR RTE" VAL_BLK 0x0 RTE_RL_SWORD 0 NO_COMPU_METHOD -32768 32767 MATRIX_DIM 11 12 1 SYMBOL_LINK "Rte_CalprmRom_CalRegn01Inin00_DEFAULT_RTE_CALPRM_GROUP.AssiPahFwlHiFrqUpprLimY_Ary2D" 0 DISPLAY_IDENTIFIER AssiPahFwl.CalibrationPorts.AssiPahFwlHiFrqUpprLimY.Ary2D /end CHARACTERISTIC
/begin CHARACTERISTIC AssiPahFwl.AssiPahFwlHysCmpLim.Val "MICROSAR RTE" VALUE 0x0 RTE_RL_FLOAT32_IEEE 0 NO_COMPU_METHOD -3.402823466e+38 3.402823466e+38 SYMBOL_LINK "Rte_CalprmRom_CalRegn01Inin00_DEFAULT_RTE_CALPRM_GROUP.AssiPahFwlHysCmpLim_Val" 0 DISPLAY_IDENTIFIER AssiPahFwl.CalibrationPorts.AssiPahFwlHysCmpLim.Val /end CHARACTERISTIC
/begin CHARACTERISTIC AssiPahFwl.AssiPahFwlRestoreThd.Val "MICROSAR RTE" VALUE 0x0 RTE_RL_FLOAT32_IEEE 0 NO_COMPU_METHOD -3.402823466e+38 3.402823466e+38 SYMBOL_LINK "Rte_CalprmRom_CalRegn01Inin00_DEFAULT_RTE_CALPRM_GROUP.AssiPahFwlRestoreThd_Val" 0 DISPLAY_IDENTIFIER AssiPahFwl.CalibrationPorts.AssiPahFwlRestoreThd.Val /end CHARACTERISTIC
/begin CHARACTERISTIC AssiPahFwl.AssiPahFwlUpprLimX.Ary2D "MICROSAR RTE" VAL_BLK 0x0 RTE_RL_SWORD 0 NO_COMPU_METHOD -32768 32767 MATRIX_DIM 11 12 1 SYMBOL_LINK "Rte_CalprmRom_CalRegn01Inin00_DEFAULT_RTE_CALPRM_GROUP.AssiPahFwlUpprLimX_Ary2D" 0 DISPLAY_IDENTIFIER AssiPahFwl.CalibrationPorts.AssiPahFwlUpprLimX.Ary2D /end CHARACTERISTIC
/begin CHARACTERISTIC AssiPahFwl.AssiPahFwlUpprLimY.Ary2D "MICROSAR RTE" VAL_BLK 0x0 RTE_RL_SWORD 0 NO_COMPU_METHOD -32768 32767 MATRIX_DIM 11 12 1 SYMBOL_LINK "Rte_CalprmRom_CalRegn01Inin00_DEFAULT_RTE_CALPRM_GROUP.AssiPahFwlUpprLimY_Ary2D" 0 DISPLAY_IDENTIFIER AssiPahFwl.CalibrationPorts.AssiPahFwlUpprLimY.Ary2D /end CHARACTERISTIC
/begin CHARACTERISTIC AssiPahFwl.AssiPahFwlVehSpd.Ary1D "MICROSAR RTE" VAL_BLK 0x0 RTE_RL_UWORD 0 NO_COMPU_METHOD 0 65535 MATRIX_DIM 12 1 1 SYMBOL_LINK "Rte_CalprmRom_CalRegn01Cmn_DEFAULT_RTE_CALPRM_GROUP.AssiPahFwlVehSpd_Ary1D" 0 DISPLAY_IDENTIFIER AssiPahFwl.CalibrationPorts.AssiPahFwlVehSpd.Ary1D /end CHARACTERISTIC
/begin CHARACTERISTIC AssiPahFwl.BasAssiPahFwlOverLimDiagcFailStep.Val "MICROSAR RTE" VALUE 0x0 RTE_RL_UWORD 0 NO_COMPU_METHOD 0 65535 SYMBOL_LINK "Rte_CalprmRom_CalRegn01Cmn_DEFAULT_RTE_CALPRM_GROUP.BasAssiPahFwlOverLimDiagcFailStep_Val" 0 DISPLAY_IDENTIFIER AssiPahFwl.CalibrationPorts.BasAssiPahFwlOverLimDiagcFailStep.Val /end CHARACTERISTIC
/begin CHARACTERISTIC AssiPahFwl.BasAssiPahFwlOverLimDiagcPassStep.Val "MICROSAR RTE" VALUE 0x0 RTE_RL_UWORD 0 NO_COMPU_METHOD 0 65535 SYMBOL_LINK "Rte_CalprmRom_CalRegn01Cmn_DEFAULT_RTE_CALPRM_GROUP.BasAssiPahFwlOverLimDiagcPassStep_Val" 0 DISPLAY_IDENTIFIER AssiPahFwl.CalibrationPorts.BasAssiPahFwlOverLimDiagcPassStep.Val /end CHARACTERISTIC
/begin CHARACTERISTIC AssiPahFwl.HiFrqAssiPahFwlOverLimDiagcFailStep.Val "MICROSAR RTE" VALUE 0x0 RTE_RL_UWORD 0 NO_COMPU_METHOD 0 65535 SYMBOL_LINK "Rte_CalprmRom_CalRegn01Cmn_DEFAULT_RTE_CALPRM_GROUP.HiFrqAssiPahFwlOverLimDiagcFailStep_Val" 0 DISPLAY_IDENTIFIER AssiPahFwl.CalibrationPorts.HiFrqAssiPahFwlOverLimDiagcFailStep.Val /end CHARACTERISTIC
/begin CHARACTERISTIC AssiPahFwl.HiFrqAssiPahFwlOverLimDiagcPassStep.Val "MICROSAR RTE" VALUE 0x0 RTE_RL_UWORD 0 NO_COMPU_METHOD 0 65535 SYMBOL_LINK "Rte_CalprmRom_CalRegn01Cmn_DEFAULT_RTE_CALPRM_GROUP.HiFrqAssiPahFwlOverLimDiagcPassStep_Val" 0 DISPLAY_IDENTIFIER AssiPahFwl.CalibrationPorts.HiFrqAssiPahFwlOverLimDiagcPassStep.Val /end CHARACTERISTIC
/begin CHARACTERISTIC AssiSumLim.AssiSumLimNtc0x0C4FailStep.Val "MICROSAR RTE" VALUE 0x0 RTE_RL_UWORD 0 NO_COMPU_METHOD 0 65535 SYMBOL_LINK "Rte_CalprmRom_CalRegn01Cmn_DEFAULT_RTE_CALPRM_GROUP.AssiSumLimNtc0x0C4FailStep_Val" 0 DISPLAY_IDENTIFIER AssiSumLim.CalibrationPorts.AssiSumLimNtc0x0C4FailStep.Val /end CHARACTERISTIC
/begin CHARACTERISTIC AssiSumLim.AssiSumLimNtc0x0C4PassStep.Val "MICROSAR RTE" VALUE 0x0 RTE_RL_UWORD 0 NO_COMPU_METHOD 0 65535 SYMBOL_LINK "Rte_CalprmRom_CalRegn01Cmn_DEFAULT_RTE_CALPRM_GROUP.AssiSumLimNtc0x0C4PassStep_Val" 0 DISPLAY_IDENTIFIER AssiSumLim.CalibrationPorts.AssiSumLimNtc0x0C4PassStep.Val /end CHARACTERISTIC
/begin CHARACTERISTIC AssiSumLim.AssiSumLimPullCmpLim.Val "MICROSAR RTE" VALUE 0x0 RTE_RL_FLOAT32_IEEE 0 NO_COMPU_METHOD 0 8.8 SYMBOL_LINK "Rte_CalprmRom_CalRegn01Cmn_DEFAULT_RTE_CALPRM_GROUP.AssiSumLimPullCmpLim_Val" 0 DISPLAY_IDENTIFIER AssiSumLim.CalibrationPorts.AssiSumLimPullCmpLim.Val /end CHARACTERISTIC
/begin CHARACTERISTIC BattVltg.BattVltgCorrlnSysMinVltg.Val "MICROSAR RTE" VALUE 0x0 RTE_RL_FLOAT32_IEEE 0 NO_COMPU_METHOD -3.402823466e+38 3.402823466e+38 SYMBOL_LINK "Rte_CalprmRom_CalRegn01Cmn_DEFAULT_RTE_CALPRM_GROUP.BattVltgCorrlnSysMinVltg_Val" 0 DISPLAY_IDENTIFIER BattVltg.CalibrationPorts.BattVltgCorrlnSysMinVltg.Val /end CHARACTERISTIC
/begin CHARACTERISTIC BattVltg.BattVltgSwdMax.Val "MICROSAR RTE" VALUE 0x0 RTE_RL_FLOAT32_IEEE 0 NO_COMPU_METHOD 6.0 26.5 SYMBOL_LINK "Rte_CalprmRom_CalRegn01Cmn_DEFAULT_RTE_CALPRM_GROUP.BattVltgSwdMax_Val" 0 DISPLAY_IDENTIFIER BattVltg.CalibrationPorts.BattVltgSwdMax.Val /end CHARACTERISTIC
/begin CHARACTERISTIC BattVltg.BrdgVltgMax.Val "MICROSAR RTE" VALUE 0x0 RTE_RL_FLOAT32_IEEE 0 NO_COMPU_METHOD -3.402823466e+38 3.402823466e+38 SYMBOL_LINK "Rte_CalprmRom_CalRegn01Cmn_DEFAULT_RTE_CALPRM_GROUP.BrdgVltgMax_Val" 0 DISPLAY_IDENTIFIER BattVltg.CalibrationPorts.BrdgVltgMax.Val /end CHARACTERISTIC
/begin CHARACTERISTIC BattVltgCorrln.BattVltgCorrlnAllwdVltgDif.Val "MICROSAR RTE" VALUE 0x0 RTE_RL_FLOAT32_IEEE 0 NO_COMPU_METHOD -3.402823466e+38 3.402823466e+38 SYMBOL_LINK "Rte_CalprmRom_CalRegn01Cmn_DEFAULT_RTE_CALPRM_GROUP.BattVltgCorrlnAllwdVltgDif_Val" 0 DISPLAY_IDENTIFIER BattVltgCorrln.CalibrationPorts.BattVltgCorrlnAllwdVltgDif.Val /end CHARACTERISTIC
/begin CHARACTERISTIC BattVltgCorrln.BattVltgCorrlnBattLoVltg.Val "MICROSAR RTE" VALUE 0x0 RTE_RL_FLOAT32_IEEE 0 NO_COMPU_METHOD -3.402823466e+38 3.402823466e+38 SYMBOL_LINK "Rte_CalprmRom_CalRegn01Cmn_DEFAULT_RTE_CALPRM_GROUP.BattVltgCorrlnBattLoVltg_Val" 0 DISPLAY_IDENTIFIER BattVltgCorrln.CalibrationPorts.BattVltgCorrlnBattLoVltg.Val /end CHARACTERISTIC
/begin CHARACTERISTIC BattVltgCorrln.BattVltgCorrlnBattOverVltg.Val "MICROSAR RTE" VALUE 0x0 RTE_RL_FLOAT32_IEEE 0 NO_COMPU_METHOD -3.402823466e+38 3.402823466e+38 SYMBOL_LINK "Rte_CalprmRom_CalRegn01Cmn_DEFAULT_RTE_CALPRM_GROUP.BattVltgCorrlnBattOverVltg_Val" 0 DISPLAY_IDENTIFIER BattVltgCorrln.CalibrationPorts.BattVltgCorrlnBattOverVltg.Val /end CHARACTERISTIC
/begin CHARACTERISTIC BattVltgCorrln.BattVltgCorrlnBattUnderVltg.Val "MICROSAR RTE" VALUE 0x0 RTE_RL_FLOAT32_IEEE 0 NO_COMPU_METHOD -3.402823466e+38 3.402823466e+38 SYMBOL_LINK "Rte_CalprmRom_CalRegn01Cmn_DEFAULT_RTE_CALPRM_GROUP.BattVltgCorrlnBattUnderVltg_Val" 0 DISPLAY_IDENTIFIER BattVltgCorrln.CalibrationPorts.BattVltgCorrlnBattUnderVltg.Val /end CHARACTERISTIC
/begin CHARACTERISTIC BattVltgCorrln.BattVltgCorrlnNtc0x03C0x0440x04CFailStep.Val "MICROSAR RTE" VALUE 0x0 RTE_RL_UWORD 0 NO_COMPU_METHOD 0 65535 SYMBOL_LINK "Rte_CalprmRom_CalRegn01Cmn_DEFAULT_RTE_CALPRM_GROUP.BattVltgCorrlnNtc0x03C0x0440x04CFailStep_Val" 0 DISPLAY_IDENTIFIER BattVltgCorrln.CalibrationPorts.BattVltgCorrlnNtc0x03C0x0440x04CFailStep.Val /end CHARACTERISTIC
/begin CHARACTERISTIC BattVltgCorrln.BattVltgCorrlnNtc0x03C0x0440x04CPassStep.Val "MICROSAR RTE" VALUE 0x0 RTE_RL_UWORD 0 NO_COMPU_METHOD 0 65535 SYMBOL_LINK "Rte_CalprmRom_CalRegn01Cmn_DEFAULT_RTE_CALPRM_GROUP.BattVltgCorrlnNtc0x03C0x0440x04CPassStep_Val" 0 DISPLAY_IDENTIFIER BattVltgCorrln.CalibrationPorts.BattVltgCorrlnNtc0x03C0x0440x04CPassStep.Val /end CHARACTERISTIC
/begin CHARACTERISTIC BattVltgCorrln.BattVltgCorrlnNtc0x03DFailStep.Val "MICROSAR RTE" VALUE 0x0 RTE_RL_UWORD 0 NO_COMPU_METHOD 0 65535 SYMBOL_LINK "Rte_CalprmRom_CalRegn01Cmn_DEFAULT_RTE_CALPRM_GROUP.BattVltgCorrlnNtc0x03DFailStep_Val" 0 DISPLAY_IDENTIFIER BattVltgCorrln.CalibrationPorts.BattVltgCorrlnNtc0x03DFailStep.Val /end CHARACTERISTIC
/begin CHARACTERISTIC BattVltgCorrln.BattVltgCorrlnNtc0x03DPassStep.Val "MICROSAR RTE" VALUE 0x0 RTE_RL_UWORD 0 NO_COMPU_METHOD 0 65535 SYMBOL_LINK "Rte_CalprmRom_CalRegn01Cmn_DEFAULT_RTE_CALPRM_GROUP.BattVltgCorrlnNtc0x03DPassStep_Val" 0 DISPLAY_IDENTIFIER BattVltgCorrln.CalibrationPorts.BattVltgCorrlnNtc0x03DPassStep.Val /end CHARACTERISTIC
/begin CHARACTERISTIC BattVltgCorrln.BattVltgCorrlnNtc0x0B0FailStep.Val "MICROSAR RTE" VALUE 0x0 RTE_RL_UWORD 0 NO_COMPU_METHOD 0 65535 SYMBOL_LINK "Rte_CalprmRom_CalRegn01Cmn_DEFAULT_RTE_CALPRM_GROUP.BattVltgCorrlnNtc0x0B0FailStep_Val" 0 DISPLAY_IDENTIFIER BattVltgCorrln.CalibrationPorts.BattVltgCorrlnNtc0x0B0FailStep.Val /end CHARACTERISTIC
/begin CHARACTERISTIC BattVltgCorrln.BattVltgCorrlnNtc0x0B0PassStep.Val "MICROSAR RTE" VALUE 0x0 RTE_RL_UWORD 0 NO_COMPU_METHOD 0 65535 SYMBOL_LINK "Rte_CalprmRom_CalRegn01Cmn_DEFAULT_RTE_CALPRM_GROUP.BattVltgCorrlnNtc0x0B0PassStep_Val" 0 DISPLAY_IDENTIFIER BattVltgCorrln.CalibrationPorts.BattVltgCorrlnNtc0x0B0PassStep.Val /end CHARACTERISTIC
/begin CHARACTERISTIC BattVltgCorrln.BattVltgCorrlnNtc0x0B1FailStep.Val "MICROSAR RTE" VALUE 0x0 RTE_RL_UWORD 0 NO_COMPU_METHOD 0 65535 SYMBOL_LINK "Rte_CalprmRom_CalRegn01Cmn_DEFAULT_RTE_CALPRM_GROUP.BattVltgCorrlnNtc0x0B1FailStep_Val" 0 DISPLAY_IDENTIFIER BattVltgCorrln.CalibrationPorts.BattVltgCorrlnNtc0x0B1FailStep.Val /end CHARACTERISTIC
/begin CHARACTERISTIC BattVltgCorrln.BattVltgCorrlnNtc0x0B1PassStep.Val "MICROSAR RTE" VALUE 0x0 RTE_RL_UWORD 0 NO_COMPU_METHOD 0 65535 SYMBOL_LINK "Rte_CalprmRom_CalRegn01Cmn_DEFAULT_RTE_CALPRM_GROUP.BattVltgCorrlnNtc0x0B1PassStep_Val" 0 DISPLAY_IDENTIFIER BattVltgCorrln.CalibrationPorts.BattVltgCorrlnNtc0x0B1PassStep.Val /end CHARACTERISTIC
/begin CHARACTERISTIC BattVltgCorrln.BattVltgCorrlnNtc0x0B5FailStep.Val "MICROSAR RTE" VALUE 0x0 RTE_RL_UWORD 0 NO_COMPU_METHOD 0 65535 SYMBOL_LINK "Rte_CalprmRom_CalRegn01Cmn_DEFAULT_RTE_CALPRM_GROUP.BattVltgCorrlnNtc0x0B5FailStep_Val" 0 DISPLAY_IDENTIFIER BattVltgCorrln.CalibrationPorts.BattVltgCorrlnNtc0x0B5FailStep.Val /end CHARACTERISTIC
/begin CHARACTERISTIC BattVltgCorrln.BattVltgCorrlnNtc0x0B5PassStep.Val "MICROSAR RTE" VALUE 0x0 RTE_RL_UWORD 0 NO_COMPU_METHOD 0 65535 SYMBOL_LINK "Rte_CalprmRom_CalRegn01Cmn_DEFAULT_RTE_CALPRM_GROUP.BattVltgCorrlnNtc0x0B5PassStep_Val" 0 DISPLAY_IDENTIFIER BattVltgCorrln.CalibrationPorts.BattVltgCorrlnNtc0x0B5PassStep.Val /end CHARACTERISTIC
/begin CHARACTERISTIC BattVltgCorrln.BattVltgCorrlnRcvrlBattLoVltg.Val "MICROSAR RTE" VALUE 0x0 RTE_RL_FLOAT32_IEEE 0 NO_COMPU_METHOD -3.402823466e+38 3.402823466e+38 SYMBOL_LINK "Rte_CalprmRom_CalRegn01Cmn_DEFAULT_RTE_CALPRM_GROUP.BattVltgCorrlnRcvrlBattLoVltg_Val" 0 DISPLAY_IDENTIFIER BattVltgCorrln.CalibrationPorts.BattVltgCorrlnRcvrlBattLoVltg.Val /end CHARACTERISTIC
/begin CHARACTERISTIC BattVltgCorrln.BattVltgCorrlnRcvrlBattOverVltg.Val "MICROSAR RTE" VALUE 0x0 RTE_RL_FLOAT32_IEEE 0 NO_COMPU_METHOD -3.402823466e+38 3.402823466e+38 SYMBOL_LINK "Rte_CalprmRom_CalRegn01Cmn_DEFAULT_RTE_CALPRM_GROUP.BattVltgCorrlnRcvrlBattOverVltg_Val" 0 DISPLAY_IDENTIFIER BattVltgCorrln.CalibrationPorts.BattVltgCorrlnRcvrlBattOverVltg.Val /end CHARACTERISTIC
/begin CHARACTERISTIC BattVltgCorrln.BattVltgCorrlnRcvrlBattUnderVltg.Val "MICROSAR RTE" VALUE 0x0 RTE_RL_FLOAT32_IEEE 0 NO_COMPU_METHOD -3.402823466e+38 3.402823466e+38 SYMBOL_LINK "Rte_CalprmRom_CalRegn01Cmn_DEFAULT_RTE_CALPRM_GROUP.BattVltgCorrlnRcvrlBattUnderVltg_Val" 0 DISPLAY_IDENTIFIER BattVltgCorrln.CalibrationPorts.BattVltgCorrlnRcvrlBattUnderVltg.Val /end CHARACTERISTIC
/begin CHARACTERISTIC BattVltgCorrln.BattVltgCorrlnSysMinVltg.Val "MICROSAR RTE" VALUE 0x0 RTE_RL_FLOAT32_IEEE 0 NO_COMPU_METHOD -3.402823466e+38 3.402823466e+38 SYMBOL_LINK "Rte_CalprmRom_CalRegn01Cmn_DEFAULT_RTE_CALPRM_GROUP.BattVltgCorrlnSysMinVltg_Val" 0 DISPLAY_IDENTIFIER BattVltgCorrln.CalibrationPorts.BattVltgCorrlnSysMinVltg.Val /end CHARACTERISTIC
/begin CHARACTERISTIC BattVltgCorrln.BattVltgSwdMax.Val "MICROSAR RTE" VALUE 0x0 RTE_RL_FLOAT32_IEEE 0 NO_COMPU_METHOD -3.402823466e+38 3.402823466e+38 SYMBOL_LINK "Rte_CalprmRom_CalRegn01Cmn_DEFAULT_RTE_CALPRM_GROUP.BattVltgSwdMax_Val" 0 DISPLAY_IDENTIFIER BattVltgCorrln.CalibrationPorts.BattVltgSwdMax.Val /end CHARACTERISTIC
/begin CHARACTERISTIC CDD_AdcDiagc.AdcDiagcNtc0x032FailStep.Val "MICROSAR RTE" VALUE 0x0 RTE_RL_UWORD 0 NO_COMPU_METHOD 0 65535 SYMBOL_LINK "Rte_CalprmRom_CalRegn01Cmn_DEFAULT_RTE_CALPRM_GROUP.AdcDiagcNtc0x032FailStep_Val" 0 DISPLAY_IDENTIFIER CDD_AdcDiagc.CalibrationPorts.AdcDiagcNtc0x032FailStep.Val /end CHARACTERISTIC
/begin CHARACTERISTIC CDD_AdcDiagc.AdcDiagcNtc0x032PassStep.Val "MICROSAR RTE" VALUE 0x0 RTE_RL_UWORD 0 NO_COMPU_METHOD 0 65535 SYMBOL_LINK "Rte_CalprmRom_CalRegn01Cmn_DEFAULT_RTE_CALPRM_GROUP.AdcDiagcNtc0x032PassStep_Val" 0 DISPLAY_IDENTIFIER CDD_AdcDiagc.CalibrationPorts.AdcDiagcNtc0x032PassStep.Val /end CHARACTERISTIC
/begin CHARACTERISTIC CDD_AdcDiagc.AdcDiagcNtc0x033FailStep.Val "MICROSAR RTE" VALUE 0x0 RTE_RL_UWORD 0 NO_COMPU_METHOD 0 65535 SYMBOL_LINK "Rte_CalprmRom_CalRegn01Cmn_DEFAULT_RTE_CALPRM_GROUP.AdcDiagcNtc0x033FailStep_Val" 0 DISPLAY_IDENTIFIER CDD_AdcDiagc.CalibrationPorts.AdcDiagcNtc0x033FailStep.Val /end CHARACTERISTIC
/begin CHARACTERISTIC CDD_AdcDiagc.AdcDiagcNtc0x033PassStep.Val "MICROSAR RTE" VALUE 0x0 RTE_RL_UWORD 0 NO_COMPU_METHOD 0 65535 SYMBOL_LINK "Rte_CalprmRom_CalRegn01Cmn_DEFAULT_RTE_CALPRM_GROUP.AdcDiagcNtc0x033PassStep_Val" 0 DISPLAY_IDENTIFIER CDD_AdcDiagc.CalibrationPorts.AdcDiagcNtc0x033PassStep.Val /end CHARACTERISTIC
/begin CHARACTERISTIC CDD_CurrMeas.CurrMeasEolFixdPwmPerd.Val "MICROSAR RTE" VALUE 0x0 RTE_RL_ULONG 0 NO_COMPU_METHOD 0 4294967295 SYMBOL_LINK "Rte_CalprmRom_CalRegn01Cmn_DEFAULT_RTE_CALPRM_GROUP.CurrMeasEolFixdPwmPerd_Val" 0 DISPLAY_IDENTIFIER CDD_CurrMeas.CalibrationPorts.CurrMeasEolFixdPwmPerd.Val /end CHARACTERISTIC
/begin CHARACTERISTIC CDD_CurrMeas.CurrMeasEolGainCalSetDft.CurrMeasMotCurrEolGainA "MICROSAR RTE" VALUE 0x0 RTE_RL_FLOAT32_IEEE 0 NO_COMPU_METHOD -3.402823466e+38 3.402823466e+38 SYMBOL_LINK "Rte_CalprmRom_CDD_CurrMeas_DEFAULT_RTE_CDATA_GROUP.CurrMeasEolGainCalSetDft.CurrMeasMotCurrEolGainA" 0 DISPLAY_IDENTIFIER CDD_CurrMeas.CalibrationParameters.CurrMeasEolGainCalSetDft.CurrMeasMotCurrEolGainA /end CHARACTERISTIC
/begin CHARACTERISTIC CDD_CurrMeas.CurrMeasEolGainCalSetDft.CurrMeasMotCurrEolGainB "MICROSAR RTE" VALUE 0x0 RTE_RL_FLOAT32_IEEE 0 NO_COMPU_METHOD -3.402823466e+38 3.402823466e+38 SYMBOL_LINK "Rte_CalprmRom_CDD_CurrMeas_DEFAULT_RTE_CDATA_GROUP.CurrMeasEolGainCalSetDft.CurrMeasMotCurrEolGainB" 0 DISPLAY_IDENTIFIER CDD_CurrMeas.CalibrationParameters.CurrMeasEolGainCalSetDft.CurrMeasMotCurrEolGainB /end CHARACTERISTIC
/begin CHARACTERISTIC CDD_CurrMeas.CurrMeasEolGainCalSetDft.CurrMeasMotCurrEolGainC "MICROSAR RTE" VALUE 0x0 RTE_RL_FLOAT32_IEEE 0 NO_COMPU_METHOD -3.402823466e+38 3.402823466e+38 SYMBOL_LINK "Rte_CalprmRom_CDD_CurrMeas_DEFAULT_RTE_CDATA_GROUP.CurrMeasEolGainCalSetDft.CurrMeasMotCurrEolGainC" 0 DISPLAY_IDENTIFIER CDD_CurrMeas.CalibrationParameters.CurrMeasEolGainCalSetDft.CurrMeasMotCurrEolGainC /end CHARACTERISTIC
/begin CHARACTERISTIC CDD_CurrMeas.CurrMeasEolGainCalSetDft.CurrMeasMotCurrEolGainD "MICROSAR RTE" VALUE 0x0 RTE_RL_FLOAT32_IEEE 0 NO_COMPU_METHOD -3.402823466e+38 3.402823466e+38 SYMBOL_LINK "Rte_CalprmRom_CDD_CurrMeas_DEFAULT_RTE_CDATA_GROUP.CurrMeasEolGainCalSetDft.CurrMeasMotCurrEolGainD" 0 DISPLAY_IDENTIFIER CDD_CurrMeas.CalibrationParameters.CurrMeasEolGainCalSetDft.CurrMeasMotCurrEolGainD /end CHARACTERISTIC
/begin CHARACTERISTIC CDD_CurrMeas.CurrMeasEolGainCalSetDft.CurrMeasMotCurrEolGainE "MICROSAR RTE" VALUE 0x0 RTE_RL_FLOAT32_IEEE 0 NO_COMPU_METHOD -3.402823466e+38 3.402823466e+38 SYMBOL_LINK "Rte_CalprmRom_CDD_CurrMeas_DEFAULT_RTE_CDATA_GROUP.CurrMeasEolGainCalSetDft.CurrMeasMotCurrEolGainE" 0 DISPLAY_IDENTIFIER CDD_CurrMeas.CalibrationParameters.CurrMeasEolGainCalSetDft.CurrMeasMotCurrEolGainE /end CHARACTERISTIC
/begin CHARACTERISTIC CDD_CurrMeas.CurrMeasEolGainCalSetDft.CurrMeasMotCurrEolGainF "MICROSAR RTE" VALUE 0x0 RTE_RL_FLOAT32_IEEE 0 NO_COMPU_METHOD -3.402823466e+38 3.402823466e+38 SYMBOL_LINK "Rte_CalprmRom_CDD_CurrMeas_DEFAULT_RTE_CDATA_GROUP.CurrMeasEolGainCalSetDft.CurrMeasMotCurrEolGainF" 0 DISPLAY_IDENTIFIER CDD_CurrMeas.CalibrationParameters.CurrMeasEolGainCalSetDft.CurrMeasMotCurrEolGainF /end CHARACTERISTIC
/begin CHARACTERISTIC CDD_CurrMeas.CurrMeasEolGainMax.Val "MICROSAR RTE" VALUE 0x0 RTE_RL_FLOAT32_IEEE 0 NO_COMPU_METHOD -3.402823466e+38 3.402823466e+38 SYMBOL_LINK "Rte_CalprmRom_CalRegn01Cmn_DEFAULT_RTE_CALPRM_GROUP.CurrMeasEolGainMax_Val" 0 DISPLAY_IDENTIFIER CDD_CurrMeas.CalibrationPorts.CurrMeasEolGainMax.Val /end CHARACTERISTIC
/begin CHARACTERISTIC CDD_CurrMeas.CurrMeasEolGainMin.Val "MICROSAR RTE" VALUE 0x0 RTE_RL_FLOAT32_IEEE 0 NO_COMPU_METHOD -3.402823466e+38 3.402823466e+38 SYMBOL_LINK "Rte_CalprmRom_CalRegn01Cmn_DEFAULT_RTE_CALPRM_GROUP.CurrMeasEolGainMin_Val" 0 DISPLAY_IDENTIFIER CDD_CurrMeas.CalibrationPorts.CurrMeasEolGainMin.Val /end CHARACTERISTIC
/begin CHARACTERISTIC CDD_CurrMeas.CurrMeasEolGainNrOfSample.Val "MICROSAR RTE" VALUE 0x0 RTE_RL_UWORD 0 NO_COMPU_METHOD 0 65535 SYMBOL_LINK "Rte_CalprmRom_CalRegn01Cmn_DEFAULT_RTE_CALPRM_GROUP.CurrMeasEolGainNrOfSample_Val" 0 DISPLAY_IDENTIFIER CDD_CurrMeas.CalibrationPorts.CurrMeasEolGainNrOfSample.Val /end CHARACTERISTIC
/begin CHARACTERISTIC CDD_CurrMeas.CurrMeasEolGainNumer.Val "MICROSAR RTE" VALUE 0x0 RTE_RL_FLOAT32_IEEE 0 NO_COMPU_METHOD -3.402823466e+38 3.402823466e+38 SYMBOL_LINK "Rte_CalprmRom_CalRegn01Cmn_DEFAULT_RTE_CALPRM_GROUP.CurrMeasEolGainNumer_Val" 0 DISPLAY_IDENTIFIER CDD_CurrMeas.CalibrationPorts.CurrMeasEolGainNumer.Val /end CHARACTERISTIC
/begin CHARACTERISTIC CDD_CurrMeas.CurrMeasEolMaxMotVel.Val "MICROSAR RTE" VALUE 0x0 RTE_RL_FLOAT32_IEEE 0 NO_COMPU_METHOD -3.402823466e+38 3.402823466e+38 SYMBOL_LINK "Rte_CalprmRom_CalRegn01Cmn_DEFAULT_RTE_CALPRM_GROUP.CurrMeasEolMaxMotVel_Val" 0 DISPLAY_IDENTIFIER CDD_CurrMeas.CalibrationPorts.CurrMeasEolMaxMotVel.Val /end CHARACTERISTIC
/begin CHARACTERISTIC CDD_CurrMeas.CurrMeasEolOffsCalSetDft.CurrMeasEolOffsHiBrdgVltg "MICROSAR RTE" VALUE 0x0 RTE_RL_FLOAT32_IEEE 0 NO_COMPU_METHOD -3.402823466e+38 3.402823466e+38 SYMBOL_LINK "Rte_CalprmRom_CDD_CurrMeas_DEFAULT_RTE_CDATA_GROUP.CurrMeasEolOffsCalSetDft.CurrMeasEolOffsHiBrdgVltg" 0 DISPLAY_IDENTIFIER CDD_CurrMeas.CalibrationParameters.CurrMeasEolOffsCalSetDft.CurrMeasEolOffsHiBrdgVltg /end CHARACTERISTIC
/begin CHARACTERISTIC CDD_CurrMeas.CurrMeasEolOffsCalSetDft.CurrMeasMotCurrEolOffsDifA "MICROSAR RTE" VALUE 0x0 RTE_RL_FLOAT32_IEEE 0 NO_COMPU_METHOD -3.402823466e+38 3.402823466e+38 SYMBOL_LINK "Rte_CalprmRom_CDD_CurrMeas_DEFAULT_RTE_CDATA_GROUP.CurrMeasEolOffsCalSetDft.CurrMeasMotCurrEolOffsDifA" 0 DISPLAY_IDENTIFIER CDD_CurrMeas.CalibrationParameters.CurrMeasEolOffsCalSetDft.CurrMeasMotCurrEolOffsDifA /end CHARACTERISTIC
/begin CHARACTERISTIC CDD_CurrMeas.CurrMeasEolOffsCalSetDft.CurrMeasMotCurrEolOffsDifB "MICROSAR RTE" VALUE 0x0 RTE_RL_FLOAT32_IEEE 0 NO_COMPU_METHOD -3.402823466e+38 3.402823466e+38 SYMBOL_LINK "Rte_CalprmRom_CDD_CurrMeas_DEFAULT_RTE_CDATA_GROUP.CurrMeasEolOffsCalSetDft.CurrMeasMotCurrEolOffsDifB" 0 DISPLAY_IDENTIFIER CDD_CurrMeas.CalibrationParameters.CurrMeasEolOffsCalSetDft.CurrMeasMotCurrEolOffsDifB /end CHARACTERISTIC
/begin CHARACTERISTIC CDD_CurrMeas.CurrMeasEolOffsCalSetDft.CurrMeasMotCurrEolOffsDifC "MICROSAR RTE" VALUE 0x0 RTE_RL_FLOAT32_IEEE 0 NO_COMPU_METHOD -3.402823466e+38 3.402823466e+38 SYMBOL_LINK "Rte_CalprmRom_CDD_CurrMeas_DEFAULT_RTE_CDATA_GROUP.CurrMeasEolOffsCalSetDft.CurrMeasMotCurrEolOffsDifC" 0 DISPLAY_IDENTIFIER CDD_CurrMeas.CalibrationParameters.CurrMeasEolOffsCalSetDft.CurrMeasMotCurrEolOffsDifC /end CHARACTERISTIC
/begin CHARACTERISTIC CDD_CurrMeas.CurrMeasEolOffsCalSetDft.CurrMeasMotCurrEolOffsDifD "MICROSAR RTE" VALUE 0x0 RTE_RL_FLOAT32_IEEE 0 NO_COMPU_METHOD -3.402823466e+38 3.402823466e+38 SYMBOL_LINK "Rte_CalprmRom_CDD_CurrMeas_DEFAULT_RTE_CDATA_GROUP.CurrMeasEolOffsCalSetDft.CurrMeasMotCurrEolOffsDifD" 0 DISPLAY_IDENTIFIER CDD_CurrMeas.CalibrationParameters.CurrMeasEolOffsCalSetDft.CurrMeasMotCurrEolOffsDifD /end CHARACTERISTIC
/begin CHARACTERISTIC CDD_CurrMeas.CurrMeasEolOffsCalSetDft.CurrMeasMotCurrEolOffsDifE "MICROSAR RTE" VALUE 0x0 RTE_RL_FLOAT32_IEEE 0 NO_COMPU_METHOD -3.402823466e+38 3.402823466e+38 SYMBOL_LINK "Rte_CalprmRom_CDD_CurrMeas_DEFAULT_RTE_CDATA_GROUP.CurrMeasEolOffsCalSetDft.CurrMeasMotCurrEolOffsDifE" 0 DISPLAY_IDENTIFIER CDD_CurrMeas.CalibrationParameters.CurrMeasEolOffsCalSetDft.CurrMeasMotCurrEolOffsDifE /end CHARACTERISTIC
/begin CHARACTERISTIC CDD_CurrMeas.CurrMeasEolOffsCalSetDft.CurrMeasMotCurrEolOffsDifF "MICROSAR RTE" VALUE 0x0 RTE_RL_FLOAT32_IEEE 0 NO_COMPU_METHOD -3.402823466e+38 3.402823466e+38 SYMBOL_LINK "Rte_CalprmRom_CDD_CurrMeas_DEFAULT_RTE_CDATA_GROUP.CurrMeasEolOffsCalSetDft.CurrMeasMotCurrEolOffsDifF" 0 DISPLAY_IDENTIFIER CDD_CurrMeas.CalibrationParameters.CurrMeasEolOffsCalSetDft.CurrMeasMotCurrEolOffsDifF /end CHARACTERISTIC
/begin CHARACTERISTIC CDD_CurrMeas.CurrMeasEolOffsCalSetDft.CurrMeasMotCurrOffsLoAvrgA "MICROSAR RTE" VALUE 0x0 RTE_RL_FLOAT32_IEEE 0 NO_COMPU_METHOD -3.402823466e+38 3.402823466e+38 SYMBOL_LINK "Rte_CalprmRom_CDD_CurrMeas_DEFAULT_RTE_CDATA_GROUP.CurrMeasEolOffsCalSetDft.CurrMeasMotCurrOffsLoAvrgA" 0 DISPLAY_IDENTIFIER CDD_CurrMeas.CalibrationParameters.CurrMeasEolOffsCalSetDft.CurrMeasMotCurrOffsLoAvrgA /end CHARACTERISTIC
/begin CHARACTERISTIC CDD_CurrMeas.CurrMeasEolOffsCalSetDft.CurrMeasMotCurrOffsLoAvrgB "MICROSAR RTE" VALUE 0x0 RTE_RL_FLOAT32_IEEE 0 NO_COMPU_METHOD -3.402823466e+38 3.402823466e+38 SYMBOL_LINK "Rte_CalprmRom_CDD_CurrMeas_DEFAULT_RTE_CDATA_GROUP.CurrMeasEolOffsCalSetDft.CurrMeasMotCurrOffsLoAvrgB" 0 DISPLAY_IDENTIFIER CDD_CurrMeas.CalibrationParameters.CurrMeasEolOffsCalSetDft.CurrMeasMotCurrOffsLoAvrgB /end CHARACTERISTIC
/begin CHARACTERISTIC CDD_CurrMeas.CurrMeasEolOffsCalSetDft.CurrMeasMotCurrOffsLoAvrgC "MICROSAR RTE" VALUE 0x0 RTE_RL_FLOAT32_IEEE 0 NO_COMPU_METHOD -3.402823466e+38 3.402823466e+38 SYMBOL_LINK "Rte_CalprmRom_CDD_CurrMeas_DEFAULT_RTE_CDATA_GROUP.CurrMeasEolOffsCalSetDft.CurrMeasMotCurrOffsLoAvrgC" 0 DISPLAY_IDENTIFIER CDD_CurrMeas.CalibrationParameters.CurrMeasEolOffsCalSetDft.CurrMeasMotCurrOffsLoAvrgC /end CHARACTERISTIC
/begin CHARACTERISTIC CDD_CurrMeas.CurrMeasEolOffsCalSetDft.CurrMeasMotCurrOffsLoAvrgD "MICROSAR RTE" VALUE 0x0 RTE_RL_FLOAT32_IEEE 0 NO_COMPU_METHOD -3.402823466e+38 3.402823466e+38 SYMBOL_LINK "Rte_CalprmRom_CDD_CurrMeas_DEFAULT_RTE_CDATA_GROUP.CurrMeasEolOffsCalSetDft.CurrMeasMotCurrOffsLoAvrgD" 0 DISPLAY_IDENTIFIER CDD_CurrMeas.CalibrationParameters.CurrMeasEolOffsCalSetDft.CurrMeasMotCurrOffsLoAvrgD /end CHARACTERISTIC
/begin CHARACTERISTIC CDD_CurrMeas.CurrMeasEolOffsCalSetDft.CurrMeasMotCurrOffsLoAvrgE "MICROSAR RTE" VALUE 0x0 RTE_RL_FLOAT32_IEEE 0 NO_COMPU_METHOD -3.402823466e+38 3.402823466e+38 SYMBOL_LINK "Rte_CalprmRom_CDD_CurrMeas_DEFAULT_RTE_CDATA_GROUP.CurrMeasEolOffsCalSetDft.CurrMeasMotCurrOffsLoAvrgE" 0 DISPLAY_IDENTIFIER CDD_CurrMeas.CalibrationParameters.CurrMeasEolOffsCalSetDft.CurrMeasMotCurrOffsLoAvrgE /end CHARACTERISTIC
/begin CHARACTERISTIC CDD_CurrMeas.CurrMeasEolOffsCalSetDft.CurrMeasMotCurrOffsLoAvrgF "MICROSAR RTE" VALUE 0x0 RTE_RL_FLOAT32_IEEE 0 NO_COMPU_METHOD -3.402823466e+38 3.402823466e+38 SYMBOL_LINK "Rte_CalprmRom_CDD_CurrMeas_DEFAULT_RTE_CDATA_GROUP.CurrMeasEolOffsCalSetDft.CurrMeasMotCurrOffsLoAvrgF" 0 DISPLAY_IDENTIFIER CDD_CurrMeas.CalibrationParameters.CurrMeasEolOffsCalSetDft.CurrMeasMotCurrOffsLoAvrgF /end CHARACTERISTIC
/begin CHARACTERISTIC CDD_CurrMeas.CurrMeasEolOffsHiBrdgVltgMin.Val "MICROSAR RTE" VALUE 0x0 RTE_RL_FLOAT32_IEEE 0 NO_COMPU_METHOD -3.402823466e+38 3.402823466e+38 SYMBOL_LINK "Rte_CalprmRom_CalRegn01Cmn_DEFAULT_RTE_CALPRM_GROUP.CurrMeasEolOffsHiBrdgVltgMin_Val" 0 DISPLAY_IDENTIFIER CDD_CurrMeas.CalibrationPorts.CurrMeasEolOffsHiBrdgVltgMin.Val /end CHARACTERISTIC
/begin CHARACTERISTIC CDD_CurrMeas.CurrMeasEolOffsHiCmuOffs.Val "MICROSAR RTE" VALUE 0x0 RTE_RL_ULONG 0 NO_COMPU_METHOD 0 4294967295 SYMBOL_LINK "Rte_CalprmRom_CalRegn01Cmn_DEFAULT_RTE_CALPRM_GROUP.CurrMeasEolOffsHiCmuOffs_Val" 0 DISPLAY_IDENTIFIER CDD_CurrMeas.CalibrationPorts.CurrMeasEolOffsHiCmuOffs.Val /end CHARACTERISTIC
/begin CHARACTERISTIC CDD_CurrMeas.CurrMeasEolOffsLoCmuOffs.Val "MICROSAR RTE" VALUE 0x0 RTE_RL_ULONG 0 NO_COMPU_METHOD 0 4294967295 SYMBOL_LINK "Rte_CalprmRom_CalRegn01Cmn_DEFAULT_RTE_CALPRM_GROUP.CurrMeasEolOffsLoCmuOffs_Val" 0 DISPLAY_IDENTIFIER CDD_CurrMeas.CalibrationPorts.CurrMeasEolOffsLoCmuOffs.Val /end CHARACTERISTIC
/begin CHARACTERISTIC CDD_CurrMeas.CurrMeasEolOffsMax.Val "MICROSAR RTE" VALUE 0x0 RTE_RL_FLOAT32_IEEE 0 NO_COMPU_METHOD -3.402823466e+38 3.402823466e+38 SYMBOL_LINK "Rte_CalprmRom_CalRegn01Cmn_DEFAULT_RTE_CALPRM_GROUP.CurrMeasEolOffsMax_Val" 0 DISPLAY_IDENTIFIER CDD_CurrMeas.CalibrationPorts.CurrMeasEolOffsMax.Val /end CHARACTERISTIC
/begin CHARACTERISTIC CDD_CurrMeas.CurrMeasEolOffsMin.Val "MICROSAR RTE" VALUE 0x0 RTE_RL_FLOAT32_IEEE 0 NO_COMPU_METHOD -3.402823466e+38 3.402823466e+38 SYMBOL_LINK "Rte_CalprmRom_CalRegn01Cmn_DEFAULT_RTE_CALPRM_GROUP.CurrMeasEolOffsMin_Val" 0 DISPLAY_IDENTIFIER CDD_CurrMeas.CalibrationPorts.CurrMeasEolOffsMin.Val /end CHARACTERISTIC
/begin CHARACTERISTIC CDD_CurrMeas.CurrMeasEolOffsNrOfSample.Val "MICROSAR RTE" VALUE 0x0 RTE_RL_UWORD 0 NO_COMPU_METHOD 0 65535 SYMBOL_LINK "Rte_CalprmRom_CalRegn01Cmn_DEFAULT_RTE_CALPRM_GROUP.CurrMeasEolOffsNrOfSample_Val" 0 DISPLAY_IDENTIFIER CDD_CurrMeas.CalibrationPorts.CurrMeasEolOffsNrOfSample.Val /end CHARACTERISTIC
/begin CHARACTERISTIC CDD_CurrMeas.CurrMeasEolTranCntrThd.Val "MICROSAR RTE" VALUE 0x0 RTE_RL_UBYTE 0 NO_COMPU_METHOD 0 255 SYMBOL_LINK "Rte_CalprmRom_CalRegn01Cmn_DEFAULT_RTE_CALPRM_GROUP.CurrMeasEolTranCntrThd_Val" 0 DISPLAY_IDENTIFIER CDD_CurrMeas.CalibrationPorts.CurrMeasEolTranCntrThd.Val /end CHARACTERISTIC
/begin CHARACTERISTIC CDD_CurrMeas.CurrMeasMinRqrdPhaOnTi.Val "MICROSAR RTE" VALUE 0x0 RTE_RL_ULONG 0 NO_COMPU_METHOD 0 4294967295 SYMBOL_LINK "Rte_CalprmRom_CalRegn01Cmn_DEFAULT_RTE_CALPRM_GROUP.CurrMeasMinRqrdPhaOnTi_Val" 0 DISPLAY_IDENTIFIER CDD_CurrMeas.CalibrationPorts.CurrMeasMinRqrdPhaOnTi.Val /end CHARACTERISTIC
/begin CHARACTERISTIC CDD_CurrMeas.CurrMeasMotAgCompuDly.Val "MICROSAR RTE" VALUE 0x0 RTE_RL_ULONG 0 NO_COMPU_METHOD 0 4294967295 SYMBOL_LINK "Rte_CalprmRom_CalRegn01Cmn_DEFAULT_RTE_CALPRM_GROUP.CurrMeasMotAgCompuDly_Val" 0 DISPLAY_IDENTIFIER CDD_CurrMeas.CalibrationPorts.CurrMeasMotAgCompuDly.Val /end CHARACTERISTIC
/begin CHARACTERISTIC CDD_CurrMeas.CurrMeasMotCurrAdcVlyWrmIninMax.Val "MICROSAR RTE" VALUE 0x0 RTE_RL_FLOAT32_IEEE 0 NO_COMPU_METHOD -3.402823466e+38 3.402823466e+38 SYMBOL_LINK "Rte_CalprmRom_CalRegn01Cmn_DEFAULT_RTE_CALPRM_GROUP.CurrMeasMotCurrAdcVlyWrmIninMax_Val" 0 DISPLAY_IDENTIFIER CDD_CurrMeas.CalibrationPorts.CurrMeasMotCurrAdcVlyWrmIninMax.Val /end CHARACTERISTIC
/begin CHARACTERISTIC CDD_CurrMeas.CurrMeasMotCurrAdcVlyWrmIninMin.Val "MICROSAR RTE" VALUE 0x0 RTE_RL_FLOAT32_IEEE 0 NO_COMPU_METHOD -3.402823466e+38 3.402823466e+38 SYMBOL_LINK "Rte_CalprmRom_CalRegn01Cmn_DEFAULT_RTE_CALPRM_GROUP.CurrMeasMotCurrAdcVlyWrmIninMin_Val" 0 DISPLAY_IDENTIFIER CDD_CurrMeas.CalibrationPorts.CurrMeasMotCurrAdcVlyWrmIninMin.Val /end CHARACTERISTIC
/begin CHARACTERISTIC CDD_CurrMeas.CurrMeasNtc0x05DFailStep.Val "MICROSAR RTE" VALUE 0x0 RTE_RL_UWORD 0 NO_COMPU_METHOD 0 65535 SYMBOL_LINK "Rte_CalprmRom_CalRegn01Cmn_DEFAULT_RTE_CALPRM_GROUP.CurrMeasNtc0x05DFailStep_Val" 0 DISPLAY_IDENTIFIER CDD_CurrMeas.CalibrationPorts.CurrMeasNtc0x05DFailStep.Val /end CHARACTERISTIC
/begin CHARACTERISTIC CDD_CurrMeas.CurrMeasNtc0x05DPassStep.Val "MICROSAR RTE" VALUE 0x0 RTE_RL_UWORD 0 NO_COMPU_METHOD 0 65535 SYMBOL_LINK "Rte_CalprmRom_CalRegn01Cmn_DEFAULT_RTE_CALPRM_GROUP.CurrMeasNtc0x05DPassStep_Val" 0 DISPLAY_IDENTIFIER CDD_CurrMeas.CalibrationPorts.CurrMeasNtc0x05DPassStep.Val /end CHARACTERISTIC
/begin CHARACTERISTIC CDD_CurrMeas.CurrMeasNtc0x06DFailStep.Val "MICROSAR RTE" VALUE 0x0 RTE_RL_UWORD 0 NO_COMPU_METHOD 0 65535 SYMBOL_LINK "Rte_CalprmRom_CalRegn01Cmn_DEFAULT_RTE_CALPRM_GROUP.CurrMeasNtc0x06DFailStep_Val" 0 DISPLAY_IDENTIFIER CDD_CurrMeas.CalibrationPorts.CurrMeasNtc0x06DFailStep.Val /end CHARACTERISTIC
/begin CHARACTERISTIC CDD_CurrMeas.CurrMeasNtc0x06DPassStep.Val "MICROSAR RTE" VALUE 0x0 RTE_RL_UWORD 0 NO_COMPU_METHOD 0 65535 SYMBOL_LINK "Rte_CalprmRom_CalRegn01Cmn_DEFAULT_RTE_CALPRM_GROUP.CurrMeasNtc0x06DPassStep_Val" 0 DISPLAY_IDENTIFIER CDD_CurrMeas.CalibrationPorts.CurrMeasNtc0x06DPassStep.Val /end CHARACTERISTIC
/**********************************************************************************************************************
* MEASUREMENT
*********************************************************************************************************************/
/begin MEASUREMENT Assi.AssiCmdBas.Val "MICROSAR RTE" FLOAT32_IEEE NO_COMPU_METHOD 0 0 -8.8 8.8 ECU_ADDRESS 0 SYMBOL_LINK "Rte_Assi_AssiCmdBas_Val" 0 DISPLAY_IDENTIFIER Assi.SenderPorts.AssiCmdBas.Val /end MEASUREMENT
/begin MEASUREMENT Assi.AssiCmdBasSca.Val "MICROSAR RTE" FLOAT32_IEEE NO_COMPU_METHOD 0 0 0.0 1.0 ECU_ADDRESS 0 SYMBOL_LINK "Rte_GmTqArbn_AssiCmdBasSca_Val" 0 DISPLAY_IDENTIFIER Assi.ReceiverPorts.AssiCmdBasSca.Val /end MEASUREMENT
/begin MEASUREMENT Assi.AssiLnrGain.Val "MICROSAR RTE" FLOAT32_IEEE NO_COMPU_METHOD 0 0 0.0 1.0 ECU_ADDRESS 0 SYMBOL_LINK "Rte_CmnMfgSrv_AssiLnrGain_Val" 0 DISPLAY_IDENTIFIER Assi.ReceiverPorts.AssiLnrGain.Val /end MEASUREMENT
/begin MEASUREMENT Assi.AssiLnrGainEna.Logl "MICROSAR RTE" UBYTE RTE_CM_BOOLEAN 0 0 0 255 ECU_ADDRESS 0 SYMBOL_LINK "Rte_CmnMfgSrv_AssiLnrGainEna_Logl" 0 DISPLAY_IDENTIFIER Assi.ReceiverPorts.AssiLnrGainEna.Logl /end MEASUREMENT
/begin MEASUREMENT Assi.HwTq.Val "MICROSAR RTE" FLOAT32_IEEE NO_COMPU_METHOD 0 0 -10.0 10.0 ECU_ADDRESS 0 SYMBOL_LINK "Rte_Swp_HwTqSwp_Val" 0 DISPLAY_IDENTIFIER Assi.ReceiverPorts.HwTq.Val /end MEASUREMENT
/begin MEASUREMENT Assi.HwTqHysOvrl.Val "MICROSAR RTE" FLOAT32_IEEE NO_COMPU_METHOD 0 0 -10.0 10.0 ECU_ADDRESS 0 SYMBOL_LINK "Rte_Assi_HwTqHysOvrl_Val" 0 DISPLAY_IDENTIFIER Assi.ReceiverPorts.HwTqHysOvrl.Val /end MEASUREMENT
/begin MEASUREMENT Assi.HwTqOvrl.Val "MICROSAR RTE" FLOAT32_IEEE NO_COMPU_METHOD 0 0 -10.0 10.0 ECU_ADDRESS 0 SYMBOL_LINK "Rte_GmTqArbn_HwTqOvrl_Val" 0 DISPLAY_IDENTIFIER Assi.ReceiverPorts.HwTqOvrl.Val /end MEASUREMENT
/begin MEASUREMENT Assi.ThermLimSlowFilMax.Val "MICROSAR RTE" FLOAT32_IEEE NO_COMPU_METHOD 0 0 0.0 200.0 ECU_ADDRESS 0 SYMBOL_LINK "Rte_DutyCycThermProtn_ThermLimSlowFilMax_Val" 0 DISPLAY_IDENTIFIER Assi.ReceiverPorts.ThermLimSlowFilMax.Val /end MEASUREMENT
/begin MEASUREMENT Assi.VehSpd.Val "MICROSAR RTE" FLOAT32_IEEE NO_COMPU_METHOD 0 0 0.0 511.0 ECU_ADDRESS 0 SYMBOL_LINK "Rte_VehSigCdng_VehSpd_Val" 0 DISPLAY_IDENTIFIER Assi.ReceiverPorts.VehSpd.Val /end MEASUREMENT
/begin MEASUREMENT Assi.WhlImbRejctnAmp.Val "MICROSAR RTE" FLOAT32_IEEE NO_COMPU_METHOD 0 0 0 8.8 ECU_ADDRESS 0 SYMBOL_LINK "Rte_WhlImbRejctn_WhlImbRejctnAmp_Val" 0 DISPLAY_IDENTIFIER Assi.ReceiverPorts.WhlImbRejctnAmp.Val /end MEASUREMENT
/begin MEASUREMENT Assi.dAssiThermAssiSca "MICROSAR RTE" FLOAT32_IEEE NO_COMPU_METHOD 0 0 0.0 1.0 ECU_ADDRESS 0 SYMBOL_LINK "Rte_Assi_dAssiThermAssiSca" 0 DISPLAY_IDENTIFIER Assi.PerInstanceMemories.dAssiThermAssiSca /end MEASUREMENT
/begin MEASUREMENT Assi.dAssiWhlImbRejctnBlnd "MICROSAR RTE" FLOAT32_IEEE NO_COMPU_METHOD 0 0 0.0 1.0 ECU_ADDRESS 0 SYMBOL_LINK "Rte_Assi_dAssiWhlImbRejctnBlnd" 0 DISPLAY_IDENTIFIER Assi.PerInstanceMemories.dAssiWhlImbRejctnBlnd /end MEASUREMENT
/begin MEASUREMENT AssiHiFrq.AssiHiFrqCmd.Val "MICROSAR RTE" FLOAT32_IEEE NO_COMPU_METHOD 0 0 -3.402823466e+38 3.402823466e+38 ECU_ADDRESS 0 SYMBOL_LINK "Rte_AssiHiFrq_AssiHiFrqCmd_Val" 0 DISPLAY_IDENTIFIER AssiHiFrq.SenderPorts.AssiHiFrqCmd.Val /end MEASUREMENT
/begin MEASUREMENT AssiHiFrq.HwTq.Val "MICROSAR RTE" FLOAT32_IEEE NO_COMPU_METHOD 0 0 -3.402823466e+38 3.402823466e+38 ECU_ADDRESS 0 SYMBOL_LINK "Rte_Swp_HwTqSwp_Val" 0 DISPLAY_IDENTIFIER AssiHiFrq.ReceiverPorts.HwTq.Val /end MEASUREMENT
/begin MEASUREMENT AssiHiFrq.HwTqHpFil.CorrnFac "MICROSAR RTE" FLOAT32_IEEE NO_COMPU_METHOD 0 0 -3.402823466e+38 3.402823466e+38 ECU_ADDRESS 0 SYMBOL_LINK "Rte_AssiHiFrq_HwTqHpFil.CorrnFac" 0 DISPLAY_IDENTIFIER AssiHiFrq.PerInstanceMemories.HwTqHpFil.CorrnFac /end MEASUREMENT
/begin MEASUREMENT AssiHiFrq.HwTqHpFil.FilLpRec.FilGain "MICROSAR RTE" FLOAT32_IEEE NO_COMPU_METHOD 0 0 -3.402823466e+38 3.402823466e+38 ECU_ADDRESS 0 SYMBOL_LINK "Rte_AssiHiFrq_HwTqHpFil.FilLpRec.FilGain" 0 DISPLAY_IDENTIFIER AssiHiFrq.PerInstanceMemories.HwTqHpFil.FilLpRec.FilGain /end MEASUREMENT
/begin MEASUREMENT AssiHiFrq.HwTqHpFil.FilLpRec.FilSt "MICROSAR RTE" FLOAT32_IEEE NO_COMPU_METHOD 0 0 -3.402823466e+38 3.402823466e+38 ECU_ADDRESS 0 SYMBOL_LINK "Rte_AssiHiFrq_HwTqHpFil.FilLpRec.FilSt" 0 DISPLAY_IDENTIFIER AssiHiFrq.PerInstanceMemories.HwTqHpFil.FilLpRec.FilSt /end MEASUREMENT
/begin MEASUREMENT AssiHiFrq.VehSpd.Val "MICROSAR RTE" FLOAT32_IEEE NO_COMPU_METHOD 0 0 -3.402823466e+38 3.402823466e+38 ECU_ADDRESS 0 SYMBOL_LINK "Rte_VehSigCdng_VehSpd_Val" 0 DISPLAY_IDENTIFIER AssiHiFrq.ReceiverPorts.VehSpd.Val /end MEASUREMENT
/begin MEASUREMENT AssiHiFrq.WhlImbRejctnAmp.Val "MICROSAR RTE" FLOAT32_IEEE NO_COMPU_METHOD 0 0 -3.402823466e+38 3.402823466e+38 ECU_ADDRESS 0 SYMBOL_LINK "Rte_WhlImbRejctn_WhlImbRejctnAmp_Val" 0 DISPLAY_IDENTIFIER AssiHiFrq.ReceiverPorts.WhlImbRejctnAmp.Val /end MEASUREMENT
/begin MEASUREMENT AssiHiFrq.dAssiHiFrqGain "MICROSAR RTE" FLOAT32_IEEE NO_COMPU_METHOD 0 0 -3.402823466e+38 3.402823466e+38 ECU_ADDRESS 0 SYMBOL_LINK "Rte_AssiHiFrq_dAssiHiFrqGain" 0 DISPLAY_IDENTIFIER AssiHiFrq.PerInstanceMemories.dAssiHiFrqGain /end MEASUREMENT
/begin MEASUREMENT AssiHiFrq.dAssiHiFrqGainBlnd "MICROSAR RTE" FLOAT32_IEEE NO_COMPU_METHOD 0 0 -3.402823466e+38 3.402823466e+38 ECU_ADDRESS 0 SYMBOL_LINK "Rte_AssiHiFrq_dAssiHiFrqGainBlnd" 0 DISPLAY_IDENTIFIER AssiHiFrq.PerInstanceMemories.dAssiHiFrqGainBlnd /end MEASUREMENT
/begin MEASUREMENT AssiHiFrq.dAssiHiFrqGainWhlImbRejtcnZero "MICROSAR RTE" FLOAT32_IEEE NO_COMPU_METHOD 0 0 -3.402823466e+38 3.402823466e+38 ECU_ADDRESS 0 SYMBOL_LINK "Rte_AssiHiFrq_dAssiHiFrqGainWhlImbRejtcnZero" 0 DISPLAY_IDENTIFIER AssiHiFrq.PerInstanceMemories.dAssiHiFrqGainWhlImbRejtcnZero /end MEASUREMENT
/begin MEASUREMENT AssiPahFwl.AssiCmdBas.Val "MICROSAR RTE" FLOAT32_IEEE NO_COMPU_METHOD 0 0 -3.402823466e+38 3.402823466e+38 ECU_ADDRESS 0 SYMBOL_LINK "Rte_Assi_AssiCmdBas_Val" 0 DISPLAY_IDENTIFIER AssiPahFwl.ReceiverPorts.AssiCmdBas.Val /end MEASUREMENT
/begin MEASUREMENT AssiPahFwl.AssiCmdSum.Val "MICROSAR RTE" FLOAT32_IEEE NO_COMPU_METHOD 0 0 -3.402823466e+38 3.402823466e+38 ECU_ADDRESS 0 SYMBOL_LINK "Rte_AssiPahFwl_AssiCmdSum_Val" 0 DISPLAY_IDENTIFIER AssiPahFwl.SenderPorts.AssiCmdSum.Val /end MEASUREMENT
/begin MEASUREMENT AssiPahFwl.AssiHiFrqCmd.Val "MICROSAR RTE" FLOAT32_IEEE NO_COMPU_METHOD 0 0 -3.402823466e+38 3.402823466e+38 ECU_ADDRESS 0 SYMBOL_LINK "Rte_AssiHiFrq_AssiHiFrqCmd_Val" 0 DISPLAY_IDENTIFIER AssiPahFwl.ReceiverPorts.AssiHiFrqCmd.Val /end MEASUREMENT
/begin MEASUREMENT AssiPahFwl.AssiLnrGainEna.Logl "MICROSAR RTE" UBYTE RTE_CM_BOOLEAN 0 0 0 255 ECU_ADDRESS 0 SYMBOL_LINK "Rte_CmnMfgSrv_AssiLnrGainEna_Logl" 0 DISPLAY_IDENTIFIER AssiPahFwl.ReceiverPorts.AssiLnrGainEna.Logl /end MEASUREMENT
/begin MEASUREMENT AssiPahFwl.AssiPahLimrActv.Val "MICROSAR RTE" FLOAT32_IEEE NO_COMPU_METHOD 0 0 -3.402823466e+38 3.402823466e+38 ECU_ADDRESS 0 SYMBOL_LINK "Rte_AssiPahFwl_AssiPahLimrActv_Val" 0 DISPLAY_IDENTIFIER AssiPahFwl.SenderPorts.AssiPahLimrActv.Val /end MEASUREMENT
/begin MEASUREMENT AssiPahFwl.AssiPrfmncPrev "MICROSAR RTE" UBYTE RTE_CM_BOOLEAN 0 0 0 255 ECU_ADDRESS 0 SYMBOL_LINK "Rte_AssiPahFwl_AssiPrfmncPrev" 0 DISPLAY_IDENTIFIER AssiPahFwl.PerInstanceMemories.AssiPrfmncPrev /end MEASUREMENT
/begin MEASUREMENT AssiPahFwl.CombdAssiPrev "MICROSAR RTE" FLOAT32_IEEE NO_COMPU_METHOD 0 0 -3.402823466e+38 3.402823466e+38 ECU_ADDRESS 0 SYMBOL_LINK "Rte_AssiPahFwl_CombdAssiPrev" 0 DISPLAY_IDENTIFIER AssiPahFwl.PerInstanceMemories.CombdAssiPrev /end MEASUREMENT
/begin MEASUREMENT AssiPahFwl.FwlActvLpFilStVari.FilGain "MICROSAR RTE" FLOAT32_IEEE NO_COMPU_METHOD 0 0 -3.402823466e+38 3.402823466e+38 ECU_ADDRESS 0 SYMBOL_LINK "Rte_AssiPahFwl_FwlActvLpFilStVari.FilGain" 0 DISPLAY_IDENTIFIER AssiPahFwl.PerInstanceMemories.FwlActvLpFilStVari.FilGain /end MEASUREMENT
/begin MEASUREMENT AssiPahFwl.FwlActvLpFilStVari.FilSt "MICROSAR RTE" FLOAT32_IEEE NO_COMPU_METHOD 0 0 -3.402823466e+38 3.402823466e+38 ECU_ADDRESS 0 SYMBOL_LINK "Rte_AssiPahFwl_FwlActvLpFilStVari.FilSt" 0 DISPLAY_IDENTIFIER AssiPahFwl.PerInstanceMemories.FwlActvLpFilStVari.FilSt /end MEASUREMENT
/begin MEASUREMENT AssiPahFwl.HiFrqCmdLpFilStVari.FilGain "MICROSAR RTE" FLOAT32_IEEE NO_COMPU_METHOD 0 0 -3.402823466e+38 3.402823466e+38 ECU_ADDRESS 0 SYMBOL_LINK "Rte_AssiPahFwl_HiFrqCmdLpFilStVari.FilGain" 0 DISPLAY_IDENTIFIER AssiPahFwl.PerInstanceMemories.HiFrqCmdLpFilStVari.FilGain /end MEASUREMENT
/begin MEASUREMENT AssiPahFwl.HiFrqCmdLpFilStVari.FilSt "MICROSAR RTE" FLOAT32_IEEE NO_COMPU_METHOD 0 0 -3.402823466e+38 3.402823466e+38 ECU_ADDRESS 0 SYMBOL_LINK "Rte_AssiPahFwl_HiFrqCmdLpFilStVari.FilSt" 0 DISPLAY_IDENTIFIER AssiPahFwl.PerInstanceMemories.HiFrqCmdLpFilStVari.FilSt /end MEASUREMENT
/begin MEASUREMENT AssiPahFwl.HwTq.Val "MICROSAR RTE" FLOAT32_IEEE NO_COMPU_METHOD 0 0 -3.402823466e+38 3.402823466e+38 ECU_ADDRESS 0 SYMBOL_LINK "Rte_Swp_HwTqSwp_Val" 0 DISPLAY_IDENTIFIER AssiPahFwl.ReceiverPorts.HwTq.Val /end MEASUREMENT
/begin MEASUREMENT AssiPahFwl.HwTqOvrl.Val "MICROSAR RTE" FLOAT32_IEEE NO_COMPU_METHOD 0 0 -3.402823466e+38 3.402823466e+38 ECU_ADDRESS 0 SYMBOL_LINK "Rte_GmTqArbn_HwTqOvrl_Val" 0 DISPLAY_IDENTIFIER AssiPahFwl.ReceiverPorts.HwTqOvrl.Val /end MEASUREMENT
/begin MEASUREMENT AssiPahFwl.HysCmpCmd.Val "MICROSAR RTE" FLOAT32_IEEE NO_COMPU_METHOD 0 0 -3.402823466e+38 3.402823466e+38 ECU_ADDRESS 0 SYMBOL_LINK "Rte_HysCmp_HysCmpCmd_Val" 0 DISPLAY_IDENTIFIER AssiPahFwl.ReceiverPorts.HysCmpCmd.Val /end MEASUREMENT
/begin MEASUREMENT AssiPahFwl.LowrLimLpFilStVari.FilGain "MICROSAR RTE" FLOAT32_IEEE NO_COMPU_METHOD 0 0 -3.402823466e+38 3.402823466e+38 ECU_ADDRESS 0 SYMBOL_LINK "Rte_AssiPahFwl_LowrLimLpFilStVari.FilGain" 0 DISPLAY_IDENTIFIER AssiPahFwl.PerInstanceMemories.LowrLimLpFilStVari.FilGain /end MEASUREMENT
/begin MEASUREMENT AssiPahFwl.LowrLimLpFilStVari.FilSt "MICROSAR RTE" FLOAT32_IEEE NO_COMPU_METHOD 0 0 -3.402823466e+38 3.402823466e+38 ECU_ADDRESS 0 SYMBOL_LINK "Rte_AssiPahFwl_LowrLimLpFilStVari.FilSt" 0 DISPLAY_IDENTIFIER AssiPahFwl.PerInstanceMemories.LowrLimLpFilStVari.FilSt /end MEASUREMENT
/begin MEASUREMENT AssiPahFwl.UpprLimLpFilStVari.FilGain "MICROSAR RTE" FLOAT32_IEEE NO_COMPU_METHOD 0 0 -3.402823466e+38 3.402823466e+38 ECU_ADDRESS 0 SYMBOL_LINK "Rte_AssiPahFwl_UpprLimLpFilStVari.FilGain" 0 DISPLAY_IDENTIFIER AssiPahFwl.PerInstanceMemories.UpprLimLpFilStVari.FilGain /end MEASUREMENT
/begin MEASUREMENT AssiPahFwl.UpprLimLpFilStVari.FilSt "MICROSAR RTE" FLOAT32_IEEE NO_COMPU_METHOD 0 0 -3.402823466e+38 3.402823466e+38 ECU_ADDRESS 0 SYMBOL_LINK "Rte_AssiPahFwl_UpprLimLpFilStVari.FilSt" 0 DISPLAY_IDENTIFIER AssiPahFwl.PerInstanceMemories.UpprLimLpFilStVari.FilSt /end MEASUREMENT
/begin MEASUREMENT AssiPahFwl.VehSpd.Val "MICROSAR RTE" FLOAT32_IEEE NO_COMPU_METHOD 0 0 -3.402823466e+38 3.402823466e+38 ECU_ADDRESS 0 SYMBOL_LINK "Rte_VehSigCdng_VehSpd_Val" 0 DISPLAY_IDENTIFIER AssiPahFwl.ReceiverPorts.VehSpd.Val /end MEASUREMENT
/begin MEASUREMENT AssiPahFwl.dAssiPahFwlActvRaw "MICROSAR RTE" FLOAT32_IEEE NO_COMPU_METHOD 0 0 -3.402823466e+38 3.402823466e+38 ECU_ADDRESS 0 SYMBOL_LINK "Rte_AssiPahFwl_dAssiPahFwlActvRaw" 0 DISPLAY_IDENTIFIER AssiPahFwl.PerInstanceMemories.dAssiPahFwlActvRaw /end MEASUREMENT
/begin MEASUREMENT AssiPahFwl.dAssiPahFwlBasAssiCmdOverLim "MICROSAR RTE" UBYTE RTE_CM_BOOLEAN 0 0 0 255 ECU_ADDRESS 0 SYMBOL_LINK "Rte_AssiPahFwl_dAssiPahFwlBasAssiCmdOverLim" 0 DISPLAY_IDENTIFIER AssiPahFwl.PerInstanceMemories.dAssiPahFwlBasAssiCmdOverLim /end MEASUREMENT
/begin MEASUREMENT AssiPahFwl.dAssiPahFwlBasAssiLimd "MICROSAR RTE" FLOAT32_IEEE NO_COMPU_METHOD 0 0 -3.402823466e+38 3.402823466e+38 ECU_ADDRESS 0 SYMBOL_LINK "Rte_AssiPahFwl_dAssiPahFwlBasAssiLimd" 0 DISPLAY_IDENTIFIER AssiPahFwl.PerInstanceMemories.dAssiPahFwlBasAssiLimd /end MEASUREMENT
/begin MEASUREMENT AssiPahFwl.dAssiPahFwlBasAssiLowrLim "MICROSAR RTE" FLOAT32_IEEE NO_COMPU_METHOD 0 0 -3.402823466e+38 3.402823466e+38 ECU_ADDRESS 0 SYMBOL_LINK "Rte_AssiPahFwl_dAssiPahFwlBasAssiLowrLim" 0 DISPLAY_IDENTIFIER AssiPahFwl.PerInstanceMemories.dAssiPahFwlBasAssiLowrLim /end MEASUREMENT
/begin MEASUREMENT AssiPahFwl.dAssiPahFwlBasAssiUpprLim "MICROSAR RTE" FLOAT32_IEEE NO_COMPU_METHOD 0 0 -3.402823466e+38 3.402823466e+38 ECU_ADDRESS 0 SYMBOL_LINK "Rte_AssiPahFwl_dAssiPahFwlBasAssiUpprLim" 0 DISPLAY_IDENTIFIER AssiPahFwl.PerInstanceMemories.dAssiPahFwlBasAssiUpprLim /end MEASUREMENT
/begin MEASUREMENT AssiPahFwl.dAssiPahFwlHiFrqAssiLowrLimFild "MICROSAR RTE" FLOAT32_IEEE NO_COMPU_METHOD 0 0 -3.402823466e+38 3.402823466e+38 ECU_ADDRESS 0 SYMBOL_LINK "Rte_AssiPahFwl_dAssiPahFwlHiFrqAssiLowrLimFild" 0 DISPLAY_IDENTIFIER AssiPahFwl.PerInstanceMemories.dAssiPahFwlHiFrqAssiLowrLimFild /end MEASUREMENT
/begin MEASUREMENT AssiPahFwl.dAssiPahFwlHiFrqAssiUpprLimFild "MICROSAR RTE" FLOAT32_IEEE NO_COMPU_METHOD 0 0 -3.402823466e+38 3.402823466e+38 ECU_ADDRESS 0 SYMBOL_LINK "Rte_AssiPahFwl_dAssiPahFwlHiFrqAssiUpprLimFild" 0 DISPLAY_IDENTIFIER AssiPahFwl.PerInstanceMemories.dAssiPahFwlHiFrqAssiUpprLimFild /end MEASUREMENT
/begin MEASUREMENT AssiPahFwl.dAssiPahFwlHiFrqCmdHpPah "MICROSAR RTE" FLOAT32_IEEE NO_COMPU_METHOD 0 0 -3.402823466e+38 3.402823466e+38 ECU_ADDRESS 0 SYMBOL_LINK "Rte_AssiPahFwl_dAssiPahFwlHiFrqCmdHpPah" 0 DISPLAY_IDENTIFIER AssiPahFwl.PerInstanceMemories.dAssiPahFwlHiFrqCmdHpPah /end MEASUREMENT
/begin MEASUREMENT AssiPahFwl.dAssiPahFwlHiFrqCmdLpPah "MICROSAR RTE" FLOAT32_IEEE NO_COMPU_METHOD 0 0 -3.402823466e+38 3.402823466e+38 ECU_ADDRESS 0 SYMBOL_LINK "Rte_AssiPahFwl_dAssiPahFwlHiFrqCmdLpPah" 0 DISPLAY_IDENTIFIER AssiPahFwl.PerInstanceMemories.dAssiPahFwlHiFrqCmdLpPah /end MEASUREMENT
/begin MEASUREMENT AssiPahFwl.dAssiPahFwlHiFrqCmdOverLim "MICROSAR RTE" UBYTE RTE_CM_BOOLEAN 0 0 0 255 ECU_ADDRESS 0 SYMBOL_LINK "Rte_AssiPahFwl_dAssiPahFwlHiFrqCmdOverLim" 0 DISPLAY_IDENTIFIER AssiPahFwl.PerInstanceMemories.dAssiPahFwlHiFrqCmdOverLim /end MEASUREMENT
/begin MEASUREMENT AssiPahFwl.dAssiPahFwlHiFrqLpLimd "MICROSAR RTE" FLOAT32_IEEE NO_COMPU_METHOD 0 0 -3.402823466e+38 3.402823466e+38 ECU_ADDRESS 0 SYMBOL_LINK "Rte_AssiPahFwl_dAssiPahFwlHiFrqLpLimd" 0 DISPLAY_IDENTIFIER AssiPahFwl.PerInstanceMemories.dAssiPahFwlHiFrqLpLimd /end MEASUREMENT
/begin MEASUREMENT AssiPahFwl.dAssiPahFwlSumInp "MICROSAR RTE" FLOAT32_IEEE NO_COMPU_METHOD 0 0 -3.402823466e+38 3.402823466e+38 ECU_ADDRESS 0 SYMBOL_LINK "Rte_AssiPahFwl_dAssiPahFwlSumInp" 0 DISPLAY_IDENTIFIER AssiPahFwl.PerInstanceMemories.dAssiPahFwlSumInp /end MEASUREMENT
/begin MEASUREMENT AssiSumLim.AssiCmd.Val "MICROSAR RTE" FLOAT32_IEEE NO_COMPU_METHOD 0 0 -8.8 8.8 ECU_ADDRESS 0 SYMBOL_LINK "Rte_StabyCmp_AssiCmd_Val" 0 DISPLAY_IDENTIFIER AssiSumLim.ReceiverPorts.AssiCmd.Val /end MEASUREMENT
/begin MEASUREMENT AssiSumLim.DampgCmd.Val "MICROSAR RTE" FLOAT32_IEEE NO_COMPU_METHOD 0 0 -8.8 8.8 ECU_ADDRESS 0 SYMBOL_LINK "Rte_DampgPahFwl_DampgCmd_Val" 0 DISPLAY_IDENTIFIER AssiSumLim.ReceiverPorts.DampgCmd.Val /end MEASUREMENT
/begin MEASUREMENT AssiSumLim.EotActvCmd.Val "MICROSAR RTE" FLOAT32_IEEE NO_COMPU_METHOD 0 0 -8.8 8.8 ECU_ADDRESS 0 SYMBOL_LINK "Rte_EotProtnFwl_EotActvCmdLimd_Val" 0 DISPLAY_IDENTIFIER AssiSumLim.ReceiverPorts.EotActvCmd.Val /end MEASUREMENT
/begin MEASUREMENT AssiSumLim.EotAssiSca.Val "MICROSAR RTE" FLOAT32_IEEE NO_COMPU_METHOD 0 0 0.0 1.0 ECU_ADDRESS 0 SYMBOL_LINK "Rte_LimrCdng_EotAssiScaCdnd_Val" 0 DISPLAY_IDENTIFIER AssiSumLim.ReceiverPorts.EotAssiSca.Val /end MEASUREMENT
/begin MEASUREMENT AssiSumLim.EotDampgCmd.Val "MICROSAR RTE" FLOAT32_IEEE NO_COMPU_METHOD 0 0 -8.8 8.8 ECU_ADDRESS 0 SYMBOL_LINK "Rte_EotProtnFwl_EotDampgCmdLimd_Val" 0 DISPLAY_IDENTIFIER AssiSumLim.ReceiverPorts.EotDampgCmd.Val /end MEASUREMENT
/begin MEASUREMENT AssiSumLim.EotMotTqLim.Val "MICROSAR RTE" FLOAT32_IEEE NO_COMPU_METHOD 0 0 0 8.8 ECU_ADDRESS 0 SYMBOL_LINK "Rte_LimrCdng_EotMotTqLimCdnd_Val" 0 DISPLAY_IDENTIFIER AssiSumLim.ReceiverPorts.EotMotTqLim.Val /end MEASUREMENT
/begin MEASUREMENT AssiSumLim.HwTqLoaMtgtnEna.Logl "MICROSAR RTE" UBYTE RTE_CM_BOOLEAN 0 0 0 255 ECU_ADDRESS 0 SYMBOL_LINK "Rte_LoaMgr_HwTqLoaMtgtnEna_Logl" 0 DISPLAY_IDENTIFIER AssiSumLim.ReceiverPorts.HwTqLoaMtgtnEna.Logl /end MEASUREMENT
/begin MEASUREMENT AssiSumLim.MotTqCmd.Val "MICROSAR RTE" FLOAT32_IEEE NO_COMPU_METHOD 0 0 -8.8 8.8 ECU_ADDRESS 0 SYMBOL_LINK "Rte_AssiSumLim_MotTqCmd_Val" 0 DISPLAY_IDENTIFIER AssiSumLim.SenderPorts.MotTqCmd.Val /end MEASUREMENT
/begin MEASUREMENT AssiSumLim.MotTqCmdLimDi.Logl "MICROSAR RTE" UBYTE RTE_CM_BOOLEAN 0 0 0 255 ECU_ADDRESS 0 SYMBOL_LINK "Rte_AssiSumLim_MotTqCmdLimDi_Logl" 0 DISPLAY_IDENTIFIER AssiSumLim.ReceiverPorts.MotTqCmdLimDi.Logl /end MEASUREMENT
/begin MEASUREMENT AssiSumLim.MotTqCmdLimdPreStall.Val "MICROSAR RTE" FLOAT32_IEEE NO_COMPU_METHOD 0 0 0 8.8 ECU_ADDRESS 0 SYMBOL_LINK "Rte_AssiSumLim_MotTqCmdLimdPreStall_Val" 0 DISPLAY_IDENTIFIER AssiSumLim.SenderPorts.MotTqCmdLimdPreStall.Val /end MEASUREMENT
/begin MEASUREMENT AssiSumLim.MotTqCmdLimrMin.Val "MICROSAR RTE" FLOAT32_IEEE NO_COMPU_METHOD 0 0 0 8.8 ECU_ADDRESS 0 SYMBOL_LINK "Rte_AssiSumLim_MotTqCmdLimrMin_Val" 0 DISPLAY_IDENTIFIER AssiSumLim.SenderPorts.MotTqCmdLimrMin.Val /end MEASUREMENT
/begin MEASUREMENT AssiSumLim.MotTqCmdOvrl.Val "MICROSAR RTE" FLOAT32_IEEE NO_COMPU_METHOD 0 0 -8.8 8.8 ECU_ADDRESS 0 SYMBOL_LINK "Rte_GmTqArbn_MotTqCmdOvrl_Val" 0 DISPLAY_IDENTIFIER AssiSumLim.ReceiverPorts.MotTqCmdOvrl.Val /end MEASUREMENT
/begin MEASUREMENT AssiSumLim.MotTqCmdPreLim.Val "MICROSAR RTE" FLOAT32_IEEE NO_COMPU_METHOD 0 0 -8.8 8.8 ECU_ADDRESS 0 SYMBOL_LINK "Rte_AssiSumLim_MotTqCmdPreLim_Val" 0 DISPLAY_IDENTIFIER AssiSumLim.SenderPorts.MotTqCmdPreLim.Val /end MEASUREMENT
/begin MEASUREMENT AssiSumLim.PinionCentrLrnCmd.Val "MICROSAR RTE" FLOAT32_IEEE NO_COMPU_METHOD 0 0 -8.8 8.8 ECU_ADDRESS 0 SYMBOL_LINK "Rte_AssiSumLim_PinionCentrLrnCmd_Val" 0 DISPLAY_IDENTIFIER AssiSumLim.ReceiverPorts.PinionCentrLrnCmd.Val /end MEASUREMENT
/begin MEASUREMENT AssiSumLim.PinionCentrLrnEna.Logl "MICROSAR RTE" UBYTE RTE_CM_BOOLEAN 0 0 0 255 ECU_ADDRESS 0 SYMBOL_LINK "Rte_AssiSumLim_PinionCentrLrnEna_Logl" 0 DISPLAY_IDENTIFIER AssiSumLim.ReceiverPorts.PinionCentrLrnEna.Logl /end MEASUREMENT
/begin MEASUREMENT AssiSumLim.PullCmpCmd.Val "MICROSAR RTE" FLOAT32_IEEE NO_COMPU_METHOD 0 0 -8.8 8.8 ECU_ADDRESS 0 SYMBOL_LINK "Rte_PullCmpActv_PullCmpCmd_Val" 0 DISPLAY_IDENTIFIER AssiSumLim.ReceiverPorts.PullCmpCmd.Val /end MEASUREMENT
/begin MEASUREMENT AssiSumLim.PwrLimrRednFac.Val "MICROSAR RTE" FLOAT32_IEEE NO_COMPU_METHOD 0 0 0.0 1.0 ECU_ADDRESS 0 SYMBOL_LINK "Rte_PwrLimr_PwrLimrRednFac_Val" 0 DISPLAY_IDENTIFIER AssiSumLim.ReceiverPorts.PwrLimrRednFac.Val /end MEASUREMENT
/begin MEASUREMENT AssiSumLim.RtnCmd.Val "MICROSAR RTE" FLOAT32_IEEE NO_COMPU_METHOD 0 0 -8.8 8.8 ECU_ADDRESS 0 SYMBOL_LINK "Rte_RtnPahFwl_RtnCmdLimd_Val" 0 DISPLAY_IDENTIFIER AssiSumLim.ReceiverPorts.RtnCmd.Val /end MEASUREMENT
/begin MEASUREMENT AssiSumLim.StallMotTqLim.Val "MICROSAR RTE" FLOAT32_IEEE NO_COMPU_METHOD 0 0 0 8.8 ECU_ADDRESS 0 SYMBOL_LINK "Rte_LimrCdng_StallMotTqLimCdnd_Val" 0 DISPLAY_IDENTIFIER AssiSumLim.ReceiverPorts.StallMotTqLim.Val /end MEASUREMENT
/begin MEASUREMENT AssiSumLim.SysMotTqCmdSca.Val "MICROSAR RTE" FLOAT32_IEEE NO_COMPU_METHOD 0 0 0.0 1.0 ECU_ADDRESS 0 SYMBOL_LINK "Rte_LimrCdng_SysMotTqCmdScaCdnd_Val" 0 DISPLAY_IDENTIFIER AssiSumLim.ReceiverPorts.SysMotTqCmdSca.Val /end MEASUREMENT
/begin MEASUREMENT AssiSumLim.SysProtnRednFac.Val "MICROSAR RTE" FLOAT32_IEEE NO_COMPU_METHOD 0 0 0.0 1.0 ECU_ADDRESS 0 SYMBOL_LINK "Rte_AssiSumLim_SysProtnRednFac_Val" 0 DISPLAY_IDENTIFIER AssiSumLim.SenderPorts.SysProtnRednFac.Val /end MEASUREMENT
/begin MEASUREMENT AssiSumLim.ThermMotTqLim.Val "MICROSAR RTE" FLOAT32_IEEE NO_COMPU_METHOD 0 0 0 8.8 ECU_ADDRESS 0 SYMBOL_LINK "Rte_LimrCdng_ThermMotTqLimCdnd_Val" 0 DISPLAY_IDENTIFIER AssiSumLim.ReceiverPorts.ThermMotTqLim.Val /end MEASUREMENT
/begin MEASUREMENT AssiSumLim.ThermRednFac.Val "MICROSAR RTE" FLOAT32_IEEE NO_COMPU_METHOD 0 0 0.0 1.0 ECU_ADDRESS 0 SYMBOL_LINK "Rte_DutyCycThermProtn_ThermRednFac_Val" 0 DISPLAY_IDENTIFIER AssiSumLim.ReceiverPorts.ThermRednFac.Val /end MEASUREMENT
/begin MEASUREMENT AssiSumLim.TqLoaCmd.Val "MICROSAR RTE" FLOAT32_IEEE NO_COMPU_METHOD 0 0 -8.8 8.8 ECU_ADDRESS 0 SYMBOL_LINK "Rte_TqLoa_TqLoaCmd_Val" 0 DISPLAY_IDENTIFIER AssiSumLim.ReceiverPorts.TqLoaCmd.Val /end MEASUREMENT
/begin MEASUREMENT AssiSumLim.TqSteerMtgtnCmd.Val "MICROSAR RTE" FLOAT32_IEEE NO_COMPU_METHOD 0 0 -3.0 3.0 ECU_ADDRESS 0 SYMBOL_LINK "Rte_AssiSumLim_TqSteerMtgtnCmd_Val" 0 DISPLAY_IDENTIFIER AssiSumLim.ReceiverPorts.TqSteerMtgtnCmd.Val /end MEASUREMENT
/begin MEASUREMENT AssiSumLim.VehSpd.Val "MICROSAR RTE" FLOAT32_IEEE NO_COMPU_METHOD 0 0 0.0 511.0 ECU_ADDRESS 0 SYMBOL_LINK "Rte_VehSigCdng_VehSpd_Val" 0 DISPLAY_IDENTIFIER AssiSumLim.ReceiverPorts.VehSpd.Val /end MEASUREMENT
/begin MEASUREMENT AssiSumLim.VehSpdMotTqLim.Val "MICROSAR RTE" FLOAT32_IEEE NO_COMPU_METHOD 0 0 0 8.8 ECU_ADDRESS 0 SYMBOL_LINK "Rte_LimrCdng_VehSpdMotTqLimCdnd_Val" 0 DISPLAY_IDENTIFIER AssiSumLim.ReceiverPorts.VehSpdMotTqLim.Val /end MEASUREMENT
/begin MEASUREMENT AssiSumLim.WhlImbRejctnCmd.Val "MICROSAR RTE" FLOAT32_IEEE NO_COMPU_METHOD 0 0 -8.0 8.0 ECU_ADDRESS 0 SYMBOL_LINK "Rte_WhlImbRejctn_WhlImbRejctnCmd_Val" 0 DISPLAY_IDENTIFIER AssiSumLim.ReceiverPorts.WhlImbRejctnCmd.Val /end MEASUREMENT
/begin MEASUREMENT BattVltg.BattSwdVltgCorrlnSts.Val "MICROSAR RTE" UBYTE NO_COMPU_METHOD 0 0 0 255 ECU_ADDRESS 0 SYMBOL_LINK "Rte_BattVltgCorrln_BattSwdVltgCorrlnSts_Val" 0 DISPLAY_IDENTIFIER BattVltg.ReceiverPorts.BattSwdVltgCorrlnSts.Val /end MEASUREMENT
/begin MEASUREMENT BattVltg.BattVltg.Val "MICROSAR RTE" FLOAT32_IEEE NO_COMPU_METHOD 0 0 0.0 40.0 ECU_ADDRESS 0 SYMBOL_LINK "Rte_CDD_GmG2kcaMcuCfg_BattVltg_Val" 0 DISPLAY_IDENTIFIER BattVltg.ReceiverPorts.BattVltg.Val /end MEASUREMENT
/begin MEASUREMENT BattVltg.BattVltgSwd1.Val "MICROSAR RTE" FLOAT32_IEEE NO_COMPU_METHOD 0 0 0.0 40.0 ECU_ADDRESS 0 SYMBOL_LINK "Rte_CDD_GmG2kcaMcuCfg_BattVltgSwd1_Val" 0 DISPLAY_IDENTIFIER BattVltg.ReceiverPorts.BattVltgSwd1.Val /end MEASUREMENT
/begin MEASUREMENT BattVltg.BattVltgSwd2.Val "MICROSAR RTE" FLOAT32_IEEE NO_COMPU_METHOD 0 0 0.0 40.0 ECU_ADDRESS 0 SYMBOL_LINK "Rte_CDD_GmG2kcaMcuCfg_BattVltgSwd2_Val" 0 DISPLAY_IDENTIFIER BattVltg.ReceiverPorts.BattVltgSwd2.Val /end MEASUREMENT
/begin MEASUREMENT BattVltg.BrdgVltg.Val "MICROSAR RTE" FLOAT32_IEEE NO_COMPU_METHOD 0 0 6.0 26.5 ECU_ADDRESS 0 SYMBOL_LINK "Rte_BattVltg_BrdgVltg_Val" 0 DISPLAY_IDENTIFIER BattVltg.SenderPorts.BrdgVltg.Val /end MEASUREMENT
/begin MEASUREMENT BattVltgCorrln.BattSwdVltgCorrlnSts.Val "MICROSAR RTE" UBYTE NO_COMPU_METHOD 0 0 0 255 ECU_ADDRESS 0 SYMBOL_LINK "Rte_BattVltgCorrln_BattSwdVltgCorrlnSts_Val" 0 DISPLAY_IDENTIFIER BattVltgCorrln.SenderPorts.BattSwdVltgCorrlnSts.Val /end MEASUREMENT
/begin MEASUREMENT BattVltgCorrln.BattVltg.Val "MICROSAR RTE" FLOAT32_IEEE NO_COMPU_METHOD 0 0 -3.402823466e+38 3.402823466e+38 ECU_ADDRESS 0 SYMBOL_LINK "Rte_CDD_GmG2kcaMcuCfg_BattVltg_Val" 0 DISPLAY_IDENTIFIER BattVltgCorrln.ReceiverPorts.BattVltg.Val /end MEASUREMENT
/begin MEASUREMENT BattVltgCorrln.BattVltgAdcFaild.Logl "MICROSAR RTE" UBYTE RTE_CM_BOOLEAN 0 0 0 255 ECU_ADDRESS 0 SYMBOL_LINK "Rte_CDD_GmG2kcaMcuCfg_BattVltgAdcFaild_Logl" 0 DISPLAY_IDENTIFIER BattVltgCorrln.ReceiverPorts.BattVltgAdcFaild.Logl /end MEASUREMENT
/begin MEASUREMENT BattVltgCorrln.BattVltgCorrlnIdptSig.Val "MICROSAR RTE" UBYTE NO_COMPU_METHOD 0 0 0 255 ECU_ADDRESS 0 SYMBOL_LINK "Rte_BattVltgCorrln_BattVltgCorrlnIdptSig_Val" 0 DISPLAY_IDENTIFIER BattVltgCorrln.SenderPorts.BattVltgCorrlnIdptSig.Val /end MEASUREMENT
/begin MEASUREMENT BattVltgCorrln.BattVltgSwd1.Val "MICROSAR RTE" FLOAT32_IEEE NO_COMPU_METHOD 0 0 -3.402823466e+38 3.402823466e+38 ECU_ADDRESS 0 SYMBOL_LINK "Rte_CDD_GmG2kcaMcuCfg_BattVltgSwd1_Val" 0 DISPLAY_IDENTIFIER BattVltgCorrln.ReceiverPorts.BattVltgSwd1.Val /end MEASUREMENT
/begin MEASUREMENT BattVltgCorrln.BattVltgSwd1AdcFaild.Logl "MICROSAR RTE" UBYTE RTE_CM_BOOLEAN 0 0 0 255 ECU_ADDRESS 0 SYMBOL_LINK "Rte_CDD_GmG2kcaMcuCfg_BattVltgSwd1AdcFaild_Logl" 0 DISPLAY_IDENTIFIER BattVltgCorrln.ReceiverPorts.BattVltgSwd1AdcFaild.Logl /end MEASUREMENT
/begin MEASUREMENT BattVltgCorrln.BattVltgSwd2.Val "MICROSAR RTE" FLOAT32_IEEE NO_COMPU_METHOD 0 0 -3.402823466e+38 3.402823466e+38 ECU_ADDRESS 0 SYMBOL_LINK "Rte_CDD_GmG2kcaMcuCfg_BattVltgSwd2_Val" 0 DISPLAY_IDENTIFIER BattVltgCorrln.ReceiverPorts.BattVltgSwd2.Val /end MEASUREMENT
/begin MEASUREMENT BattVltgCorrln.BattVltgSwd2AdcFaild.Logl "MICROSAR RTE" UBYTE RTE_CM_BOOLEAN 0 0 0 255 ECU_ADDRESS 0 SYMBOL_LINK "Rte_CDD_GmG2kcaMcuCfg_BattVltgSwd2AdcFaild_Logl" 0 DISPLAY_IDENTIFIER BattVltgCorrln.ReceiverPorts.BattVltgSwd2AdcFaild.Logl /end MEASUREMENT
/begin MEASUREMENT BattVltgCorrln.DftBrdgVltgActv.Logl "MICROSAR RTE" UBYTE RTE_CM_BOOLEAN 0 0 0 255 ECU_ADDRESS 0 SYMBOL_LINK "Rte_BattVltgCorrln_DftBrdgVltgActv_Logl" 0 DISPLAY_IDENTIFIER BattVltgCorrln.SenderPorts.DftBrdgVltgActv.Logl /end MEASUREMENT
/begin MEASUREMENT BattVltgCorrln.DiagcStsIvtr1Inactv.Logl "MICROSAR RTE" UBYTE RTE_CM_BOOLEAN 0 0 0 255 ECU_ADDRESS 0 SYMBOL_LINK "Rte_DiagcMgr_DiagcStsIvtr1Inactv_Logl" 0 DISPLAY_IDENTIFIER BattVltgCorrln.ReceiverPorts.DiagcStsIvtr1Inactv.Logl /end MEASUREMENT
/begin MEASUREMENT BattVltgCorrln.DiagcStsIvtr2Inactv.Logl "MICROSAR RTE" UBYTE RTE_CM_BOOLEAN 0 0 0 255 ECU_ADDRESS 0 SYMBOL_LINK "Rte_DiagcMgr_DiagcStsIvtr2Inactv_Logl" 0 DISPLAY_IDENTIFIER BattVltgCorrln.ReceiverPorts.DiagcStsIvtr2Inactv.Logl /end MEASUREMENT
/begin MEASUREMENT BattVltgCorrln.InhbBattVltgDiagc.Logl "MICROSAR RTE" UBYTE RTE_CM_BOOLEAN 0 0 0 255 ECU_ADDRESS 0 SYMBOL_LINK "Rte_BattVltgCorrln_InhbBattVltgDiagc_Logl" 0 DISPLAY_IDENTIFIER BattVltgCorrln.ReceiverPorts.InhbBattVltgDiagc.Logl /end MEASUREMENT
/begin MEASUREMENT BattVltgCorrln.StrtUpSt.Val "MICROSAR RTE" UBYTE NO_COMPU_METHOD 0 0 0 255 ECU_ADDRESS 0 SYMBOL_LINK "Rte_PwrUpSeq_StrtUpSt_Val" 0 DISPLAY_IDENTIFIER BattVltgCorrln.ReceiverPorts.StrtUpSt.Val /end MEASUREMENT
/begin MEASUREMENT BattVltgCorrln.SwdVltgLimd.Logl "MICROSAR RTE" UBYTE RTE_CM_BOOLEAN 0 0 0 255 ECU_ADDRESS 0 SYMBOL_LINK "Rte_BattVltgCorrln_SwdVltgLimd_Logl" 0 DISPLAY_IDENTIFIER BattVltgCorrln.SenderPorts.SwdVltgLimd.Logl /end MEASUREMENT
/begin MEASUREMENT BattVltgCorrln.SysSt.Val "MICROSAR RTE" UBYTE RTE_CM_ENUM_SysSt1 0 0 0 255 ECU_ADDRESS 0 SYMBOL_LINK "Rte_SysStMod_SysSt_Val" 0 DISPLAY_IDENTIFIER BattVltgCorrln.ReceiverPorts.SysSt.Val /end MEASUREMENT
/begin MEASUREMENT BattVltgCorrln.dBattVltgCorrlnBattVltgOk "MICROSAR RTE" UBYTE NO_COMPU_METHOD 0 0 0 255 ECU_ADDRESS 0 SYMBOL_LINK "Rte_BattVltgCorrln_dBattVltgCorrlnBattVltgOk" 0 DISPLAY_IDENTIFIER BattVltgCorrln.PerInstanceMemories.dBattVltgCorrlnBattVltgOk /end MEASUREMENT
/begin MEASUREMENT BattVltgCorrln.dBattVltgCorrlnBattVltgRngOk "MICROSAR RTE" UBYTE NO_COMPU_METHOD 0 0 0 255 ECU_ADDRESS 0 SYMBOL_LINK "Rte_BattVltgCorrln_dBattVltgCorrlnBattVltgRngOk" 0 DISPLAY_IDENTIFIER BattVltgCorrln.PerInstanceMemories.dBattVltgCorrlnBattVltgRngOk /end MEASUREMENT
/begin MEASUREMENT BattVltgCorrln.dBattVltgCorrlnBattVltgSwd1Ok "MICROSAR RTE" UBYTE NO_COMPU_METHOD 0 0 0 255 ECU_ADDRESS 0 SYMBOL_LINK "Rte_BattVltgCorrln_dBattVltgCorrlnBattVltgSwd1Ok" 0 DISPLAY_IDENTIFIER BattVltgCorrln.PerInstanceMemories.dBattVltgCorrlnBattVltgSwd1Ok /end MEASUREMENT
/begin MEASUREMENT BattVltgCorrln.dBattVltgCorrlnBattVltgSwd1RngOk "MICROSAR RTE" UBYTE NO_COMPU_METHOD 0 0 0 255 ECU_ADDRESS 0 SYMBOL_LINK "Rte_BattVltgCorrln_dBattVltgCorrlnBattVltgSwd1RngOk" 0 DISPLAY_IDENTIFIER BattVltgCorrln.PerInstanceMemories.dBattVltgCorrlnBattVltgSwd1RngOk /end MEASUREMENT
/begin MEASUREMENT BattVltgCorrln.dBattVltgCorrlnBattVltgSwd2Ok "MICROSAR RTE" UBYTE NO_COMPU_METHOD 0 0 0 255 ECU_ADDRESS 0 SYMBOL_LINK "Rte_BattVltgCorrln_dBattVltgCorrlnBattVltgSwd2Ok" 0 DISPLAY_IDENTIFIER BattVltgCorrln.PerInstanceMemories.dBattVltgCorrlnBattVltgSwd2Ok /end MEASUREMENT
/begin MEASUREMENT BattVltgCorrln.dBattVltgCorrlnBattVltgSwd2RngOk "MICROSAR RTE" UBYTE NO_COMPU_METHOD 0 0 0 255 ECU_ADDRESS 0 SYMBOL_LINK "Rte_BattVltgCorrln_dBattVltgCorrlnBattVltgSwd2RngOk" 0 DISPLAY_IDENTIFIER BattVltgCorrln.PerInstanceMemories.dBattVltgCorrlnBattVltgSwd2RngOk /end MEASUREMENT
/begin MEASUREMENT BattVltgCorrln.dBattVltgCorrlnNtc0x03CQlfrSts "MICROSAR RTE" UBYTE RTE_CM_ENUM_SigQlfr1 0 0 0 255 ECU_ADDRESS 0 SYMBOL_LINK "Rte_BattVltgCorrln_dBattVltgCorrlnNtc0x03CQlfrSts" 0 DISPLAY_IDENTIFIER BattVltgCorrln.PerInstanceMemories.dBattVltgCorrlnNtc0x03CQlfrSts /end MEASUREMENT
/begin MEASUREMENT BattVltgCorrln.dBattVltgCorrlnNtc0x03DQlfrSts "MICROSAR RTE" UBYTE RTE_CM_ENUM_SigQlfr1 0 0 0 255 ECU_ADDRESS 0 SYMBOL_LINK "Rte_BattVltgCorrln_dBattVltgCorrlnNtc0x03DQlfrSts" 0 DISPLAY_IDENTIFIER BattVltgCorrln.PerInstanceMemories.dBattVltgCorrlnNtc0x03DQlfrSts /end MEASUREMENT
/begin MEASUREMENT BattVltgCorrln.dBattVltgCorrlnNtc0x044QlfrSts "MICROSAR RTE" UBYTE RTE_CM_ENUM_SigQlfr1 0 0 0 255 ECU_ADDRESS 0 SYMBOL_LINK "Rte_BattVltgCorrln_dBattVltgCorrlnNtc0x044QlfrSts" 0 DISPLAY_IDENTIFIER BattVltgCorrln.PerInstanceMemories.dBattVltgCorrlnNtc0x044QlfrSts /end MEASUREMENT
/begin MEASUREMENT BattVltgCorrln.dBattVltgCorrlnNtc0x04CQlfrSts "MICROSAR RTE" UBYTE RTE_CM_ENUM_SigQlfr1 0 0 0 255 ECU_ADDRESS 0 SYMBOL_LINK "Rte_BattVltgCorrln_dBattVltgCorrlnNtc0x04CQlfrSts" 0 DISPLAY_IDENTIFIER BattVltgCorrln.PerInstanceMemories.dBattVltgCorrlnNtc0x04CQlfrSts /end MEASUREMENT
/begin MEASUREMENT CDD_Adc0CfgAndUse.Adc0DiagcEndPtr "MICROSAR RTE" UBYTE NO_COMPU_METHOD 0 0 0 255 ECU_ADDRESS 0 SYMBOL_LINK "Rte_CDD_Adc0CfgAndUse_Adc0DiagcEndPtr" 0 DISPLAY_IDENTIFIER CDD_Adc0CfgAndUse.PerInstanceMemories.Adc0DiagcEndPtr /end MEASUREMENT
/begin MEASUREMENT CDD_Adc0CfgAndUse.Adc0DiagcStrtPtr "MICROSAR RTE" UBYTE NO_COMPU_METHOD 0 0 0 255 ECU_ADDRESS 0 SYMBOL_LINK "Rte_CDD_Adc0CfgAndUse_Adc0DiagcStrtPtr" 0 DISPLAY_IDENTIFIER CDD_Adc0CfgAndUse.PerInstanceMemories.Adc0DiagcStrtPtr /end MEASUREMENT
/begin MEASUREMENT CDD_Adc1CfgAndUse.Adc1DiagcEndPtr "MICROSAR RTE" UBYTE NO_COMPU_METHOD 0 0 0 255 ECU_ADDRESS 0 SYMBOL_LINK "Rte_CDD_Adc1CfgAndUse_Adc1DiagcEndPtr" 0 DISPLAY_IDENTIFIER CDD_Adc1CfgAndUse.PerInstanceMemories.Adc1DiagcEndPtr /end MEASUREMENT
/begin MEASUREMENT CDD_Adc1CfgAndUse.Adc1DiagcStrtPtr "MICROSAR RTE" UBYTE NO_COMPU_METHOD 0 0 0 255 ECU_ADDRESS 0 SYMBOL_LINK "Rte_CDD_Adc1CfgAndUse_Adc1DiagcStrtPtr" 0 DISPLAY_IDENTIFIER CDD_Adc1CfgAndUse.PerInstanceMemories.Adc1DiagcStrtPtr /end MEASUREMENT
/begin MEASUREMENT CDD_Adc1CfgAndUse.AdcDiagcEndPtrOutp.Val "MICROSAR RTE" UBYTE NO_COMPU_METHOD 0 0 0 255 ECU_ADDRESS 0 SYMBOL_LINK "Rte_CDD_AdcDiagc_AdcDiagcEndPtrOutp_Val" 0 DISPLAY_IDENTIFIER CDD_Adc1CfgAndUse.ReceiverPorts.AdcDiagcEndPtrOutp.Val /end MEASUREMENT
/begin MEASUREMENT CDD_Adc1CfgAndUse.AdcDiagcStrtPtrOutp.Val "MICROSAR RTE" UBYTE NO_COMPU_METHOD 0 0 0 255 ECU_ADDRESS 0 SYMBOL_LINK "Rte_CDD_AdcDiagc_AdcDiagcStrtPtrOutp_Val" 0 DISPLAY_IDENTIFIER CDD_Adc1CfgAndUse.ReceiverPorts.AdcDiagcStrtPtrOutp.Val /end MEASUREMENT
/begin MEASUREMENT CDD_AdcDiagc.Adc0Faild.Logl "MICROSAR RTE" UBYTE RTE_CM_BOOLEAN 0 0 0 255 ECU_ADDRESS 0 SYMBOL_LINK "Rte_CDD_AdcDiagc_Adc0Faild_Logl" 0 DISPLAY_IDENTIFIER CDD_AdcDiagc.SenderPorts.Adc0Faild.Logl /end MEASUREMENT
/begin MEASUREMENT CDD_AdcDiagc.Adc0FltCntSt0 "MICROSAR RTE" UBYTE NO_COMPU_METHOD 0 0 0 255 ECU_ADDRESS 0 SYMBOL_LINK "Rte_CDD_AdcDiagc_Adc0FltCntSt0" 0 DISPLAY_IDENTIFIER CDD_AdcDiagc.PerInstanceMemories.Adc0FltCntSt0 /end MEASUREMENT
/begin MEASUREMENT CDD_AdcDiagc.Adc0FltCntSt2 "MICROSAR RTE" UBYTE NO_COMPU_METHOD 0 0 0 255 ECU_ADDRESS 0 SYMBOL_LINK "Rte_CDD_AdcDiagc_Adc0FltCntSt2" 0 DISPLAY_IDENTIFIER CDD_AdcDiagc.PerInstanceMemories.Adc0FltCntSt2 /end MEASUREMENT
/begin MEASUREMENT CDD_AdcDiagc.Adc0FltCntSt4 "MICROSAR RTE" UBYTE NO_COMPU_METHOD 0 0 0 255 ECU_ADDRESS 0 SYMBOL_LINK "Rte_CDD_AdcDiagc_Adc0FltCntSt4" 0 DISPLAY_IDENTIFIER CDD_AdcDiagc.PerInstanceMemories.Adc0FltCntSt4 /end MEASUREMENT
/begin MEASUREMENT CDD_AdcDiagc.Adc0FltCntSt6 "MICROSAR RTE" UBYTE NO_COMPU_METHOD 0 0 0 255 ECU_ADDRESS 0 SYMBOL_LINK "Rte_CDD_AdcDiagc_Adc0FltCntSt6" 0 DISPLAY_IDENTIFIER CDD_AdcDiagc.PerInstanceMemories.Adc0FltCntSt6 /end MEASUREMENT
/begin MEASUREMENT CDD_AdcDiagc.Adc0ScanGroup2Ref0.Val "MICROSAR RTE" FLOAT32_IEEE NO_COMPU_METHOD 0 0 -3.402823466e+38 3.402823466e+38 ECU_ADDRESS 0 SYMBOL_LINK "Rte_CDD_MotCtrlMgr_Adc0ScanGroup2Ref0_Val" 0 DISPLAY_IDENTIFIER CDD_AdcDiagc.ReceiverPorts.Adc0ScanGroup2Ref0.Val /end MEASUREMENT
/begin MEASUREMENT CDD_AdcDiagc.Adc0ScanGroup2Ref1.Val "MICROSAR RTE" FLOAT32_IEEE NO_COMPU_METHOD 0 0 -3.402823466e+38 3.402823466e+38 ECU_ADDRESS 0 SYMBOL_LINK "Rte_CDD_MotCtrlMgr_Adc0ScanGroup2Ref1_Val" 0 DISPLAY_IDENTIFIER CDD_AdcDiagc.ReceiverPorts.Adc0ScanGroup2Ref1.Val /end MEASUREMENT
/begin MEASUREMENT CDD_AdcDiagc.Adc0ScanGroup2RefFltCntSt "MICROSAR RTE" UBYTE NO_COMPU_METHOD 0 0 0 255 ECU_ADDRESS 0 SYMBOL_LINK "Rte_CDD_AdcDiagc_Adc0ScanGroup2RefFltCntSt" 0 DISPLAY_IDENTIFIER CDD_AdcDiagc.PerInstanceMemories.Adc0ScanGroup2RefFltCntSt /end MEASUREMENT
/begin MEASUREMENT CDD_AdcDiagc.Adc0ScanGroup3Ref0.Val "MICROSAR RTE" FLOAT32_IEEE NO_COMPU_METHOD 0 0 -3.402823466e+38 3.402823466e+38 ECU_ADDRESS 0 SYMBOL_LINK "Rte_CDD_MotCtrlMgr_Adc0ScanGroup3Ref0_Val" 0 DISPLAY_IDENTIFIER CDD_AdcDiagc.ReceiverPorts.Adc0ScanGroup3Ref0.Val /end MEASUREMENT
/begin MEASUREMENT CDD_AdcDiagc.Adc0ScanGroup3Ref1.Val "MICROSAR RTE" FLOAT32_IEEE NO_COMPU_METHOD 0 0 -3.402823466e+38 3.402823466e+38 ECU_ADDRESS 0 SYMBOL_LINK "Rte_CDD_MotCtrlMgr_Adc0ScanGroup3Ref1_Val" 0 DISPLAY_IDENTIFIER CDD_AdcDiagc.ReceiverPorts.Adc0ScanGroup3Ref1.Val /end MEASUREMENT
/begin MEASUREMENT CDD_AdcDiagc.Adc0ScanGroup3RefFltCntSt "MICROSAR RTE" UBYTE NO_COMPU_METHOD 0 0 0 255 ECU_ADDRESS 0 SYMBOL_LINK "Rte_CDD_AdcDiagc_Adc0ScanGroup3RefFltCntSt" 0 DISPLAY_IDENTIFIER CDD_AdcDiagc.PerInstanceMemories.Adc0ScanGroup3RefFltCntSt /end MEASUREMENT
/begin MEASUREMENT CDD_AdcDiagc.Adc0SelfDiag0.Val "MICROSAR RTE" FLOAT32_IEEE NO_COMPU_METHOD 0 0 -3.402823466e+38 3.402823466e+38 ECU_ADDRESS 0 SYMBOL_LINK "Rte_CDD_MotCtrlMgr_Adc0SelfDiag0_Val" 0 DISPLAY_IDENTIFIER CDD_AdcDiagc.ReceiverPorts.Adc0SelfDiag0.Val /end MEASUREMENT
/begin MEASUREMENT CDD_AdcDiagc.Adc0SelfDiag2.Val "MICROSAR RTE" FLOAT32_IEEE NO_COMPU_METHOD 0 0 -3.402823466e+38 3.402823466e+38 ECU_ADDRESS 0 SYMBOL_LINK "Rte_CDD_MotCtrlMgr_Adc0SelfDiag2_Val" 0 DISPLAY_IDENTIFIER CDD_AdcDiagc.ReceiverPorts.Adc0SelfDiag2.Val /end MEASUREMENT
/begin MEASUREMENT CDD_AdcDiagc.Adc0SelfDiag4.Val "MICROSAR RTE" FLOAT32_IEEE NO_COMPU_METHOD 0 0 -3.402823466e+38 3.402823466e+38 ECU_ADDRESS 0 SYMBOL_LINK "Rte_CDD_MotCtrlMgr_Adc0SelfDiag4_Val" 0 DISPLAY_IDENTIFIER CDD_AdcDiagc.ReceiverPorts.Adc0SelfDiag4.Val /end MEASUREMENT
/begin MEASUREMENT CDD_AdcDiagc.Adc1Faild.Logl "MICROSAR RTE" UBYTE RTE_CM_BOOLEAN 0 0 0 255 ECU_ADDRESS 0 SYMBOL_LINK "Rte_CDD_AdcDiagc_Adc1Faild_Logl" 0 DISPLAY_IDENTIFIER CDD_AdcDiagc.SenderPorts.Adc1Faild.Logl /end MEASUREMENT
/begin MEASUREMENT CDD_AdcDiagc.Adc1FltCntSt0 "MICROSAR RTE" UBYTE NO_COMPU_METHOD 0 0 0 255 ECU_ADDRESS 0 SYMBOL_LINK "Rte_CDD_AdcDiagc_Adc1FltCntSt0" 0 DISPLAY_IDENTIFIER CDD_AdcDiagc.PerInstanceMemories.Adc1FltCntSt0 /end MEASUREMENT
/begin MEASUREMENT CDD_AdcDiagc.Adc1FltCntSt2 "MICROSAR RTE" UBYTE NO_COMPU_METHOD 0 0 0 255 ECU_ADDRESS 0 SYMBOL_LINK "Rte_CDD_AdcDiagc_Adc1FltCntSt2" 0 DISPLAY_IDENTIFIER CDD_AdcDiagc.PerInstanceMemories.Adc1FltCntSt2 /end MEASUREMENT
/begin MEASUREMENT CDD_AdcDiagc.Adc1FltCntSt4 "MICROSAR RTE" UBYTE NO_COMPU_METHOD 0 0 0 255 ECU_ADDRESS 0 SYMBOL_LINK "Rte_CDD_AdcDiagc_Adc1FltCntSt4" 0 DISPLAY_IDENTIFIER CDD_AdcDiagc.PerInstanceMemories.Adc1FltCntSt4 /end MEASUREMENT
/begin MEASUREMENT CDD_AdcDiagc.Adc1FltCntSt6 "MICROSAR RTE" UBYTE NO_COMPU_METHOD 0 0 0 255 ECU_ADDRESS 0 SYMBOL_LINK "Rte_CDD_AdcDiagc_Adc1FltCntSt6" 0 DISPLAY_IDENTIFIER CDD_AdcDiagc.PerInstanceMemories.Adc1FltCntSt6 /end MEASUREMENT
/begin MEASUREMENT CDD_AdcDiagc.Adc1ScanGroup2Ref0.Val "MICROSAR RTE" FLOAT32_IEEE NO_COMPU_METHOD 0 0 -3.402823466e+38 3.402823466e+38 ECU_ADDRESS 0 SYMBOL_LINK "Rte_CDD_GmG2kcaMcuCfg_Adc1ScanGroup2Ref0_Val" 0 DISPLAY_IDENTIFIER CDD_AdcDiagc.ReceiverPorts.Adc1ScanGroup2Ref0.Val /end MEASUREMENT
/begin MEASUREMENT CDD_AdcDiagc.Adc1ScanGroup2Ref1.Val "MICROSAR RTE" FLOAT32_IEEE NO_COMPU_METHOD 0 0 -3.402823466e+38 3.402823466e+38 ECU_ADDRESS 0 SYMBOL_LINK "Rte_CDD_GmG2kcaMcuCfg_Adc1ScanGroup2Ref1_Val" 0 DISPLAY_IDENTIFIER CDD_AdcDiagc.ReceiverPorts.Adc1ScanGroup2Ref1.Val /end MEASUREMENT
/begin MEASUREMENT CDD_AdcDiagc.Adc1ScanGroup2RefFltCntSt "MICROSAR RTE" UBYTE NO_COMPU_METHOD 0 0 0 255 ECU_ADDRESS 0 SYMBOL_LINK "Rte_CDD_AdcDiagc_Adc1ScanGroup2RefFltCntSt" 0 DISPLAY_IDENTIFIER CDD_AdcDiagc.PerInstanceMemories.Adc1ScanGroup2RefFltCntSt /end MEASUREMENT
/begin MEASUREMENT CDD_AdcDiagc.Adc1ScanGroup3Ref0.Val "MICROSAR RTE" FLOAT32_IEEE NO_COMPU_METHOD 0 0 -3.402823466e+38 3.402823466e+38 ECU_ADDRESS 0 SYMBOL_LINK "Rte_CDD_GmG2kcaMcuCfg_Adc1ScanGroup3Ref0_Val" 0 DISPLAY_IDENTIFIER CDD_AdcDiagc.ReceiverPorts.Adc1ScanGroup3Ref0.Val /end MEASUREMENT
/begin MEASUREMENT CDD_AdcDiagc.Adc1ScanGroup3Ref1.Val "MICROSAR RTE" FLOAT32_IEEE NO_COMPU_METHOD 0 0 -3.402823466e+38 3.402823466e+38 ECU_ADDRESS 0 SYMBOL_LINK "Rte_CDD_GmG2kcaMcuCfg_Adc1ScanGroup3Ref1_Val" 0 DISPLAY_IDENTIFIER CDD_AdcDiagc.ReceiverPorts.Adc1ScanGroup3Ref1.Val /end MEASUREMENT
/begin MEASUREMENT CDD_AdcDiagc.Adc1ScanGroup3RefFltCntSt "MICROSAR RTE" UBYTE NO_COMPU_METHOD 0 0 0 255 ECU_ADDRESS 0 SYMBOL_LINK "Rte_CDD_AdcDiagc_Adc1ScanGroup3RefFltCntSt" 0 DISPLAY_IDENTIFIER CDD_AdcDiagc.PerInstanceMemories.Adc1ScanGroup3RefFltCntSt /end MEASUREMENT
/begin MEASUREMENT CDD_AdcDiagc.Adc1SelfDiag0.Val "MICROSAR RTE" FLOAT32_IEEE NO_COMPU_METHOD 0 0 -3.402823466e+38 3.402823466e+38 ECU_ADDRESS 0 SYMBOL_LINK "Rte_CDD_GmG2kcaMcuCfg_Adc1SelfDiag0_Val" 0 DISPLAY_IDENTIFIER CDD_AdcDiagc.ReceiverPorts.Adc1SelfDiag0.Val /end MEASUREMENT
/begin MEASUREMENT CDD_AdcDiagc.Adc1SelfDiag2.Val "MICROSAR RTE" FLOAT32_IEEE NO_COMPU_METHOD 0 0 -3.402823466e+38 3.402823466e+38 ECU_ADDRESS 0 SYMBOL_LINK "Rte_CDD_GmG2kcaMcuCfg_Adc1SelfDiag2_Val" 0 DISPLAY_IDENTIFIER CDD_AdcDiagc.ReceiverPorts.Adc1SelfDiag2.Val /end MEASUREMENT
/begin MEASUREMENT CDD_AdcDiagc.Adc1SelfDiag4.Val "MICROSAR RTE" FLOAT32_IEEE NO_COMPU_METHOD 0 0 -3.402823466e+38 3.402823466e+38 ECU_ADDRESS 0 SYMBOL_LINK "Rte_CDD_GmG2kcaMcuCfg_Adc1SelfDiag4_Val" 0 DISPLAY_IDENTIFIER CDD_AdcDiagc.ReceiverPorts.Adc1SelfDiag4.Val /end MEASUREMENT
/begin MEASUREMENT CDD_AdcDiagc.AdcDiagcEndPtr "MICROSAR RTE" UBYTE NO_COMPU_METHOD 0 0 0 255 ECU_ADDRESS 0 SYMBOL_LINK "Rte_CDD_AdcDiagc_AdcDiagcEndPtr" 0 DISPLAY_IDENTIFIER CDD_AdcDiagc.PerInstanceMemories.AdcDiagcEndPtr /end MEASUREMENT
/begin MEASUREMENT CDD_AdcDiagc.AdcDiagcEndPtrOutp.Val "MICROSAR RTE" UBYTE NO_COMPU_METHOD 0 0 0 255 ECU_ADDRESS 0 SYMBOL_LINK "Rte_CDD_AdcDiagc_AdcDiagcEndPtrOutp_Val" 0 DISPLAY_IDENTIFIER CDD_AdcDiagc.SenderPorts.AdcDiagcEndPtrOutp.Val /end MEASUREMENT
/begin MEASUREMENT CDD_AdcDiagc.AdcDiagcSt "MICROSAR RTE" UBYTE NO_COMPU_METHOD 0 0 0 255 ECU_ADDRESS 0 SYMBOL_LINK "Rte_CDD_AdcDiagc_AdcDiagcSt" 0 DISPLAY_IDENTIFIER CDD_AdcDiagc.PerInstanceMemories.AdcDiagcSt /end MEASUREMENT
/begin MEASUREMENT CDD_AdcDiagc.AdcDiagcStrtPtr "MICROSAR RTE" UBYTE NO_COMPU_METHOD 0 0 0 255 ECU_ADDRESS 0 SYMBOL_LINK "Rte_CDD_AdcDiagc_AdcDiagcStrtPtr" 0 DISPLAY_IDENTIFIER CDD_AdcDiagc.PerInstanceMemories.AdcDiagcStrtPtr /end MEASUREMENT
/begin MEASUREMENT CDD_AdcDiagc.AdcDiagcStrtPtrOutp.Val "MICROSAR RTE" UBYTE NO_COMPU_METHOD 0 0 0 255 ECU_ADDRESS 0 SYMBOL_LINK "Rte_CDD_AdcDiagc_AdcDiagcStrtPtrOutp_Val" 0 DISPLAY_IDENTIFIER CDD_AdcDiagc.SenderPorts.AdcDiagcStrtPtrOutp.Val /end MEASUREMENT
/begin MEASUREMENT CDD_CurrMeas.BrdgVltg.Val "MICROSAR RTE" FLOAT32_IEEE NO_COMPU_METHOD 0 0 -3.402823466e+38 3.402823466e+38 ECU_ADDRESS 0 SYMBOL_LINK "Rte_BattVltg_BrdgVltg_Val" 0 DISPLAY_IDENTIFIER CDD_CurrMeas.ReceiverPorts.BrdgVltg.Val /end MEASUREMENT
/begin MEASUREMENT CDD_CurrMeas.BrdgVltgSumPrev "MICROSAR RTE" FLOAT32_IEEE NO_COMPU_METHOD 0 0 -3.402823466e+38 3.402823466e+38 ECU_ADDRESS 0 SYMBOL_LINK "Rte_CDD_CurrMeas_BrdgVltgSumPrev" 0 DISPLAY_IDENTIFIER CDD_CurrMeas.PerInstanceMemories.BrdgVltgSumPrev /end MEASUREMENT
/begin MEASUREMENT CDD_CurrMeas.CurrMeasEolGainCalSet.CurrMeasMotCurrEolGainA "MICROSAR RTE" FLOAT32_IEEE NO_COMPU_METHOD 0 0 -3.402823466e+38 3.402823466e+38 ECU_ADDRESS 0 SYMBOL_LINK "Rte_CDD_CurrMeas_CurrMeasEolGainCalSet.CurrMeasMotCurrEolGainA" 0 DISPLAY_IDENTIFIER CDD_CurrMeas.PerInstanceMemories.CurrMeasEolGainCalSet.CurrMeasMotCurrEolGainA /end MEASUREMENT
/begin MEASUREMENT CDD_CurrMeas.CurrMeasEolGainCalSet.CurrMeasMotCurrEolGainB "MICROSAR RTE" FLOAT32_IEEE NO_COMPU_METHOD 0 0 -3.402823466e+38 3.402823466e+38 ECU_ADDRESS 0 SYMBOL_LINK "Rte_CDD_CurrMeas_CurrMeasEolGainCalSet.CurrMeasMotCurrEolGainB" 0 DISPLAY_IDENTIFIER CDD_CurrMeas.PerInstanceMemories.CurrMeasEolGainCalSet.CurrMeasMotCurrEolGainB /end MEASUREMENT
/begin MEASUREMENT CDD_CurrMeas.CurrMeasEolGainCalSet.CurrMeasMotCurrEolGainC "MICROSAR RTE" FLOAT32_IEEE NO_COMPU_METHOD 0 0 -3.402823466e+38 3.402823466e+38 ECU_ADDRESS 0 SYMBOL_LINK "Rte_CDD_CurrMeas_CurrMeasEolGainCalSet.CurrMeasMotCurrEolGainC" 0 DISPLAY_IDENTIFIER CDD_CurrMeas.PerInstanceMemories.CurrMeasEolGainCalSet.CurrMeasMotCurrEolGainC /end MEASUREMENT
/begin MEASUREMENT CDD_CurrMeas.CurrMeasEolGainCalSet.CurrMeasMotCurrEolGainD "MICROSAR RTE" FLOAT32_IEEE NO_COMPU_METHOD 0 0 -3.402823466e+38 3.402823466e+38 ECU_ADDRESS 0 SYMBOL_LINK "Rte_CDD_CurrMeas_CurrMeasEolGainCalSet.CurrMeasMotCurrEolGainD" 0 DISPLAY_IDENTIFIER CDD_CurrMeas.PerInstanceMemories.CurrMeasEolGainCalSet.CurrMeasMotCurrEolGainD /end MEASUREMENT
/begin MEASUREMENT CDD_CurrMeas.CurrMeasEolGainCalSet.CurrMeasMotCurrEolGainE "MICROSAR RTE" FLOAT32_IEEE NO_COMPU_METHOD 0 0 -3.402823466e+38 3.402823466e+38 ECU_ADDRESS 0 SYMBOL_LINK "Rte_CDD_CurrMeas_CurrMeasEolGainCalSet.CurrMeasMotCurrEolGainE" 0 DISPLAY_IDENTIFIER CDD_CurrMeas.PerInstanceMemories.CurrMeasEolGainCalSet.CurrMeasMotCurrEolGainE /end MEASUREMENT
/begin MEASUREMENT CDD_CurrMeas.CurrMeasEolGainCalSet.CurrMeasMotCurrEolGainF "MICROSAR RTE" FLOAT32_IEEE NO_COMPU_METHOD 0 0 -3.402823466e+38 3.402823466e+38 ECU_ADDRESS 0 SYMBOL_LINK "Rte_CDD_CurrMeas_CurrMeasEolGainCalSet.CurrMeasMotCurrEolGainF" 0 DISPLAY_IDENTIFIER CDD_CurrMeas.PerInstanceMemories.CurrMeasEolGainCalSet.CurrMeasMotCurrEolGainF /end MEASUREMENT
/begin MEASUREMENT CDD_CurrMeas.CurrMeasEolOffsCalSet.CurrMeasEolOffsHiBrdgVltg "MICROSAR RTE" FLOAT32_IEEE NO_COMPU_METHOD 0 0 -3.402823466e+38 3.402823466e+38 ECU_ADDRESS 0 SYMBOL_LINK "Rte_CDD_CurrMeas_CurrMeasEolOffsCalSet.CurrMeasEolOffsHiBrdgVltg" 0 DISPLAY_IDENTIFIER CDD_CurrMeas.PerInstanceMemories.CurrMeasEolOffsCalSet.CurrMeasEolOffsHiBrdgVltg /end MEASUREMENT
/begin MEASUREMENT CDD_CurrMeas.CurrMeasEolOffsCalSet.CurrMeasMotCurrEolOffsDifA "MICROSAR RTE" FLOAT32_IEEE NO_COMPU_METHOD 0 0 -3.402823466e+38 3.402823466e+38 ECU_ADDRESS 0 SYMBOL_LINK "Rte_CDD_CurrMeas_CurrMeasEolOffsCalSet.CurrMeasMotCurrEolOffsDifA" 0 DISPLAY_IDENTIFIER CDD_CurrMeas.PerInstanceMemories.CurrMeasEolOffsCalSet.CurrMeasMotCurrEolOffsDifA /end MEASUREMENT
/begin MEASUREMENT CDD_CurrMeas.CurrMeasEolOffsCalSet.CurrMeasMotCurrEolOffsDifB "MICROSAR RTE" FLOAT32_IEEE NO_COMPU_METHOD 0 0 -3.402823466e+38 3.402823466e+38 ECU_ADDRESS 0 SYMBOL_LINK "Rte_CDD_CurrMeas_CurrMeasEolOffsCalSet.CurrMeasMotCurrEolOffsDifB" 0 DISPLAY_IDENTIFIER CDD_CurrMeas.PerInstanceMemories.CurrMeasEolOffsCalSet.CurrMeasMotCurrEolOffsDifB /end MEASUREMENT
/begin MEASUREMENT CDD_CurrMeas.CurrMeasEolOffsCalSet.CurrMeasMotCurrEolOffsDifC "MICROSAR RTE" FLOAT32_IEEE NO_COMPU_METHOD 0 0 -3.402823466e+38 3.402823466e+38 ECU_ADDRESS 0 SYMBOL_LINK "Rte_CDD_CurrMeas_CurrMeasEolOffsCalSet.CurrMeasMotCurrEolOffsDifC" 0 DISPLAY_IDENTIFIER CDD_CurrMeas.PerInstanceMemories.CurrMeasEolOffsCalSet.CurrMeasMotCurrEolOffsDifC /end MEASUREMENT
/begin MEASUREMENT CDD_CurrMeas.CurrMeasEolOffsCalSet.CurrMeasMotCurrEolOffsDifD "MICROSAR RTE" FLOAT32_IEEE NO_COMPU_METHOD 0 0 -3.402823466e+38 3.402823466e+38 ECU_ADDRESS 0 SYMBOL_LINK "Rte_CDD_CurrMeas_CurrMeasEolOffsCalSet.CurrMeasMotCurrEolOffsDifD" 0 DISPLAY_IDENTIFIER CDD_CurrMeas.PerInstanceMemories.CurrMeasEolOffsCalSet.CurrMeasMotCurrEolOffsDifD /end MEASUREMENT
/begin MEASUREMENT CDD_CurrMeas.CurrMeasEolOffsCalSet.CurrMeasMotCurrEolOffsDifE "MICROSAR RTE" FLOAT32_IEEE NO_COMPU_METHOD 0 0 -3.402823466e+38 3.402823466e+38 ECU_ADDRESS 0 SYMBOL_LINK "Rte_CDD_CurrMeas_CurrMeasEolOffsCalSet.CurrMeasMotCurrEolOffsDifE" 0 DISPLAY_IDENTIFIER CDD_CurrMeas.PerInstanceMemories.CurrMeasEolOffsCalSet.CurrMeasMotCurrEolOffsDifE /end MEASUREMENT
/begin MEASUREMENT CDD_CurrMeas.CurrMeasEolOffsCalSet.CurrMeasMotCurrEolOffsDifF "MICROSAR RTE" FLOAT32_IEEE NO_COMPU_METHOD 0 0 -3.402823466e+38 3.402823466e+38 ECU_ADDRESS 0 SYMBOL_LINK "Rte_CDD_CurrMeas_CurrMeasEolOffsCalSet.CurrMeasMotCurrEolOffsDifF" 0 DISPLAY_IDENTIFIER CDD_CurrMeas.PerInstanceMemories.CurrMeasEolOffsCalSet.CurrMeasMotCurrEolOffsDifF /end MEASUREMENT
/begin MEASUREMENT CDD_CurrMeas.CurrMeasEolOffsCalSet.CurrMeasMotCurrOffsLoAvrgA "MICROSAR RTE" FLOAT32_IEEE NO_COMPU_METHOD 0 0 -3.402823466e+38 3.402823466e+38 ECU_ADDRESS 0 SYMBOL_LINK "Rte_CDD_CurrMeas_CurrMeasEolOffsCalSet.CurrMeasMotCurrOffsLoAvrgA" 0 DISPLAY_IDENTIFIER CDD_CurrMeas.PerInstanceMemories.CurrMeasEolOffsCalSet.CurrMeasMotCurrOffsLoAvrgA /end MEASUREMENT
/begin MEASUREMENT CDD_CurrMeas.CurrMeasEolOffsCalSet.CurrMeasMotCurrOffsLoAvrgB "MICROSAR RTE" FLOAT32_IEEE NO_COMPU_METHOD 0 0 -3.402823466e+38 3.402823466e+38 ECU_ADDRESS 0 SYMBOL_LINK "Rte_CDD_CurrMeas_CurrMeasEolOffsCalSet.CurrMeasMotCurrOffsLoAvrgB" 0 DISPLAY_IDENTIFIER CDD_CurrMeas.PerInstanceMemories.CurrMeasEolOffsCalSet.CurrMeasMotCurrOffsLoAvrgB /end MEASUREMENT
/begin MEASUREMENT CDD_CurrMeas.CurrMeasEolOffsCalSet.CurrMeasMotCurrOffsLoAvrgC "MICROSAR RTE" FLOAT32_IEEE NO_COMPU_METHOD 0 0 -3.402823466e+38 3.402823466e+38 ECU_ADDRESS 0 SYMBOL_LINK "Rte_CDD_CurrMeas_CurrMeasEolOffsCalSet.CurrMeasMotCurrOffsLoAvrgC" 0 DISPLAY_IDENTIFIER CDD_CurrMeas.PerInstanceMemories.CurrMeasEolOffsCalSet.CurrMeasMotCurrOffsLoAvrgC /end MEASUREMENT
/begin MEASUREMENT CDD_CurrMeas.CurrMeasEolOffsCalSet.CurrMeasMotCurrOffsLoAvrgD "MICROSAR RTE" FLOAT32_IEEE NO_COMPU_METHOD 0 0 -3.402823466e+38 3.402823466e+38 ECU_ADDRESS 0 SYMBOL_LINK "Rte_CDD_CurrMeas_CurrMeasEolOffsCalSet.CurrMeasMotCurrOffsLoAvrgD" 0 DISPLAY_IDENTIFIER CDD_CurrMeas.PerInstanceMemories.CurrMeasEolOffsCalSet.CurrMeasMotCurrOffsLoAvrgD /end MEASUREMENT
/begin MEASUREMENT CDD_CurrMeas.CurrMeasEolOffsCalSet.CurrMeasMotCurrOffsLoAvrgE "MICROSAR RTE" FLOAT32_IEEE NO_COMPU_METHOD 0 0 -3.402823466e+38 3.402823466e+38 ECU_ADDRESS 0 SYMBOL_LINK "Rte_CDD_CurrMeas_CurrMeasEolOffsCalSet.CurrMeasMotCurrOffsLoAvrgE" 0 DISPLAY_IDENTIFIER CDD_CurrMeas.PerInstanceMemories.CurrMeasEolOffsCalSet.CurrMeasMotCurrOffsLoAvrgE /end MEASUREMENT
/begin MEASUREMENT CDD_CurrMeas.CurrMeasEolOffsCalSet.CurrMeasMotCurrOffsLoAvrgF "MICROSAR RTE" FLOAT32_IEEE NO_COMPU_METHOD 0 0 -3.402823466e+38 3.402823466e+38 ECU_ADDRESS 0 SYMBOL_LINK "Rte_CDD_CurrMeas_CurrMeasEolOffsCalSet.CurrMeasMotCurrOffsLoAvrgF" 0 DISPLAY_IDENTIFIER CDD_CurrMeas.PerInstanceMemories.CurrMeasEolOffsCalSet.CurrMeasMotCurrOffsLoAvrgF /end MEASUREMENT
/begin MEASUREMENT CDD_CurrMeas.CurrMeasWrmIninTestCmpl.Logl "MICROSAR RTE" UBYTE RTE_CM_BOOLEAN 0 0 0 255 ECU_ADDRESS 0 SYMBOL_LINK "Rte_CDD_CurrMeas_CurrMeasWrmIninTestCmpl_Logl" 0 DISPLAY_IDENTIFIER CDD_CurrMeas.SenderPorts.CurrMeasWrmIninTestCmpl.Logl /end MEASUREMENT
/begin MEASUREMENT CDD_CurrMeas.DiagcStsIvtr1Inactv.Logl "MICROSAR RTE" UBYTE RTE_CM_BOOLEAN 0 0 0 255 ECU_ADDRESS 0 SYMBOL_LINK "Rte_DiagcMgr_DiagcStsIvtr1Inactv_Logl" 0 DISPLAY_IDENTIFIER CDD_CurrMeas.ReceiverPorts.DiagcStsIvtr1Inactv.Logl /end MEASUREMENT
/begin MEASUREMENT CDD_CurrMeas.DiagcStsIvtr2Inactv.Logl "MICROSAR RTE" UBYTE RTE_CM_BOOLEAN 0 0 0 255 ECU_ADDRESS 0 SYMBOL_LINK "Rte_DiagcMgr_DiagcStsIvtr2Inactv_Logl" 0 DISPLAY_IDENTIFIER CDD_CurrMeas.ReceiverPorts.DiagcStsIvtr2Inactv.Logl /end MEASUREMENT
/begin MEASUREMENT CDD_CurrMeas.EolGainSts "MICROSAR RTE" UBYTE NO_COMPU_METHOD 0 0 0 255 ECU_ADDRESS 0 SYMBOL_LINK "Rte_CDD_CurrMeas_EolGainSts" 0 DISPLAY_IDENTIFIER CDD_CurrMeas.PerInstanceMemories.EolGainSts /end MEASUREMENT
/begin MEASUREMENT CDD_CurrMeas.EolOffsHiBrdgVltg "MICROSAR RTE" FLOAT32_IEEE NO_COMPU_METHOD 0 0 -3.402823466e+38 3.402823466e+38 ECU_ADDRESS 0 SYMBOL_LINK "Rte_CDD_CurrMeas_EolOffsHiBrdgVltg" 0 DISPLAY_IDENTIFIER CDD_CurrMeas.PerInstanceMemories.EolOffsHiBrdgVltg /end MEASUREMENT
/begin MEASUREMENT CDD_CurrMeas.EolOffsSts "MICROSAR RTE" UBYTE NO_COMPU_METHOD 0 0 0 255 ECU_ADDRESS 0 SYMBOL_LINK "Rte_CDD_CurrMeas_EolOffsSts" 0 DISPLAY_IDENTIFIER CDD_CurrMeas.PerInstanceMemories.EolOffsSts /end MEASUREMENT
/begin MEASUREMENT CDD_CurrMeas.EolTranCntrPrev "MICROSAR RTE" UBYTE NO_COMPU_METHOD 0 0 0 255 ECU_ADDRESS 0 SYMBOL_LINK "Rte_CDD_CurrMeas_EolTranCntrPrev" 0 DISPLAY_IDENTIFIER CDD_CurrMeas.PerInstanceMemories.EolTranCntrPrev /end MEASUREMENT
/begin MEASUREMENT CDD_CurrMeas.GainEolAvrgCntrPrev "MICROSAR RTE" UWORD NO_COMPU_METHOD 0 0 0 65535 ECU_ADDRESS 0 SYMBOL_LINK "Rte_CDD_CurrMeas_GainEolAvrgCntrPrev" 0 DISPLAY_IDENTIFIER CDD_CurrMeas.PerInstanceMemories.GainEolAvrgCntrPrev /end MEASUREMENT
/begin MEASUREMENT CDD_CurrMeas.MotCtrlNtc5DErrCntPrev "MICROSAR RTE" UWORD NO_COMPU_METHOD 0 0 0 65535 ECU_ADDRESS 0 SYMBOL_LINK "Rte_CDD_CurrMeas_MotCtrlNtc5DErrCntPrev" 0 DISPLAY_IDENTIFIER CDD_CurrMeas.PerInstanceMemories.MotCtrlNtc5DErrCntPrev /end MEASUREMENT
/begin MEASUREMENT CDD_CurrMeas.MotCtrlNtc6DErrCntPrev "MICROSAR RTE" UWORD NO_COMPU_METHOD 0 0 0 65535 ECU_ADDRESS 0 SYMBOL_LINK "Rte_CDD_CurrMeas_MotCtrlNtc6DErrCntPrev" 0 DISPLAY_IDENTIFIER CDD_CurrMeas.PerInstanceMemories.MotCtrlNtc6DErrCntPrev /end MEASUREMENT
/begin MEASUREMENT CDD_CurrMeas.MotCurrAdcVlyA.Val "MICROSAR RTE" FLOAT32_IEEE NO_COMPU_METHOD 0 0 -3.402823466e+38 3.402823466e+38 ECU_ADDRESS 0 SYMBOL_LINK "Rte_CDD_MotCtrlMgr_MotCurrAdcVlyA_Val" 0 DISPLAY_IDENTIFIER CDD_CurrMeas.ReceiverPorts.MotCurrAdcVlyA.Val /end MEASUREMENT
/begin MEASUREMENT CDD_CurrMeas.MotCurrAdcVlyB.Val "MICROSAR RTE" FLOAT32_IEEE NO_COMPU_METHOD 0 0 -3.402823466e+38 3.402823466e+38 ECU_ADDRESS 0 SYMBOL_LINK "Rte_CDD_MotCtrlMgr_MotCurrAdcVlyB_Val" 0 DISPLAY_IDENTIFIER CDD_CurrMeas.ReceiverPorts.MotCurrAdcVlyB.Val /end MEASUREMENT
/begin MEASUREMENT CDD_CurrMeas.MotCurrAdcVlyC.Val "MICROSAR RTE" FLOAT32_IEEE NO_COMPU_METHOD 0 0 -3.402823466e+38 3.402823466e+38 ECU_ADDRESS 0 SYMBOL_LINK "Rte_CDD_MotCtrlMgr_MotCurrAdcVlyC_Val" 0 DISPLAY_IDENTIFIER CDD_CurrMeas.ReceiverPorts.MotCurrAdcVlyC.Val /end MEASUREMENT
/begin MEASUREMENT CDD_CurrMeas.MotCurrAdcVlyD.Val "MICROSAR RTE" FLOAT32_IEEE NO_COMPU_METHOD 0 0 -3.402823466e+38 3.402823466e+38 ECU_ADDRESS 0 SYMBOL_LINK "Rte_CDD_MotCtrlMgr_MotCurrAdcVlyA_Val" 0 DISPLAY_IDENTIFIER CDD_CurrMeas.ReceiverPorts.MotCurrAdcVlyD.Val /end MEASUREMENT
/begin MEASUREMENT CDD_CurrMeas.MotCurrAdcVlyE.Val "MICROSAR RTE" FLOAT32_IEEE NO_COMPU_METHOD 0 0 -3.402823466e+38 3.402823466e+38 ECU_ADDRESS 0 SYMBOL_LINK "Rte_CDD_MotCtrlMgr_MotCurrAdcVlyB_Val" 0 DISPLAY_IDENTIFIER CDD_CurrMeas.ReceiverPorts.MotCurrAdcVlyE.Val /end MEASUREMENT
/begin MEASUREMENT CDD_CurrMeas.MotCurrAdcVlyF.Val "MICROSAR RTE" FLOAT32_IEEE NO_COMPU_METHOD 0 0 -3.402823466e+38 3.402823466e+38 ECU_ADDRESS 0 SYMBOL_LINK "Rte_CDD_MotCtrlMgr_MotCurrAdcVlyC_Val" 0 DISPLAY_IDENTIFIER CDD_CurrMeas.ReceiverPorts.MotCurrAdcVlyF.Val /end MEASUREMENT
/begin MEASUREMENT CDD_CurrMeas.MotCurrEolCalSt.Val "MICROSAR RTE" UBYTE RTE_CM_ENUM_MotCurrEolCalSt2 0 0 0 255 ECU_ADDRESS 0 SYMBOL_LINK "Rte_CDD_CurrMeas_MotCurrEolCalSt_Val" 0 DISPLAY_IDENTIFIER CDD_CurrMeas.SenderPorts.MotCurrEolCalSt.Val /end MEASUREMENT
/begin MEASUREMENT CDD_CurrMeas.MotCurrEolCalStPrev "MICROSAR RTE" UBYTE RTE_CM_ENUM_MotCurrEolCalSt2 0 0 0 255 ECU_ADDRESS 0 SYMBOL_LINK "Rte_CDD_CurrMeas_MotCurrEolCalStPrev" 0 DISPLAY_IDENTIFIER CDD_CurrMeas.PerInstanceMemories.MotCurrEolCalStPrev /end MEASUREMENT
/begin MEASUREMENT CDD_CurrMeas.MotCurrEolGainA "MICROSAR RTE" FLOAT32_IEEE NO_COMPU_METHOD 0 0 -3.402823466e+38 3.402823466e+38 ECU_ADDRESS 0 SYMBOL_LINK "Rte_CDD_CurrMeas_MotCurrEolGainA" 0 DISPLAY_IDENTIFIER CDD_CurrMeas.PerInstanceMemories.MotCurrEolGainA /end MEASUREMENT
/begin MEASUREMENT CDD_CurrMeas.MotCurrEolGainB "MICROSAR RTE" FLOAT32_IEEE NO_COMPU_METHOD 0 0 -3.402823466e+38 3.402823466e+38 ECU_ADDRESS 0 SYMBOL_LINK "Rte_CDD_CurrMeas_MotCurrEolGainB" 0 DISPLAY_IDENTIFIER CDD_CurrMeas.PerInstanceMemories.MotCurrEolGainB /end MEASUREMENT
/begin MEASUREMENT CDD_CurrMeas.MotCurrEolGainC "MICROSAR RTE" FLOAT32_IEEE NO_COMPU_METHOD 0 0 -3.402823466e+38 3.402823466e+38 ECU_ADDRESS 0 SYMBOL_LINK "Rte_CDD_CurrMeas_MotCurrEolGainC" 0 DISPLAY_IDENTIFIER CDD_CurrMeas.PerInstanceMemories.MotCurrEolGainC /end MEASUREMENT
/begin MEASUREMENT CDD_CurrMeas.MotCurrEolGainD "MICROSAR RTE" FLOAT32_IEEE NO_COMPU_METHOD 0 0 -3.402823466e+38 3.402823466e+38 ECU_ADDRESS 0 SYMBOL_LINK "Rte_CDD_CurrMeas_MotCurrEolGainD" 0 DISPLAY_IDENTIFIER CDD_CurrMeas.PerInstanceMemories.MotCurrEolGainD /end MEASUREMENT
/begin MEASUREMENT CDD_CurrMeas.MotCurrEolGainE "MICROSAR RTE" FLOAT32_IEEE NO_COMPU_METHOD 0 0 -3.402823466e+38 3.402823466e+38 ECU_ADDRESS 0 SYMBOL_LINK "Rte_CDD_CurrMeas_MotCurrEolGainE" 0 DISPLAY_IDENTIFIER CDD_CurrMeas.PerInstanceMemories.MotCurrEolGainE /end MEASUREMENT
/begin MEASUREMENT CDD_CurrMeas.MotCurrEolGainF "MICROSAR RTE" FLOAT32_IEEE NO_COMPU_METHOD 0 0 -3.402823466e+38 3.402823466e+38 ECU_ADDRESS 0 SYMBOL_LINK "Rte_CDD_CurrMeas_MotCurrEolGainF" 0 DISPLAY_IDENTIFIER CDD_CurrMeas.PerInstanceMemories.MotCurrEolGainF /end MEASUREMENT
/**********************************************************************************************************************
* GROUP
*********************************************************************************************************************/
/begin GROUP Assi "MICROSAR RTE"
 /begin SUB_GROUP Assi.CalibrationPorts Assi.PerInstanceMemories Assi.ReceiverPorts Assi.SenderPorts /end SUB_GROUP
 /begin FUNCTION_LIST /end FUNCTION_LIST
 /begin REF_CHARACTERISTIC /end REF_CHARACTERISTIC
 /begin REF_MEASUREMENT /end REF_MEASUREMENT
/end GROUP
/begin GROUP Assi.AssiCmdBas.Val "MICROSAR RTE" /begin SUB_GROUP /end SUB_GROUP /begin FUNCTION_LIST /end FUNCTION_LIST /begin REF_CHARACTERISTIC /end REF_CHARACTERISTIC /begin REF_MEASUREMENT Assi.AssiCmdBas.Val /end REF_MEASUREMENT /end GROUP
/begin GROUP Assi.AssiCmdBasSca.Val "MICROSAR RTE" /begin SUB_GROUP /end SUB_GROUP /begin FUNCTION_LIST /end FUNCTION_LIST /begin REF_CHARACTERISTIC /end REF_CHARACTERISTIC /begin REF_MEASUREMENT Assi.AssiCmdBasSca.Val /end REF_MEASUREMENT /end GROUP
/begin GROUP Assi.AssiLnrGain.Val "MICROSAR RTE" /begin SUB_GROUP /end SUB_GROUP /begin FUNCTION_LIST /end FUNCTION_LIST /begin REF_CHARACTERISTIC /end REF_CHARACTERISTIC /begin REF_MEASUREMENT Assi.AssiLnrGain.Val /end REF_MEASUREMENT /end GROUP
/begin GROUP Assi.AssiLnrGainEna.Logl "MICROSAR RTE" /begin SUB_GROUP /end SUB_GROUP /begin FUNCTION_LIST /end FUNCTION_LIST /begin REF_CHARACTERISTIC /end REF_CHARACTERISTIC /begin REF_MEASUREMENT Assi.AssiLnrGainEna.Logl /end REF_MEASUREMENT /end GROUP
/begin GROUP Assi.AssiMotTqWhlImbRejctnMaxX.Ary2D "MICROSAR RTE" /begin SUB_GROUP /end SUB_GROUP /begin FUNCTION_LIST /end FUNCTION_LIST /begin REF_CHARACTERISTIC Assi.AssiMotTqWhlImbRejctnMaxX.Ary2D /end REF_CHARACTERISTIC /begin REF_MEASUREMENT /end REF_MEASUREMENT /end GROUP
/begin GROUP Assi.AssiMotTqWhlImbRejctnMaxY.Ary2D "MICROSAR RTE" /begin SUB_GROUP /end SUB_GROUP /begin FUNCTION_LIST /end FUNCTION_LIST /begin REF_CHARACTERISTIC Assi.AssiMotTqWhlImbRejctnMaxY.Ary2D /end REF_CHARACTERISTIC /begin REF_MEASUREMENT /end REF_MEASUREMENT /end GROUP
/begin GROUP Assi.AssiMotTqWhlImbRejctnMinX.Ary2D "MICROSAR RTE" /begin SUB_GROUP /end SUB_GROUP /begin FUNCTION_LIST /end FUNCTION_LIST /begin REF_CHARACTERISTIC Assi.AssiMotTqWhlImbRejctnMinX.Ary2D /end REF_CHARACTERISTIC /begin REF_MEASUREMENT /end REF_MEASUREMENT /end GROUP
/begin GROUP Assi.AssiMotTqWhlImbRejctnMinY.Ary2D "MICROSAR RTE" /begin SUB_GROUP /end SUB_GROUP /begin FUNCTION_LIST /end FUNCTION_LIST /begin REF_CHARACTERISTIC Assi.AssiMotTqWhlImbRejctnMinY.Ary2D /end REF_CHARACTERISTIC /begin REF_MEASUREMENT /end REF_MEASUREMENT /end GROUP
/begin GROUP Assi.AssiThermScaX.Ary1D "MICROSAR RTE" /begin SUB_GROUP /end SUB_GROUP /begin FUNCTION_LIST /end FUNCTION_LIST /begin REF_CHARACTERISTIC Assi.AssiThermScaX.Ary1D /end REF_CHARACTERISTIC /begin REF_MEASUREMENT /end REF_MEASUREMENT /end GROUP
/begin GROUP Assi.AssiThermScaY.Ary1D "MICROSAR RTE" /begin SUB_GROUP /end SUB_GROUP /begin FUNCTION_LIST /end FUNCTION_LIST /begin REF_CHARACTERISTIC Assi.AssiThermScaY.Ary1D /end REF_CHARACTERISTIC /begin REF_MEASUREMENT /end REF_MEASUREMENT /end GROUP
/begin GROUP Assi.AssiWhlImbRejctnBlndScaX.Ary2D "MICROSAR RTE" /begin SUB_GROUP /end SUB_GROUP /begin FUNCTION_LIST /end FUNCTION_LIST /begin REF_CHARACTERISTIC Assi.AssiWhlImbRejctnBlndScaX.Ary2D /end REF_CHARACTERISTIC /begin REF_MEASUREMENT /end REF_MEASUREMENT /end GROUP
/begin GROUP Assi.AssiWhlImbRejctnBlndScaY.Ary2D "MICROSAR RTE" /begin SUB_GROUP /end SUB_GROUP /begin FUNCTION_LIST /end FUNCTION_LIST /begin REF_CHARACTERISTIC Assi.AssiWhlImbRejctnBlndScaY.Ary2D /end REF_CHARACTERISTIC /begin REF_MEASUREMENT /end REF_MEASUREMENT /end GROUP
/begin GROUP Assi.CalibrationPorts "MICROSAR RTE"
 /begin SUB_GROUP Assi.AssiMotTqWhlImbRejctnMaxX.Ary2D Assi.AssiMotTqWhlImbRejctnMaxY.Ary2D Assi.AssiMotTqWhlImbRejctnMinX.Ary2D Assi.AssiMotTqWhlImbRejctnMinY.Ary2D Assi.AssiThermScaX.Ary1D Assi.AssiThermScaY.Ary1D Assi.AssiWhlImbRejctnBlndScaX.Ary2D Assi.AssiWhlImbRejctnBlndScaY.Ary2D Assi.SysGlbPrmVehSpd.Ary1D Assi.SysGlbPrmVehSpdBilnrSeln.Ary1D /end SUB_GROUP
 /begin FUNCTION_LIST /end FUNCTION_LIST
 /begin REF_CHARACTERISTIC /end REF_CHARACTERISTIC
 /begin REF_MEASUREMENT /end REF_MEASUREMENT
/end GROUP
/begin GROUP Assi.HwTq.Val "MICROSAR RTE" /begin SUB_GROUP /end SUB_GROUP /begin FUNCTION_LIST /end FUNCTION_LIST /begin REF_CHARACTERISTIC /end REF_CHARACTERISTIC /begin REF_MEASUREMENT Assi.HwTq.Val /end REF_MEASUREMENT /end GROUP
/begin GROUP Assi.HwTqHysOvrl.Val "MICROSAR RTE" /begin SUB_GROUP /end SUB_GROUP /begin FUNCTION_LIST /end FUNCTION_LIST /begin REF_CHARACTERISTIC /end REF_CHARACTERISTIC /begin REF_MEASUREMENT Assi.HwTqHysOvrl.Val /end REF_MEASUREMENT /end GROUP
/begin GROUP Assi.HwTqOvrl.Val "MICROSAR RTE" /begin SUB_GROUP /end SUB_GROUP /begin FUNCTION_LIST /end FUNCTION_LIST /begin REF_CHARACTERISTIC /end REF_CHARACTERISTIC /begin REF_MEASUREMENT Assi.HwTqOvrl.Val /end REF_MEASUREMENT /end GROUP
/begin GROUP Assi.PerInstanceMemories "MICROSAR RTE" /begin SUB_GROUP Assi.dAssiThermAssiSca Assi.dAssiWhlImbRejctnBlnd /end SUB_GROUP /begin FUNCTION_LIST /end FUNCTION_LIST /begin REF_CHARACTERISTIC /end REF_CHARACTERISTIC /begin REF_MEASUREMENT /end REF_MEASUREMENT /end GROUP
/begin GROUP Assi.ReceiverPorts "MICROSAR RTE"
 /begin SUB_GROUP Assi.AssiCmdBasSca.Val Assi.AssiLnrGain.Val Assi.AssiLnrGainEna.Logl Assi.HwTq.Val Assi.HwTqHysOvrl.Val Assi.HwTqOvrl.Val Assi.ThermLimSlowFilMax.Val Assi.VehSpd.Val Assi.WhlImbRejctnAmp.Val /end SUB_GROUP
 /begin FUNCTION_LIST /end FUNCTION_LIST
 /begin REF_CHARACTERISTIC /end REF_CHARACTERISTIC
 /begin REF_MEASUREMENT /end REF_MEASUREMENT
/end GROUP
/begin GROUP Assi.SenderPorts "MICROSAR RTE" /begin SUB_GROUP Assi.AssiCmdBas.Val /end SUB_GROUP /begin FUNCTION_LIST /end FUNCTION_LIST /begin REF_CHARACTERISTIC /end REF_CHARACTERISTIC /begin REF_MEASUREMENT /end REF_MEASUREMENT /end GROUP
/begin GROUP Assi.SysGlbPrmVehSpd.Ary1D "MICROSAR RTE" /begin SUB_GROUP /end SUB_GROUP /begin FUNCTION_LIST /end FUNCTION_LIST /begin REF_CHARACTERISTIC Assi.SysGlbPrmVehSpd.Ary1D /end REF_CHARACTERISTIC /begin REF_MEASUREMENT /end REF_MEASUREMENT /end GROUP
/begin GROUP Assi.SysGlbPrmVehSpdBilnrSeln.Ary1D "MICROSAR RTE" /begin SUB_GROUP /end SUB_GROUP /begin FUNCTION_LIST /end FUNCTION_LIST /begin REF_CHARACTERISTIC Assi.SysGlbPrmVehSpdBilnrSeln.Ary1D /end REF_CHARACTERISTIC /begin REF_MEASUREMENT /end REF_MEASUREMENT /end GROUP
/begin GROUP Assi.ThermLimSlowFilMax.Val "MICROSAR RTE" /begin SUB_GROUP /end SUB_GROUP /begin FUNCTION_LIST /end FUNCTION_LIST /begin REF_CHARACTERISTIC /end REF_CHARACTERISTIC /begin REF_MEASUREMENT Assi.ThermLimSlowFilMax.Val /end REF_MEASUREMENT /end GROUP
/begin GROUP Assi.VehSpd.Val "MICROSAR RTE" /begin SUB_GROUP /end SUB_GROUP /begin FUNCTION_LIST /end FUNCTION_LIST /begin REF_CHARACTERISTIC /end REF_CHARACTERISTIC /begin REF_MEASUREMENT Assi.VehSpd.Val /end REF_MEASUREMENT /end GROUP
/begin GROUP Assi.WhlImbRejctnAmp.Val "MICROSAR RTE" /begin SUB_GROUP /end SUB_GROUP /begin FUNCTION_LIST /end FUNCTION_LIST /begin REF_CHARACTERISTIC /end REF_CHARACTERISTIC /begin REF_MEASUREMENT Assi.WhlImbRejctnAmp.Val /end REF_MEASUREMENT /end GROUP
/begin GROUP Assi.dAssiThermAssiSca "MICROSAR RTE" /begin SUB_GROUP /end SUB_GROUP /begin FUNCTION_LIST /end FUNCTION_LIST /begin REF_CHARACTERISTIC /end REF_CHARACTERISTIC /begin REF_MEASUREMENT Assi.dAssiThermAssiSca /end REF_MEASUREMENT /end GROUP
/begin GROUP Assi.dAssiWhlImbRejctnBlnd "MICROSAR RTE" /begin SUB_GROUP /end SUB_GROUP /begin FUNCTION_LIST /end FUNCTION_LIST /begin REF_CHARACTERISTIC /end REF_CHARACTERISTIC /begin REF_MEASUREMENT Assi.dAssiWhlImbRejctnBlnd /end REF_MEASUREMENT /end GROUP
/begin GROUP AssiHiFrq "MICROSAR RTE"
 /begin SUB_GROUP AssiHiFrq.CalibrationPorts AssiHiFrq.PerInstanceMemories AssiHiFrq.ReceiverPorts AssiHiFrq.SenderPorts /end SUB_GROUP
 /begin FUNCTION_LIST /end FUNCTION_LIST
 /begin REF_CHARACTERISTIC /end REF_CHARACTERISTIC
 /begin REF_MEASUREMENT /end REF_MEASUREMENT
/end GROUP
/begin GROUP AssiHiFrq.AssiHiFrqCmd.Val "MICROSAR RTE" /begin SUB_GROUP /end SUB_GROUP /begin FUNCTION_LIST /end FUNCTION_LIST /begin REF_CHARACTERISTIC /end REF_CHARACTERISTIC /begin REF_MEASUREMENT AssiHiFrq.AssiHiFrqCmd.Val /end REF_MEASUREMENT /end GROUP
/begin GROUP AssiHiFrq.AssiHiFrqGainY.Ary2D "MICROSAR RTE" /begin SUB_GROUP /end SUB_GROUP /begin FUNCTION_LIST /end FUNCTION_LIST /begin REF_CHARACTERISTIC AssiHiFrq.AssiHiFrqGainY.Ary2D /end REF_CHARACTERISTIC /begin REF_MEASUREMENT /end REF_MEASUREMENT /end GROUP
/begin GROUP AssiHiFrq.AssiHiFrqHpFilFrqY.Ary1D "MICROSAR RTE" /begin SUB_GROUP /end SUB_GROUP /begin FUNCTION_LIST /end FUNCTION_LIST /begin REF_CHARACTERISTIC AssiHiFrq.AssiHiFrqHpFilFrqY.Ary1D /end REF_CHARACTERISTIC /begin REF_MEASUREMENT /end REF_MEASUREMENT /end GROUP
/begin GROUP AssiHiFrq.AssiHiFrqTqWhlImbRejctnTqX.Ary2D "MICROSAR RTE" /begin SUB_GROUP /end SUB_GROUP /begin FUNCTION_LIST /end FUNCTION_LIST /begin REF_CHARACTERISTIC AssiHiFrq.AssiHiFrqTqWhlImbRejctnTqX.Ary2D /end REF_CHARACTERISTIC /begin REF_MEASUREMENT /end REF_MEASUREMENT /end GROUP
/begin GROUP AssiHiFrq.AssiHiFrqTqX.Ary2D "MICROSAR RTE" /begin SUB_GROUP /end SUB_GROUP /begin FUNCTION_LIST /end FUNCTION_LIST /begin REF_CHARACTERISTIC AssiHiFrq.AssiHiFrqTqX.Ary2D /end REF_CHARACTERISTIC /begin REF_MEASUREMENT /end REF_MEASUREMENT /end GROUP
/begin GROUP AssiHiFrq.AssiHiFrqWhlImbRejctnGainY.Ary2D "MICROSAR RTE" /begin SUB_GROUP /end SUB_GROUP /begin FUNCTION_LIST /end FUNCTION_LIST /begin REF_CHARACTERISTIC AssiHiFrq.AssiHiFrqWhlImbRejctnGainY.Ary2D /end REF_CHARACTERISTIC /begin REF_MEASUREMENT /end REF_MEASUREMENT /end GROUP
/begin GROUP AssiHiFrq.AssiHiFrqWhlImbRejtcnBlndX.Ary2D "MICROSAR RTE" /begin SUB_GROUP /end SUB_GROUP /begin FUNCTION_LIST /end FUNCTION_LIST /begin REF_CHARACTERISTIC AssiHiFrq.AssiHiFrqWhlImbRejtcnBlndX.Ary2D /end REF_CHARACTERISTIC /begin REF_MEASUREMENT /end REF_MEASUREMENT /end GROUP
/begin GROUP AssiHiFrq.AssiHiFrqWhlImbRejtcnBlndY.Ary2D "MICROSAR RTE" /begin SUB_GROUP /end SUB_GROUP /begin FUNCTION_LIST /end FUNCTION_LIST /begin REF_CHARACTERISTIC AssiHiFrq.AssiHiFrqWhlImbRejtcnBlndY.Ary2D /end REF_CHARACTERISTIC /begin REF_MEASUREMENT /end REF_MEASUREMENT /end GROUP
/begin GROUP AssiHiFrq.CalibrationPorts "MICROSAR RTE"
 /begin SUB_GROUP AssiHiFrq.AssiHiFrqGainY.Ary2D AssiHiFrq.AssiHiFrqHpFilFrqY.Ary1D AssiHiFrq.AssiHiFrqTqWhlImbRejctnTqX.Ary2D AssiHiFrq.AssiHiFrqTqX.Ary2D AssiHiFrq.AssiHiFrqWhlImbRejctnGainY.Ary2D AssiHiFrq.AssiHiFrqWhlImbRejtcnBlndX.Ary2D AssiHiFrq.AssiHiFrqWhlImbRejtcnBlndY.Ary2D AssiHiFrq.SysGlbPrmVehSpdBilnrSeln.Ary1D /end SUB_GROUP
 /begin FUNCTION_LIST /end FUNCTION_LIST
 /begin REF_CHARACTERISTIC /end REF_CHARACTERISTIC
 /begin REF_MEASUREMENT /end REF_MEASUREMENT
/end GROUP
/begin GROUP AssiHiFrq.HwTq.Val "MICROSAR RTE" /begin SUB_GROUP /end SUB_GROUP /begin FUNCTION_LIST /end FUNCTION_LIST /begin REF_CHARACTERISTIC /end REF_CHARACTERISTIC /begin REF_MEASUREMENT AssiHiFrq.HwTq.Val /end REF_MEASUREMENT /end GROUP
/begin GROUP AssiHiFrq.HwTqHpFil "MICROSAR RTE" /begin SUB_GROUP /end SUB_GROUP /begin FUNCTION_LIST /end FUNCTION_LIST /begin REF_CHARACTERISTIC /end REF_CHARACTERISTIC
 /begin REF_MEASUREMENT AssiHiFrq.HwTqHpFil.CorrnFac AssiHiFrq.HwTqHpFil.FilLpRec.FilGain AssiHiFrq.HwTqHpFil.FilLpRec.FilSt /end REF_MEASUREMENT
/end GROUP
/begin GROUP AssiHiFrq.PerInstanceMemories "MICROSAR RTE"
 /begin SUB_GROUP AssiHiFrq.HwTqHpFil AssiHiFrq.dAssiHiFrqGain AssiHiFrq.dAssiHiFrqGainBlnd AssiHiFrq.dAssiHiFrqGainWhlImbRejtcnZero /end SUB_GROUP
 /begin FUNCTION_LIST /end FUNCTION_LIST
 /begin REF_CHARACTERISTIC /end REF_CHARACTERISTIC
 /begin REF_MEASUREMENT /end REF_MEASUREMENT
/end GROUP
/begin GROUP AssiHiFrq.ReceiverPorts "MICROSAR RTE"
 /begin SUB_GROUP AssiHiFrq.HwTq.Val AssiHiFrq.VehSpd.Val AssiHiFrq.WhlImbRejctnAmp.Val /end SUB_GROUP
 /begin FUNCTION_LIST /end FUNCTION_LIST
 /begin REF_CHARACTERISTIC /end REF_CHARACTERISTIC
 /begin REF_MEASUREMENT /end REF_MEASUREMENT
/end GROUP
/begin GROUP AssiHiFrq.SenderPorts "MICROSAR RTE" /begin SUB_GROUP AssiHiFrq.AssiHiFrqCmd.Val /end SUB_GROUP /begin FUNCTION_LIST /end FUNCTION_LIST /begin REF_CHARACTERISTIC /end REF_CHARACTERISTIC /begin REF_MEASUREMENT /end REF_MEASUREMENT /end GROUP
/begin GROUP AssiHiFrq.SysGlbPrmVehSpdBilnrSeln.Ary1D "MICROSAR RTE" /begin SUB_GROUP /end SUB_GROUP /begin FUNCTION_LIST /end FUNCTION_LIST /begin REF_CHARACTERISTIC AssiHiFrq.SysGlbPrmVehSpdBilnrSeln.Ary1D /end REF_CHARACTERISTIC /begin REF_MEASUREMENT /end REF_MEASUREMENT /end GROUP
/begin GROUP AssiHiFrq.VehSpd.Val "MICROSAR RTE" /begin SUB_GROUP /end SUB_GROUP /begin FUNCTION_LIST /end FUNCTION_LIST /begin REF_CHARACTERISTIC /end REF_CHARACTERISTIC /begin REF_MEASUREMENT AssiHiFrq.VehSpd.Val /end REF_MEASUREMENT /end GROUP
/begin GROUP AssiHiFrq.WhlImbRejctnAmp.Val "MICROSAR RTE" /begin SUB_GROUP /end SUB_GROUP /begin FUNCTION_LIST /end FUNCTION_LIST /begin REF_CHARACTERISTIC /end REF_CHARACTERISTIC /begin REF_MEASUREMENT AssiHiFrq.WhlImbRejctnAmp.Val /end REF_MEASUREMENT /end GROUP
/begin GROUP AssiHiFrq.dAssiHiFrqGain "MICROSAR RTE" /begin SUB_GROUP /end SUB_GROUP /begin FUNCTION_LIST /end FUNCTION_LIST /begin REF_CHARACTERISTIC /end REF_CHARACTERISTIC /begin REF_MEASUREMENT AssiHiFrq.dAssiHiFrqGain /end REF_MEASUREMENT /end GROUP
/begin GROUP AssiHiFrq.dAssiHiFrqGainBlnd "MICROSAR RTE" /begin SUB_GROUP /end SUB_GROUP /begin FUNCTION_LIST /end FUNCTION_LIST /begin REF_CHARACTERISTIC /end REF_CHARACTERISTIC /begin REF_MEASUREMENT AssiHiFrq.dAssiHiFrqGainBlnd /end REF_MEASUREMENT /end GROUP
/begin GROUP AssiHiFrq.dAssiHiFrqGainWhlImbRejtcnZero "MICROSAR RTE" /begin SUB_GROUP /end SUB_GROUP /begin FUNCTION_LIST /end FUNCTION_LIST /begin REF_CHARACTERISTIC /end REF_CHARACTERISTIC /begin REF_MEASUREMENT AssiHiFrq.dAssiHiFrqGainWhlImbRejtcnZero /end REF_MEASUREMENT /end GROUP
/begin GROUP AssiPahFwl "MICROSAR RTE"
 /begin SUB_GROUP AssiPahFwl.CalibrationPorts AssiPahFwl.PerInstanceMemories AssiPahFwl.ReceiverPorts AssiPahFwl.SenderPorts /end SUB_GROUP
 /begin FUNCTION_LIST /end FUNCTION_LIST
 /begin REF_CHARACTERISTIC /end REF_CHARACTERISTIC
 /begin REF_MEASUREMENT /end REF_MEASUREMENT
/end GROUP
/begin GROUP AssiPahFwl.AssiCmdBas.Val "MICROSAR RTE" /begin SUB_GROUP /end SUB_GROUP /begin FUNCTION_LIST /end FUNCTION_LIST /begin REF_CHARACTERISTIC /end REF_CHARACTERISTIC /begin REF_MEASUREMENT AssiPahFwl.AssiCmdBas.Val /end REF_MEASUREMENT /end GROUP
/begin GROUP AssiPahFwl.AssiCmdSum.Val "MICROSAR RTE" /begin SUB_GROUP /end SUB_GROUP /begin FUNCTION_LIST /end FUNCTION_LIST /begin REF_CHARACTERISTIC /end REF_CHARACTERISTIC /begin REF_MEASUREMENT AssiPahFwl.AssiCmdSum.Val /end REF_MEASUREMENT /end GROUP
/begin GROUP AssiPahFwl.AssiHiFrqCmd.Val "MICROSAR RTE" /begin SUB_GROUP /end SUB_GROUP /begin FUNCTION_LIST /end FUNCTION_LIST /begin REF_CHARACTERISTIC /end REF_CHARACTERISTIC /begin REF_MEASUREMENT AssiPahFwl.AssiHiFrqCmd.Val /end REF_MEASUREMENT /end GROUP
/begin GROUP AssiPahFwl.AssiLnrGainEna.Logl "MICROSAR RTE" /begin SUB_GROUP /end SUB_GROUP /begin FUNCTION_LIST /end FUNCTION_LIST /begin REF_CHARACTERISTIC /end REF_CHARACTERISTIC /begin REF_MEASUREMENT AssiPahFwl.AssiLnrGainEna.Logl /end REF_MEASUREMENT /end GROUP
/begin GROUP AssiPahFwl.AssiPahFwlCmdSplitLpFilFrq.Val "MICROSAR RTE" /begin SUB_GROUP /end SUB_GROUP /begin FUNCTION_LIST /end FUNCTION_LIST /begin REF_CHARACTERISTIC AssiPahFwl.AssiPahFwlCmdSplitLpFilFrq.Val /end REF_CHARACTERISTIC /begin REF_MEASUREMENT /end REF_MEASUREMENT /end GROUP
/begin GROUP AssiPahFwl.AssiPahFwlDftAssiX.Ary1D "MICROSAR RTE" /begin SUB_GROUP /end SUB_GROUP /begin FUNCTION_LIST /end FUNCTION_LIST /begin REF_CHARACTERISTIC AssiPahFwl.AssiPahFwlDftAssiX.Ary1D /end REF_CHARACTERISTIC /begin REF_MEASUREMENT /end REF_MEASUREMENT /end GROUP
/begin GROUP AssiPahFwl.AssiPahFwlDftAssiY.Ary1D "MICROSAR RTE" /begin SUB_GROUP /end SUB_GROUP /begin FUNCTION_LIST /end FUNCTION_LIST /begin REF_CHARACTERISTIC AssiPahFwl.AssiPahFwlDftAssiY.Ary1D /end REF_CHARACTERISTIC /begin REF_MEASUREMENT /end REF_MEASUREMENT /end GROUP
/begin GROUP AssiPahFwl.AssiPahFwlDiRcvr.Logl "MICROSAR RTE" /begin SUB_GROUP /end SUB_GROUP /begin FUNCTION_LIST /end FUNCTION_LIST /begin REF_CHARACTERISTIC AssiPahFwl.AssiPahFwlDiRcvr.Logl /end REF_CHARACTERISTIC /begin REF_MEASUREMENT /end REF_MEASUREMENT /end GROUP
/begin GROUP AssiPahFwl.AssiPahFwlFwlActvLpFilFrq.Val "MICROSAR RTE" /begin SUB_GROUP /end SUB_GROUP /begin FUNCTION_LIST /end FUNCTION_LIST /begin REF_CHARACTERISTIC AssiPahFwl.AssiPahFwlFwlActvLpFilFrq.Val /end REF_CHARACTERISTIC /begin REF_MEASUREMENT /end REF_MEASUREMENT /end GROUP
/begin GROUP AssiPahFwl.AssiPahFwlHiFrqUpprLimY.Ary2D "MICROSAR RTE" /begin SUB_GROUP /end SUB_GROUP /begin FUNCTION_LIST /end FUNCTION_LIST /begin REF_CHARACTERISTIC AssiPahFwl.AssiPahFwlHiFrqUpprLimY.Ary2D /end REF_CHARACTERISTIC /begin REF_MEASUREMENT /end REF_MEASUREMENT /end GROUP
/begin GROUP AssiPahFwl.AssiPahFwlHysCmpLim.Val "MICROSAR RTE" /begin SUB_GROUP /end SUB_GROUP /begin FUNCTION_LIST /end FUNCTION_LIST /begin REF_CHARACTERISTIC AssiPahFwl.AssiPahFwlHysCmpLim.Val /end REF_CHARACTERISTIC /begin REF_MEASUREMENT /end REF_MEASUREMENT /end GROUP
/begin GROUP AssiPahFwl.AssiPahFwlRestoreThd.Val "MICROSAR RTE" /begin SUB_GROUP /end SUB_GROUP /begin FUNCTION_LIST /end FUNCTION_LIST /begin REF_CHARACTERISTIC AssiPahFwl.AssiPahFwlRestoreThd.Val /end REF_CHARACTERISTIC /begin REF_MEASUREMENT /end REF_MEASUREMENT /end GROUP
/begin GROUP AssiPahFwl.AssiPahFwlUpprLimX.Ary2D "MICROSAR RTE" /begin SUB_GROUP /end SUB_GROUP /begin FUNCTION_LIST /end FUNCTION_LIST /begin REF_CHARACTERISTIC AssiPahFwl.AssiPahFwlUpprLimX.Ary2D /end REF_CHARACTERISTIC /begin REF_MEASUREMENT /end REF_MEASUREMENT /end GROUP
/begin GROUP AssiPahFwl.AssiPahFwlUpprLimY.Ary2D "MICROSAR RTE" /begin SUB_GROUP /end SUB_GROUP /begin FUNCTION_LIST /end FUNCTION_LIST /begin REF_CHARACTERISTIC AssiPahFwl.AssiPahFwlUpprLimY.Ary2D /end REF_CHARACTERISTIC /begin REF_MEASUREMENT /end REF_MEASUREMENT /end GROUP
/begin GROUP AssiPahFwl.AssiPahFwlVehSpd.Ary1D "MICROSAR RTE" /begin SUB_GROUP /end SUB_GROUP /begin FUNCTION_LIST /end FUNCTION_LIST /begin REF_CHARACTERISTIC AssiPahFwl.AssiPahFwlVehSpd.Ary1D /end REF_CHARACTERISTIC /begin REF_MEASUREMENT /end REF_MEASUREMENT /end GROUP
/begin GROUP AssiPahFwl.AssiPahLimrActv.Val "MICROSAR RTE" /begin SUB_GROUP /end SUB_GROUP /begin FUNCTION_LIST /end FUNCTION_LIST /begin REF_CHARACTERISTIC /end REF_CHARACTERISTIC /begin REF_MEASUREMENT AssiPahFwl.AssiPahLimrActv.Val /end REF_MEASUREMENT /end GROUP
/begin GROUP AssiPahFwl.AssiPrfmncPrev "MICROSAR RTE" /begin SUB_GROUP /end SUB_GROUP /begin FUNCTION_LIST /end FUNCTION_LIST /begin REF_CHARACTERISTIC /end REF_CHARACTERISTIC /begin REF_MEASUREMENT AssiPahFwl.AssiPrfmncPrev /end REF_MEASUREMENT /end GROUP
/begin GROUP AssiPahFwl.BasAssiPahFwlOverLimDiagcFailStep.Val "MICROSAR RTE" /begin SUB_GROUP /end SUB_GROUP /begin FUNCTION_LIST /end FUNCTION_LIST /begin REF_CHARACTERISTIC AssiPahFwl.BasAssiPahFwlOverLimDiagcFailStep.Val /end REF_CHARACTERISTIC /begin REF_MEASUREMENT /end REF_MEASUREMENT /end GROUP
/begin GROUP AssiPahFwl.BasAssiPahFwlOverLimDiagcPassStep.Val "MICROSAR RTE" /begin SUB_GROUP /end SUB_GROUP /begin FUNCTION_LIST /end FUNCTION_LIST /begin REF_CHARACTERISTIC AssiPahFwl.BasAssiPahFwlOverLimDiagcPassStep.Val /end REF_CHARACTERISTIC /begin REF_MEASUREMENT /end REF_MEASUREMENT /end GROUP
/begin GROUP AssiPahFwl.CalibrationPorts "MICROSAR RTE"
 /begin SUB_GROUP AssiPahFwl.AssiPahFwlCmdSplitLpFilFrq.Val AssiPahFwl.AssiPahFwlDftAssiX.Ary1D AssiPahFwl.AssiPahFwlDftAssiY.Ary1D AssiPahFwl.AssiPahFwlDiRcvr.Logl AssiPahFwl.AssiPahFwlFwlActvLpFilFrq.Val AssiPahFwl.AssiPahFwlHiFrqUpprLimY.Ary2D AssiPahFwl.AssiPahFwlHysCmpLim.Val AssiPahFwl.AssiPahFwlRestoreThd.Val AssiPahFwl.AssiPahFwlUpprLimX.Ary2D AssiPahFwl.AssiPahFwlUpprLimY.Ary2D AssiPahFwl.AssiPahFwlVehSpd.Ary1D AssiPahFwl.BasAssiPahFwlOverLimDiagcFailStep.Val AssiPahFwl.BasAssiPahFwlOverLimDiagcPassStep.Val AssiPahFwl.HiFrqAssiPahFwlOverLimDiagcFailStep.Val AssiPahFwl.HiFrqAssiPahFwlOverLimDiagcPassStep.Val /end SUB_GROUP
 /begin FUNCTION_LIST /end FUNCTION_LIST
 /begin REF_CHARACTERISTIC /end REF_CHARACTERISTIC
 /begin REF_MEASUREMENT /end REF_MEASUREMENT
/end GROUP
/begin GROUP AssiPahFwl.CombdAssiPrev "MICROSAR RTE" /begin SUB_GROUP /end SUB_GROUP /begin FUNCTION_LIST /end FUNCTION_LIST /begin REF_CHARACTERISTIC /end REF_CHARACTERISTIC /begin REF_MEASUREMENT AssiPahFwl.CombdAssiPrev /end REF_MEASUREMENT /end GROUP
/begin GROUP AssiPahFwl.FwlActvLpFilStVari "MICROSAR RTE" /begin SUB_GROUP /end SUB_GROUP /begin FUNCTION_LIST /end FUNCTION_LIST /begin REF_CHARACTERISTIC /end REF_CHARACTERISTIC
 /begin REF_MEASUREMENT AssiPahFwl.FwlActvLpFilStVari.FilGain AssiPahFwl.FwlActvLpFilStVari.FilSt /end REF_MEASUREMENT
/end GROUP
/begin GROUP AssiPahFwl.HiFrqAssiPahFwlOverLimDiagcFailStep.Val "MICROSAR RTE" /begin SUB_GROUP /end SUB_GROUP /begin FUNCTION_LIST /end FUNCTION_LIST /begin REF_CHARACTERISTIC AssiPahFwl.HiFrqAssiPahFwlOverLimDiagcFailStep.Val /end REF_CHARACTERISTIC /begin REF_MEASUREMENT /end REF_MEASUREMENT /end GROUP
/begin GROUP AssiPahFwl.HiFrqAssiPahFwlOverLimDiagcPassStep.Val "MICROSAR RTE" /begin SUB_GROUP /end SUB_GROUP /begin FUNCTION_LIST /end FUNCTION_LIST /begin REF_CHARACTERISTIC AssiPahFwl.HiFrqAssiPahFwlOverLimDiagcPassStep.Val /end REF_CHARACTERISTIC /begin REF_MEASUREMENT /end REF_MEASUREMENT /end GROUP
/begin GROUP AssiPahFwl.HiFrqCmdLpFilStVari "MICROSAR RTE" /begin SUB_GROUP /end SUB_GROUP /begin FUNCTION_LIST /end FUNCTION_LIST /begin REF_CHARACTERISTIC /end REF_CHARACTERISTIC
 /begin REF_MEASUREMENT AssiPahFwl.HiFrqCmdLpFilStVari.FilGain AssiPahFwl.HiFrqCmdLpFilStVari.FilSt /end REF_MEASUREMENT
/end GROUP
/begin GROUP AssiPahFwl.HwTq.Val "MICROSAR RTE" /begin SUB_GROUP /end SUB_GROUP /begin FUNCTION_LIST /end FUNCTION_LIST /begin REF_CHARACTERISTIC /end REF_CHARACTERISTIC /begin REF_MEASUREMENT AssiPahFwl.HwTq.Val /end REF_MEASUREMENT /end GROUP
/begin GROUP AssiPahFwl.HwTqOvrl.Val "MICROSAR RTE" /begin SUB_GROUP /end SUB_GROUP /begin FUNCTION_LIST /end FUNCTION_LIST /begin REF_CHARACTERISTIC /end REF_CHARACTERISTIC /begin REF_MEASUREMENT AssiPahFwl.HwTqOvrl.Val /end REF_MEASUREMENT /end GROUP
/begin GROUP AssiPahFwl.HysCmpCmd.Val "MICROSAR RTE" /begin SUB_GROUP /end SUB_GROUP /begin FUNCTION_LIST /end FUNCTION_LIST /begin REF_CHARACTERISTIC /end REF_CHARACTERISTIC /begin REF_MEASUREMENT AssiPahFwl.HysCmpCmd.Val /end REF_MEASUREMENT /end GROUP
/begin GROUP AssiPahFwl.LowrLimLpFilStVari "MICROSAR RTE" /begin SUB_GROUP /end SUB_GROUP /begin FUNCTION_LIST /end FUNCTION_LIST /begin REF_CHARACTERISTIC /end REF_CHARACTERISTIC
 /begin REF_MEASUREMENT AssiPahFwl.LowrLimLpFilStVari.FilGain AssiPahFwl.LowrLimLpFilStVari.FilSt /end REF_MEASUREMENT
/end GROUP
/begin GROUP AssiPahFwl.PerInstanceMemories "MICROSAR RTE"
 /begin SUB_GROUP AssiPahFwl.AssiPrfmncPrev AssiPahFwl.CombdAssiPrev AssiPahFwl.FwlActvLpFilStVari AssiPahFwl.HiFrqCmdLpFilStVari AssiPahFwl.LowrLimLpFilStVari AssiPahFwl.UpprLimLpFilStVari AssiPahFwl.dAssiPahFwlActvRaw AssiPahFwl.dAssiPahFwlBasAssiCmdOverLim AssiPahFwl.dAssiPahFwlBasAssiLimd AssiPahFwl.dAssiPahFwlBasAssiLowrLim AssiPahFwl.dAssiPahFwlBasAssiUpprLim AssiPahFwl.dAssiPahFwlHiFrqAssiLowrLimFild AssiPahFwl.dAssiPahFwlHiFrqAssiUpprLimFild AssiPahFwl.dAssiPahFwlHiFrqCmdHpPah AssiPahFwl.dAssiPahFwlHiFrqCmdLpPah AssiPahFwl.dAssiPahFwlHiFrqCmdOverLim AssiPahFwl.dAssiPahFwlHiFrqLpLimd AssiPahFwl.dAssiPahFwlSumInp /end SUB_GROUP
 /begin FUNCTION_LIST /end FUNCTION_LIST
 /begin REF_CHARACTERISTIC /end REF_CHARACTERISTIC
 /begin REF_MEASUREMENT /end REF_MEASUREMENT
/end GROUP
/begin GROUP AssiPahFwl.ReceiverPorts "MICROSAR RTE"
 /begin SUB_GROUP AssiPahFwl.AssiCmdBas.Val AssiPahFwl.AssiHiFrqCmd.Val AssiPahFwl.AssiLnrGainEna.Logl AssiPahFwl.HwTq.Val AssiPahFwl.HwTqOvrl.Val AssiPahFwl.HysCmpCmd.Val AssiPahFwl.VehSpd.Val /end SUB_GROUP
 /begin FUNCTION_LIST /end FUNCTION_LIST
 /begin REF_CHARACTERISTIC /end REF_CHARACTERISTIC
 /begin REF_MEASUREMENT /end REF_MEASUREMENT
/end GROUP
/begin GROUP AssiPahFwl.SenderPorts "MICROSAR RTE" /begin SUB_GROUP AssiPahFwl.AssiCmdSum.Val AssiPahFwl.AssiPahLimrActv.Val /end SUB_GROUP /begin FUNCTION_LIST /end FUNCTION_LIST /begin REF_CHARACTERISTIC /end REF_CHARACTERISTIC /begin REF_MEASUREMENT /end REF_MEASUREMENT /end GROUP
/begin GROUP AssiPahFwl.UpprLimLpFilStVari "MICROSAR RTE" /begin SUB_GROUP /end SUB_GROUP /begin FUNCTION_LIST /end FUNCTION_LIST /begin REF_CHARACTERISTIC /end REF_CHARACTERISTIC
 /begin REF_MEASUREMENT AssiPahFwl.UpprLimLpFilStVari.FilGain AssiPahFwl.UpprLimLpFilStVari.FilSt /end REF_MEASUREMENT
/end GROUP
/begin GROUP AssiPahFwl.VehSpd.Val "MICROSAR RTE" /begin SUB_GROUP /end SUB_GROUP /begin FUNCTION_LIST /end FUNCTION_LIST /begin REF_CHARACTERISTIC /end REF_CHARACTERISTIC /begin REF_MEASUREMENT AssiPahFwl.VehSpd.Val /end REF_MEASUREMENT /end GROUP
/begin GROUP AssiPahFwl.dAssiPahFwlActvRaw "MICROSAR RTE" /begin SUB_GROUP /end SUB_GROUP /begin FUNCTION_LIST /end FUNCTION_LIST /begin REF_CHARACTERISTIC /end REF_CHARACTERISTIC /begin REF_MEASUREMENT AssiPahFwl.dAssiPahFwlActvRaw /end REF_MEASUREMENT /end GROUP
/begin GROUP AssiPahFwl.dAssiPahFwlBasAssiCmdOverLim "MICROSAR RTE" /begin SUB_GROUP /end SUB_GROUP /begin FUNCTION_LIST /end FUNCTION_LIST /begin REF_CHARACTERISTIC /end REF_CHARACTERISTIC /begin REF_MEASUREMENT AssiPahFwl.dAssiPahFwlBasAssiCmdOverLim /end REF_MEASUREMENT /end GROUP
/begin GROUP AssiPahFwl.dAssiPahFwlBasAssiLimd "MICROSAR RTE" /begin SUB_GROUP /end SUB_GROUP /begin FUNCTION_LIST /end FUNCTION_LIST /begin REF_CHARACTERISTIC /end REF_CHARACTERISTIC /begin REF_MEASUREMENT AssiPahFwl.dAssiPahFwlBasAssiLimd /end REF_MEASUREMENT /end GROUP
/begin GROUP AssiPahFwl.dAssiPahFwlBasAssiLowrLim "MICROSAR RTE" /begin SUB_GROUP /end SUB_GROUP /begin FUNCTION_LIST /end FUNCTION_LIST /begin REF_CHARACTERISTIC /end REF_CHARACTERISTIC /begin REF_MEASUREMENT AssiPahFwl.dAssiPahFwlBasAssiLowrLim /end REF_MEASUREMENT /end GROUP
/begin GROUP AssiPahFwl.dAssiPahFwlBasAssiUpprLim "MICROSAR RTE" /begin SUB_GROUP /end SUB_GROUP /begin FUNCTION_LIST /end FUNCTION_LIST /begin REF_CHARACTERISTIC /end REF_CHARACTERISTIC /begin REF_MEASUREMENT AssiPahFwl.dAssiPahFwlBasAssiUpprLim /end REF_MEASUREMENT /end GROUP
/begin GROUP AssiPahFwl.dAssiPahFwlHiFrqAssiLowrLimFild "MICROSAR RTE" /begin SUB_GROUP /end SUB_GROUP /begin FUNCTION_LIST /end FUNCTION_LIST /begin REF_CHARACTERISTIC /end REF_CHARACTERISTIC /begin REF_MEASUREMENT AssiPahFwl.dAssiPahFwlHiFrqAssiLowrLimFild /end REF_MEASUREMENT /end GROUP
/begin GROUP AssiPahFwl.dAssiPahFwlHiFrqAssiUpprLimFild "MICROSAR RTE" /begin SUB_GROUP /end SUB_GROUP /begin FUNCTION_LIST /end FUNCTION_LIST /begin REF_CHARACTERISTIC /end REF_CHARACTERISTIC /begin REF_MEASUREMENT AssiPahFwl.dAssiPahFwlHiFrqAssiUpprLimFild /end REF_MEASUREMENT /end GROUP
/begin GROUP AssiPahFwl.dAssiPahFwlHiFrqCmdHpPah "MICROSAR RTE" /begin SUB_GROUP /end SUB_GROUP /begin FUNCTION_LIST /end FUNCTION_LIST /begin REF_CHARACTERISTIC /end REF_CHARACTERISTIC /begin REF_MEASUREMENT AssiPahFwl.dAssiPahFwlHiFrqCmdHpPah /end REF_MEASUREMENT /end GROUP
/begin GROUP AssiPahFwl.dAssiPahFwlHiFrqCmdLpPah "MICROSAR RTE" /begin SUB_GROUP /end SUB_GROUP /begin FUNCTION_LIST /end FUNCTION_LIST /begin REF_CHARACTERISTIC /end REF_CHARACTERISTIC /begin REF_MEASUREMENT AssiPahFwl.dAssiPahFwlHiFrqCmdLpPah /end REF_MEASUREMENT /end GROUP
/begin GROUP AssiPahFwl.dAssiPahFwlHiFrqCmdOverLim "MICROSAR RTE" /begin SUB_GROUP /end SUB_GROUP /begin FUNCTION_LIST /end FUNCTION_LIST /begin REF_CHARACTERISTIC /end REF_CHARACTERISTIC /begin REF_MEASUREMENT AssiPahFwl.dAssiPahFwlHiFrqCmdOverLim /end REF_MEASUREMENT /end GROUP
/begin GROUP AssiPahFwl.dAssiPahFwlHiFrqLpLimd "MICROSAR RTE" /begin SUB_GROUP /end SUB_GROUP /begin FUNCTION_LIST /end FUNCTION_LIST /begin REF_CHARACTERISTIC /end REF_CHARACTERISTIC /begin REF_MEASUREMENT AssiPahFwl.dAssiPahFwlHiFrqLpLimd /end REF_MEASUREMENT /end GROUP
/begin GROUP AssiPahFwl.dAssiPahFwlSumInp "MICROSAR RTE" /begin SUB_GROUP /end SUB_GROUP /begin FUNCTION_LIST /end FUNCTION_LIST /begin REF_CHARACTERISTIC /end REF_CHARACTERISTIC /begin REF_MEASUREMENT AssiPahFwl.dAssiPahFwlSumInp /end REF_MEASUREMENT /end GROUP
/begin GROUP AssiSumLim "MICROSAR RTE"
 /begin SUB_GROUP AssiSumLim.CalibrationPorts AssiSumLim.ReceiverPorts AssiSumLim.SenderPorts /end SUB_GROUP
 /begin FUNCTION_LIST /end FUNCTION_LIST
 /begin REF_CHARACTERISTIC /end REF_CHARACTERISTIC
 /begin REF_MEASUREMENT /end REF_MEASUREMENT
/end GROUP
/begin GROUP AssiSumLim.AssiCmd.Val "MICROSAR RTE" /begin SUB_GROUP /end SUB_GROUP /begin FUNCTION_LIST /end FUNCTION_LIST /begin REF_CHARACTERISTIC /end REF_CHARACTERISTIC /begin REF_MEASUREMENT AssiSumLim.AssiCmd.Val /end REF_MEASUREMENT /end GROUP
/begin GROUP AssiSumLim.AssiSumLimNtc0x0C4FailStep.Val "MICROSAR RTE" /begin SUB_GROUP /end SUB_GROUP /begin FUNCTION_LIST /end FUNCTION_LIST /begin REF_CHARACTERISTIC AssiSumLim.AssiSumLimNtc0x0C4FailStep.Val /end REF_CHARACTERISTIC /begin REF_MEASUREMENT /end REF_MEASUREMENT /end GROUP
/begin GROUP AssiSumLim.AssiSumLimNtc0x0C4PassStep.Val "MICROSAR RTE" /begin SUB_GROUP /end SUB_GROUP /begin FUNCTION_LIST /end FUNCTION_LIST /begin REF_CHARACTERISTIC AssiSumLim.AssiSumLimNtc0x0C4PassStep.Val /end REF_CHARACTERISTIC /begin REF_MEASUREMENT /end REF_MEASUREMENT /end GROUP
/begin GROUP AssiSumLim.AssiSumLimPullCmpLim.Val "MICROSAR RTE" /begin SUB_GROUP /end SUB_GROUP /begin FUNCTION_LIST /end FUNCTION_LIST /begin REF_CHARACTERISTIC AssiSumLim.AssiSumLimPullCmpLim.Val /end REF_CHARACTERISTIC /begin REF_MEASUREMENT /end REF_MEASUREMENT /end GROUP
/begin GROUP AssiSumLim.CalibrationPorts "MICROSAR RTE"
 /begin SUB_GROUP AssiSumLim.AssiSumLimNtc0x0C4FailStep.Val AssiSumLim.AssiSumLimNtc0x0C4PassStep.Val AssiSumLim.AssiSumLimPullCmpLim.Val /end SUB_GROUP
 /begin FUNCTION_LIST /end FUNCTION_LIST
 /begin REF_CHARACTERISTIC /end REF_CHARACTERISTIC
 /begin REF_MEASUREMENT /end REF_MEASUREMENT
/end GROUP
/begin GROUP AssiSumLim.DampgCmd.Val "MICROSAR RTE" /begin SUB_GROUP /end SUB_GROUP /begin FUNCTION_LIST /end FUNCTION_LIST /begin REF_CHARACTERISTIC /end REF_CHARACTERISTIC /begin REF_MEASUREMENT AssiSumLim.DampgCmd.Val /end REF_MEASUREMENT /end GROUP
/begin GROUP AssiSumLim.EotActvCmd.Val "MICROSAR RTE" /begin SUB_GROUP /end SUB_GROUP /begin FUNCTION_LIST /end FUNCTION_LIST /begin REF_CHARACTERISTIC /end REF_CHARACTERISTIC /begin REF_MEASUREMENT AssiSumLim.EotActvCmd.Val /end REF_MEASUREMENT /end GROUP
/begin GROUP AssiSumLim.EotAssiSca.Val "MICROSAR RTE" /begin SUB_GROUP /end SUB_GROUP /begin FUNCTION_LIST /end FUNCTION_LIST /begin REF_CHARACTERISTIC /end REF_CHARACTERISTIC /begin REF_MEASUREMENT AssiSumLim.EotAssiSca.Val /end REF_MEASUREMENT /end GROUP
/begin GROUP AssiSumLim.EotDampgCmd.Val "MICROSAR RTE" /begin SUB_GROUP /end SUB_GROUP /begin FUNCTION_LIST /end FUNCTION_LIST /begin REF_CHARACTERISTIC /end REF_CHARACTERISTIC /begin REF_MEASUREMENT AssiSumLim.EotDampgCmd.Val /end REF_MEASUREMENT /end GROUP
/begin GROUP AssiSumLim.EotMotTqLim.Val "MICROSAR RTE" /begin SUB_GROUP /end SUB_GROUP /begin FUNCTION_LIST /end FUNCTION_LIST /begin REF_CHARACTERISTIC /end REF_CHARACTERISTIC /begin REF_MEASUREMENT AssiSumLim.EotMotTqLim.Val /end REF_MEASUREMENT /end GROUP
/begin GROUP AssiSumLim.HwTqLoaMtgtnEna.Logl "MICROSAR RTE" /begin SUB_GROUP /end SUB_GROUP /begin FUNCTION_LIST /end FUNCTION_LIST /begin REF_CHARACTERISTIC /end REF_CHARACTERISTIC /begin REF_MEASUREMENT AssiSumLim.HwTqLoaMtgtnEna.Logl /end REF_MEASUREMENT /end GROUP
/begin GROUP AssiSumLim.MotTqCmd.Val "MICROSAR RTE" /begin SUB_GROUP /end SUB_GROUP /begin FUNCTION_LIST /end FUNCTION_LIST /begin REF_CHARACTERISTIC /end REF_CHARACTERISTIC /begin REF_MEASUREMENT AssiSumLim.MotTqCmd.Val /end REF_MEASUREMENT /end GROUP
/begin GROUP AssiSumLim.MotTqCmdLimDi.Logl "MICROSAR RTE" /begin SUB_GROUP /end SUB_GROUP /begin FUNCTION_LIST /end FUNCTION_LIST /begin REF_CHARACTERISTIC /end REF_CHARACTERISTIC /begin REF_MEASUREMENT AssiSumLim.MotTqCmdLimDi.Logl /end REF_MEASUREMENT /end GROUP
/begin GROUP AssiSumLim.MotTqCmdLimdPreStall.Val "MICROSAR RTE" /begin SUB_GROUP /end SUB_GROUP /begin FUNCTION_LIST /end FUNCTION_LIST /begin REF_CHARACTERISTIC /end REF_CHARACTERISTIC /begin REF_MEASUREMENT AssiSumLim.MotTqCmdLimdPreStall.Val /end REF_MEASUREMENT /end GROUP
/begin GROUP AssiSumLim.MotTqCmdLimrMin.Val "MICROSAR RTE" /begin SUB_GROUP /end SUB_GROUP /begin FUNCTION_LIST /end FUNCTION_LIST /begin REF_CHARACTERISTIC /end REF_CHARACTERISTIC /begin REF_MEASUREMENT AssiSumLim.MotTqCmdLimrMin.Val /end REF_MEASUREMENT /end GROUP
/begin GROUP AssiSumLim.MotTqCmdOvrl.Val "MICROSAR RTE" /begin SUB_GROUP /end SUB_GROUP /begin FUNCTION_LIST /end FUNCTION_LIST /begin REF_CHARACTERISTIC /end REF_CHARACTERISTIC /begin REF_MEASUREMENT AssiSumLim.MotTqCmdOvrl.Val /end REF_MEASUREMENT /end GROUP
/begin GROUP AssiSumLim.MotTqCmdPreLim.Val "MICROSAR RTE" /begin SUB_GROUP /end SUB_GROUP /begin FUNCTION_LIST /end FUNCTION_LIST /begin REF_CHARACTERISTIC /end REF_CHARACTERISTIC /begin REF_MEASUREMENT AssiSumLim.MotTqCmdPreLim.Val /end REF_MEASUREMENT /end GROUP
/begin GROUP AssiSumLim.PinionCentrLrnCmd.Val "MICROSAR RTE" /begin SUB_GROUP /end SUB_GROUP /begin FUNCTION_LIST /end FUNCTION_LIST /begin REF_CHARACTERISTIC /end REF_CHARACTERISTIC /begin REF_MEASUREMENT AssiSumLim.PinionCentrLrnCmd.Val /end REF_MEASUREMENT /end GROUP
/begin GROUP AssiSumLim.PinionCentrLrnEna.Logl "MICROSAR RTE" /begin SUB_GROUP /end SUB_GROUP /begin FUNCTION_LIST /end FUNCTION_LIST /begin REF_CHARACTERISTIC /end REF_CHARACTERISTIC /begin REF_MEASUREMENT AssiSumLim.PinionCentrLrnEna.Logl /end REF_MEASUREMENT /end GROUP
/begin GROUP AssiSumLim.PullCmpCmd.Val "MICROSAR RTE" /begin SUB_GROUP /end SUB_GROUP /begin FUNCTION_LIST /end FUNCTION_LIST /begin REF_CHARACTERISTIC /end REF_CHARACTERISTIC /begin REF_MEASUREMENT AssiSumLim.PullCmpCmd.Val /end REF_MEASUREMENT /end GROUP
/begin GROUP AssiSumLim.PwrLimrRednFac.Val "MICROSAR RTE" /begin SUB_GROUP /end SUB_GROUP /begin FUNCTION_LIST /end FUNCTION_LIST /begin REF_CHARACTERISTIC /end REF_CHARACTERISTIC /begin REF_MEASUREMENT AssiSumLim.PwrLimrRednFac.Val /end REF_MEASUREMENT /end GROUP
/begin GROUP AssiSumLim.ReceiverPorts "MICROSAR RTE"
 /begin SUB_GROUP AssiSumLim.AssiCmd.Val AssiSumLim.DampgCmd.Val AssiSumLim.EotActvCmd.Val AssiSumLim.EotAssiSca.Val AssiSumLim.EotDampgCmd.Val AssiSumLim.EotMotTqLim.Val AssiSumLim.HwTqLoaMtgtnEna.Logl AssiSumLim.MotTqCmdLimDi.Logl AssiSumLim.MotTqCmdOvrl.Val AssiSumLim.PinionCentrLrnCmd.Val AssiSumLim.PinionCentrLrnEna.Logl AssiSumLim.PullCmpCmd.Val AssiSumLim.PwrLimrRednFac.Val AssiSumLim.RtnCmd.Val AssiSumLim.StallMotTqLim.Val AssiSumLim.SysMotTqCmdSca.Val AssiSumLim.ThermMotTqLim.Val AssiSumLim.ThermRednFac.Val AssiSumLim.TqLoaCmd.Val AssiSumLim.TqSteerMtgtnCmd.Val AssiSumLim.VehSpd.Val AssiSumLim.VehSpdMotTqLim.Val AssiSumLim.WhlImbRejctnCmd.Val /end SUB_GROUP
 /begin FUNCTION_LIST /end FUNCTION_LIST
 /begin REF_CHARACTERISTIC /end REF_CHARACTERISTIC
 /begin REF_MEASUREMENT /end REF_MEASUREMENT
/end GROUP
/begin GROUP AssiSumLim.RtnCmd.Val "MICROSAR RTE" /begin SUB_GROUP /end SUB_GROUP /begin FUNCTION_LIST /end FUNCTION_LIST /begin REF_CHARACTERISTIC /end REF_CHARACTERISTIC /begin REF_MEASUREMENT AssiSumLim.RtnCmd.Val /end REF_MEASUREMENT /end GROUP
/begin GROUP AssiSumLim.SenderPorts "MICROSAR RTE"
 /begin SUB_GROUP AssiSumLim.MotTqCmd.Val AssiSumLim.MotTqCmdLimdPreStall.Val AssiSumLim.MotTqCmdLimrMin.Val AssiSumLim.MotTqCmdPreLim.Val AssiSumLim.SysProtnRednFac.Val /end SUB_GROUP
 /begin FUNCTION_LIST /end FUNCTION_LIST
 /begin REF_CHARACTERISTIC /end REF_CHARACTERISTIC
 /begin REF_MEASUREMENT /end REF_MEASUREMENT
/end GROUP
/begin GROUP AssiSumLim.StallMotTqLim.Val "MICROSAR RTE" /begin SUB_GROUP /end SUB_GROUP /begin FUNCTION_LIST /end FUNCTION_LIST /begin REF_CHARACTERISTIC /end REF_CHARACTERISTIC /begin REF_MEASUREMENT AssiSumLim.StallMotTqLim.Val /end REF_MEASUREMENT /end GROUP
/begin GROUP AssiSumLim.SysMotTqCmdSca.Val "MICROSAR RTE" /begin SUB_GROUP /end SUB_GROUP /begin FUNCTION_LIST /end FUNCTION_LIST /begin REF_CHARACTERISTIC /end REF_CHARACTERISTIC /begin REF_MEASUREMENT AssiSumLim.SysMotTqCmdSca.Val /end REF_MEASUREMENT /end GROUP
/begin GROUP AssiSumLim.SysProtnRednFac.Val "MICROSAR RTE" /begin SUB_GROUP /end SUB_GROUP /begin FUNCTION_LIST /end FUNCTION_LIST /begin REF_CHARACTERISTIC /end REF_CHARACTERISTIC /begin REF_MEASUREMENT AssiSumLim.SysProtnRednFac.Val /end REF_MEASUREMENT /end GROUP
/begin GROUP AssiSumLim.ThermMotTqLim.Val "MICROSAR RTE" /begin SUB_GROUP /end SUB_GROUP /begin FUNCTION_LIST /end FUNCTION_LIST /begin REF_CHARACTERISTIC /end REF_CHARACTERISTIC /begin REF_MEASUREMENT AssiSumLim.ThermMotTqLim.Val /end REF_MEASUREMENT /end GROUP
/begin GROUP AssiSumLim.ThermRednFac.Val "MICROSAR RTE" /begin SUB_GROUP /end SUB_GROUP /begin FUNCTION_LIST /end FUNCTION_LIST /begin REF_CHARACTERISTIC /end REF_CHARACTERISTIC /begin REF_MEASUREMENT AssiSumLim.ThermRednFac.Val /end REF_MEASUREMENT /end GROUP
/begin GROUP AssiSumLim.TqLoaCmd.Val "MICROSAR RTE" /begin SUB_GROUP /end SUB_GROUP /begin FUNCTION_LIST /end FUNCTION_LIST /begin REF_CHARACTERISTIC /end REF_CHARACTERISTIC /begin REF_MEASUREMENT AssiSumLim.TqLoaCmd.Val /end REF_MEASUREMENT /end GROUP
/begin GROUP AssiSumLim.TqSteerMtgtnCmd.Val "MICROSAR RTE" /begin SUB_GROUP /end SUB_GROUP /begin FUNCTION_LIST /end FUNCTION_LIST /begin REF_CHARACTERISTIC /end REF_CHARACTERISTIC /begin REF_MEASUREMENT AssiSumLim.TqSteerMtgtnCmd.Val /end REF_MEASUREMENT /end GROUP
/begin GROUP AssiSumLim.VehSpd.Val "MICROSAR RTE" /begin SUB_GROUP /end SUB_GROUP /begin FUNCTION_LIST /end FUNCTION_LIST /begin REF_CHARACTERISTIC /end REF_CHARACTERISTIC /begin REF_MEASUREMENT AssiSumLim.VehSpd.Val /end REF_MEASUREMENT /end GROUP
/begin GROUP AssiSumLim.VehSpdMotTqLim.Val "MICROSAR RTE" /begin SUB_GROUP /end SUB_GROUP /begin FUNCTION_LIST /end FUNCTION_LIST /begin REF_CHARACTERISTIC /end REF_CHARACTERISTIC /begin REF_MEASUREMENT AssiSumLim.VehSpdMotTqLim.Val /end REF_MEASUREMENT /end GROUP
/begin GROUP AssiSumLim.WhlImbRejctnCmd.Val "MICROSAR RTE" /begin SUB_GROUP /end SUB_GROUP /begin FUNCTION_LIST /end FUNCTION_LIST /begin REF_CHARACTERISTIC /end REF_CHARACTERISTIC /begin REF_MEASUREMENT AssiSumLim.WhlImbRejctnCmd.Val /end REF_MEASUREMENT /end GROUP
/begin GROUP BattVltg "MICROSAR RTE"
 /begin SUB_GROUP BattVltg.CalibrationPorts BattVltg.ReceiverPorts BattVltg.SenderPorts /end SUB_GROUP
 /begin FUNCTION_LIST /end FUNCTION_LIST
 /begin REF_CHARACTERISTIC /end REF_CHARACTERISTIC
 /begin REF_MEASUREMENT /end REF_MEASUREMENT
/end GROUP
/begin GROUP BattVltg.BattSwdVltgCorrlnSts.Val "MICROSAR RTE" /begin SUB_GROUP /end SUB_GROUP /begin FUNCTION_LIST /end FUNCTION_LIST /begin REF_CHARACTERISTIC /end REF_CHARACTERISTIC /begin REF_MEASUREMENT BattVltg.BattSwdVltgCorrlnSts.Val /end REF_MEASUREMENT /end GROUP
/begin GROUP BattVltg.BattVltg.Val "MICROSAR RTE" /begin SUB_GROUP /end SUB_GROUP /begin FUNCTION_LIST /end FUNCTION_LIST /begin REF_CHARACTERISTIC /end REF_CHARACTERISTIC /begin REF_MEASUREMENT BattVltg.BattVltg.Val /end REF_MEASUREMENT /end GROUP
/begin GROUP BattVltg.BattVltgCorrlnSysMinVltg.Val "MICROSAR RTE" /begin SUB_GROUP /end SUB_GROUP /begin FUNCTION_LIST /end FUNCTION_LIST /begin REF_CHARACTERISTIC BattVltg.BattVltgCorrlnSysMinVltg.Val /end REF_CHARACTERISTIC /begin REF_MEASUREMENT /end REF_MEASUREMENT /end GROUP
/begin GROUP BattVltg.BattVltgSwd1.Val "MICROSAR RTE" /begin SUB_GROUP /end SUB_GROUP /begin FUNCTION_LIST /end FUNCTION_LIST /begin REF_CHARACTERISTIC /end REF_CHARACTERISTIC /begin REF_MEASUREMENT BattVltg.BattVltgSwd1.Val /end REF_MEASUREMENT /end GROUP
/begin GROUP BattVltg.BattVltgSwd2.Val "MICROSAR RTE" /begin SUB_GROUP /end SUB_GROUP /begin FUNCTION_LIST /end FUNCTION_LIST /begin REF_CHARACTERISTIC /end REF_CHARACTERISTIC /begin REF_MEASUREMENT BattVltg.BattVltgSwd2.Val /end REF_MEASUREMENT /end GROUP
/begin GROUP BattVltg.BattVltgSwdMax.Val "MICROSAR RTE" /begin SUB_GROUP /end SUB_GROUP /begin FUNCTION_LIST /end FUNCTION_LIST /begin REF_CHARACTERISTIC BattVltg.BattVltgSwdMax.Val /end REF_CHARACTERISTIC /begin REF_MEASUREMENT /end REF_MEASUREMENT /end GROUP
/begin GROUP BattVltg.BrdgVltg.Val "MICROSAR RTE" /begin SUB_GROUP /end SUB_GROUP /begin FUNCTION_LIST /end FUNCTION_LIST /begin REF_CHARACTERISTIC /end REF_CHARACTERISTIC /begin REF_MEASUREMENT BattVltg.BrdgVltg.Val /end REF_MEASUREMENT /end GROUP
/begin GROUP BattVltg.BrdgVltgMax.Val "MICROSAR RTE" /begin SUB_GROUP /end SUB_GROUP /begin FUNCTION_LIST /end FUNCTION_LIST /begin REF_CHARACTERISTIC BattVltg.BrdgVltgMax.Val /end REF_CHARACTERISTIC /begin REF_MEASUREMENT /end REF_MEASUREMENT /end GROUP
/begin GROUP BattVltg.CalibrationPorts "MICROSAR RTE"
 /begin SUB_GROUP BattVltg.BattVltgCorrlnSysMinVltg.Val BattVltg.BattVltgSwdMax.Val BattVltg.BrdgVltgMax.Val /end SUB_GROUP
 /begin FUNCTION_LIST /end FUNCTION_LIST
 /begin REF_CHARACTERISTIC /end REF_CHARACTERISTIC
 /begin REF_MEASUREMENT /end REF_MEASUREMENT
/end GROUP
/begin GROUP BattVltg.ReceiverPorts "MICROSAR RTE"
 /begin SUB_GROUP BattVltg.BattSwdVltgCorrlnSts.Val BattVltg.BattVltg.Val BattVltg.BattVltgSwd1.Val BattVltg.BattVltgSwd2.Val /end SUB_GROUP
 /begin FUNCTION_LIST /end FUNCTION_LIST
 /begin REF_CHARACTERISTIC /end REF_CHARACTERISTIC
 /begin REF_MEASUREMENT /end REF_MEASUREMENT
/end GROUP
/begin GROUP BattVltg.SenderPorts "MICROSAR RTE" /begin SUB_GROUP BattVltg.BrdgVltg.Val /end SUB_GROUP /begin FUNCTION_LIST /end FUNCTION_LIST /begin REF_CHARACTERISTIC /end REF_CHARACTERISTIC /begin REF_MEASUREMENT /end REF_MEASUREMENT /end GROUP
/begin GROUP BattVltgCorrln "MICROSAR RTE"
 /begin SUB_GROUP BattVltgCorrln.CalibrationPorts BattVltgCorrln.PerInstanceMemories BattVltgCorrln.ReceiverPorts BattVltgCorrln.SenderPorts /end SUB_GROUP
 /begin FUNCTION_LIST /end FUNCTION_LIST
 /begin REF_CHARACTERISTIC /end REF_CHARACTERISTIC
 /begin REF_MEASUREMENT /end REF_MEASUREMENT
/end GROUP
/begin GROUP BattVltgCorrln.BattSwdVltgCorrlnSts.Val "MICROSAR RTE" /begin SUB_GROUP /end SUB_GROUP /begin FUNCTION_LIST /end FUNCTION_LIST /begin REF_CHARACTERISTIC /end REF_CHARACTERISTIC /begin REF_MEASUREMENT BattVltgCorrln.BattSwdVltgCorrlnSts.Val /end REF_MEASUREMENT /end GROUP
/begin GROUP BattVltgCorrln.BattVltg.Val "MICROSAR RTE" /begin SUB_GROUP /end SUB_GROUP /begin FUNCTION_LIST /end FUNCTION_LIST /begin REF_CHARACTERISTIC /end REF_CHARACTERISTIC /begin REF_MEASUREMENT BattVltgCorrln.BattVltg.Val /end REF_MEASUREMENT /end GROUP
/begin GROUP BattVltgCorrln.BattVltgAdcFaild.Logl "MICROSAR RTE" /begin SUB_GROUP /end SUB_GROUP /begin FUNCTION_LIST /end FUNCTION_LIST /begin REF_CHARACTERISTIC /end REF_CHARACTERISTIC /begin REF_MEASUREMENT BattVltgCorrln.BattVltgAdcFaild.Logl /end REF_MEASUREMENT /end GROUP
/begin GROUP BattVltgCorrln.BattVltgCorrlnAllwdVltgDif.Val "MICROSAR RTE" /begin SUB_GROUP /end SUB_GROUP /begin FUNCTION_LIST /end FUNCTION_LIST /begin REF_CHARACTERISTIC BattVltgCorrln.BattVltgCorrlnAllwdVltgDif.Val /end REF_CHARACTERISTIC /begin REF_MEASUREMENT /end REF_MEASUREMENT /end GROUP
/begin GROUP BattVltgCorrln.BattVltgCorrlnBattLoVltg.Val "MICROSAR RTE" /begin SUB_GROUP /end SUB_GROUP /begin FUNCTION_LIST /end FUNCTION_LIST /begin REF_CHARACTERISTIC BattVltgCorrln.BattVltgCorrlnBattLoVltg.Val /end REF_CHARACTERISTIC /begin REF_MEASUREMENT /end REF_MEASUREMENT /end GROUP
/begin GROUP BattVltgCorrln.BattVltgCorrlnBattOverVltg.Val "MICROSAR RTE" /begin SUB_GROUP /end SUB_GROUP /begin FUNCTION_LIST /end FUNCTION_LIST /begin REF_CHARACTERISTIC BattVltgCorrln.BattVltgCorrlnBattOverVltg.Val /end REF_CHARACTERISTIC /begin REF_MEASUREMENT /end REF_MEASUREMENT /end GROUP
/begin GROUP BattVltgCorrln.BattVltgCorrlnBattUnderVltg.Val "MICROSAR RTE" /begin SUB_GROUP /end SUB_GROUP /begin FUNCTION_LIST /end FUNCTION_LIST /begin REF_CHARACTERISTIC BattVltgCorrln.BattVltgCorrlnBattUnderVltg.Val /end REF_CHARACTERISTIC /begin REF_MEASUREMENT /end REF_MEASUREMENT /end GROUP
/begin GROUP BattVltgCorrln.BattVltgCorrlnIdptSig.Val "MICROSAR RTE" /begin SUB_GROUP /end SUB_GROUP /begin FUNCTION_LIST /end FUNCTION_LIST /begin REF_CHARACTERISTIC /end REF_CHARACTERISTIC /begin REF_MEASUREMENT BattVltgCorrln.BattVltgCorrlnIdptSig.Val /end REF_MEASUREMENT /end GROUP
/begin GROUP BattVltgCorrln.BattVltgCorrlnNtc0x03C0x0440x04CFailStep.Val "MICROSAR RTE" /begin SUB_GROUP /end SUB_GROUP /begin FUNCTION_LIST /end FUNCTION_LIST
 /begin REF_CHARACTERISTIC BattVltgCorrln.BattVltgCorrlnNtc0x03C0x0440x04CFailStep.Val /end REF_CHARACTERISTIC
 /begin REF_MEASUREMENT /end REF_MEASUREMENT
/end GROUP
/begin GROUP BattVltgCorrln.BattVltgCorrlnNtc0x03C0x0440x04CPassStep.Val "MICROSAR RTE" /begin SUB_GROUP /end SUB_GROUP /begin FUNCTION_LIST /end FUNCTION_LIST
 /begin REF_CHARACTERISTIC BattVltgCorrln.BattVltgCorrlnNtc0x03C0x0440x04CPassStep.Val /end REF_CHARACTERISTIC
 /begin REF_MEASUREMENT /end REF_MEASUREMENT
/end GROUP
/begin GROUP BattVltgCorrln.BattVltgCorrlnNtc0x03DFailStep.Val "MICROSAR RTE" /begin SUB_GROUP /end SUB_GROUP /begin FUNCTION_LIST /end FUNCTION_LIST /begin REF_CHARACTERISTIC BattVltgCorrln.BattVltgCorrlnNtc0x03DFailStep.Val /end REF_CHARACTERISTIC /begin REF_MEASUREMENT /end REF_MEASUREMENT /end GROUP
/begin GROUP BattVltgCorrln.BattVltgCorrlnNtc0x03DPassStep.Val "MICROSAR RTE" /begin SUB_GROUP /end SUB_GROUP /begin FUNCTION_LIST /end FUNCTION_LIST /begin REF_CHARACTERISTIC BattVltgCorrln.BattVltgCorrlnNtc0x03DPassStep.Val /end REF_CHARACTERISTIC /begin REF_MEASUREMENT /end REF_MEASUREMENT /end GROUP
/begin GROUP BattVltgCorrln.BattVltgCorrlnNtc0x0B0FailStep.Val "MICROSAR RTE" /begin SUB_GROUP /end SUB_GROUP /begin FUNCTION_LIST /end FUNCTION_LIST /begin REF_CHARACTERISTIC BattVltgCorrln.BattVltgCorrlnNtc0x0B0FailStep.Val /end REF_CHARACTERISTIC /begin REF_MEASUREMENT /end REF_MEASUREMENT /end GROUP
/begin GROUP BattVltgCorrln.BattVltgCorrlnNtc0x0B0PassStep.Val "MICROSAR RTE" /begin SUB_GROUP /end SUB_GROUP /begin FUNCTION_LIST /end FUNCTION_LIST /begin REF_CHARACTERISTIC BattVltgCorrln.BattVltgCorrlnNtc0x0B0PassStep.Val /end REF_CHARACTERISTIC /begin REF_MEASUREMENT /end REF_MEASUREMENT /end GROUP
/begin GROUP BattVltgCorrln.BattVltgCorrlnNtc0x0B1FailStep.Val "MICROSAR RTE" /begin SUB_GROUP /end SUB_GROUP /begin FUNCTION_LIST /end FUNCTION_LIST /begin REF_CHARACTERISTIC BattVltgCorrln.BattVltgCorrlnNtc0x0B1FailStep.Val /end REF_CHARACTERISTIC /begin REF_MEASUREMENT /end REF_MEASUREMENT /end GROUP
/begin GROUP BattVltgCorrln.BattVltgCorrlnNtc0x0B1PassStep.Val "MICROSAR RTE" /begin SUB_GROUP /end SUB_GROUP /begin FUNCTION_LIST /end FUNCTION_LIST /begin REF_CHARACTERISTIC BattVltgCorrln.BattVltgCorrlnNtc0x0B1PassStep.Val /end REF_CHARACTERISTIC /begin REF_MEASUREMENT /end REF_MEASUREMENT /end GROUP
/begin GROUP BattVltgCorrln.BattVltgCorrlnNtc0x0B5FailStep.Val "MICROSAR RTE" /begin SUB_GROUP /end SUB_GROUP /begin FUNCTION_LIST /end FUNCTION_LIST /begin REF_CHARACTERISTIC BattVltgCorrln.BattVltgCorrlnNtc0x0B5FailStep.Val /end REF_CHARACTERISTIC /begin REF_MEASUREMENT /end REF_MEASUREMENT /end GROUP
/begin GROUP BattVltgCorrln.BattVltgCorrlnNtc0x0B5PassStep.Val "MICROSAR RTE" /begin SUB_GROUP /end SUB_GROUP /begin FUNCTION_LIST /end FUNCTION_LIST /begin REF_CHARACTERISTIC BattVltgCorrln.BattVltgCorrlnNtc0x0B5PassStep.Val /end REF_CHARACTERISTIC /begin REF_MEASUREMENT /end REF_MEASUREMENT /end GROUP
/begin GROUP BattVltgCorrln.BattVltgCorrlnRcvrlBattLoVltg.Val "MICROSAR RTE" /begin SUB_GROUP /end SUB_GROUP /begin FUNCTION_LIST /end FUNCTION_LIST /begin REF_CHARACTERISTIC BattVltgCorrln.BattVltgCorrlnRcvrlBattLoVltg.Val /end REF_CHARACTERISTIC /begin REF_MEASUREMENT /end REF_MEASUREMENT /end GROUP
/begin GROUP BattVltgCorrln.BattVltgCorrlnRcvrlBattOverVltg.Val "MICROSAR RTE" /begin SUB_GROUP /end SUB_GROUP /begin FUNCTION_LIST /end FUNCTION_LIST /begin REF_CHARACTERISTIC BattVltgCorrln.BattVltgCorrlnRcvrlBattOverVltg.Val /end REF_CHARACTERISTIC /begin REF_MEASUREMENT /end REF_MEASUREMENT /end GROUP
/begin GROUP BattVltgCorrln.BattVltgCorrlnRcvrlBattUnderVltg.Val "MICROSAR RTE" /begin SUB_GROUP /end SUB_GROUP /begin FUNCTION_LIST /end FUNCTION_LIST /begin REF_CHARACTERISTIC BattVltgCorrln.BattVltgCorrlnRcvrlBattUnderVltg.Val /end REF_CHARACTERISTIC /begin REF_MEASUREMENT /end REF_MEASUREMENT /end GROUP
/begin GROUP BattVltgCorrln.BattVltgCorrlnSysMinVltg.Val "MICROSAR RTE" /begin SUB_GROUP /end SUB_GROUP /begin FUNCTION_LIST /end FUNCTION_LIST /begin REF_CHARACTERISTIC BattVltgCorrln.BattVltgCorrlnSysMinVltg.Val /end REF_CHARACTERISTIC /begin REF_MEASUREMENT /end REF_MEASUREMENT /end GROUP
/begin GROUP BattVltgCorrln.BattVltgSwd1.Val "MICROSAR RTE" /begin SUB_GROUP /end SUB_GROUP /begin FUNCTION_LIST /end FUNCTION_LIST /begin REF_CHARACTERISTIC /end REF_CHARACTERISTIC /begin REF_MEASUREMENT BattVltgCorrln.BattVltgSwd1.Val /end REF_MEASUREMENT /end GROUP
/begin GROUP BattVltgCorrln.BattVltgSwd1AdcFaild.Logl "MICROSAR RTE" /begin SUB_GROUP /end SUB_GROUP /begin FUNCTION_LIST /end FUNCTION_LIST /begin REF_CHARACTERISTIC /end REF_CHARACTERISTIC /begin REF_MEASUREMENT BattVltgCorrln.BattVltgSwd1AdcFaild.Logl /end REF_MEASUREMENT /end GROUP
/begin GROUP BattVltgCorrln.BattVltgSwd2.Val "MICROSAR RTE" /begin SUB_GROUP /end SUB_GROUP /begin FUNCTION_LIST /end FUNCTION_LIST /begin REF_CHARACTERISTIC /end REF_CHARACTERISTIC /begin REF_MEASUREMENT BattVltgCorrln.BattVltgSwd2.Val /end REF_MEASUREMENT /end GROUP
/begin GROUP BattVltgCorrln.BattVltgSwd2AdcFaild.Logl "MICROSAR RTE" /begin SUB_GROUP /end SUB_GROUP /begin FUNCTION_LIST /end FUNCTION_LIST /begin REF_CHARACTERISTIC /end REF_CHARACTERISTIC /begin REF_MEASUREMENT BattVltgCorrln.BattVltgSwd2AdcFaild.Logl /end REF_MEASUREMENT /end GROUP
/begin GROUP BattVltgCorrln.BattVltgSwdMax.Val "MICROSAR RTE" /begin SUB_GROUP /end SUB_GROUP /begin FUNCTION_LIST /end FUNCTION_LIST /begin REF_CHARACTERISTIC BattVltgCorrln.BattVltgSwdMax.Val /end REF_CHARACTERISTIC /begin REF_MEASUREMENT /end REF_MEASUREMENT /end GROUP
/begin GROUP BattVltgCorrln.CalibrationPorts "MICROSAR RTE"
 /begin SUB_GROUP BattVltgCorrln.BattVltgCorrlnAllwdVltgDif.Val BattVltgCorrln.BattVltgCorrlnBattLoVltg.Val BattVltgCorrln.BattVltgCorrlnBattOverVltg.Val BattVltgCorrln.BattVltgCorrlnBattUnderVltg.Val BattVltgCorrln.BattVltgCorrlnNtc0x03C0x0440x04CFailStep.Val BattVltgCorrln.BattVltgCorrlnNtc0x03C0x0440x04CPassStep.Val BattVltgCorrln.BattVltgCorrlnNtc0x03DFailStep.Val BattVltgCorrln.BattVltgCorrlnNtc0x03DPassStep.Val BattVltgCorrln.BattVltgCorrlnNtc0x0B0FailStep.Val BattVltgCorrln.BattVltgCorrlnNtc0x0B0PassStep.Val BattVltgCorrln.BattVltgCorrlnNtc0x0B1FailStep.Val BattVltgCorrln.BattVltgCorrlnNtc0x0B1PassStep.Val BattVltgCorrln.BattVltgCorrlnNtc0x0B5FailStep.Val BattVltgCorrln.BattVltgCorrlnNtc0x0B5PassStep.Val BattVltgCorrln.BattVltgCorrlnRcvrlBattLoVltg.Val BattVltgCorrln.BattVltgCorrlnRcvrlBattOverVltg.Val BattVltgCorrln.BattVltgCorrlnRcvrlBattUnderVltg.Val BattVltgCorrln.BattVltgCorrlnSysMinVltg.Val BattVltgCorrln.BattVltgSwdMax.Val /end SUB_GROUP
 /begin FUNCTION_LIST /end FUNCTION_LIST
 /begin REF_CHARACTERISTIC /end REF_CHARACTERISTIC
 /begin REF_MEASUREMENT /end REF_MEASUREMENT
/end GROUP
/begin GROUP BattVltgCorrln.DftBrdgVltgActv.Logl "MICROSAR RTE" /begin SUB_GROUP /end SUB_GROUP /begin FUNCTION_LIST /end FUNCTION_LIST /begin REF_CHARACTERISTIC /end REF_CHARACTERISTIC /begin REF_MEASUREMENT BattVltgCorrln.DftBrdgVltgActv.Logl /end REF_MEASUREMENT /end GROUP
/begin GROUP BattVltgCorrln.DiagcStsIvtr1Inactv.Logl "MICROSAR RTE" /begin SUB_GROUP /end SUB_GROUP /begin FUNCTION_LIST /end FUNCTION_LIST /begin REF_CHARACTERISTIC /end REF_CHARACTERISTIC /begin REF_MEASUREMENT BattVltgCorrln.DiagcStsIvtr1Inactv.Logl /end REF_MEASUREMENT /end GROUP
/begin GROUP BattVltgCorrln.DiagcStsIvtr2Inactv.Logl "MICROSAR RTE" /begin SUB_GROUP /end SUB_GROUP /begin FUNCTION_LIST /end FUNCTION_LIST /begin REF_CHARACTERISTIC /end REF_CHARACTERISTIC /begin REF_MEASUREMENT BattVltgCorrln.DiagcStsIvtr2Inactv.Logl /end REF_MEASUREMENT /end GROUP
/begin GROUP BattVltgCorrln.InhbBattVltgDiagc.Logl "MICROSAR RTE" /begin SUB_GROUP /end SUB_GROUP /begin FUNCTION_LIST /end FUNCTION_LIST /begin REF_CHARACTERISTIC /end REF_CHARACTERISTIC /begin REF_MEASUREMENT BattVltgCorrln.InhbBattVltgDiagc.Logl /end REF_MEASUREMENT /end GROUP
/begin GROUP BattVltgCorrln.PerInstanceMemories "MICROSAR RTE"
 /begin SUB_GROUP BattVltgCorrln.dBattVltgCorrlnBattVltgOk BattVltgCorrln.dBattVltgCorrlnBattVltgRngOk BattVltgCorrln.dBattVltgCorrlnBattVltgSwd1Ok BattVltgCorrln.dBattVltgCorrlnBattVltgSwd1RngOk BattVltgCorrln.dBattVltgCorrlnBattVltgSwd2Ok BattVltgCorrln.dBattVltgCorrlnBattVltgSwd2RngOk BattVltgCorrln.dBattVltgCorrlnNtc0x03CQlfrSts BattVltgCorrln.dBattVltgCorrlnNtc0x03DQlfrSts BattVltgCorrln.dBattVltgCorrlnNtc0x044QlfrSts BattVltgCorrln.dBattVltgCorrlnNtc0x04CQlfrSts /end SUB_GROUP
 /begin FUNCTION_LIST /end FUNCTION_LIST
 /begin REF_CHARACTERISTIC /end REF_CHARACTERISTIC
 /begin REF_MEASUREMENT /end REF_MEASUREMENT
/end GROUP
/begin GROUP BattVltgCorrln.ReceiverPorts "MICROSAR RTE"
 /begin SUB_GROUP BattVltgCorrln.BattVltg.Val BattVltgCorrln.BattVltgAdcFaild.Logl BattVltgCorrln.BattVltgSwd1.Val BattVltgCorrln.BattVltgSwd1AdcFaild.Logl BattVltgCorrln.BattVltgSwd2.Val BattVltgCorrln.BattVltgSwd2AdcFaild.Logl BattVltgCorrln.DiagcStsIvtr1Inactv.Logl BattVltgCorrln.DiagcStsIvtr2Inactv.Logl BattVltgCorrln.InhbBattVltgDiagc.Logl BattVltgCorrln.StrtUpSt.Val BattVltgCorrln.SysSt.Val /end SUB_GROUP
 /begin FUNCTION_LIST /end FUNCTION_LIST
 /begin REF_CHARACTERISTIC /end REF_CHARACTERISTIC
 /begin REF_MEASUREMENT /end REF_MEASUREMENT
/end GROUP
/begin GROUP BattVltgCorrln.SenderPorts "MICROSAR RTE"
 /begin SUB_GROUP BattVltgCorrln.BattSwdVltgCorrlnSts.Val BattVltgCorrln.BattVltgCorrlnIdptSig.Val BattVltgCorrln.DftBrdgVltgActv.Logl BattVltgCorrln.SwdVltgLimd.Logl /end SUB_GROUP
 /begin FUNCTION_LIST /end FUNCTION_LIST
 /begin REF_CHARACTERISTIC /end REF_CHARACTERISTIC
 /begin REF_MEASUREMENT /end REF_MEASUREMENT
/end GROUP
/begin GROUP BattVltgCorrln.StrtUpSt.Val "MICROSAR RTE" /begin SUB_GROUP /end SUB_GROUP /begin FUNCTION_LIST /end FUNCTION_LIST /begin REF_CHARACTERISTIC /end REF_CHARACTERISTIC /begin REF_MEASUREMENT BattVltgCorrln.StrtUpSt.Val /end REF_MEASUREMENT /end GROUP
/begin GROUP BattVltgCorrln.SwdVltgLimd.Logl "MICROSAR RTE" /begin SUB_GROUP /end SUB_GROUP /begin FUNCTION_LIST /end FUNCTION_LIST /begin REF_CHARACTERISTIC /end REF_CHARACTERISTIC /begin REF_MEASUREMENT BattVltgCorrln.SwdVltgLimd.Logl /end REF_MEASUREMENT /end GROUP
/begin GROUP BattVltgCorrln.SysSt.Val "MICROSAR RTE" /begin SUB_GROUP /end SUB_GROUP /begin FUNCTION_LIST /end FUNCTION_LIST /begin REF_CHARACTERISTIC /end REF_CHARACTERISTIC /begin REF_MEASUREMENT BattVltgCorrln.SysSt.Val /end REF_MEASUREMENT /end GROUP
/begin GROUP BattVltgCorrln.dBattVltgCorrlnBattVltgOk "MICROSAR RTE" /begin SUB_GROUP /end SUB_GROUP /begin FUNCTION_LIST /end FUNCTION_LIST /begin REF_CHARACTERISTIC /end REF_CHARACTERISTIC /begin REF_MEASUREMENT BattVltgCorrln.dBattVltgCorrlnBattVltgOk /end REF_MEASUREMENT /end GROUP
/begin GROUP BattVltgCorrln.dBattVltgCorrlnBattVltgRngOk "MICROSAR RTE" /begin SUB_GROUP /end SUB_GROUP /begin FUNCTION_LIST /end FUNCTION_LIST /begin REF_CHARACTERISTIC /end REF_CHARACTERISTIC /begin REF_MEASUREMENT BattVltgCorrln.dBattVltgCorrlnBattVltgRngOk /end REF_MEASUREMENT /end GROUP
/begin GROUP BattVltgCorrln.dBattVltgCorrlnBattVltgSwd1Ok "MICROSAR RTE" /begin SUB_GROUP /end SUB_GROUP /begin FUNCTION_LIST /end FUNCTION_LIST /begin REF_CHARACTERISTIC /end REF_CHARACTERISTIC /begin REF_MEASUREMENT BattVltgCorrln.dBattVltgCorrlnBattVltgSwd1Ok /end REF_MEASUREMENT /end GROUP
/begin GROUP BattVltgCorrln.dBattVltgCorrlnBattVltgSwd1RngOk "MICROSAR RTE" /begin SUB_GROUP /end SUB_GROUP /begin FUNCTION_LIST /end FUNCTION_LIST /begin REF_CHARACTERISTIC /end REF_CHARACTERISTIC /begin REF_MEASUREMENT BattVltgCorrln.dBattVltgCorrlnBattVltgSwd1RngOk /end REF_MEASUREMENT /end GROUP
/begin GROUP BattVltgCorrln.dBattVltgCorrlnBattVltgSwd2Ok "MICROSAR RTE" /begin SUB_GROUP /end SUB_GROUP /begin FUNCTION_LIST /end FUNCTION_LIST /begin REF_CHARACTERISTIC /end REF_CHARACTERISTIC /begin REF_MEASUREMENT BattVltgCorrln.dBattVltgCorrlnBattVltgSwd2Ok /end REF_MEASUREMENT /end GROUP
/begin GROUP BattVltgCorrln.dBattVltgCorrlnBattVltgSwd2RngOk "MICROSAR RTE" /begin SUB_GROUP /end SUB_GROUP /begin FUNCTION_LIST /end FUNCTION_LIST /begin REF_CHARACTERISTIC /end REF_CHARACTERISTIC /begin REF_MEASUREMENT BattVltgCorrln.dBattVltgCorrlnBattVltgSwd2RngOk /end REF_MEASUREMENT /end GROUP
/begin GROUP BattVltgCorrln.dBattVltgCorrlnNtc0x03CQlfrSts "MICROSAR RTE" /begin SUB_GROUP /end SUB_GROUP /begin FUNCTION_LIST /end FUNCTION_LIST /begin REF_CHARACTERISTIC /end REF_CHARACTERISTIC /begin REF_MEASUREMENT BattVltgCorrln.dBattVltgCorrlnNtc0x03CQlfrSts /end REF_MEASUREMENT /end GROUP
/begin GROUP BattVltgCorrln.dBattVltgCorrlnNtc0x03DQlfrSts "MICROSAR RTE" /begin SUB_GROUP /end SUB_GROUP /begin FUNCTION_LIST /end FUNCTION_LIST /begin REF_CHARACTERISTIC /end REF_CHARACTERISTIC /begin REF_MEASUREMENT BattVltgCorrln.dBattVltgCorrlnNtc0x03DQlfrSts /end REF_MEASUREMENT /end GROUP
/begin GROUP BattVltgCorrln.dBattVltgCorrlnNtc0x044QlfrSts "MICROSAR RTE" /begin SUB_GROUP /end SUB_GROUP /begin FUNCTION_LIST /end FUNCTION_LIST /begin REF_CHARACTERISTIC /end REF_CHARACTERISTIC /begin REF_MEASUREMENT BattVltgCorrln.dBattVltgCorrlnNtc0x044QlfrSts /end REF_MEASUREMENT /end GROUP
/begin GROUP BattVltgCorrln.dBattVltgCorrlnNtc0x04CQlfrSts "MICROSAR RTE" /begin SUB_GROUP /end SUB_GROUP /begin FUNCTION_LIST /end FUNCTION_LIST /begin REF_CHARACTERISTIC /end REF_CHARACTERISTIC /begin REF_MEASUREMENT BattVltgCorrln.dBattVltgCorrlnNtc0x04CQlfrSts /end REF_MEASUREMENT /end GROUP
/begin GROUP CDD_Adc0CfgAndUse "MICROSAR RTE" /begin SUB_GROUP CDD_Adc0CfgAndUse.PerInstanceMemories /end SUB_GROUP /begin FUNCTION_LIST /end FUNCTION_LIST /begin REF_CHARACTERISTIC /end REF_CHARACTERISTIC /begin REF_MEASUREMENT /end REF_MEASUREMENT /end GROUP
/begin GROUP CDD_Adc0CfgAndUse.Adc0DiagcEndPtr "MICROSAR RTE" /begin SUB_GROUP /end SUB_GROUP /begin FUNCTION_LIST /end FUNCTION_LIST /begin REF_CHARACTERISTIC /end REF_CHARACTERISTIC /begin REF_MEASUREMENT CDD_Adc0CfgAndUse.Adc0DiagcEndPtr /end REF_MEASUREMENT /end GROUP
/begin GROUP CDD_Adc0CfgAndUse.Adc0DiagcStrtPtr "MICROSAR RTE" /begin SUB_GROUP /end SUB_GROUP /begin FUNCTION_LIST /end FUNCTION_LIST /begin REF_CHARACTERISTIC /end REF_CHARACTERISTIC /begin REF_MEASUREMENT CDD_Adc0CfgAndUse.Adc0DiagcStrtPtr /end REF_MEASUREMENT /end GROUP
/begin GROUP CDD_Adc0CfgAndUse.PerInstanceMemories "MICROSAR RTE"
 /begin SUB_GROUP CDD_Adc0CfgAndUse.Adc0DiagcEndPtr CDD_Adc0CfgAndUse.Adc0DiagcStrtPtr /end SUB_GROUP
 /begin FUNCTION_LIST /end FUNCTION_LIST
 /begin REF_CHARACTERISTIC /end REF_CHARACTERISTIC
 /begin REF_MEASUREMENT /end REF_MEASUREMENT
/end GROUP
/begin GROUP CDD_Adc1CfgAndUse "MICROSAR RTE"
 /begin SUB_GROUP CDD_Adc1CfgAndUse.PerInstanceMemories CDD_Adc1CfgAndUse.ReceiverPorts /end SUB_GROUP
 /begin FUNCTION_LIST /end FUNCTION_LIST
 /begin REF_CHARACTERISTIC /end REF_CHARACTERISTIC
 /begin REF_MEASUREMENT /end REF_MEASUREMENT
/end GROUP
/begin GROUP CDD_Adc1CfgAndUse.Adc1DiagcEndPtr "MICROSAR RTE" /begin SUB_GROUP /end SUB_GROUP /begin FUNCTION_LIST /end FUNCTION_LIST /begin REF_CHARACTERISTIC /end REF_CHARACTERISTIC /begin REF_MEASUREMENT CDD_Adc1CfgAndUse.Adc1DiagcEndPtr /end REF_MEASUREMENT /end GROUP
/begin GROUP CDD_Adc1CfgAndUse.Adc1DiagcStrtPtr "MICROSAR RTE" /begin SUB_GROUP /end SUB_GROUP /begin FUNCTION_LIST /end FUNCTION_LIST /begin REF_CHARACTERISTIC /end REF_CHARACTERISTIC /begin REF_MEASUREMENT CDD_Adc1CfgAndUse.Adc1DiagcStrtPtr /end REF_MEASUREMENT /end GROUP
/begin GROUP CDD_Adc1CfgAndUse.AdcDiagcEndPtrOutp.Val "MICROSAR RTE" /begin SUB_GROUP /end SUB_GROUP /begin FUNCTION_LIST /end FUNCTION_LIST /begin REF_CHARACTERISTIC /end REF_CHARACTERISTIC /begin REF_MEASUREMENT CDD_Adc1CfgAndUse.AdcDiagcEndPtrOutp.Val /end REF_MEASUREMENT /end GROUP
/begin GROUP CDD_Adc1CfgAndUse.AdcDiagcStrtPtrOutp.Val "MICROSAR RTE" /begin SUB_GROUP /end SUB_GROUP /begin FUNCTION_LIST /end FUNCTION_LIST /begin REF_CHARACTERISTIC /end REF_CHARACTERISTIC /begin REF_MEASUREMENT CDD_Adc1CfgAndUse.AdcDiagcStrtPtrOutp.Val /end REF_MEASUREMENT /end GROUP
/begin GROUP CDD_Adc1CfgAndUse.PerInstanceMemories "MICROSAR RTE"
 /begin SUB_GROUP CDD_Adc1CfgAndUse.Adc1DiagcEndPtr CDD_Adc1CfgAndUse.Adc1DiagcStrtPtr /end SUB_GROUP
 /begin FUNCTION_LIST /end FUNCTION_LIST
 /begin REF_CHARACTERISTIC /end REF_CHARACTERISTIC
 /begin REF_MEASUREMENT /end REF_MEASUREMENT
/end GROUP
/begin GROUP CDD_Adc1CfgAndUse.ReceiverPorts "MICROSAR RTE"
 /begin SUB_GROUP CDD_Adc1CfgAndUse.AdcDiagcEndPtrOutp.Val CDD_Adc1CfgAndUse.AdcDiagcStrtPtrOutp.Val /end SUB_GROUP
 /begin FUNCTION_LIST /end FUNCTION_LIST
 /begin REF_CHARACTERISTIC /end REF_CHARACTERISTIC
 /begin REF_MEASUREMENT /end REF_MEASUREMENT
/end GROUP
/begin GROUP CDD_AdcDiagc "MICROSAR RTE"
 /begin SUB_GROUP CDD_AdcDiagc.CalibrationPorts CDD_AdcDiagc.PerInstanceMemories CDD_AdcDiagc.ReceiverPorts CDD_AdcDiagc.SenderPorts /end SUB_GROUP
 /begin FUNCTION_LIST /end FUNCTION_LIST
 /begin REF_CHARACTERISTIC /end REF_CHARACTERISTIC
 /begin REF_MEASUREMENT /end REF_MEASUREMENT
/end GROUP
/begin GROUP CDD_AdcDiagc.Adc0Faild.Logl "MICROSAR RTE" /begin SUB_GROUP /end SUB_GROUP /begin FUNCTION_LIST /end FUNCTION_LIST /begin REF_CHARACTERISTIC /end REF_CHARACTERISTIC /begin REF_MEASUREMENT CDD_AdcDiagc.Adc0Faild.Logl /end REF_MEASUREMENT /end GROUP
/begin GROUP CDD_AdcDiagc.Adc0FltCntSt0 "MICROSAR RTE" /begin SUB_GROUP /end SUB_GROUP /begin FUNCTION_LIST /end FUNCTION_LIST /begin REF_CHARACTERISTIC /end REF_CHARACTERISTIC /begin REF_MEASUREMENT CDD_AdcDiagc.Adc0FltCntSt0 /end REF_MEASUREMENT /end GROUP
/begin GROUP CDD_AdcDiagc.Adc0FltCntSt2 "MICROSAR RTE" /begin SUB_GROUP /end SUB_GROUP /begin FUNCTION_LIST /end FUNCTION_LIST /begin REF_CHARACTERISTIC /end REF_CHARACTERISTIC /begin REF_MEASUREMENT CDD_AdcDiagc.Adc0FltCntSt2 /end REF_MEASUREMENT /end GROUP
/begin GROUP CDD_AdcDiagc.Adc0FltCntSt4 "MICROSAR RTE" /begin SUB_GROUP /end SUB_GROUP /begin FUNCTION_LIST /end FUNCTION_LIST /begin REF_CHARACTERISTIC /end REF_CHARACTERISTIC /begin REF_MEASUREMENT CDD_AdcDiagc.Adc0FltCntSt4 /end REF_MEASUREMENT /end GROUP
/begin GROUP CDD_AdcDiagc.Adc0FltCntSt6 "MICROSAR RTE" /begin SUB_GROUP /end SUB_GROUP /begin FUNCTION_LIST /end FUNCTION_LIST /begin REF_CHARACTERISTIC /end REF_CHARACTERISTIC /begin REF_MEASUREMENT CDD_AdcDiagc.Adc0FltCntSt6 /end REF_MEASUREMENT /end GROUP
/begin GROUP CDD_AdcDiagc.Adc0ScanGroup2Ref0.Val "MICROSAR RTE" /begin SUB_GROUP /end SUB_GROUP /begin FUNCTION_LIST /end FUNCTION_LIST /begin REF_CHARACTERISTIC /end REF_CHARACTERISTIC /begin REF_MEASUREMENT CDD_AdcDiagc.Adc0ScanGroup2Ref0.Val /end REF_MEASUREMENT /end GROUP
/begin GROUP CDD_AdcDiagc.Adc0ScanGroup2Ref1.Val "MICROSAR RTE" /begin SUB_GROUP /end SUB_GROUP /begin FUNCTION_LIST /end FUNCTION_LIST /begin REF_CHARACTERISTIC /end REF_CHARACTERISTIC /begin REF_MEASUREMENT CDD_AdcDiagc.Adc0ScanGroup2Ref1.Val /end REF_MEASUREMENT /end GROUP
/begin GROUP CDD_AdcDiagc.Adc0ScanGroup2RefFltCntSt "MICROSAR RTE" /begin SUB_GROUP /end SUB_GROUP /begin FUNCTION_LIST /end FUNCTION_LIST /begin REF_CHARACTERISTIC /end REF_CHARACTERISTIC /begin REF_MEASUREMENT CDD_AdcDiagc.Adc0ScanGroup2RefFltCntSt /end REF_MEASUREMENT /end GROUP
/begin GROUP CDD_AdcDiagc.Adc0ScanGroup3Ref0.Val "MICROSAR RTE" /begin SUB_GROUP /end SUB_GROUP /begin FUNCTION_LIST /end FUNCTION_LIST /begin REF_CHARACTERISTIC /end REF_CHARACTERISTIC /begin REF_MEASUREMENT CDD_AdcDiagc.Adc0ScanGroup3Ref0.Val /end REF_MEASUREMENT /end GROUP
/begin GROUP CDD_AdcDiagc.Adc0ScanGroup3Ref1.Val "MICROSAR RTE" /begin SUB_GROUP /end SUB_GROUP /begin FUNCTION_LIST /end FUNCTION_LIST /begin REF_CHARACTERISTIC /end REF_CHARACTERISTIC /begin REF_MEASUREMENT CDD_AdcDiagc.Adc0ScanGroup3Ref1.Val /end REF_MEASUREMENT /end GROUP
/begin GROUP CDD_AdcDiagc.Adc0ScanGroup3RefFltCntSt "MICROSAR RTE" /begin SUB_GROUP /end SUB_GROUP /begin FUNCTION_LIST /end FUNCTION_LIST /begin REF_CHARACTERISTIC /end REF_CHARACTERISTIC /begin REF_MEASUREMENT CDD_AdcDiagc.Adc0ScanGroup3RefFltCntSt /end REF_MEASUREMENT /end GROUP
/begin GROUP CDD_AdcDiagc.Adc0SelfDiag0.Val "MICROSAR RTE" /begin SUB_GROUP /end SUB_GROUP /begin FUNCTION_LIST /end FUNCTION_LIST /begin REF_CHARACTERISTIC /end REF_CHARACTERISTIC /begin REF_MEASUREMENT CDD_AdcDiagc.Adc0SelfDiag0.Val /end REF_MEASUREMENT /end GROUP
/begin GROUP CDD_AdcDiagc.Adc0SelfDiag2.Val "MICROSAR RTE" /begin SUB_GROUP /end SUB_GROUP /begin FUNCTION_LIST /end FUNCTION_LIST /begin REF_CHARACTERISTIC /end REF_CHARACTERISTIC /begin REF_MEASUREMENT CDD_AdcDiagc.Adc0SelfDiag2.Val /end REF_MEASUREMENT /end GROUP
/begin GROUP CDD_AdcDiagc.Adc0SelfDiag4.Val "MICROSAR RTE" /begin SUB_GROUP /end SUB_GROUP /begin FUNCTION_LIST /end FUNCTION_LIST /begin REF_CHARACTERISTIC /end REF_CHARACTERISTIC /begin REF_MEASUREMENT CDD_AdcDiagc.Adc0SelfDiag4.Val /end REF_MEASUREMENT /end GROUP
/begin GROUP CDD_AdcDiagc.Adc1Faild.Logl "MICROSAR RTE" /begin SUB_GROUP /end SUB_GROUP /begin FUNCTION_LIST /end FUNCTION_LIST /begin REF_CHARACTERISTIC /end REF_CHARACTERISTIC /begin REF_MEASUREMENT CDD_AdcDiagc.Adc1Faild.Logl /end REF_MEASUREMENT /end GROUP
/begin GROUP CDD_AdcDiagc.Adc1FltCntSt0 "MICROSAR RTE" /begin SUB_GROUP /end SUB_GROUP /begin FUNCTION_LIST /end FUNCTION_LIST /begin REF_CHARACTERISTIC /end REF_CHARACTERISTIC /begin REF_MEASUREMENT CDD_AdcDiagc.Adc1FltCntSt0 /end REF_MEASUREMENT /end GROUP
/begin GROUP CDD_AdcDiagc.Adc1FltCntSt2 "MICROSAR RTE" /begin SUB_GROUP /end SUB_GROUP /begin FUNCTION_LIST /end FUNCTION_LIST /begin REF_CHARACTERISTIC /end REF_CHARACTERISTIC /begin REF_MEASUREMENT CDD_AdcDiagc.Adc1FltCntSt2 /end REF_MEASUREMENT /end GROUP
/begin GROUP CDD_AdcDiagc.Adc1FltCntSt4 "MICROSAR RTE" /begin SUB_GROUP /end SUB_GROUP /begin FUNCTION_LIST /end FUNCTION_LIST /begin REF_CHARACTERISTIC /end REF_CHARACTERISTIC /begin REF_MEASUREMENT CDD_AdcDiagc.Adc1FltCntSt4 /end REF_MEASUREMENT /end GROUP
/begin GROUP CDD_AdcDiagc.Adc1FltCntSt6 "MICROSAR RTE" /begin SUB_GROUP /end SUB_GROUP /begin FUNCTION_LIST /end FUNCTION_LIST /begin REF_CHARACTERISTIC /end REF_CHARACTERISTIC /begin REF_MEASUREMENT CDD_AdcDiagc.Adc1FltCntSt6 /end REF_MEASUREMENT /end GROUP
/begin GROUP CDD_AdcDiagc.Adc1ScanGroup2Ref0.Val "MICROSAR RTE" /begin SUB_GROUP /end SUB_GROUP /begin FUNCTION_LIST /end FUNCTION_LIST /begin REF_CHARACTERISTIC /end REF_CHARACTERISTIC /begin REF_MEASUREMENT CDD_AdcDiagc.Adc1ScanGroup2Ref0.Val /end REF_MEASUREMENT /end GROUP
/begin GROUP CDD_AdcDiagc.Adc1ScanGroup2Ref1.Val "MICROSAR RTE" /begin SUB_GROUP /end SUB_GROUP /begin FUNCTION_LIST /end FUNCTION_LIST /begin REF_CHARACTERISTIC /end REF_CHARACTERISTIC /begin REF_MEASUREMENT CDD_AdcDiagc.Adc1ScanGroup2Ref1.Val /end REF_MEASUREMENT /end GROUP
/begin GROUP CDD_AdcDiagc.Adc1ScanGroup2RefFltCntSt "MICROSAR RTE" /begin SUB_GROUP /end SUB_GROUP /begin FUNCTION_LIST /end FUNCTION_LIST /begin REF_CHARACTERISTIC /end REF_CHARACTERISTIC /begin REF_MEASUREMENT CDD_AdcDiagc.Adc1ScanGroup2RefFltCntSt /end REF_MEASUREMENT /end GROUP
/begin GROUP CDD_AdcDiagc.Adc1ScanGroup3Ref0.Val "MICROSAR RTE" /begin SUB_GROUP /end SUB_GROUP /begin FUNCTION_LIST /end FUNCTION_LIST /begin REF_CHARACTERISTIC /end REF_CHARACTERISTIC /begin REF_MEASUREMENT CDD_AdcDiagc.Adc1ScanGroup3Ref0.Val /end REF_MEASUREMENT /end GROUP
/begin GROUP CDD_AdcDiagc.Adc1ScanGroup3Ref1.Val "MICROSAR RTE" /begin SUB_GROUP /end SUB_GROUP /begin FUNCTION_LIST /end FUNCTION_LIST /begin REF_CHARACTERISTIC /end REF_CHARACTERISTIC /begin REF_MEASUREMENT CDD_AdcDiagc.Adc1ScanGroup3Ref1.Val /end REF_MEASUREMENT /end GROUP
/begin GROUP CDD_AdcDiagc.Adc1ScanGroup3RefFltCntSt "MICROSAR RTE" /begin SUB_GROUP /end SUB_GROUP /begin FUNCTION_LIST /end FUNCTION_LIST /begin REF_CHARACTERISTIC /end REF_CHARACTERISTIC /begin REF_MEASUREMENT CDD_AdcDiagc.Adc1ScanGroup3RefFltCntSt /end REF_MEASUREMENT /end GROUP
/begin GROUP CDD_AdcDiagc.Adc1SelfDiag0.Val "MICROSAR RTE" /begin SUB_GROUP /end SUB_GROUP /begin FUNCTION_LIST /end FUNCTION_LIST /begin REF_CHARACTERISTIC /end REF_CHARACTERISTIC /begin REF_MEASUREMENT CDD_AdcDiagc.Adc1SelfDiag0.Val /end REF_MEASUREMENT /end GROUP
/begin GROUP CDD_AdcDiagc.Adc1SelfDiag2.Val "MICROSAR RTE" /begin SUB_GROUP /end SUB_GROUP /begin FUNCTION_LIST /end FUNCTION_LIST /begin REF_CHARACTERISTIC /end REF_CHARACTERISTIC /begin REF_MEASUREMENT CDD_AdcDiagc.Adc1SelfDiag2.Val /end REF_MEASUREMENT /end GROUP
/begin GROUP CDD_AdcDiagc.Adc1SelfDiag4.Val "MICROSAR RTE" /begin SUB_GROUP /end SUB_GROUP /begin FUNCTION_LIST /end FUNCTION_LIST /begin REF_CHARACTERISTIC /end REF_CHARACTERISTIC /begin REF_MEASUREMENT CDD_AdcDiagc.Adc1SelfDiag4.Val /end REF_MEASUREMENT /end GROUP
/begin GROUP CDD_AdcDiagc.AdcDiagcEndPtr "MICROSAR RTE" /begin SUB_GROUP /end SUB_GROUP /begin FUNCTION_LIST /end FUNCTION_LIST /begin REF_CHARACTERISTIC /end REF_CHARACTERISTIC /begin REF_MEASUREMENT CDD_AdcDiagc.AdcDiagcEndPtr /end REF_MEASUREMENT /end GROUP
/begin GROUP CDD_AdcDiagc.AdcDiagcEndPtrOutp.Val "MICROSAR RTE" /begin SUB_GROUP /end SUB_GROUP /begin FUNCTION_LIST /end FUNCTION_LIST /begin REF_CHARACTERISTIC /end REF_CHARACTERISTIC /begin REF_MEASUREMENT CDD_AdcDiagc.AdcDiagcEndPtrOutp.Val /end REF_MEASUREMENT /end GROUP
/begin GROUP CDD_AdcDiagc.AdcDiagcNtc0x032FailStep.Val "MICROSAR RTE" /begin SUB_GROUP /end SUB_GROUP /begin FUNCTION_LIST /end FUNCTION_LIST /begin REF_CHARACTERISTIC CDD_AdcDiagc.AdcDiagcNtc0x032FailStep.Val /end REF_CHARACTERISTIC /begin REF_MEASUREMENT /end REF_MEASUREMENT /end GROUP
/begin GROUP CDD_AdcDiagc.AdcDiagcNtc0x032PassStep.Val "MICROSAR RTE" /begin SUB_GROUP /end SUB_GROUP /begin FUNCTION_LIST /end FUNCTION_LIST /begin REF_CHARACTERISTIC CDD_AdcDiagc.AdcDiagcNtc0x032PassStep.Val /end REF_CHARACTERISTIC /begin REF_MEASUREMENT /end REF_MEASUREMENT /end GROUP
/begin GROUP CDD_AdcDiagc.AdcDiagcNtc0x033FailStep.Val "MICROSAR RTE" /begin SUB_GROUP /end SUB_GROUP /begin FUNCTION_LIST /end FUNCTION_LIST /begin REF_CHARACTERISTIC CDD_AdcDiagc.AdcDiagcNtc0x033FailStep.Val /end REF_CHARACTERISTIC /begin REF_MEASUREMENT /end REF_MEASUREMENT /end GROUP
/begin GROUP CDD_AdcDiagc.AdcDiagcNtc0x033PassStep.Val "MICROSAR RTE" /begin SUB_GROUP /end SUB_GROUP /begin FUNCTION_LIST /end FUNCTION_LIST /begin REF_CHARACTERISTIC CDD_AdcDiagc.AdcDiagcNtc0x033PassStep.Val /end REF_CHARACTERISTIC /begin REF_MEASUREMENT /end REF_MEASUREMENT /end GROUP
/begin GROUP CDD_AdcDiagc.AdcDiagcSt "MICROSAR RTE" /begin SUB_GROUP /end SUB_GROUP /begin FUNCTION_LIST /end FUNCTION_LIST /begin REF_CHARACTERISTIC /end REF_CHARACTERISTIC /begin REF_MEASUREMENT CDD_AdcDiagc.AdcDiagcSt /end REF_MEASUREMENT /end GROUP
/begin GROUP CDD_AdcDiagc.AdcDiagcStrtPtr "MICROSAR RTE" /begin SUB_GROUP /end SUB_GROUP /begin FUNCTION_LIST /end FUNCTION_LIST /begin REF_CHARACTERISTIC /end REF_CHARACTERISTIC /begin REF_MEASUREMENT CDD_AdcDiagc.AdcDiagcStrtPtr /end REF_MEASUREMENT /end GROUP
/begin GROUP CDD_AdcDiagc.AdcDiagcStrtPtrOutp.Val "MICROSAR RTE" /begin SUB_GROUP /end SUB_GROUP /begin FUNCTION_LIST /end FUNCTION_LIST /begin REF_CHARACTERISTIC /end REF_CHARACTERISTIC /begin REF_MEASUREMENT CDD_AdcDiagc.AdcDiagcStrtPtrOutp.Val /end REF_MEASUREMENT /end GROUP
/begin GROUP CDD_AdcDiagc.CalibrationPorts "MICROSAR RTE"
 /begin SUB_GROUP CDD_AdcDiagc.AdcDiagcNtc0x032FailStep.Val CDD_AdcDiagc.AdcDiagcNtc0x032PassStep.Val CDD_AdcDiagc.AdcDiagcNtc0x033FailStep.Val CDD_AdcDiagc.AdcDiagcNtc0x033PassStep.Val /end SUB_GROUP
 /begin FUNCTION_LIST /end FUNCTION_LIST
 /begin REF_CHARACTERISTIC /end REF_CHARACTERISTIC
 /begin REF_MEASUREMENT /end REF_MEASUREMENT
/end GROUP
/begin GROUP CDD_AdcDiagc.PerInstanceMemories "MICROSAR RTE"
 /begin SUB_GROUP CDD_AdcDiagc.Adc0FltCntSt0 CDD_AdcDiagc.Adc0FltCntSt2 CDD_AdcDiagc.Adc0FltCntSt4 CDD_AdcDiagc.Adc0FltCntSt6 CDD_AdcDiagc.Adc0ScanGroup2RefFltCntSt CDD_AdcDiagc.Adc0ScanGroup3RefFltCntSt CDD_AdcDiagc.Adc1FltCntSt0 CDD_AdcDiagc.Adc1FltCntSt2 CDD_AdcDiagc.Adc1FltCntSt4 CDD_AdcDiagc.Adc1FltCntSt6 CDD_AdcDiagc.Adc1ScanGroup2RefFltCntSt CDD_AdcDiagc.Adc1ScanGroup3RefFltCntSt CDD_AdcDiagc.AdcDiagcEndPtr CDD_AdcDiagc.AdcDiagcSt CDD_AdcDiagc.AdcDiagcStrtPtr /end SUB_GROUP
 /begin FUNCTION_LIST /end FUNCTION_LIST
 /begin REF_CHARACTERISTIC /end REF_CHARACTERISTIC
 /begin REF_MEASUREMENT /end REF_MEASUREMENT
/end GROUP
/begin GROUP CDD_AdcDiagc.ReceiverPorts "MICROSAR RTE"
 /begin SUB_GROUP CDD_AdcDiagc.Adc0ScanGroup2Ref0.Val CDD_AdcDiagc.Adc0ScanGroup2Ref1.Val CDD_AdcDiagc.Adc0ScanGroup3Ref0.Val CDD_AdcDiagc.Adc0ScanGroup3Ref1.Val CDD_AdcDiagc.Adc0SelfDiag0.Val CDD_AdcDiagc.Adc0SelfDiag2.Val CDD_AdcDiagc.Adc0SelfDiag4.Val CDD_AdcDiagc.Adc1ScanGroup2Ref0.Val CDD_AdcDiagc.Adc1ScanGroup2Ref1.Val CDD_AdcDiagc.Adc1ScanGroup3Ref0.Val CDD_AdcDiagc.Adc1ScanGroup3Ref1.Val CDD_AdcDiagc.Adc1SelfDiag0.Val CDD_AdcDiagc.Adc1SelfDiag2.Val CDD_AdcDiagc.Adc1SelfDiag4.Val /end SUB_GROUP
 /begin FUNCTION_LIST /end FUNCTION_LIST
 /begin REF_CHARACTERISTIC /end REF_CHARACTERISTIC
 /begin REF_MEASUREMENT /end REF_MEASUREMENT
/end GROUP
/begin GROUP CDD_AdcDiagc.SenderPorts "MICROSAR RTE"
 /begin SUB_GROUP CDD_AdcDiagc.Adc0Faild.Logl CDD_AdcDiagc.Adc1Faild.Logl CDD_AdcDiagc.AdcDiagcEndPtrOutp.Val CDD_AdcDiagc.AdcDiagcStrtPtrOutp.Val /end SUB_GROUP
 /begin FUNCTION_LIST /end FUNCTION_LIST
 /begin REF_CHARACTERISTIC /end REF_CHARACTERISTIC
 /begin REF_MEASUREMENT /end REF_MEASUREMENT
/end GROUP
/begin GROUP CDD_CurrMeas "MICROSAR RTE"
 /begin SUB_GROUP CDD_CurrMeas.CalibrationParameters CDD_CurrMeas.CalibrationPorts CDD_CurrMeas.PerInstanceMemories CDD_CurrMeas.ReceiverPorts CDD_CurrMeas.SenderPorts /end SUB_GROUP
 /begin FUNCTION_LIST /end FUNCTION_LIST
 /begin REF_CHARACTERISTIC /end REF_CHARACTERISTIC
 /begin REF_MEASUREMENT /end REF_MEASUREMENT
/end GROUP
/begin GROUP CDD_CurrMeas.BrdgVltg.Val "MICROSAR RTE" /begin SUB_GROUP /end SUB_GROUP /begin FUNCTION_LIST /end FUNCTION_LIST /begin REF_CHARACTERISTIC /end REF_CHARACTERISTIC /begin REF_MEASUREMENT CDD_CurrMeas.BrdgVltg.Val /end REF_MEASUREMENT /end GROUP
/begin GROUP CDD_CurrMeas.BrdgVltgSumPrev "MICROSAR RTE" /begin SUB_GROUP /end SUB_GROUP /begin FUNCTION_LIST /end FUNCTION_LIST /begin REF_CHARACTERISTIC /end REF_CHARACTERISTIC /begin REF_MEASUREMENT CDD_CurrMeas.BrdgVltgSumPrev /end REF_MEASUREMENT /end GROUP
/begin GROUP CDD_CurrMeas.CalibrationParameters "MICROSAR RTE"
 /begin SUB_GROUP CDD_CurrMeas.CurrMeasEolGainCalSetDft CDD_CurrMeas.CurrMeasEolOffsCalSetDft /end SUB_GROUP
 /begin FUNCTION_LIST /end FUNCTION_LIST
 /begin REF_CHARACTERISTIC /end REF_CHARACTERISTIC
 /begin REF_MEASUREMENT /end REF_MEASUREMENT
/end GROUP
/begin GROUP CDD_CurrMeas.CalibrationPorts "MICROSAR RTE"
 /begin SUB_GROUP CDD_CurrMeas.CurrMeasEolFixdPwmPerd.Val CDD_CurrMeas.CurrMeasEolGainMax.Val CDD_CurrMeas.CurrMeasEolGainMin.Val CDD_CurrMeas.CurrMeasEolGainNrOfSample.Val CDD_CurrMeas.CurrMeasEolGainNumer.Val CDD_CurrMeas.CurrMeasEolMaxMotVel.Val CDD_CurrMeas.CurrMeasEolOffsHiBrdgVltgMin.Val CDD_CurrMeas.CurrMeasEolOffsHiCmuOffs.Val CDD_CurrMeas.CurrMeasEolOffsLoCmuOffs.Val CDD_CurrMeas.CurrMeasEolOffsMax.Val CDD_CurrMeas.CurrMeasEolOffsMin.Val CDD_CurrMeas.CurrMeasEolOffsNrOfSample.Val CDD_CurrMeas.CurrMeasEolTranCntrThd.Val CDD_CurrMeas.CurrMeasMinRqrdPhaOnTi.Val CDD_CurrMeas.CurrMeasMotAgCompuDly.Val CDD_CurrMeas.CurrMeasMotCurrAdcVlyWrmIninMax.Val CDD_CurrMeas.CurrMeasMotCurrAdcVlyWrmIninMin.Val CDD_CurrMeas.CurrMeasNtc0x05DFailStep.Val CDD_CurrMeas.CurrMeasNtc0x05DPassStep.Val CDD_CurrMeas.CurrMeasNtc0x06DFailStep.Val CDD_CurrMeas.CurrMeasNtc0x06DPassStep.Val CDD_CurrMeas.SysGlbPrmMotPoleCnt.Val /end SUB_GROUP
 /begin FUNCTION_LIST /end FUNCTION_LIST
 /begin REF_CHARACTERISTIC /end REF_CHARACTERISTIC
 /begin REF_MEASUREMENT /end REF_MEASUREMENT
/end GROUP
/begin GROUP CDD_CurrMeas.CurrMeasEolFixdPwmPerd.Val "MICROSAR RTE" /begin SUB_GROUP /end SUB_GROUP /begin FUNCTION_LIST /end FUNCTION_LIST /begin REF_CHARACTERISTIC CDD_CurrMeas.CurrMeasEolFixdPwmPerd.Val /end REF_CHARACTERISTIC /begin REF_MEASUREMENT /end REF_MEASUREMENT /end GROUP
/begin GROUP CDD_CurrMeas.CurrMeasEolGainCalSet "MICROSAR RTE" /begin SUB_GROUP /end SUB_GROUP /begin FUNCTION_LIST /end FUNCTION_LIST /begin REF_CHARACTERISTIC /end REF_CHARACTERISTIC
 /begin REF_MEASUREMENT CDD_CurrMeas.CurrMeasEolGainCalSet.CurrMeasMotCurrEolGainA CDD_CurrMeas.CurrMeasEolGainCalSet.CurrMeasMotCurrEolGainB CDD_CurrMeas.CurrMeasEolGainCalSet.CurrMeasMotCurrEolGainC CDD_CurrMeas.CurrMeasEolGainCalSet.CurrMeasMotCurrEolGainD CDD_CurrMeas.CurrMeasEolGainCalSet.CurrMeasMotCurrEolGainE CDD_CurrMeas.CurrMeasEolGainCalSet.CurrMeasMotCurrEolGainF /end REF_MEASUREMENT
/end GROUP
/begin GROUP CDD_CurrMeas.CurrMeasEolGainCalSetDft "MICROSAR RTE" /begin SUB_GROUP /end SUB_GROUP /begin FUNCTION_LIST /end FUNCTION_LIST
 /begin REF_CHARACTERISTIC CDD_CurrMeas.CurrMeasEolGainCalSetDft.CurrMeasMotCurrEolGainA CDD_CurrMeas.CurrMeasEolGainCalSetDft.CurrMeasMotCurrEolGainB CDD_CurrMeas.CurrMeasEolGainCalSetDft.CurrMeasMotCurrEolGainC CDD_CurrMeas.CurrMeasEolGainCalSetDft.CurrMeasMotCurrEolGainD CDD_CurrMeas.CurrMeasEolGainCalSetDft.CurrMeasMotCurrEolGainE CDD_CurrMeas.CurrMeasEolGainCalSetDft.CurrMeasMotCurrEolGainF /end REF_CHARACTERISTIC
 /begin REF_MEASUREMENT /end REF_MEASUREMENT
/end GROUP
/begin GROUP CDD_CurrMeas.CurrMeasEolGainMax.Val "MICROSAR RTE" /begin SUB_GROUP /end SUB_GROUP /begin FUNCTION_LIST /end FUNCTION_LIST /begin REF_CHARACTERISTIC CDD_CurrMeas.CurrMeasEolGainMax.Val /end REF_CHARACTERISTIC /begin REF_MEASUREMENT /end REF_MEASUREMENT /end GROUP
/begin GROUP CDD_CurrMeas.CurrMeasEolGainMin.Val "MICROSAR RTE" /begin SUB_GROUP /end SUB_GROUP /begin FUNCTION_LIST /end FUNCTION_LIST /begin REF_CHARACTERISTIC CDD_CurrMeas.CurrMeasEolGainMin.Val /end REF_CHARACTERISTIC /begin REF_MEASUREMENT /end REF_MEASUREMENT /end GROUP
/begin GROUP CDD_CurrMeas.CurrMeasEolGainNrOfSample.Val "MICROSAR RTE" /begin SUB_GROUP /end SUB_GROUP /begin FUNCTION_LIST /end FUNCTION_LIST /begin REF_CHARACTERISTIC CDD_CurrMeas.CurrMeasEolGainNrOfSample.Val /end REF_CHARACTERISTIC /begin REF_MEASUREMENT /end REF_MEASUREMENT /end GROUP
/begin GROUP CDD_CurrMeas.CurrMeasEolGainNumer.Val "MICROSAR RTE" /begin SUB_GROUP /end SUB_GROUP /begin FUNCTION_LIST /end FUNCTION_LIST /begin REF_CHARACTERISTIC CDD_CurrMeas.CurrMeasEolGainNumer.Val /end REF_CHARACTERISTIC /begin REF_MEASUREMENT /end REF_MEASUREMENT /end GROUP
/begin GROUP CDD_CurrMeas.CurrMeasEolMaxMotVel.Val "MICROSAR RTE" /begin SUB_GROUP /end SUB_GROUP /begin FUNCTION_LIST /end FUNCTION_LIST /begin REF_CHARACTERISTIC CDD_CurrMeas.CurrMeasEolMaxMotVel.Val /end REF_CHARACTERISTIC /begin REF_MEASUREMENT /end REF_MEASUREMENT /end GROUP
/begin GROUP CDD_CurrMeas.CurrMeasEolOffsCalSet "MICROSAR RTE" /begin SUB_GROUP /end SUB_GROUP /begin FUNCTION_LIST /end FUNCTION_LIST /begin REF_CHARACTERISTIC /end REF_CHARACTERISTIC
 /begin REF_MEASUREMENT CDD_CurrMeas.CurrMeasEolOffsCalSet.CurrMeasEolOffsHiBrdgVltg CDD_CurrMeas.CurrMeasEolOffsCalSet.CurrMeasMotCurrEolOffsDifA CDD_CurrMeas.CurrMeasEolOffsCalSet.CurrMeasMotCurrEolOffsDifB CDD_CurrMeas.CurrMeasEolOffsCalSet.CurrMeasMotCurrEolOffsDifC CDD_CurrMeas.CurrMeasEolOffsCalSet.CurrMeasMotCurrEolOffsDifD CDD_CurrMeas.CurrMeasEolOffsCalSet.CurrMeasMotCurrEolOffsDifE CDD_CurrMeas.CurrMeasEolOffsCalSet.CurrMeasMotCurrEolOffsDifF CDD_CurrMeas.CurrMeasEolOffsCalSet.CurrMeasMotCurrOffsLoAvrgA CDD_CurrMeas.CurrMeasEolOffsCalSet.CurrMeasMotCurrOffsLoAvrgB CDD_CurrMeas.CurrMeasEolOffsCalSet.CurrMeasMotCurrOffsLoAvrgC CDD_CurrMeas.CurrMeasEolOffsCalSet.CurrMeasMotCurrOffsLoAvrgD CDD_CurrMeas.CurrMeasEolOffsCalSet.CurrMeasMotCurrOffsLoAvrgE CDD_CurrMeas.CurrMeasEolOffsCalSet.CurrMeasMotCurrOffsLoAvrgF /end REF_MEASUREMENT
/end GROUP
/begin GROUP CDD_CurrMeas.CurrMeasEolOffsCalSetDft "MICROSAR RTE" /begin SUB_GROUP /end SUB_GROUP /begin FUNCTION_LIST /end FUNCTION_LIST
 /begin REF_CHARACTERISTIC CDD_CurrMeas.CurrMeasEolOffsCalSetDft.CurrMeasEolOffsHiBrdgVltg CDD_CurrMeas.CurrMeasEolOffsCalSetDft.CurrMeasMotCurrEolOffsDifA CDD_CurrMeas.CurrMeasEolOffsCalSetDft.CurrMeasMotCurrEolOffsDifB CDD_CurrMeas.CurrMeasEolOffsCalSetDft.CurrMeasMotCurrEolOffsDifC CDD_CurrMeas.CurrMeasEolOffsCalSetDft.CurrMeasMotCurrEolOffsDifD CDD_CurrMeas.CurrMeasEolOffsCalSetDft.CurrMeasMotCurrEolOffsDifE CDD_CurrMeas.CurrMeasEolOffsCalSetDft.CurrMeasMotCurrEolOffsDifF CDD_CurrMeas.CurrMeasEolOffsCalSetDft.CurrMeasMotCurrOffsLoAvrgA CDD_CurrMeas.CurrMeasEolOffsCalSetDft.CurrMeasMotCurrOffsLoAvrgB CDD_CurrMeas.CurrMeasEolOffsCalSetDft.CurrMeasMotCurrOffsLoAvrgC CDD_CurrMeas.CurrMeasEolOffsCalSetDft.CurrMeasMotCurrOffsLoAvrgD CDD_CurrMeas.CurrMeasEolOffsCalSetDft.CurrMeasMotCurrOffsLoAvrgE CDD_CurrMeas.CurrMeasEolOffsCalSetDft.CurrMeasMotCurrOffsLoAvrgF /end REF_CHARACTERISTIC
 /begin REF_MEASUREMENT /end REF_MEASUREMENT
/end GROUP
/begin GROUP CDD_CurrMeas.CurrMeasEolOffsHiBrdgVltgMin.Val "MICROSAR RTE" /begin SUB_GROUP /end SUB_GROUP /begin FUNCTION_LIST /end FUNCTION_LIST /begin REF_CHARACTERISTIC CDD_CurrMeas.CurrMeasEolOffsHiBrdgVltgMin.Val /end REF_CHARACTERISTIC /begin REF_MEASUREMENT /end REF_MEASUREMENT /end GROUP
/begin GROUP CDD_CurrMeas.CurrMeasEolOffsHiCmuOffs.Val "MICROSAR RTE" /begin SUB_GROUP /end SUB_GROUP /begin FUNCTION_LIST /end FUNCTION_LIST /begin REF_CHARACTERISTIC CDD_CurrMeas.CurrMeasEolOffsHiCmuOffs.Val /end REF_CHARACTERISTIC /begin REF_MEASUREMENT /end REF_MEASUREMENT /end GROUP
/begin GROUP CDD_CurrMeas.CurrMeasEolOffsLoCmuOffs.Val "MICROSAR RTE" /begin SUB_GROUP /end SUB_GROUP /begin FUNCTION_LIST /end FUNCTION_LIST /begin REF_CHARACTERISTIC CDD_CurrMeas.CurrMeasEolOffsLoCmuOffs.Val /end REF_CHARACTERISTIC /begin REF_MEASUREMENT /end REF_MEASUREMENT /end GROUP
/begin GROUP CDD_CurrMeas.CurrMeasEolOffsMax.Val "MICROSAR RTE" /begin SUB_GROUP /end SUB_GROUP /begin FUNCTION_LIST /end FUNCTION_LIST /begin REF_CHARACTERISTIC CDD_CurrMeas.CurrMeasEolOffsMax.Val /end REF_CHARACTERISTIC /begin REF_MEASUREMENT /end REF_MEASUREMENT /end GROUP
/begin GROUP CDD_CurrMeas.CurrMeasEolOffsMin.Val "MICROSAR RTE" /begin SUB_GROUP /end SUB_GROUP /begin FUNCTION_LIST /end FUNCTION_LIST /begin REF_CHARACTERISTIC CDD_CurrMeas.CurrMeasEolOffsMin.Val /end REF_CHARACTERISTIC /begin REF_MEASUREMENT /end REF_MEASUREMENT /end GROUP
/begin GROUP CDD_CurrMeas.CurrMeasEolOffsNrOfSample.Val "MICROSAR RTE" /begin SUB_GROUP /end SUB_GROUP /begin FUNCTION_LIST /end FUNCTION_LIST /begin REF_CHARACTERISTIC CDD_CurrMeas.CurrMeasEolOffsNrOfSample.Val /end REF_CHARACTERISTIC /begin REF_MEASUREMENT /end REF_MEASUREMENT /end GROUP
/begin GROUP CDD_CurrMeas.CurrMeasEolTranCntrThd.Val "MICROSAR RTE" /begin SUB_GROUP /end SUB_GROUP /begin FUNCTION_LIST /end FUNCTION_LIST /begin REF_CHARACTERISTIC CDD_CurrMeas.CurrMeasEolTranCntrThd.Val /end REF_CHARACTERISTIC /begin REF_MEASUREMENT /end REF_MEASUREMENT /end GROUP
/begin GROUP CDD_CurrMeas.CurrMeasMinRqrdPhaOnTi.Val "MICROSAR RTE" /begin SUB_GROUP /end SUB_GROUP /begin FUNCTION_LIST /end FUNCTION_LIST /begin REF_CHARACTERISTIC CDD_CurrMeas.CurrMeasMinRqrdPhaOnTi.Val /end REF_CHARACTERISTIC /begin REF_MEASUREMENT /end REF_MEASUREMENT /end GROUP
/begin GROUP CDD_CurrMeas.CurrMeasMotAgCompuDly.Val "MICROSAR RTE" /begin SUB_GROUP /end SUB_GROUP /begin FUNCTION_LIST /end FUNCTION_LIST /begin REF_CHARACTERISTIC CDD_CurrMeas.CurrMeasMotAgCompuDly.Val /end REF_CHARACTERISTIC /begin REF_MEASUREMENT /end REF_MEASUREMENT /end GROUP
/begin GROUP CDD_CurrMeas.CurrMeasMotCurrAdcVlyWrmIninMax.Val "MICROSAR RTE" /begin SUB_GROUP /end SUB_GROUP /begin FUNCTION_LIST /end FUNCTION_LIST /begin REF_CHARACTERISTIC CDD_CurrMeas.CurrMeasMotCurrAdcVlyWrmIninMax.Val /end REF_CHARACTERISTIC /begin REF_MEASUREMENT /end REF_MEASUREMENT /end GROUP
/begin GROUP CDD_CurrMeas.CurrMeasMotCurrAdcVlyWrmIninMin.Val "MICROSAR RTE" /begin SUB_GROUP /end SUB_GROUP /begin FUNCTION_LIST /end FUNCTION_LIST /begin REF_CHARACTERISTIC CDD_CurrMeas.CurrMeasMotCurrAdcVlyWrmIninMin.Val /end REF_CHARACTERISTIC /begin REF_MEASUREMENT /end REF_MEASUREMENT /end GROUP
/begin GROUP CDD_CurrMeas.CurrMeasNtc0x05DFailStep.Val "MICROSAR RTE" /begin SUB_GROUP /end SUB_GROUP /begin FUNCTION_LIST /end FUNCTION_LIST /begin REF_CHARACTERISTIC CDD_CurrMeas.CurrMeasNtc0x05DFailStep.Val /end REF_CHARACTERISTIC /begin REF_MEASUREMENT /end REF_MEASUREMENT /end GROUP
/begin GROUP CDD_CurrMeas.CurrMeasNtc0x05DPassStep.Val "MICROSAR RTE" /begin SUB_GROUP /end SUB_GROUP /begin FUNCTION_LIST /end FUNCTION_LIST /begin REF_CHARACTERISTIC CDD_CurrMeas.CurrMeasNtc0x05DPassStep.Val /end REF_CHARACTERISTIC /begin REF_MEASUREMENT /end REF_MEASUREMENT /end GROUP
/begin GROUP CDD_CurrMeas.CurrMeasNtc0x06DFailStep.Val "MICROSAR RTE" /begin SUB_GROUP /end SUB_GROUP /begin FUNCTION_LIST /end FUNCTION_LIST /begin REF_CHARACTERISTIC CDD_CurrMeas.CurrMeasNtc0x06DFailStep.Val /end REF_CHARACTERISTIC /begin REF_MEASUREMENT /end REF_MEASUREMENT /end GROUP
/begin GROUP CDD_CurrMeas.CurrMeasNtc0x06DPassStep.Val "MICROSAR RTE" /begin SUB_GROUP /end SUB_GROUP /begin FUNCTION_LIST /end FUNCTION_LIST /begin REF_CHARACTERISTIC CDD_CurrMeas.CurrMeasNtc0x06DPassStep.Val /end REF_CHARACTERISTIC /begin REF_MEASUREMENT /end REF_MEASUREMENT /end GROUP
/begin GROUP CDD_CurrMeas.CurrMeasWrmIninTestCmpl.Logl "MICROSAR RTE" /begin SUB_GROUP /end SUB_GROUP /begin FUNCTION_LIST /end FUNCTION_LIST /begin REF_CHARACTERISTIC /end REF_CHARACTERISTIC /begin REF_MEASUREMENT CDD_CurrMeas.CurrMeasWrmIninTestCmpl.Logl /end REF_MEASUREMENT /end GROUP
/begin GROUP CDD_CurrMeas.DiagcStsIvtr1Inactv.Logl "MICROSAR RTE" /begin SUB_GROUP /end SUB_GROUP /begin FUNCTION_LIST /end FUNCTION_LIST /begin REF_CHARACTERISTIC /end REF_CHARACTERISTIC /begin REF_MEASUREMENT CDD_CurrMeas.DiagcStsIvtr1Inactv.Logl /end REF_MEASUREMENT /end GROUP
/begin GROUP CDD_CurrMeas.DiagcStsIvtr2Inactv.Logl "MICROSAR RTE" /begin SUB_GROUP /end SUB_GROUP /begin FUNCTION_LIST /end FUNCTION_LIST /begin REF_CHARACTERISTIC /end REF_CHARACTERISTIC /begin REF_MEASUREMENT CDD_CurrMeas.DiagcStsIvtr2Inactv.Logl /end REF_MEASUREMENT /end GROUP
/begin GROUP CDD_CurrMeas.EolGainSts "MICROSAR RTE" /begin SUB_GROUP /end SUB_GROUP /begin FUNCTION_LIST /end FUNCTION_LIST /begin REF_CHARACTERISTIC /end REF_CHARACTERISTIC /begin REF_MEASUREMENT CDD_CurrMeas.EolGainSts /end REF_MEASUREMENT /end GROUP
/begin GROUP CDD_CurrMeas.EolOffsHiBrdgVltg "MICROSAR RTE" /begin SUB_GROUP /end SUB_GROUP /begin FUNCTION_LIST /end FUNCTION_LIST /begin REF_CHARACTERISTIC /end REF_CHARACTERISTIC /begin REF_MEASUREMENT CDD_CurrMeas.EolOffsHiBrdgVltg /end REF_MEASUREMENT /end GROUP
/begin GROUP CDD_CurrMeas.EolOffsSts "MICROSAR RTE" /begin SUB_GROUP /end SUB_GROUP /begin FUNCTION_LIST /end FUNCTION_LIST /begin REF_CHARACTERISTIC /end REF_CHARACTERISTIC /begin REF_MEASUREMENT CDD_CurrMeas.EolOffsSts /end REF_MEASUREMENT /end GROUP
/begin GROUP CDD_CurrMeas.EolTranCntrPrev "MICROSAR RTE" /begin SUB_GROUP /end SUB_GROUP /begin FUNCTION_LIST /end FUNCTION_LIST /begin REF_CHARACTERISTIC /end REF_CHARACTERISTIC /begin REF_MEASUREMENT CDD_CurrMeas.EolTranCntrPrev /end REF_MEASUREMENT /end GROUP
/begin GROUP CDD_CurrMeas.GainEolAvrgCntrPrev "MICROSAR RTE" /begin SUB_GROUP /end SUB_GROUP /begin FUNCTION_LIST /end FUNCTION_LIST /begin REF_CHARACTERISTIC /end REF_CHARACTERISTIC /begin REF_MEASUREMENT CDD_CurrMeas.GainEolAvrgCntrPrev /end REF_MEASUREMENT /end GROUP
/begin GROUP CDD_CurrMeas.MotCtrlNtc5DErrCntPrev "MICROSAR RTE" /begin SUB_GROUP /end SUB_GROUP /begin FUNCTION_LIST /end FUNCTION_LIST /begin REF_CHARACTERISTIC /end REF_CHARACTERISTIC /begin REF_MEASUREMENT CDD_CurrMeas.MotCtrlNtc5DErrCntPrev /end REF_MEASUREMENT /end GROUP
/begin GROUP CDD_CurrMeas.MotCtrlNtc6DErrCntPrev "MICROSAR RTE" /begin SUB_GROUP /end SUB_GROUP /begin FUNCTION_LIST /end FUNCTION_LIST /begin REF_CHARACTERISTIC /end REF_CHARACTERISTIC /begin REF_MEASUREMENT CDD_CurrMeas.MotCtrlNtc6DErrCntPrev /end REF_MEASUREMENT /end GROUP
/begin GROUP CDD_CurrMeas.MotCurrAdcVlyA.Val "MICROSAR RTE" /begin SUB_GROUP /end SUB_GROUP /begin FUNCTION_LIST /end FUNCTION_LIST /begin REF_CHARACTERISTIC /end REF_CHARACTERISTIC /begin REF_MEASUREMENT CDD_CurrMeas.MotCurrAdcVlyA.Val /end REF_MEASUREMENT /end GROUP
/begin GROUP CDD_CurrMeas.MotCurrAdcVlyB.Val "MICROSAR RTE" /begin SUB_GROUP /end SUB_GROUP /begin FUNCTION_LIST /end FUNCTION_LIST /begin REF_CHARACTERISTIC /end REF_CHARACTERISTIC /begin REF_MEASUREMENT CDD_CurrMeas.MotCurrAdcVlyB.Val /end REF_MEASUREMENT /end GROUP
/begin GROUP CDD_CurrMeas.MotCurrAdcVlyC.Val "MICROSAR RTE" /begin SUB_GROUP /end SUB_GROUP /begin FUNCTION_LIST /end FUNCTION_LIST /begin REF_CHARACTERISTIC /end REF_CHARACTERISTIC /begin REF_MEASUREMENT CDD_CurrMeas.MotCurrAdcVlyC.Val /end REF_MEASUREMENT /end GROUP
/begin GROUP CDD_CurrMeas.MotCurrAdcVlyD.Val "MICROSAR RTE" /begin SUB_GROUP /end SUB_GROUP /begin FUNCTION_LIST /end FUNCTION_LIST /begin REF_CHARACTERISTIC /end REF_CHARACTERISTIC /begin REF_MEASUREMENT CDD_CurrMeas.MotCurrAdcVlyD.Val /end REF_MEASUREMENT /end GROUP
/begin GROUP CDD_CurrMeas.MotCurrAdcVlyE.Val "MICROSAR RTE" /begin SUB_GROUP /end SUB_GROUP /begin FUNCTION_LIST /end FUNCTION_LIST /begin REF_CHARACTERISTIC /end REF_CHARACTERISTIC /begin REF_MEASUREMENT CDD_CurrMeas.MotCurrAdcVlyE.Val /end REF_MEASUREMENT /end GROUP
/begin GROUP CDD_CurrMeas.MotCurrAdcVlyF.Val "MICROSAR RTE" /begin SUB_GROUP /end SUB_GROUP /begin FUNCTION_LIST /end FUNCTION_LIST /begin REF_CHARACTERISTIC /end REF_CHARACTERISTIC /begin REF_MEASUREMENT CDD_CurrMeas.MotCurrAdcVlyF.Val /end REF_MEASUREMENT /end GROUP
/begin GROUP CDD_CurrMeas.MotCurrEolCalSt.Val "MICROSAR RTE" /begin SUB_GROUP /end SUB_GROUP /begin FUNCTION_LIST /end FUNCTION_LIST /begin REF_CHARACTERISTIC /end REF_CHARACTERISTIC /begin REF_MEASUREMENT CDD_CurrMeas.MotCurrEolCalSt.Val /end REF_MEASUREMENT /end GROUP
/begin GROUP CDD_CurrMeas.MotCurrEolCalStPrev "MICROSAR RTE" /begin SUB_GROUP /end SUB_GROUP /begin FUNCTION_LIST /end FUNCTION_LIST /begin REF_CHARACTERISTIC /end REF_CHARACTERISTIC /begin REF_MEASUREMENT CDD_CurrMeas.MotCurrEolCalStPrev /end REF_MEASUREMENT /end GROUP
/begin GROUP CDD_CurrMeas.MotCurrEolGainA "MICROSAR RTE" /begin SUB_GROUP /end SUB_GROUP /begin FUNCTION_LIST /end FUNCTION_LIST /begin REF_CHARACTERISTIC /end REF_CHARACTERISTIC /begin REF_MEASUREMENT CDD_CurrMeas.MotCurrEolGainA /end REF_MEASUREMENT /end GROUP
/begin GROUP CDD_CurrMeas.MotCurrEolGainB "MICROSAR RTE" /begin SUB_GROUP /end SUB_GROUP /begin FUNCTION_LIST /end FUNCTION_LIST /begin REF_CHARACTERISTIC /end REF_CHARACTERISTIC /begin REF_MEASUREMENT CDD_CurrMeas.MotCurrEolGainB /end REF_MEASUREMENT /end GROUP
/begin GROUP CDD_CurrMeas.MotCurrEolGainC "MICROSAR RTE" /begin SUB_GROUP /end SUB_GROUP /begin FUNCTION_LIST /end FUNCTION_LIST /begin REF_CHARACTERISTIC /end REF_CHARACTERISTIC /begin REF_MEASUREMENT CDD_CurrMeas.MotCurrEolGainC /end REF_MEASUREMENT /end GROUP
/begin GROUP CDD_CurrMeas.MotCurrEolGainD "MICROSAR RTE" /begin SUB_GROUP /end SUB_GROUP /begin FUNCTION_LIST /end FUNCTION_LIST /begin REF_CHARACTERISTIC /end REF_CHARACTERISTIC /begin REF_MEASUREMENT CDD_CurrMeas.MotCurrEolGainD /end REF_MEASUREMENT /end GROUP
/begin GROUP CDD_CurrMeas.MotCurrEolGainE "MICROSAR RTE" /begin SUB_GROUP /end SUB_GROUP /begin FUNCTION_LIST /end FUNCTION_LIST /begin REF_CHARACTERISTIC /end REF_CHARACTERISTIC /begin REF_MEASUREMENT CDD_CurrMeas.MotCurrEolGainE /end REF_MEASUREMENT /end GROUP
/begin GROUP CDD_CurrMeas.MotCurrEolGainF "MICROSAR RTE" /begin SUB_GROUP /end SUB_GROUP /begin FUNCTION_LIST /end FUNCTION_LIST /begin REF_CHARACTERISTIC /end REF_CHARACTERISTIC /begin REF_MEASUREMENT CDD_CurrMeas.MotCurrEolGainF /end REF_MEASUREMENT /end GROUP
/**********************************************************************************************************************
* RECORD_LAYOUT
*********************************************************************************************************************/
/begin RECORD_LAYOUT RTE_RL_UBYTE FNC_VALUES 1 UBYTE ROW_DIR DIRECT /end RECORD_LAYOUT
/begin RECORD_LAYOUT RTE_RL_UWORD FNC_VALUES 1 UWORD ROW_DIR DIRECT /end RECORD_LAYOUT
/begin RECORD_LAYOUT RTE_RL_ULONG FNC_VALUES 1 ULONG ROW_DIR DIRECT /end RECORD_LAYOUT
/begin RECORD_LAYOUT RTE_RL_SWORD FNC_VALUES 1 SWORD ROW_DIR DIRECT /end RECORD_LAYOUT
/begin RECORD_LAYOUT RTE_RL_FLOAT32_IEEE FNC_VALUES 1 FLOAT32_IEEE ROW_DIR DIRECT /end RECORD_LAYOUT
/begin RECORD_LAYOUT RTE_RL_BOOLEAN FNC_VALUES 1 UBYTE ROW_DIR DIRECT /end RECORD_LAYOUT
/**********************************************************************************************************************
* COMPU_METHOD / COMPU_VTAB_RANGE
*********************************************************************************************************************/
/begin COMPU_METHOD RTE_CM_BOOLEAN "" TAB_VERB "%3.1" "" COMPU_TAB_REF RTE_CM_BOOLEAN /end COMPU_METHOD
/begin COMPU_VTAB_RANGE RTE_CM_BOOLEAN "" 2 0 0 "false" 1 255 "true" /end COMPU_VTAB_RANGE
/begin COMPU_METHOD RTE_CM_ENUM_SysSt1 "" TAB_VERB "%.1" "" COMPU_TAB_REF RTE_CM_ENUM_SysSt1 /end COMPU_METHOD
/begin COMPU_VTAB_RANGE RTE_CM_ENUM_SysSt1 "" 4 0 0 "SYSST_DI" 1 1 "SYSST_OFF" 2 2 "SYSST_ENA" 3 3 "SYSST_WRMININ" /end COMPU_VTAB_RANGE
/begin COMPU_METHOD RTE_CM_ENUM_SigQlfr1 "" TAB_VERB "%.1" "" COMPU_TAB_REF RTE_CM_ENUM_SigQlfr1 /end COMPU_METHOD
/begin COMPU_VTAB_RANGE RTE_CM_ENUM_SigQlfr1 "" 3 0 0 "SIGQLFR_NORES" 1 1 "SIGQLFR_PASSD" 2 2 "SIGQLFR_FAILD" /end COMPU_VTAB_RANGE
/begin COMPU_METHOD RTE_CM_ENUM_MotCurrEolCalSt2 "" TAB_VERB "%.1" "" COMPU_TAB_REF RTE_CM_ENUM_MotCurrEolCalSt2 /end COMPU_METHOD
/begin COMPU_VTAB_RANGE RTE_CM_ENUM_MotCurrEolCalSt2 "" 9 0 0 "MCECS_OFFSCMDSTRT" 1 1 "MCECS_OFFSCMDHI" 2 2 "MCECS_OFFSCMDLO" 3 3 "MCECS_OFFSCMDZERO" 4 4 "MCECS_OFFSCMDEND" 5 5 "MCECS_GAINCMDAD" 6 6 "MCECS_GAINCMDBE" 7 7 "MCECS_GAINCMDCF" 8 8 "MCECS_CMDSAFEST" /end COMPU_VTAB_RANGE
/begin COMPU_METHOD RTE_CM_Tq6 "" RAT_FUNC "%.1" "HwNm" COEFFS 0 256 0 0 0 1 /end COMPU_METHOD
/begin COMPU_METHOD RTE_CM_Tq11 "" RAT_FUNC "%.1" "MotNm" COEFFS 0 2048 0 0 0 1 /end COMPU_METHOD
/begin COMPU_METHOD RTE_CM_Uls4 "" RAT_FUNC "%.1" "Uls" COEFFS 0 16384 0 0 0 1 /end COMPU_METHOD
/begin COMPU_METHOD RTE_CM_Tq12 "" RAT_FUNC "%.1" "MotNm" COEFFS 0 2048 0 0 0 1 /end COMPU_METHOD
/begin COMPU_METHOD RTE_CM_Spd2 "" RAT_FUNC "%.1" "kph" COEFFS 0 128 0 0 0 1 /end COMPU_METHOD
