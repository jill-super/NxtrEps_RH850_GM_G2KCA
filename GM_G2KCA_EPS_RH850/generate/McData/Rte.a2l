/begin CHARACTERISTIC MotRplCoggCfg.MotRplCoggCfgMotTqRplOrder1X.Ary2D "MICROSAR RTE" VAL_BLK 0x0 RTE_RL_SWORD 0 NO_COMPU_METHOD -32768 32767 MATRIX_DIM 12 10 1 SYMBOL_LINK "Rte_CalprmRom_CalRegn01Cmn_DEFAULT_RTE_CALPRM_GROUP.MotRplCoggCfgMotTqRplOrder1X_Ary2D" 0 DISPLAY_IDENTIFIER MotRplCoggCfg.CalibrationPorts.MotRplCoggCfgMotTqRplOrder1X.Ary2D /end CHARACTERISTIC
/begin CHARACTERISTIC MotRplCoggCfg.MotRplCoggCfgMotTqRplOrder1Y.Ary2D "MICROSAR RTE" VAL_BLK 0x0 RTE_RL_SWORD 0 NO_COMPU_METHOD -32768 32767 MATRIX_DIM 12 10 1 SYMBOL_LINK "Rte_CalprmRom_CalRegn01Cmn_DEFAULT_RTE_CALPRM_GROUP.MotRplCoggCfgMotTqRplOrder1Y_Ary2D" 0 DISPLAY_IDENTIFIER MotRplCoggCfg.CalibrationPorts.MotRplCoggCfgMotTqRplOrder1Y.Ary2D /end CHARACTERISTIC
/begin CHARACTERISTIC MotRplCoggCfg.MotRplCoggCfgMotTqRplOrder2X.Ary2D "MICROSAR RTE" VAL_BLK 0x0 RTE_RL_SWORD 0 NO_COMPU_METHOD -32768 32767 MATRIX_DIM 12 10 1 SYMBOL_LINK "Rte_CalprmRom_CalRegn01Cmn_DEFAULT_RTE_CALPRM_GROUP.MotRplCoggCfgMotTqRplOrder2X_Ary2D" 0 DISPLAY_IDENTIFIER MotRplCoggCfg.CalibrationPorts.MotRplCoggCfgMotTqRplOrder2X.Ary2D /end CHARACTERISTIC
/begin CHARACTERISTIC MotRplCoggCfg.MotRplCoggCfgMotTqRplOrder2Y.Ary2D "MICROSAR RTE" VAL_BLK 0x0 RTE_RL_SWORD 0 NO_COMPU_METHOD -32768 32767 MATRIX_DIM 12 10 1 SYMBOL_LINK "Rte_CalprmRom_CalRegn01Cmn_DEFAULT_RTE_CALPRM_GROUP.MotRplCoggCfgMotTqRplOrder2Y_Ary2D" 0 DISPLAY_IDENTIFIER MotRplCoggCfg.CalibrationPorts.MotRplCoggCfgMotTqRplOrder2Y.Ary2D /end CHARACTERISTIC
/begin CHARACTERISTIC MotRplCoggCfg.MotRplCoggCfgMotTqRplOrder3X.Ary2D "MICROSAR RTE" VAL_BLK 0x0 RTE_RL_SWORD 0 NO_COMPU_METHOD -32768 32767 MATRIX_DIM 12 10 1 SYMBOL_LINK "Rte_CalprmRom_CalRegn01Cmn_DEFAULT_RTE_CALPRM_GROUP.MotRplCoggCfgMotTqRplOrder3X_Ary2D" 0 DISPLAY_IDENTIFIER MotRplCoggCfg.CalibrationPorts.MotRplCoggCfgMotTqRplOrder3X.Ary2D /end CHARACTERISTIC
/begin CHARACTERISTIC MotRplCoggCfg.MotRplCoggCfgMotTqRplOrder3Y.Ary2D "MICROSAR RTE" VAL_BLK 0x0 RTE_RL_SWORD 0 NO_COMPU_METHOD -32768 32767 MATRIX_DIM 12 10 1 SYMBOL_LINK "Rte_CalprmRom_CalRegn01Cmn_DEFAULT_RTE_CALPRM_GROUP.MotRplCoggCfgMotTqRplOrder3Y_Ary2D" 0 DISPLAY_IDENTIFIER MotRplCoggCfg.CalibrationPorts.MotRplCoggCfgMotTqRplOrder3Y.Ary2D /end CHARACTERISTIC
/begin CHARACTERISTIC MotRplCoggCfg.MotRplCoggCfgMotVelBilnrSeln.Ary1D "MICROSAR RTE" VAL_BLK 0x0 RTE_RL_UWORD 0 NO_COMPU_METHOD 0 65535 MATRIX_DIM 20 1 1 SYMBOL_LINK "Rte_CalprmRom_CalRegn01Cmn_DEFAULT_RTE_CALPRM_GROUP.MotRplCoggCfgMotVelBilnrSeln_Ary1D" 0 DISPLAY_IDENTIFIER MotRplCoggCfg.CalibrationPorts.MotRplCoggCfgMotVelBilnrSeln.Ary1D /end CHARACTERISTIC
/begin CHARACTERISTIC MotRplCoggCfg.MotRplCoggCmdHrmncOrder1Elec.Val "MICROSAR RTE" VALUE 0x0 RTE_RL_UBYTE 0 NO_COMPU_METHOD 0 255 SYMBOL_LINK "Rte_CalprmRom_CalRegn01Cmn_DEFAULT_RTE_CALPRM_GROUP.MotRplCoggCmdHrmncOrder1Elec_Val" 0 DISPLAY_IDENTIFIER MotRplCoggCfg.CalibrationPorts.MotRplCoggCmdHrmncOrder1Elec.Val /end CHARACTERISTIC
/begin CHARACTERISTIC MotRplCoggCfg.MotRplCoggCmdHrmncOrder2Elec.Val "MICROSAR RTE" VALUE 0x0 RTE_RL_UBYTE 0 NO_COMPU_METHOD 0 255 SYMBOL_LINK "Rte_CalprmRom_CalRegn01Cmn_DEFAULT_RTE_CALPRM_GROUP.MotRplCoggCmdHrmncOrder2Elec_Val" 0 DISPLAY_IDENTIFIER MotRplCoggCfg.CalibrationPorts.MotRplCoggCmdHrmncOrder2Elec.Val /end CHARACTERISTIC
/begin CHARACTERISTIC MotRplCoggCfg.MotRplCoggCmdHrmncOrder3Elec.Val "MICROSAR RTE" VALUE 0x0 RTE_RL_UBYTE 0 NO_COMPU_METHOD 0 255 SYMBOL_LINK "Rte_CalprmRom_CalRegn01Cmn_DEFAULT_RTE_CALPRM_GROUP.MotRplCoggCmdHrmncOrder3Elec_Val" 0 DISPLAY_IDENTIFIER MotRplCoggCfg.CalibrationPorts.MotRplCoggCmdHrmncOrder3Elec.Val /end CHARACTERISTIC
/begin CHARACTERISTIC MotRplCoggCfg.SysGlbPrmMotPoleCnt.Val "MICROSAR RTE" VALUE 0x0 RTE_RL_UBYTE 0 NO_COMPU_METHOD 0 255 SYMBOL_LINK "Rte_CalprmRom_CalRegn01Inin00_DEFAULT_RTE_CALPRM_GROUP.SysGlbPrmMotPoleCnt_Val" 0 DISPLAY_IDENTIFIER MotRplCoggCfg.CalibrationPorts.SysGlbPrmMotPoleCnt.Val /end CHARACTERISTIC
/begin CHARACTERISTIC MotTqCmdSca.MotTqCmdScaMax.Val "MICROSAR RTE" VALUE 0x0 RTE_RL_FLOAT32_IEEE 0 NO_COMPU_METHOD -3.402823466e+38 3.402823466e+38 SYMBOL_LINK "Rte_CalprmRom_CalRegn01Cmn_DEFAULT_RTE_CALPRM_GROUP.MotTqCmdScaMax_Val" 0 DISPLAY_IDENTIFIER MotTqCmdSca.CalibrationPorts.MotTqCmdScaMax.Val /end CHARACTERISTIC
/begin CHARACTERISTIC MotTqCmdSca.MotTqCmdScaMin.Val "MICROSAR RTE" VALUE 0x0 RTE_RL_FLOAT32_IEEE 0 NO_COMPU_METHOD -3.402823466e+38 3.402823466e+38 SYMBOL_LINK "Rte_CalprmRom_CalRegn01Cmn_DEFAULT_RTE_CALPRM_GROUP.MotTqCmdScaMin_Val" 0 DISPLAY_IDENTIFIER MotTqCmdSca.CalibrationPorts.MotTqCmdScaMin.Val /end CHARACTERISTIC
/begin CHARACTERISTIC MotTqTranlDampg.MotTqTranlDampgCmdLim.Val "MICROSAR RTE" VALUE 0x0 RTE_RL_FLOAT32_IEEE 0 NO_COMPU_METHOD -3.402823466e+38 3.402823466e+38 SYMBOL_LINK "Rte_CalprmRom_CalRegn01Inin00_DEFAULT_RTE_CALPRM_GROUP.MotTqTranlDampgCmdLim_Val" 0 DISPLAY_IDENTIFIER MotTqTranlDampg.CalibrationPorts.MotTqTranlDampgCmdLim.Val /end CHARACTERISTIC
/begin CHARACTERISTIC MotTqTranlDampg.MotTqTranlDampgDampgCoeff.Val "MICROSAR RTE" VALUE 0x0 RTE_RL_FLOAT32_IEEE 0 NO_COMPU_METHOD -3.402823466e+38 3.402823466e+38 SYMBOL_LINK "Rte_CalprmRom_CalRegn01Inin00_DEFAULT_RTE_CALPRM_GROUP.MotTqTranlDampgDampgCoeff_Val" 0 DISPLAY_IDENTIFIER MotTqTranlDampg.CalibrationPorts.MotTqTranlDampgDampgCoeff.Val /end CHARACTERISTIC
/begin CHARACTERISTIC MotTqTranlDampg.MotTqTranlDampgRampEnd.Val "MICROSAR RTE" VALUE 0x0 RTE_RL_UWORD 0 NO_COMPU_METHOD 0 65535 SYMBOL_LINK "Rte_CalprmRom_CalRegn01Inin00_DEFAULT_RTE_CALPRM_GROUP.MotTqTranlDampgRampEnd_Val" 0 DISPLAY_IDENTIFIER MotTqTranlDampg.CalibrationPorts.MotTqTranlDampgRampEnd.Val /end CHARACTERISTIC
/begin CHARACTERISTIC MotTqTranlDampg.MotTqTranlDampgTmrPt1.Val "MICROSAR RTE" VALUE 0x0 RTE_RL_FLOAT32_IEEE 0 NO_COMPU_METHOD -3.402823466e+38 3.402823466e+38 SYMBOL_LINK "Rte_CalprmRom_CalRegn01Inin00_DEFAULT_RTE_CALPRM_GROUP.MotTqTranlDampgTmrPt1_Val" 0 DISPLAY_IDENTIFIER MotTqTranlDampg.CalibrationPorts.MotTqTranlDampgTmrPt1.Val /end CHARACTERISTIC
/begin CHARACTERISTIC MotTqTranlDampg.MotTqTranlDampgTmrPt2.Val "MICROSAR RTE" VALUE 0x0 RTE_RL_FLOAT32_IEEE 0 NO_COMPU_METHOD -3.402823466e+38 3.402823466e+38 SYMBOL_LINK "Rte_CalprmRom_CalRegn01Inin00_DEFAULT_RTE_CALPRM_GROUP.MotTqTranlDampgTmrPt2_Val" 0 DISPLAY_IDENTIFIER MotTqTranlDampg.CalibrationPorts.MotTqTranlDampgTmrPt2.Val /end CHARACTERISTIC
/begin CHARACTERISTIC MotTqTranlDampg.MotTqTranlDampgVehSpdBlndX.Ary1D "MICROSAR RTE" VAL_BLK 0x0 RTE_RL_UWORD 0 NO_COMPU_METHOD 0 65535 MATRIX_DIM 4 1 1 SYMBOL_LINK "Rte_CalprmRom_CalRegn01Inin00_DEFAULT_RTE_CALPRM_GROUP.MotTqTranlDampgVehSpdBlndX_Ary1D" 0 DISPLAY_IDENTIFIER MotTqTranlDampg.CalibrationPorts.MotTqTranlDampgVehSpdBlndX.Ary1D /end CHARACTERISTIC
/begin CHARACTERISTIC MotTqTranlDampg.MotTqTranlDampgVehSpdBlndY.Ary1D "MICROSAR RTE" VAL_BLK 0x0 RTE_RL_UWORD 0 NO_COMPU_METHOD 0 65535 MATRIX_DIM 4 1 1 SYMBOL_LINK "Rte_CalprmRom_CalRegn01Cmn_DEFAULT_RTE_CALPRM_GROUP.MotTqTranlDampgVehSpdBlndY_Ary1D" 0 DISPLAY_IDENTIFIER MotTqTranlDampg.CalibrationPorts.MotTqTranlDampgVehSpdBlndY.Ary1D /end CHARACTERISTIC
/begin CHARACTERISTIC MotTqTranlDampg.MotTqTranlDampgVelThd.Val "MICROSAR RTE" VALUE 0x0 RTE_RL_FLOAT32_IEEE 0 NO_COMPU_METHOD -3.402823466e+38 3.402823466e+38 SYMBOL_LINK "Rte_CalprmRom_CalRegn01Inin00_DEFAULT_RTE_CALPRM_GROUP.MotTqTranlDampgVelThd_Val" 0 DISPLAY_IDENTIFIER MotTqTranlDampg.CalibrationPorts.MotTqTranlDampgVelThd.Val /end CHARACTERISTIC
/begin CHARACTERISTIC NxtrCalIds.NxtrCalIdsCal0DevlpAuthor.Ary1D "MICROSAR RTE" VAL_BLK 0x0 RTE_RL_UBYTE 0 NO_COMPU_METHOD 0 255 MATRIX_DIM 6 1 1 SYMBOL_LINK "Rte_CalprmRom_CalRegn01Cmn_DEFAULT_RTE_CALPRM_GROUP.NxtrCalIdsCal0DevlpAuthor_Ary1D" 0 DISPLAY_IDENTIFIER NxtrCalIds.CalibrationPorts.NxtrCalIdsCal0DevlpAuthor.Ary1D /end CHARACTERISTIC
/begin CHARACTERISTIC NxtrCalIds.NxtrCalIdsCal0DevlpDescr.Ary1D "MICROSAR RTE" VAL_BLK 0x0 RTE_RL_UBYTE 0 NO_COMPU_METHOD 0 255 MATRIX_DIM 48 1 1 SYMBOL_LINK "Rte_CalprmRom_CalRegn01Cmn_DEFAULT_RTE_CALPRM_GROUP.NxtrCalIdsCal0DevlpDesc_Ary1D" 0 DISPLAY_IDENTIFIER NxtrCalIds.CalibrationPorts.NxtrCalIdsCal0DevlpDescr.Ary1D /end CHARACTERISTIC
/begin CHARACTERISTIC NxtrCalIds.NxtrCalIdsCal0DevlpRelNr.Val "MICROSAR RTE" VALUE 0x0 RTE_RL_ULONG 0 NO_COMPU_METHOD 0 4294967295 SYMBOL_LINK "Rte_CalprmRom_CalRegn01Cmn_DEFAULT_RTE_CALPRM_GROUP.NxtrCalIdsCal0DevlpRelNr_Val" 0 DISPLAY_IDENTIFIER NxtrCalIds.CalibrationPorts.NxtrCalIdsCal0DevlpRelNr.Val /end CHARACTERISTIC
/begin CHARACTERISTIC NxtrCalIds.NxtrCalIdsCal0DevlpRelSt.Val "MICROSAR RTE" VALUE 0x0 RTE_RL_UBYTE 0 NO_COMPU_METHOD 0 255 SYMBOL_LINK "Rte_CalprmRom_CalRegn01Cmn_DEFAULT_RTE_CALPRM_GROUP.NxtrCalIdsCal0DevlpRelSt_Val" 0 DISPLAY_IDENTIFIER NxtrCalIds.CalibrationPorts.NxtrCalIdsCal0DevlpRelSt.Val /end CHARACTERISTIC
/begin CHARACTERISTIC NxtrCalIds.NxtrCalIdsCal0DevlpTiStamp.Val "MICROSAR RTE" VALUE 0x0 RTE_RL_ULONG 0 NO_COMPU_METHOD 0 4294967295 SYMBOL_LINK "Rte_CalprmRom_CalRegn01Cmn_DEFAULT_RTE_CALPRM_GROUP.NxtrCalIdsCal0DevlpTiStamp_Val" 0 DISPLAY_IDENTIFIER NxtrCalIds.CalibrationPorts.NxtrCalIdsCal0DevlpTiStamp.Val /end CHARACTERISTIC
/begin CHARACTERISTIC NxtrCalIds.NxtrCalIdsCal0DevlpVers.Val "MICROSAR RTE" VALUE 0x0 RTE_RL_UBYTE 0 NO_COMPU_METHOD 0 255 SYMBOL_LINK "Rte_CalprmRom_CalRegn01Cmn_DEFAULT_RTE_CALPRM_GROUP.NxtrCalIdsCal0DevlpVers_Val" 0 DISPLAY_IDENTIFIER NxtrCalIds.CalibrationPorts.NxtrCalIdsCal0DevlpVers.Val /end CHARACTERISTIC
/begin CHARACTERISTIC NxtrCalIds.NxtrCalIdsCal1DevlpAuthor.Ary1D "MICROSAR RTE" VAL_BLK 0x0 RTE_RL_UBYTE 0 NO_COMPU_METHOD 0 255 MATRIX_DIM 6 1 1 SYMBOL_LINK "Rte_CalprmRom_CalRegn02Cmn_DEFAULT_RTE_CALPRM_GROUP.NxtrCalIdsCal1DevlpAuthor_Ary1D" 0 DISPLAY_IDENTIFIER NxtrCalIds.CalibrationPorts.NxtrCalIdsCal1DevlpAuthor.Ary1D /end CHARACTERISTIC
/begin CHARACTERISTIC NxtrCalIds.NxtrCalIdsCal1DevlpDescr.Ary1D "MICROSAR RTE" VAL_BLK 0x0 RTE_RL_UBYTE 0 NO_COMPU_METHOD 0 255 MATRIX_DIM 48 1 1 SYMBOL_LINK "Rte_CalprmRom_CalRegn02Cmn_DEFAULT_RTE_CALPRM_GROUP.NxtrCalIdsCal1DevlpDesc_Ary1D" 0 DISPLAY_IDENTIFIER NxtrCalIds.CalibrationPorts.NxtrCalIdsCal1DevlpDescr.Ary1D /end CHARACTERISTIC
/begin CHARACTERISTIC NxtrCalIds.NxtrCalIdsCal1DevlpRelNr.Val "MICROSAR RTE" VALUE 0x0 RTE_RL_ULONG 0 NO_COMPU_METHOD 0 4294967295 SYMBOL_LINK "Rte_CalprmRom_CalRegn02Cmn_DEFAULT_RTE_CALPRM_GROUP.NxtrCalIdsCal1DevlpRelNr_Val" 0 DISPLAY_IDENTIFIER NxtrCalIds.CalibrationPorts.NxtrCalIdsCal1DevlpRelNr.Val /end CHARACTERISTIC
/begin CHARACTERISTIC NxtrCalIds.NxtrCalIdsCal1DevlpRelSt.Val "MICROSAR RTE" VALUE 0x0 RTE_RL_UBYTE 0 NO_COMPU_METHOD 0 255 SYMBOL_LINK "Rte_CalprmRom_CalRegn02Cmn_DEFAULT_RTE_CALPRM_GROUP.NxtrCalIdsCal1DevlpRelSt_Val" 0 DISPLAY_IDENTIFIER NxtrCalIds.CalibrationPorts.NxtrCalIdsCal1DevlpRelSt.Val /end CHARACTERISTIC
/begin CHARACTERISTIC NxtrCalIds.NxtrCalIdsCal1DevlpTiStamp.Val "MICROSAR RTE" VALUE 0x0 RTE_RL_ULONG 0 NO_COMPU_METHOD 0 4294967295 SYMBOL_LINK "Rte_CalprmRom_CalRegn02Cmn_DEFAULT_RTE_CALPRM_GROUP.NxtrCalIdsCal1DevlpTiStamp_Val" 0 DISPLAY_IDENTIFIER NxtrCalIds.CalibrationPorts.NxtrCalIdsCal1DevlpTiStamp.Val /end CHARACTERISTIC
/begin CHARACTERISTIC NxtrCalIds.NxtrCalIdsCal1DevlpVers.Val "MICROSAR RTE" VALUE 0x0 RTE_RL_UBYTE 0 NO_COMPU_METHOD 0 255 SYMBOL_LINK "Rte_CalprmRom_CalRegn02Cmn_DEFAULT_RTE_CALPRM_GROUP.NxtrCalIdsCal1DevlpVers_Val" 0 DISPLAY_IDENTIFIER NxtrCalIds.CalibrationPorts.NxtrCalIdsCal1DevlpVers.Val /end CHARACTERISTIC
/begin CHARACTERISTIC NxtrCalIds.NxtrCalIdsCal2DevlpAuthor.Ary1D "MICROSAR RTE" VAL_BLK 0x0 RTE_RL_UBYTE 0 NO_COMPU_METHOD 0 255 MATRIX_DIM 6 1 1 SYMBOL_LINK "Rte_CalprmRom_CalRegn03Cmn_DEFAULT_RTE_CALPRM_GROUP.NxtrCalIdsCal2DevlpAuthor_Ary1D" 0 DISPLAY_IDENTIFIER NxtrCalIds.CalibrationPorts.NxtrCalIdsCal2DevlpAuthor.Ary1D /end CHARACTERISTIC
/begin CHARACTERISTIC NxtrCalIds.NxtrCalIdsCal2DevlpDescr.Ary1D "MICROSAR RTE" VAL_BLK 0x0 RTE_RL_UBYTE 0 NO_COMPU_METHOD 0 255 MATRIX_DIM 48 1 1 SYMBOL_LINK "Rte_CalprmRom_CalRegn03Cmn_DEFAULT_RTE_CALPRM_GROUP.NxtrCalIdsCal2DevlpDesc_Ary1D" 0 DISPLAY_IDENTIFIER NxtrCalIds.CalibrationPorts.NxtrCalIdsCal2DevlpDescr.Ary1D /end CHARACTERISTIC
/begin CHARACTERISTIC NxtrCalIds.NxtrCalIdsCal2DevlpRelNr.Val "MICROSAR RTE" VALUE 0x0 RTE_RL_ULONG 0 NO_COMPU_METHOD 0 4294967295 SYMBOL_LINK "Rte_CalprmRom_CalRegn03Cmn_DEFAULT_RTE_CALPRM_GROUP.NxtrCalIdsCal2DevlpRelNr_Val" 0 DISPLAY_IDENTIFIER NxtrCalIds.CalibrationPorts.NxtrCalIdsCal2DevlpRelNr.Val /end CHARACTERISTIC
/begin CHARACTERISTIC NxtrCalIds.NxtrCalIdsCal2DevlpRelSt.Val "MICROSAR RTE" VALUE 0x0 RTE_RL_UBYTE 0 NO_COMPU_METHOD 0 255 SYMBOL_LINK "Rte_CalprmRom_CalRegn03Cmn_DEFAULT_RTE_CALPRM_GROUP.NxtrCalIdsCal2DevlpRelSt_Val" 0 DISPLAY_IDENTIFIER NxtrCalIds.CalibrationPorts.NxtrCalIdsCal2DevlpRelSt.Val /end CHARACTERISTIC
/begin CHARACTERISTIC NxtrCalIds.NxtrCalIdsCal2DevlpTiStamp.Val "MICROSAR RTE" VALUE 0x0 RTE_RL_ULONG 0 NO_COMPU_METHOD 0 4294967295 SYMBOL_LINK "Rte_CalprmRom_CalRegn03Cmn_DEFAULT_RTE_CALPRM_GROUP.NxtrCalIdsCal2DevlpTiStamp_Val" 0 DISPLAY_IDENTIFIER NxtrCalIds.CalibrationPorts.NxtrCalIdsCal2DevlpTiStamp.Val /end CHARACTERISTIC
/begin CHARACTERISTIC NxtrCalIds.NxtrCalIdsCal2DevlpVers.Val "MICROSAR RTE" VALUE 0x0 RTE_RL_UBYTE 0 NO_COMPU_METHOD 0 255 SYMBOL_LINK "Rte_CalprmRom_CalRegn03Cmn_DEFAULT_RTE_CALPRM_GROUP.NxtrCalIdsCal2DevlpVers_Val" 0 DISPLAY_IDENTIFIER NxtrCalIds.CalibrationPorts.NxtrCalIdsCal2DevlpVers.Val /end CHARACTERISTIC
/begin CHARACTERISTIC PartNr.PartNrBasMdlPartNrDft "MICROSAR RTE" VAL_BLK 0x0 RTE_RL_UBYTE 0 NO_COMPU_METHOD 0 255 MATRIX_DIM 6 1 1 SYMBOL_LINK "Rte_CalprmRom_PartNr_DEFAULT_RTE_CDATA_GROUP.PartNrBasMdlPartNrDft" 0 DISPLAY_IDENTIFIER PartNr.CalibrationParameters.PartNrBasMdlPartNrDft /end CHARACTERISTIC
/begin CHARACTERISTIC PartNr.PartNrCalProgdStsDft "MICROSAR RTE" VALUE 0x0 RTE_RL_UBYTE 0 NO_COMPU_METHOD 0 255 SYMBOL_LINK "Rte_CalprmRom_PartNr_DEFAULT_RTE_CDATA_GROUP.PartNrCalProgdStsDft" 0 DISPLAY_IDENTIFIER PartNr.CalibrationParameters.PartNrCalProgdStsDft /end CHARACTERISTIC
/begin CHARACTERISTIC PartNr.PartNrCcaMfgTrakgDft "MICROSAR RTE" VAL_BLK 0x0 RTE_RL_UBYTE 0 NO_COMPU_METHOD 0 255 MATRIX_DIM 9 1 1 SYMBOL_LINK "Rte_CalprmRom_PartNr_DEFAULT_RTE_CDATA_GROUP.PartNrCcaMfgTrakgDft" 0 DISPLAY_IDENTIFIER PartNr.CalibrationParameters.PartNrCcaMfgTrakgDft /end CHARACTERISTIC
/begin CHARACTERISTIC PartNr.PartNrCtrlPidSeedKeyDft "MICROSAR RTE" VAL_BLK 0x0 RTE_RL_UBYTE 0 NO_COMPU_METHOD 0 255 MATRIX_DIM 10 1 1 SYMBOL_LINK "Rte_CalprmRom_PartNr_DEFAULT_RTE_CDATA_GROUP.PartNrCtrlPidSeedKeyDft" 0 DISPLAY_IDENTIFIER PartNr.CalibrationParameters.PartNrCtrlPidSeedKeyDft /end CHARACTERISTIC
/begin CHARACTERISTIC PartNr.PartNrCustMfgEnaCntrDft "MICROSAR RTE" VALUE 0x0 RTE_RL_UBYTE 0 NO_COMPU_METHOD 0 255 SYMBOL_LINK "Rte_CalprmRom_PartNr_DEFAULT_RTE_CDATA_GROUP.PartNrCustMfgEnaCntrDft" 0 DISPLAY_IDENTIFIER PartNr.CalibrationParameters.PartNrCustMfgEnaCntrDft /end CHARACTERISTIC
/begin CHARACTERISTIC PartNr.PartNrDataUniversalNrSysIdDft "MICROSAR RTE" VAL_BLK 0x0 RTE_RL_UBYTE 0 NO_COMPU_METHOD 0 255 MATRIX_DIM 9 1 1 SYMBOL_LINK "Rte_CalprmRom_PartNr_DEFAULT_RTE_CDATA_GROUP.PartNrDataUniversalNrSysIdDft" 0 DISPLAY_IDENTIFIER PartNr.CalibrationParameters.PartNrDataUniversalNrSysIdDft /end CHARACTERISTIC
/begin CHARACTERISTIC PartNr.PartNrEndMdlPartNrDft "MICROSAR RTE" VAL_BLK 0x0 RTE_RL_UBYTE 0 NO_COMPU_METHOD 0 255 MATRIX_DIM 6 1 1 SYMBOL_LINK "Rte_CalprmRom_PartNr_DEFAULT_RTE_CDATA_GROUP.PartNrEndMdlPartNrDft" 0 DISPLAY_IDENTIFIER PartNr.CalibrationParameters.PartNrEndMdlPartNrDft /end CHARACTERISTIC
/begin CHARACTERISTIC PartNr.PartNrNxtrMfgTrakgDft "MICROSAR RTE" VAL_BLK 0x0 RTE_RL_UBYTE 0 NO_COMPU_METHOD 0 255 MATRIX_DIM 7 1 1 SYMBOL_LINK "Rte_CalprmRom_PartNr_DEFAULT_RTE_CDATA_GROUP.PartNrNxtrMfgTrakgDft" 0 DISPLAY_IDENTIFIER PartNr.CalibrationParameters.PartNrNxtrMfgTrakgDft /end CHARACTERISTIC
/begin CHARACTERISTIC PartNr.PartNrProgmDateDft "MICROSAR RTE" VAL_BLK 0x0 RTE_RL_UBYTE 0 NO_COMPU_METHOD 0 255 MATRIX_DIM 4 1 1 SYMBOL_LINK "Rte_CalprmRom_PartNr_DEFAULT_RTE_CDATA_GROUP.PartNrProgmDateDft" 0 DISPLAY_IDENTIFIER PartNr.CalibrationParameters.PartNrProgmDateDft /end CHARACTERISTIC
/begin CHARACTERISTIC PartNr.PartNrProgmSessionSeedKeyDft "MICROSAR RTE" VAL_BLK 0x0 RTE_RL_UBYTE 0 NO_COMPU_METHOD 0 255 MATRIX_DIM 10 1 1 SYMBOL_LINK "Rte_CalprmRom_PartNr_DEFAULT_RTE_CDATA_GROUP.PartNrProgmSessionSeedKeyDft" 0 DISPLAY_IDENTIFIER PartNr.CalibrationParameters.PartNrProgmSessionSeedKeyDft /end CHARACTERISTIC
/begin CHARACTERISTIC PartNr.PartNrRepairShopCodDft "MICROSAR RTE" VAL_BLK 0x0 RTE_RL_UBYTE 0 NO_COMPU_METHOD 0 255 MATRIX_DIM 20 1 1 SYMBOL_LINK "Rte_CalprmRom_PartNr_DEFAULT_RTE_CDATA_GROUP.PartNrRepairShopCodDft" 0 DISPLAY_IDENTIFIER PartNr.CalibrationParameters.PartNrRepairShopCodDft /end CHARACTERISTIC
/begin CHARACTERISTIC PartNr.PartNrSysCodVersNrDft "MICROSAR RTE" VAL_BLK 0x0 RTE_RL_UBYTE 0 NO_COMPU_METHOD 0 255 MATRIX_DIM 2 1 1 SYMBOL_LINK "Rte_CalprmRom_PartNr_DEFAULT_RTE_CDATA_GROUP.PartNrSysCodVersNrDft" 0 DISPLAY_IDENTIFIER PartNr.CalibrationParameters.PartNrSysCodVersNrDft /end CHARACTERISTIC
/begin CHARACTERISTIC PartNr.PartNrSysNameDft "MICROSAR RTE" VAL_BLK 0x0 RTE_RL_UBYTE 0 NO_COMPU_METHOD 0 255 MATRIX_DIM 20 1 1 SYMBOL_LINK "Rte_CalprmRom_PartNr_DEFAULT_RTE_CDATA_GROUP.PartNrSysNameDft" 0 DISPLAY_IDENTIFIER PartNr.CalibrationParameters.PartNrSysNameDft /end CHARACTERISTIC
/begin CHARACTERISTIC PartNr.PartNrVinDataDft "MICROSAR RTE" VAL_BLK 0x0 RTE_RL_UBYTE 0 NO_COMPU_METHOD 0 255 MATRIX_DIM 17 1 1 SYMBOL_LINK "Rte_CalprmRom_PartNr_DEFAULT_RTE_CDATA_GROUP.PartNrVinDataDft" 0 DISPLAY_IDENTIFIER PartNr.CalibrationParameters.PartNrVinDataDft /end CHARACTERISTIC
/begin CHARACTERISTIC PullCmpActv.PullCmpActvCmpLrnTiDecShoTerm.Val "MICROSAR RTE" VALUE 0x0 RTE_RL_FLOAT32_IEEE 0 NO_COMPU_METHOD -3.402823466e+38 3.402823466e+38 SYMBOL_LINK "Rte_CalprmRom_CalRegn03CmnGroupB_DEFAULT_RTE_CALPRM_GROUP.PullCmpActvCmpLrnTiDecShoTerm_Val" 0 DISPLAY_IDENTIFIER PullCmpActv.CalibrationPorts.PullCmpActvCmpLrnTiDecShoTerm.Val /end CHARACTERISTIC
/begin CHARACTERISTIC PullCmpActv.PullCmpActvCmpLrnTiIncShoTerm.Val "MICROSAR RTE" VALUE 0x0 RTE_RL_FLOAT32_IEEE 0 NO_COMPU_METHOD -3.402823466e+38 3.402823466e+38 SYMBOL_LINK "Rte_CalprmRom_CalRegn03CmnGroupB_DEFAULT_RTE_CALPRM_GROUP.PullCmpActvCmpLrnTiIncShoTerm_Val" 0 DISPLAY_IDENTIFIER PullCmpActv.CalibrationPorts.PullCmpActvCmpLrnTiIncShoTerm.Val /end CHARACTERISTIC
/begin CHARACTERISTIC PullCmpActv.PullCmpActvCmpLrnTiLongTerm.Val "MICROSAR RTE" VALUE 0x0 RTE_RL_FLOAT32_IEEE 0 NO_COMPU_METHOD -3.402823466e+38 3.402823466e+38 SYMBOL_LINK "Rte_CalprmRom_CalRegn03CmnGroupB_DEFAULT_RTE_CALPRM_GROUP.PullCmpActvCmpLrnTiLongTerm_Val" 0 DISPLAY_IDENTIFIER PullCmpActv.CalibrationPorts.PullCmpActvCmpLrnTiLongTerm.Val /end CHARACTERISTIC
/begin CHARACTERISTIC PullCmpActv.PullCmpActvCmpShoTermRstHwAgThd.Val "MICROSAR RTE" VALUE 0x0 RTE_RL_FLOAT32_IEEE 0 NO_COMPU_METHOD -3.402823466e+38 3.402823466e+38 SYMBOL_LINK "Rte_CalprmRom_CalRegn03CmnGroupB_DEFAULT_RTE_CALPRM_GROUP.PullCmpActvCmpShoTermRstHwAgThd_Val" 0 DISPLAY_IDENTIFIER PullCmpActv.CalibrationPorts.PullCmpActvCmpShoTermRstHwAgThd.Val /end CHARACTERISTIC
/begin CHARACTERISTIC PullCmpActv.PullCmpActvCmpShoTermRstHwTqThd.Val "MICROSAR RTE" VALUE 0x0 RTE_RL_FLOAT32_IEEE 0 NO_COMPU_METHOD -3.402823466e+38 3.402823466e+38 SYMBOL_LINK "Rte_CalprmRom_CalRegn03CmnGroupB_DEFAULT_RTE_CALPRM_GROUP.PullCmpActvCmpShoTermRstHwTqThd_Val" 0 DISPLAY_IDENTIFIER PullCmpActv.CalibrationPorts.PullCmpActvCmpShoTermRstHwTqThd.Val /end CHARACTERISTIC
/begin CHARACTERISTIC PullCmpActv.PullCmpActvCmpShoTermRstLatAThd.Val "MICROSAR RTE" VALUE 0x0 RTE_RL_FLOAT32_IEEE 0 NO_COMPU_METHOD -3.402823466e+38 3.402823466e+38 SYMBOL_LINK "Rte_CalprmRom_CalRegn03CmnGroupB_DEFAULT_RTE_CALPRM_GROUP.PullCmpActvCmpShoTermRstLatAThd_Val" 0 DISPLAY_IDENTIFIER PullCmpActv.CalibrationPorts.PullCmpActvCmpShoTermRstLatAThd.Val /end CHARACTERISTIC
/begin CHARACTERISTIC PullCmpActv.PullCmpActvCmpShoTermRstYawRate.Val "MICROSAR RTE" VALUE 0x0 RTE_RL_FLOAT32_IEEE 0 NO_COMPU_METHOD -3.402823466e+38 3.402823466e+38 SYMBOL_LINK "Rte_CalprmRom_CalRegn03CmnGroupB_DEFAULT_RTE_CALPRM_GROUP.PullCmpActvCmpShoTermRstYawRateThd_Val" 0 DISPLAY_IDENTIFIER PullCmpActv.CalibrationPorts.PullCmpActvCmpShoTermRstYawRate.Val /end CHARACTERISTIC
/begin CHARACTERISTIC PullCmpActv.PullCmpActvCmpShoTermRstYawRateThd.Val "MICROSAR RTE" VALUE 0x0 RTE_RL_FLOAT32_IEEE 0 NO_COMPU_METHOD -3.402823466e+38 3.402823466e+38 SYMBOL_LINK "Rte_CalprmRom_CalRegn03CmnGroupB_DEFAULT_RTE_CALPRM_GROUP.PullCmpActvCmpShoTermRstYawRateThd_Val" 0 DISPLAY_IDENTIFIER PullCmpActv.CalibrationPorts.PullCmpActvCmpShoTermRstYawRateThd.Val /end CHARACTERISTIC
/begin CHARACTERISTIC PullCmpActv.PullCmpActvEna.Logl "MICROSAR RTE" VALUE 0x0 RTE_RL_BOOLEAN 0 RTE_CM_BOOLEAN 0 255 SYMBOL_LINK "Rte_CalprmRom_CalRegn02CmnGroupA_DEFAULT_RTE_CALPRM_GROUP.PullCmpActvEna_Logl" 0 DISPLAY_IDENTIFIER PullCmpActv.CalibrationPorts.PullCmpActvEna.Logl /end CHARACTERISTIC
/begin CHARACTERISTIC PullCmpActv.PullCmpActvHwTqFilFrqLongTerm.Val "MICROSAR RTE" VALUE 0x0 RTE_RL_FLOAT32_IEEE 0 NO_COMPU_METHOD -3.402823466e+38 3.402823466e+38 SYMBOL_LINK "Rte_CalprmRom_CalRegn03CmnGroupB_DEFAULT_RTE_CALPRM_GROUP.PullCmpActvHwTqFilFrqLongTerm_Val" 0 DISPLAY_IDENTIFIER PullCmpActv.CalibrationPorts.PullCmpActvHwTqFilFrqLongTerm.Val /end CHARACTERISTIC
/begin CHARACTERISTIC PullCmpActv.PullCmpActvHwTqFilFrqLrngEna.Val "MICROSAR RTE" VALUE 0x0 RTE_RL_FLOAT32_IEEE 0 NO_COMPU_METHOD -3.402823466e+38 3.402823466e+38 SYMBOL_LINK "Rte_CalprmRom_CalRegn03CmnGroupB_DEFAULT_RTE_CALPRM_GROUP.PullCmpActvHwTqFilFrqLrngEna_Val" 0 DISPLAY_IDENTIFIER PullCmpActv.CalibrationPorts.PullCmpActvHwTqFilFrqLrngEna.Val /end CHARACTERISTIC
/begin CHARACTERISTIC PullCmpActv.PullCmpActvHwTqFilFrqShoTerm.Val "MICROSAR RTE" VALUE 0x0 RTE_RL_FLOAT32_IEEE 0 NO_COMPU_METHOD -3.402823466e+38 3.402823466e+38 SYMBOL_LINK "Rte_CalprmRom_CalRegn03CmnGroupB_DEFAULT_RTE_CALPRM_GROUP.PullCmpActvHwTqFilFrqShoTerm_Val" 0 DISPLAY_IDENTIFIER PullCmpActv.CalibrationPorts.PullCmpActvHwTqFilFrqShoTerm.Val /end CHARACTERISTIC
/begin CHARACTERISTIC PullCmpActv.PullCmpActvLongTermLim.Val "MICROSAR RTE" VALUE 0x0 RTE_RL_FLOAT32_IEEE 0 NO_COMPU_METHOD -3.402823466e+38 3.402823466e+38 SYMBOL_LINK "Rte_CalprmRom_CalRegn03CmnGroupB_DEFAULT_RTE_CALPRM_GROUP.PullCmpActvLongTermLim_Val" 0 DISPLAY_IDENTIFIER PullCmpActv.CalibrationPorts.PullCmpActvLongTermLim.Val /end CHARACTERISTIC
/begin CHARACTERISTIC PullCmpActv.PullCmpActvLrngEnaAgConfMinMgn.Val "MICROSAR RTE" VALUE 0x0 RTE_RL_FLOAT32_IEEE 0 NO_COMPU_METHOD -3.402823466e+38 3.402823466e+38 SYMBOL_LINK "Rte_CalprmRom_CalRegn03CmnGroupB_DEFAULT_RTE_CALPRM_GROUP.PullCmpActvLrngEnaAgConfMinMgn_Val" 0 DISPLAY_IDENTIFIER PullCmpActv.CalibrationPorts.PullCmpActvLrngEnaAgConfMinMgn.Val /end CHARACTERISTIC
/begin CHARACTERISTIC PullCmpActv.PullCmpActvLrngEnaHwAgMaxMgn.Val "MICROSAR RTE" VALUE 0x0 RTE_RL_FLOAT32_IEEE 0 NO_COMPU_METHOD -3.402823466e+38 3.402823466e+38 SYMBOL_LINK "Rte_CalprmRom_CalRegn03CmnGroupB_DEFAULT_RTE_CALPRM_GROUP.PullCmpActvLrngEnaHwAgMaxMgn_Val" 0 DISPLAY_IDENTIFIER PullCmpActv.CalibrationPorts.PullCmpActvLrngEnaHwAgMaxMgn.Val /end CHARACTERISTIC
/begin CHARACTERISTIC PullCmpActv.PullCmpActvLrngEnaHwTqMaxMgn.Val "MICROSAR RTE" VALUE 0x0 RTE_RL_FLOAT32_IEEE 0 NO_COMPU_METHOD -3.402823466e+38 3.402823466e+38 SYMBOL_LINK "Rte_CalprmRom_CalRegn03CmnGroupB_DEFAULT_RTE_CALPRM_GROUP.PullCmpActvLrngEnaHwTqMaxMgn_Val" 0 DISPLAY_IDENTIFIER PullCmpActv.CalibrationPorts.PullCmpActvLrngEnaHwTqMaxMgn.Val /end CHARACTERISTIC
/begin CHARACTERISTIC PullCmpActv.PullCmpActvLrngEnaHwVelMaxMgn.Val "MICROSAR RTE" VALUE 0x0 RTE_RL_FLOAT32_IEEE 0 NO_COMPU_METHOD -3.402823466e+38 3.402823466e+38 SYMBOL_LINK "Rte_CalprmRom_CalRegn03CmnGroupB_DEFAULT_RTE_CALPRM_GROUP.PullCmpActvLrngEnaHwVelMaxMgn_Val" 0 DISPLAY_IDENTIFIER PullCmpActv.CalibrationPorts.PullCmpActvLrngEnaHwVelMaxMgn.Val /end CHARACTERISTIC
/begin CHARACTERISTIC PullCmpActv.PullCmpActvLrngEnaLatAMaxMgn.Val "MICROSAR RTE" VALUE 0x0 RTE_RL_FLOAT32_IEEE 0 NO_COMPU_METHOD -3.402823466e+38 3.402823466e+38 SYMBOL_LINK "Rte_CalprmRom_CalRegn03CmnGroupB_DEFAULT_RTE_CALPRM_GROUP.PullCmpActvLrngEnaLatAMaxMgn_Val" 0 DISPLAY_IDENTIFIER PullCmpActv.CalibrationPorts.PullCmpActvLrngEnaLatAMaxMgn.Val /end CHARACTERISTIC
/begin CHARACTERISTIC PullCmpActv.PullCmpActvLrngEnaTiThd.Val "MICROSAR RTE" VALUE 0x0 RTE_RL_FLOAT32_IEEE 0 NO_COMPU_METHOD -3.402823466e+38 3.402823466e+38 SYMBOL_LINK "Rte_CalprmRom_CalRegn03CmnGroupB_DEFAULT_RTE_CALPRM_GROUP.PullCmpActvLrngEnaTiThd_Val" 0 DISPLAY_IDENTIFIER PullCmpActv.CalibrationPorts.PullCmpActvLrngEnaTiThd.Val /end CHARACTERISTIC
/begin CHARACTERISTIC PullCmpActv.PullCmpActvLrngEnaVehSpdMaxMgn.Val "MICROSAR RTE" VALUE 0x0 RTE_RL_FLOAT32_IEEE 0 NO_COMPU_METHOD -3.402823466e+38 3.402823466e+38 SYMBOL_LINK "Rte_CalprmRom_CalRegn03CmnGroupB_DEFAULT_RTE_CALPRM_GROUP.PullCmpActvLrngEnaVehSpdMaxMgn_Val" 0 DISPLAY_IDENTIFIER PullCmpActv.CalibrationPorts.PullCmpActvLrngEnaVehSpdMaxMgn.Val /end CHARACTERISTIC
/begin CHARACTERISTIC PullCmpActv.PullCmpActvLrngEnaVehSpdMinMgn.Val "MICROSAR RTE" VALUE 0x0 RTE_RL_FLOAT32_IEEE 0 NO_COMPU_METHOD -3.402823466e+38 3.402823466e+38 SYMBOL_LINK "Rte_CalprmRom_CalRegn03CmnGroupB_DEFAULT_RTE_CALPRM_GROUP.PullCmpActvLrngEnaVehSpdMinMgn_Val" 0 DISPLAY_IDENTIFIER PullCmpActv.CalibrationPorts.PullCmpActvLrngEnaVehSpdMinMgn.Val /end CHARACTERISTIC
/begin CHARACTERISTIC PullCmpActv.PullCmpActvLrngEnaVehSpdRateMaxMgn.Val "MICROSAR RTE" VALUE 0x0 RTE_RL_FLOAT32_IEEE 0 NO_COMPU_METHOD -3.402823466e+38 3.402823466e+38 SYMBOL_LINK "Rte_CalprmRom_CalRegn03CmnGroupB_DEFAULT_RTE_CALPRM_GROUP.PullCmpActvLrngEnaVehSpdRateMaxMgn_Val" 0 DISPLAY_IDENTIFIER PullCmpActv.CalibrationPorts.PullCmpActvLrngEnaVehSpdRateMaxMgn.Val /end CHARACTERISTIC
/begin CHARACTERISTIC PullCmpActv.PullCmpActvLrngEnaYawRateMaxMgn.Val "MICROSAR RTE" VALUE 0x0 RTE_RL_FLOAT32_IEEE 0 NO_COMPU_METHOD -3.402823466e+38 3.402823466e+38 SYMBOL_LINK "Rte_CalprmRom_CalRegn03CmnGroupB_DEFAULT_RTE_CALPRM_GROUP.PullCmpActvLrngEnaYawRateMaxMgn_Val" 0 DISPLAY_IDENTIFIER PullCmpActv.CalibrationPorts.PullCmpActvLrngEnaYawRateMaxMgn.Val /end CHARACTERISTIC
/begin CHARACTERISTIC PullCmpActv.PullCmpActvOpstSignTiShoTerm.Val "MICROSAR RTE" VALUE 0x0 RTE_RL_FLOAT32_IEEE 0 NO_COMPU_METHOD -3.402823466e+38 3.402823466e+38 SYMBOL_LINK "Rte_CalprmRom_CalRegn03CmnGroupB_DEFAULT_RTE_CALPRM_GROUP.PullCmpActvOpstSignTiShoTerm_Val" 0 DISPLAY_IDENTIFIER PullCmpActv.CalibrationPorts.PullCmpActvOpstSignTiShoTerm.Val /end CHARACTERISTIC
/begin CHARACTERISTIC PullCmpActv.PullCmpActvOutpMaxRate.Val "MICROSAR RTE" VALUE 0x0 RTE_RL_FLOAT32_IEEE 0 NO_COMPU_METHOD -3.402823466e+38 3.402823466e+38 SYMBOL_LINK "Rte_CalprmRom_CalRegn03CmnGroupB_DEFAULT_RTE_CALPRM_GROUP.PullCmpActvOutpMaxRate_Val" 0 DISPLAY_IDENTIFIER PullCmpActv.CalibrationPorts.PullCmpActvOutpMaxRate.Val /end CHARACTERISTIC
/begin CHARACTERISTIC PullCmpActv.PullCmpActvPullCmpShoTermLim.Val "MICROSAR RTE" VALUE 0x0 RTE_RL_FLOAT32_IEEE 0 NO_COMPU_METHOD -3.402823466e+38 3.402823466e+38 SYMBOL_LINK "Rte_CalprmRom_CalRegn03CmnGroupB_DEFAULT_RTE_CALPRM_GROUP.PullCmpActvPullCmpShoTermLim_Val" 0 DISPLAY_IDENTIFIER PullCmpActv.CalibrationPorts.PullCmpActvPullCmpShoTermLim.Val /end CHARACTERISTIC
/begin CHARACTERISTIC PullCmpActv.PullCmpActvPullCmpTotLim.Val "MICROSAR RTE" VALUE 0x0 RTE_RL_FLOAT32_IEEE 0 NO_COMPU_METHOD -3.402823466e+38 3.402823466e+38 SYMBOL_LINK "Rte_CalprmRom_CalRegn03CmnGroupB_DEFAULT_RTE_CALPRM_GROUP.PullCmpActvPullCmpTotLim_Val" 0 DISPLAY_IDENTIFIER PullCmpActv.CalibrationPorts.PullCmpActvPullCmpTotLim.Val /end CHARACTERISTIC
/begin CHARACTERISTIC PullCmpActv.PullCmpActvPullErrLimLongTerm.Val "MICROSAR RTE" VALUE 0x0 RTE_RL_FLOAT32_IEEE 0 NO_COMPU_METHOD -3.402823466e+38 3.402823466e+38 SYMBOL_LINK "Rte_CalprmRom_CalRegn03CmnGroupB_DEFAULT_RTE_CALPRM_GROUP.PullCmpActvPullErrLimLongTerm_Val" 0 DISPLAY_IDENTIFIER PullCmpActv.CalibrationPorts.PullCmpActvPullErrLimLongTerm.Val /end CHARACTERISTIC
/begin CHARACTERISTIC PullCmpActv.PullCmpActvPullErrMgnThd.Val "MICROSAR RTE" VALUE 0x0 RTE_RL_FLOAT32_IEEE 0 NO_COMPU_METHOD -3.402823466e+38 3.402823466e+38 SYMBOL_LINK "Rte_CalprmRom_CalRegn03CmnGroupB_DEFAULT_RTE_CALPRM_GROUP.PullCmpActvPullErrMgnThd_Val" 0 DISPLAY_IDENTIFIER PullCmpActv.CalibrationPorts.PullCmpActvPullErrMgnThd.Val /end CHARACTERISTIC
/begin CHARACTERISTIC PullCmpActv.PullCmpActvPullErrShoTermLim.Val "MICROSAR RTE" VALUE 0x0 RTE_RL_FLOAT32_IEEE 0 NO_COMPU_METHOD -3.402823466e+38 3.402823466e+38 SYMBOL_LINK "Rte_CalprmRom_CalRegn03CmnGroupB_DEFAULT_RTE_CALPRM_GROUP.PullCmpActvPullErrShoTermLim_Val" 0 DISPLAY_IDENTIFIER PullCmpActv.CalibrationPorts.PullCmpActvPullErrShoTermLim.Val /end CHARACTERISTIC
/begin CHARACTERISTIC PullCmpActv.PullCmpActvShoTermRampTi.Val "MICROSAR RTE" VALUE 0x0 RTE_RL_FLOAT32_IEEE 0 NO_COMPU_METHOD -3.402823466e+38 3.402823466e+38 SYMBOL_LINK "Rte_CalprmRom_CalRegn03CmnGroupB_DEFAULT_RTE_CALPRM_GROUP.PullCmpActvShoTermRampTi_Val" 0 DISPLAY_IDENTIFIER PullCmpActv.CalibrationPorts.PullCmpActvShoTermRampTi.Val /end CHARACTERISTIC
/begin CHARACTERISTIC PullCmpActv.PullCmpActvVehSpdScaTblX.Ary1D "MICROSAR RTE" VAL_BLK 0x0 RTE_RL_UWORD 0 NO_COMPU_METHOD 0 65535 MATRIX_DIM 4 1 1 SYMBOL_LINK "Rte_CalprmRom_CalRegn03CmnGroupB_DEFAULT_RTE_CALPRM_GROUP.PullCmpActvVehSpdScaTblX_Ary1D" 0 DISPLAY_IDENTIFIER PullCmpActv.CalibrationPorts.PullCmpActvVehSpdScaTblX.Ary1D /end CHARACTERISTIC
/begin CHARACTERISTIC PullCmpActv.PullCmpActvVehSpdScaTblY.Ary1D "MICROSAR RTE" VAL_BLK 0x0 RTE_RL_UWORD 0 NO_COMPU_METHOD 0 65535 MATRIX_DIM 4 1 1 SYMBOL_LINK "Rte_CalprmRom_CalRegn03CmnGroupB_DEFAULT_RTE_CALPRM_GROUP.PullCmpActvVehSpdScaTblY_Ary1D" 0 DISPLAY_IDENTIFIER PullCmpActv.CalibrationPorts.PullCmpActvVehSpdScaTblY.Ary1D /end CHARACTERISTIC
/begin CHARACTERISTIC PullCmpActv.PullCmpActvYawRateFilFrq.Val "MICROSAR RTE" VALUE 0x0 RTE_RL_FLOAT32_IEEE 0 NO_COMPU_METHOD -3.402823466e+38 3.402823466e+38 SYMBOL_LINK "Rte_CalprmRom_CalRegn03Inin00_DEFAULT_RTE_CALPRM_GROUP.PullCmpActvYawRateFilFrq_Val" 0 DISPLAY_IDENTIFIER PullCmpActv.CalibrationPorts.PullCmpActvYawRateFilFrq.Val /end CHARACTERISTIC
/begin CHARACTERISTIC PullCmpActv.PullCmpLongTermDft "MICROSAR RTE" VALUE 0x0 RTE_RL_FLOAT32_IEEE 0 NO_COMPU_METHOD -3.402823466e+38 3.402823466e+38 SYMBOL_LINK "Rte_CalprmRom_PullCmpActv_DEFAULT_RTE_CDATA_GROUP.PullCmpLongTermDft" 0 DISPLAY_IDENTIFIER PullCmpActv.CalibrationParameters.PullCmpLongTermDft /end CHARACTERISTIC
/begin CHARACTERISTIC PullCmpActv.SysGlbPrmSysTqRat.Val "MICROSAR RTE" VALUE 0x0 RTE_RL_FLOAT32_IEEE 0 NO_COMPU_METHOD -3.402823466e+38 3.402823466e+38 SYMBOL_LINK "Rte_CalprmRom_CalRegn03Inin00_DEFAULT_RTE_CALPRM_GROUP.SysGlbPrmSysTqRat_Val" 0 DISPLAY_IDENTIFIER PullCmpActv.CalibrationPorts.SysGlbPrmSysTqRat.Val /end CHARACTERISTIC
/begin CHARACTERISTIC PwrDiscnct.BattVltgSwdMax.Val "MICROSAR RTE" VALUE 0x0 RTE_RL_FLOAT32_IEEE 0 NO_COMPU_METHOD 6.0 26.5 SYMBOL_LINK "Rte_CalprmRom_CalRegn01Cmn_DEFAULT_RTE_CALPRM_GROUP.BattVltgSwdMax_Val" 0 DISPLAY_IDENTIFIER PwrDiscnct.CalibrationPorts.BattVltgSwdMax.Val /end CHARACTERISTIC
/begin CHARACTERISTIC PwrDiscnct.PwrDiscnctNtc0x042FailStep.Val "MICROSAR RTE" VALUE 0x0 RTE_RL_UWORD 0 NO_COMPU_METHOD 0 65535 SYMBOL_LINK "Rte_CalprmRom_CalRegn01Inin00_DEFAULT_RTE_CALPRM_GROUP.PwrDiscnctNtc0x042FailStep_Val" 0 DISPLAY_IDENTIFIER PwrDiscnct.CalibrationPorts.PwrDiscnctNtc0x042FailStep.Val /end CHARACTERISTIC
/begin CHARACTERISTIC PwrDiscnct.PwrDiscnctNtc0x042PassStep.Val "MICROSAR RTE" VALUE 0x0 RTE_RL_UWORD 0 NO_COMPU_METHOD 0 65535 SYMBOL_LINK "Rte_CalprmRom_CalRegn01Inin00_DEFAULT_RTE_CALPRM_GROUP.PwrDiscnctNtc0x042PassStep_Val" 0 DISPLAY_IDENTIFIER PwrDiscnct.CalibrationPorts.PwrDiscnctNtc0x042PassStep.Val /end CHARACTERISTIC
/begin CHARACTERISTIC PwrDiscnct.PwrDiscnctNtc0x04AFailStep.Val "MICROSAR RTE" VALUE 0x0 RTE_RL_UWORD 0 NO_COMPU_METHOD 0 65535 SYMBOL_LINK "Rte_CalprmRom_CalRegn01Inin00_DEFAULT_RTE_CALPRM_GROUP.PwrDiscnctNtc0x04AFailStep_Val" 0 DISPLAY_IDENTIFIER PwrDiscnct.CalibrationPorts.PwrDiscnctNtc0x04AFailStep.Val /end CHARACTERISTIC
/begin CHARACTERISTIC PwrDiscnct.PwrDiscnctNtc0x04APassStep.Val "MICROSAR RTE" VALUE 0x0 RTE_RL_UWORD 0 NO_COMPU_METHOD 0 65535 SYMBOL_LINK "Rte_CalprmRom_CalRegn01Inin00_DEFAULT_RTE_CALPRM_GROUP.PwrDiscnctNtc0x04APassStep_Val" 0 DISPLAY_IDENTIFIER PwrDiscnct.CalibrationPorts.PwrDiscnctNtc0x04APassStep.Val /end CHARACTERISTIC
/begin CHARACTERISTIC PwrDiscnct.PwrDiscnctOpenThd.Val "MICROSAR RTE" VALUE 0x0 RTE_RL_FLOAT32_IEEE 0 NO_COMPU_METHOD 0.0 5.0 SYMBOL_LINK "Rte_CalprmRom_CalRegn01Cmn_DEFAULT_RTE_CALPRM_GROUP.PwrDiscnctOpenThd_Val" 0 DISPLAY_IDENTIFIER PwrDiscnct.CalibrationPorts.PwrDiscnctOpenThd.Val /end CHARACTERISTIC
/begin CHARACTERISTIC PwrLimr.PwrLimrAssiRednLpFilFrq.Val "MICROSAR RTE" VALUE 0x0 RTE_RL_FLOAT32_IEEE 0 NO_COMPU_METHOD -3.402823466e+38 3.402823466e+38 SYMBOL_LINK "Rte_CalprmRom_CalRegn01Cmn_DEFAULT_RTE_CALPRM_GROUP.PwrLimrAssiRednLpFilFrq_Val" 0 DISPLAY_IDENTIFIER PwrLimr.CalibrationPorts.PwrLimrAssiRednLpFilFrq.Val /end CHARACTERISTIC
/begin CHARACTERISTIC PwrLimr.PwrLimrBackEmfConStdT.Val "MICROSAR RTE" VALUE 0x0 RTE_RL_FLOAT32_IEEE 0 NO_COMPU_METHOD -3.402823466e+38 3.402823466e+38 SYMBOL_LINK "Rte_CalprmRom_CalRegn01Cmn_DEFAULT_RTE_CALPRM_GROUP.PwrLimrBackEmfConStdT_Val" 0 DISPLAY_IDENTIFIER PwrLimr.CalibrationPorts.PwrLimrBackEmfConStdT.Val /end CHARACTERISTIC
/begin CHARACTERISTIC PwrLimr.PwrLimrBrdgVltgAdjSlew.Val "MICROSAR RTE" VALUE 0x0 RTE_RL_FLOAT32_IEEE 0 NO_COMPU_METHOD -3.402823466e+38 3.402823466e+38 SYMBOL_LINK "Rte_CalprmRom_CalRegn01Cmn_DEFAULT_RTE_CALPRM_GROUP.PwrLimrBrdgVltgAdjSlew_Val" 0 DISPLAY_IDENTIFIER PwrLimr.CalibrationPorts.PwrLimrBrdgVltgAdjSlew.Val /end CHARACTERISTIC
/begin CHARACTERISTIC PwrLimr.PwrLimrBrdgVltgAltFltAdj.Val "MICROSAR RTE" VALUE 0x0 RTE_RL_FLOAT32_IEEE 0 NO_COMPU_METHOD -3.402823466e+38 3.402823466e+38 SYMBOL_LINK "Rte_CalprmRom_CalRegn01Cmn_DEFAULT_RTE_CALPRM_GROUP.PwrLimrBrdgVltgAltFltAdj_Val" 0 DISPLAY_IDENTIFIER PwrLimr.CalibrationPorts.PwrLimrBrdgVltgAltFltAdj.Val /end CHARACTERISTIC
/begin CHARACTERISTIC PwrLimr.PwrLimrFilAssiRednThd.Val "MICROSAR RTE" VALUE 0x0 RTE_RL_FLOAT32_IEEE 0 NO_COMPU_METHOD -3.402823466e+38 3.402823466e+38 SYMBOL_LINK "Rte_CalprmRom_CalRegn01Cmn_DEFAULT_RTE_CALPRM_GROUP.PwrLimrFilAssiRednThd_Val" 0 DISPLAY_IDENTIFIER PwrLimr.CalibrationPorts.PwrLimrFilAssiRednThd.Val /end CHARACTERISTIC
/begin CHARACTERISTIC PwrLimr.PwrLimrLoVoltAssiRcvrThd.Val "MICROSAR RTE" VALUE 0x0 RTE_RL_FLOAT32_IEEE 0 NO_COMPU_METHOD -3.402823466e+38 3.402823466e+38 SYMBOL_LINK "Rte_CalprmRom_CalRegn01Cmn_DEFAULT_RTE_CALPRM_GROUP.PwrLimrLoVoltAssiRcvrThd_Val" 0 DISPLAY_IDENTIFIER PwrLimr.CalibrationPorts.PwrLimrLoVoltAssiRcvrThd.Val /end CHARACTERISTIC
/begin CHARACTERISTIC PwrLimr.PwrLimrLoVoltAssiRcvrTi.Val "MICROSAR RTE" VALUE 0x0 RTE_RL_UWORD 0 NO_COMPU_METHOD 0 65535 SYMBOL_LINK "Rte_CalprmRom_CalRegn01Cmn_DEFAULT_RTE_CALPRM_GROUP.PwrLimrLoVoltAssiRcvrTi_Val" 0 DISPLAY_IDENTIFIER PwrLimr.CalibrationPorts.PwrLimrLoVoltAssiRcvrTi.Val /end CHARACTERISTIC
/begin CHARACTERISTIC PwrLimr.PwrLimrMotEnvlpX.Ary1D "MICROSAR RTE" VAL_BLK 0x0 RTE_RL_SWORD 0 NO_COMPU_METHOD -32768 32767 MATRIX_DIM 14 1 1 SYMBOL_LINK "Rte_CalprmRom_CalRegn01Cmn_DEFAULT_RTE_CALPRM_GROUP.PwrLimrMotEnvlpX_Ary1D" 0 DISPLAY_IDENTIFIER PwrLimr.CalibrationPorts.PwrLimrMotEnvlpX.Ary1D /end CHARACTERISTIC
/begin CHARACTERISTIC PwrLimr.PwrLimrMotEnvlpY.Ary1D "MICROSAR RTE" VAL_BLK 0x0 RTE_RL_UWORD 0 NO_COMPU_METHOD 0 65535 MATRIX_DIM 14 1 1 SYMBOL_LINK "Rte_CalprmRom_CalRegn01Cmn_DEFAULT_RTE_CALPRM_GROUP.PwrLimrMotEnvlpY_Ary1D" 0 DISPLAY_IDENTIFIER PwrLimr.CalibrationPorts.PwrLimrMotEnvlpY.Ary1D /end CHARACTERISTIC
/begin CHARACTERISTIC PwrLimr.PwrLimrMotVelLpFilFrq.Val "MICROSAR RTE" VALUE 0x0 RTE_RL_FLOAT32_IEEE 0 NO_COMPU_METHOD -3.402823466e+38 3.402823466e+38 SYMBOL_LINK "Rte_CalprmRom_CalRegn01Cmn_DEFAULT_RTE_CALPRM_GROUP.PwrLimrMotVelLpFilFrq_Val" 0 DISPLAY_IDENTIFIER PwrLimr.CalibrationPorts.PwrLimrMotVelLpFilFrq.Val /end CHARACTERISTIC
/begin CHARACTERISTIC PwrLimr.PwrLimrSpdAdjSlewDec.Val "MICROSAR RTE" VALUE 0x0 RTE_RL_FLOAT32_IEEE 0 NO_COMPU_METHOD -3.402823466e+38 3.402823466e+38 SYMBOL_LINK "Rte_CalprmRom_CalRegn01Cmn_DEFAULT_RTE_CALPRM_GROUP.PwrLimrSpdAdjSlewDec_Val" 0 DISPLAY_IDENTIFIER PwrLimr.CalibrationPorts.PwrLimrSpdAdjSlewDec.Val /end CHARACTERISTIC
/begin CHARACTERISTIC PwrLimr.PwrLimrSpdAdjSlewEna.Logl "MICROSAR RTE" VALUE 0x0 RTE_RL_BOOLEAN 0 RTE_CM_BOOLEAN 0 255 SYMBOL_LINK "Rte_CalprmRom_CalRegn01Cmn_DEFAULT_RTE_CALPRM_GROUP.PwrLimrSpdAdjSlewEna_Logl" 0 DISPLAY_IDENTIFIER PwrLimr.CalibrationPorts.PwrLimrSpdAdjSlewEna.Logl /end CHARACTERISTIC
/begin CHARACTERISTIC PwrLimr.PwrLimrSpdAdjSlewInc.Val "MICROSAR RTE" VALUE 0x0 RTE_RL_FLOAT32_IEEE 0 NO_COMPU_METHOD -3.402823466e+38 3.402823466e+38 SYMBOL_LINK "Rte_CalprmRom_CalRegn01Cmn_DEFAULT_RTE_CALPRM_GROUP.PwrLimrSpdAdjSlewInc_Val" 0 DISPLAY_IDENTIFIER PwrLimr.CalibrationPorts.PwrLimrSpdAdjSlewInc.Val /end CHARACTERISTIC
/begin CHARACTERISTIC PwrLimr.PwrLimrStdOperMotEnvlpX.Ary1D "MICROSAR RTE" VAL_BLK 0x0 RTE_RL_UWORD 0 NO_COMPU_METHOD 0 65535 MATRIX_DIM 6 1 1 SYMBOL_LINK "Rte_CalprmRom_CalRegn01Cmn_DEFAULT_RTE_CALPRM_GROUP.PwrLimrStdOperMotEnvlpX_Ary1D" 0 DISPLAY_IDENTIFIER PwrLimr.CalibrationPorts.PwrLimrStdOperMotEnvlpX.Ary1D /end CHARACTERISTIC
/begin CHARACTERISTIC PwrLimr.PwrLimrStdOperMotEnvlpY.Ary1D "MICROSAR RTE" VAL_BLK 0x0 RTE_RL_UWORD 0 NO_COMPU_METHOD 0 65535 MATRIX_DIM 6 1 1 SYMBOL_LINK "Rte_CalprmRom_CalRegn01Cmn_DEFAULT_RTE_CALPRM_GROUP.PwrLimrStdOperMotEnvlpY_Ary1D" 0 DISPLAY_IDENTIFIER PwrLimr.CalibrationPorts.PwrLimrStdOperMotEnvlpY.Ary1D /end CHARACTERISTIC
/begin CHARACTERISTIC PwrLimr.PwrLimrVltgDptMotVelOffsX.Ary1D "MICROSAR RTE" VAL_BLK 0x0 RTE_RL_UWORD 0 NO_COMPU_METHOD 0 65535 MATRIX_DIM 10 1 1 SYMBOL_LINK "Rte_CalprmRom_CalRegn01Cmn_DEFAULT_RTE_CALPRM_GROUP.PwrLimrVltgDptMotVelOffsX_Ary1D" 0 DISPLAY_IDENTIFIER PwrLimr.CalibrationPorts.PwrLimrVltgDptMotVelOffsX.Ary1D /end CHARACTERISTIC
/begin CHARACTERISTIC PwrLimr.PwrLimrVltgDptMotVelOffsY.Ary1D "MICROSAR RTE" VAL_BLK 0x0 RTE_RL_UWORD 0 NO_COMPU_METHOD 0 65535 MATRIX_DIM 10 1 1 SYMBOL_LINK "Rte_CalprmRom_CalRegn01Cmn_DEFAULT_RTE_CALPRM_GROUP.PwrLimrVltgDptMotVelOffsY_Ary1D" 0 DISPLAY_IDENTIFIER PwrLimr.CalibrationPorts.PwrLimrVltgDptMotVelOffsY.Ary1D /end CHARACTERISTIC
/begin MEASUREMENT MotRplCoggCfg.MotRplCoggPrm.CoggOrder1 "MICROSAR RTE" UWORD NO_COMPU_METHOD 0 0 0 65535 ECU_ADDRESS 0 SYMBOL_LINK "Rte_MotRplCoggCfg_MotRplCoggPrm.CoggOrder1" 0 DISPLAY_IDENTIFIER MotRplCoggCfg.PerInstanceMemories.MotRplCoggPrm.CoggOrder1 /end MEASUREMENT
/begin MEASUREMENT MotRplCoggCfg.MotRplCoggPrm.CoggOrder1X "MICROSAR RTE" SWORD NO_COMPU_METHOD 0 0 -32768 32767 ECU_ADDRESS 0 SYMBOL_LINK "Rte_MotRplCoggCfg_MotRplCoggPrm.CoggOrder1X" 0 DISPLAY_IDENTIFIER MotRplCoggCfg.PerInstanceMemories.MotRplCoggPrm.CoggOrder1X /end MEASUREMENT
/begin MEASUREMENT MotRplCoggCfg.MotRplCoggPrm.CoggOrder1Y "MICROSAR RTE" SWORD NO_COMPU_METHOD 0 0 -32768 32767 ECU_ADDRESS 0 SYMBOL_LINK "Rte_MotRplCoggCfg_MotRplCoggPrm.CoggOrder1Y" 0 DISPLAY_IDENTIFIER MotRplCoggCfg.PerInstanceMemories.MotRplCoggPrm.CoggOrder1Y /end MEASUREMENT
/begin MEASUREMENT MotRplCoggCfg.MotRplCoggPrm.CoggOrder2 "MICROSAR RTE" UWORD NO_COMPU_METHOD 0 0 0 65535 ECU_ADDRESS 0 SYMBOL_LINK "Rte_MotRplCoggCfg_MotRplCoggPrm.CoggOrder2" 0 DISPLAY_IDENTIFIER MotRplCoggCfg.PerInstanceMemories.MotRplCoggPrm.CoggOrder2 /end MEASUREMENT
/begin MEASUREMENT MotRplCoggCfg.MotRplCoggPrm.CoggOrder2X "MICROSAR RTE" SWORD NO_COMPU_METHOD 0 0 -32768 32767 ECU_ADDRESS 0 SYMBOL_LINK "Rte_MotRplCoggCfg_MotRplCoggPrm.CoggOrder2X" 0 DISPLAY_IDENTIFIER MotRplCoggCfg.PerInstanceMemories.MotRplCoggPrm.CoggOrder2X /end MEASUREMENT
/begin MEASUREMENT MotRplCoggCfg.MotRplCoggPrm.CoggOrder2Y "MICROSAR RTE" SWORD NO_COMPU_METHOD 0 0 -32768 32767 ECU_ADDRESS 0 SYMBOL_LINK "Rte_MotRplCoggCfg_MotRplCoggPrm.CoggOrder2Y" 0 DISPLAY_IDENTIFIER MotRplCoggCfg.PerInstanceMemories.MotRplCoggPrm.CoggOrder2Y /end MEASUREMENT
/begin MEASUREMENT MotRplCoggCfg.MotRplCoggPrm.CoggOrder3 "MICROSAR RTE" UWORD NO_COMPU_METHOD 0 0 0 65535 ECU_ADDRESS 0 SYMBOL_LINK "Rte_MotRplCoggCfg_MotRplCoggPrm.CoggOrder3" 0 DISPLAY_IDENTIFIER MotRplCoggCfg.PerInstanceMemories.MotRplCoggPrm.CoggOrder3 /end MEASUREMENT
/begin MEASUREMENT MotRplCoggCfg.MotRplCoggPrm.CoggOrder3X "MICROSAR RTE" SWORD NO_COMPU_METHOD 0 0 -32768 32767 ECU_ADDRESS 0 SYMBOL_LINK "Rte_MotRplCoggCfg_MotRplCoggPrm.CoggOrder3X" 0 DISPLAY_IDENTIFIER MotRplCoggCfg.PerInstanceMemories.MotRplCoggPrm.CoggOrder3X /end MEASUREMENT
/begin MEASUREMENT MotRplCoggCfg.MotRplCoggPrm.CoggOrder3Y "MICROSAR RTE" SWORD NO_COMPU_METHOD 0 0 -32768 32767 ECU_ADDRESS 0 SYMBOL_LINK "Rte_MotRplCoggCfg_MotRplCoggPrm.CoggOrder3Y" 0 DISPLAY_IDENTIFIER MotRplCoggCfg.PerInstanceMemories.MotRplCoggPrm.CoggOrder3Y /end MEASUREMENT
/begin MEASUREMENT MotRplCoggCfg.MotTqCmdMrfScad.Val "MICROSAR RTE" FLOAT32_IEEE NO_COMPU_METHOD 0 0 -3.402823466e+38 3.402823466e+38 ECU_ADDRESS 0 SYMBOL_LINK "Rte_MotTqCmdSca_MotTqCmdMrfScad_Val" 0 DISPLAY_IDENTIFIER MotRplCoggCfg.ReceiverPorts.MotTqCmdMrfScad.Val /end MEASUREMENT
/begin MEASUREMENT MotRplCoggCfg.MotTqRplCoggOrder1Mgn.Val "MICROSAR RTE" FLOAT32_IEEE NO_COMPU_METHOD 0 0 -3.402823466e+38 3.402823466e+38 ECU_ADDRESS 0 SYMBOL_LINK "Rte_MotRplCoggCfg_MotTqRplCoggOrder1Mgn_Val" 0 DISPLAY_IDENTIFIER MotRplCoggCfg.SenderPorts.MotTqRplCoggOrder1Mgn.Val /end MEASUREMENT
/begin MEASUREMENT MotRplCoggCfg.MotTqRplCoggOrder1Pha.Val "MICROSAR RTE" FLOAT32_IEEE NO_COMPU_METHOD 0 0 -3.402823466e+38 3.402823466e+38 ECU_ADDRESS 0 SYMBOL_LINK "Rte_MotRplCoggCfg_MotTqRplCoggOrder1Pha_Val" 0 DISPLAY_IDENTIFIER MotRplCoggCfg.SenderPorts.MotTqRplCoggOrder1Pha.Val /end MEASUREMENT
/begin MEASUREMENT MotRplCoggCfg.MotTqRplCoggOrder2Mgn.Val "MICROSAR RTE" FLOAT32_IEEE NO_COMPU_METHOD 0 0 -3.402823466e+38 3.402823466e+38 ECU_ADDRESS 0 SYMBOL_LINK "Rte_MotRplCoggCfg_MotTqRplCoggOrder2Mgn_Val" 0 DISPLAY_IDENTIFIER MotRplCoggCfg.SenderPorts.MotTqRplCoggOrder2Mgn.Val /end MEASUREMENT
/begin MEASUREMENT MotRplCoggCfg.MotTqRplCoggOrder2Pha.Val "MICROSAR RTE" FLOAT32_IEEE NO_COMPU_METHOD 0 0 -3.402823466e+38 3.402823466e+38 ECU_ADDRESS 0 SYMBOL_LINK "Rte_MotRplCoggCfg_MotTqRplCoggOrder2Pha_Val" 0 DISPLAY_IDENTIFIER MotRplCoggCfg.SenderPorts.MotTqRplCoggOrder2Pha.Val /end MEASUREMENT
/begin MEASUREMENT MotRplCoggCfg.MotTqRplCoggOrder3Mgn.Val "MICROSAR RTE" FLOAT32_IEEE NO_COMPU_METHOD 0 0 -3.402823466e+38 3.402823466e+38 ECU_ADDRESS 0 SYMBOL_LINK "Rte_MotRplCoggCfg_MotTqRplCoggOrder3Mgn_Val" 0 DISPLAY_IDENTIFIER MotRplCoggCfg.SenderPorts.MotTqRplCoggOrder3Mgn.Val /end MEASUREMENT
/begin MEASUREMENT MotRplCoggCfg.MotTqRplCoggOrder3Pha.Val "MICROSAR RTE" FLOAT32_IEEE NO_COMPU_METHOD 0 0 -3.402823466e+38 3.402823466e+38 ECU_ADDRESS 0 SYMBOL_LINK "Rte_MotRplCoggCfg_MotTqRplCoggOrder3Pha_Val" 0 DISPLAY_IDENTIFIER MotRplCoggCfg.SenderPorts.MotTqRplCoggOrder3Pha.Val /end MEASUREMENT
/begin MEASUREMENT MotRplCoggCfg.MotTqRplOrder1X "MICROSAR RTE" SWORD NO_COMPU_METHOD 0 0 -32768 32767 MATRIX_DIM 12 10 1 ECU_ADDRESS 0 SYMBOL_LINK "Rte_MotRplCoggCfg_MotTqRplOrder1X" 0 DISPLAY_IDENTIFIER MotRplCoggCfg.PerInstanceMemories.MotTqRplOrder1X /end MEASUREMENT
/begin MEASUREMENT MotRplCoggCfg.MotTqRplOrder1Y "MICROSAR RTE" SWORD NO_COMPU_METHOD 0 0 -32768 32767 MATRIX_DIM 12 10 1 ECU_ADDRESS 0 SYMBOL_LINK "Rte_MotRplCoggCfg_MotTqRplOrder1Y" 0 DISPLAY_IDENTIFIER MotRplCoggCfg.PerInstanceMemories.MotTqRplOrder1Y /end MEASUREMENT
/begin MEASUREMENT MotRplCoggCfg.MotTqRplOrder2X "MICROSAR RTE" SWORD NO_COMPU_METHOD 0 0 -32768 32767 MATRIX_DIM 12 10 1 ECU_ADDRESS 0 SYMBOL_LINK "Rte_MotRplCoggCfg_MotTqRplOrder2X" 0 DISPLAY_IDENTIFIER MotRplCoggCfg.PerInstanceMemories.MotTqRplOrder2X /end MEASUREMENT
/begin MEASUREMENT MotRplCoggCfg.MotTqRplOrder2Y "MICROSAR RTE" SWORD NO_COMPU_METHOD 0 0 -32768 32767 MATRIX_DIM 12 10 1 ECU_ADDRESS 0 SYMBOL_LINK "Rte_MotRplCoggCfg_MotTqRplOrder2Y" 0 DISPLAY_IDENTIFIER MotRplCoggCfg.PerInstanceMemories.MotTqRplOrder2Y /end MEASUREMENT
/begin MEASUREMENT MotRplCoggCfg.MotTqRplOrder3X "MICROSAR RTE" SWORD NO_COMPU_METHOD 0 0 -32768 32767 MATRIX_DIM 12 10 1 ECU_ADDRESS 0 SYMBOL_LINK "Rte_MotRplCoggCfg_MotTqRplOrder3X" 0 DISPLAY_IDENTIFIER MotRplCoggCfg.PerInstanceMemories.MotTqRplOrder3X /end MEASUREMENT
/begin MEASUREMENT MotRplCoggCfg.MotTqRplOrder3Y "MICROSAR RTE" SWORD NO_COMPU_METHOD 0 0 -32768 32767 MATRIX_DIM 12 10 1 ECU_ADDRESS 0 SYMBOL_LINK "Rte_MotRplCoggCfg_MotTqRplOrder3Y" 0 DISPLAY_IDENTIFIER MotRplCoggCfg.PerInstanceMemories.MotTqRplOrder3Y /end MEASUREMENT
/begin MEASUREMENT MotRplCoggCfg.MotVelMrf.Val "MICROSAR RTE" FLOAT32_IEEE NO_COMPU_METHOD 0 0 -3.402823466e+38 3.402823466e+38 ECU_ADDRESS 0 SYMBOL_LINK "Rte_CDD_MotVel_MotVelMrf_Val" 0 DISPLAY_IDENTIFIER MotRplCoggCfg.ReceiverPorts.MotVelMrf.Val /end MEASUREMENT
/begin MEASUREMENT MotRplCoggCfg.dMotRplCoggCfgMotAgElecDlyRpl "MICROSAR RTE" FLOAT32_IEEE NO_COMPU_METHOD 0 0 -3.402823466e+38 3.402823466e+38 ECU_ADDRESS 0 SYMBOL_LINK "Rte_MotRplCoggCfg_dMotRplCoggCfgMotAgElecDlyRpl" 0 DISPLAY_IDENTIFIER MotRplCoggCfg.PerInstanceMemories.dMotRplCoggCfgMotAgElecDlyRpl /end MEASUREMENT
/begin MEASUREMENT MotRplCoggCfg.dMotRplCoggCfgMotCurrQaxToMotTqGain "MICROSAR RTE" FLOAT32_IEEE NO_COMPU_METHOD 0 0 -3.402823466e+38 3.402823466e+38 ECU_ADDRESS 0 SYMBOL_LINK "Rte_MotRplCoggCfg_dMotRplCoggCfgMotCurrQaxToMotTqGain" 0 DISPLAY_IDENTIFIER MotRplCoggCfg.PerInstanceMemories.dMotRplCoggCfgMotCurrQaxToMotTqGain /end MEASUREMENT
/begin MEASUREMENT MotRplCoggCfg.dMotRplCoggCfgMotTqRplOrder1Mgn "MICROSAR RTE" FLOAT32_IEEE NO_COMPU_METHOD 0 0 -3.402823466e+38 3.402823466e+38 ECU_ADDRESS 0 SYMBOL_LINK "Rte_MotRplCoggCfg_dMotRplCoggCfgMotTqRplOrder1Mgn" 0 DISPLAY_IDENTIFIER MotRplCoggCfg.PerInstanceMemories.dMotRplCoggCfgMotTqRplOrder1Mgn /end MEASUREMENT
/begin MEASUREMENT MotRplCoggCfg.dMotRplCoggCfgMotTqRplOrder1Pha "MICROSAR RTE" FLOAT32_IEEE NO_COMPU_METHOD 0 0 -3.402823466e+38 3.402823466e+38 ECU_ADDRESS 0 SYMBOL_LINK "Rte_MotRplCoggCfg_dMotRplCoggCfgMotTqRplOrder1Pha" 0 DISPLAY_IDENTIFIER MotRplCoggCfg.PerInstanceMemories.dMotRplCoggCfgMotTqRplOrder1Pha /end MEASUREMENT
/begin MEASUREMENT MotRplCoggCfg.dMotRplCoggCfgMotTqRplOrder2Mgn "MICROSAR RTE" FLOAT32_IEEE NO_COMPU_METHOD 0 0 -3.402823466e+38 3.402823466e+38 ECU_ADDRESS 0 SYMBOL_LINK "Rte_MotRplCoggCfg_dMotRplCoggCfgMotTqRplOrder2Mgn" 0 DISPLAY_IDENTIFIER MotRplCoggCfg.PerInstanceMemories.dMotRplCoggCfgMotTqRplOrder2Mgn /end MEASUREMENT
/begin MEASUREMENT MotRplCoggCfg.dMotRplCoggCfgMotTqRplOrder2Pha "MICROSAR RTE" FLOAT32_IEEE NO_COMPU_METHOD 0 0 -3.402823466e+38 3.402823466e+38 ECU_ADDRESS 0 SYMBOL_LINK "Rte_MotRplCoggCfg_dMotRplCoggCfgMotTqRplOrder2Pha" 0 DISPLAY_IDENTIFIER MotRplCoggCfg.PerInstanceMemories.dMotRplCoggCfgMotTqRplOrder2Pha /end MEASUREMENT
/begin MEASUREMENT MotRplCoggCfg.dMotRplCoggCfgMotTqRplOrder3Mgn "MICROSAR RTE" FLOAT32_IEEE NO_COMPU_METHOD 0 0 -3.402823466e+38 3.402823466e+38 ECU_ADDRESS 0 SYMBOL_LINK "Rte_MotRplCoggCfg_dMotRplCoggCfgMotTqRplOrder3Mgn" 0 DISPLAY_IDENTIFIER MotRplCoggCfg.PerInstanceMemories.dMotRplCoggCfgMotTqRplOrder3Mgn /end MEASUREMENT
/begin MEASUREMENT MotRplCoggCfg.dMotRplCoggCfgMotTqRplOrder3Pha "MICROSAR RTE" FLOAT32_IEEE NO_COMPU_METHOD 0 0 -3.402823466e+38 3.402823466e+38 ECU_ADDRESS 0 SYMBOL_LINK "Rte_MotRplCoggCfg_dMotRplCoggCfgMotTqRplOrder3Pha" 0 DISPLAY_IDENTIFIER MotRplCoggCfg.PerInstanceMemories.dMotRplCoggCfgMotTqRplOrder3Pha /end MEASUREMENT
/begin MEASUREMENT MotTqCmdSca.MotTqCmdMrf.Val "MICROSAR RTE" FLOAT32_IEEE NO_COMPU_METHOD 0 0 -3.402823466e+38 3.402823466e+38 ECU_ADDRESS 0 SYMBOL_LINK "Rte_PwrLimr_MotTqCmdPwrLimd_Val" 0 DISPLAY_IDENTIFIER MotTqCmdSca.ReceiverPorts.MotTqCmdMrf.Val /end MEASUREMENT
/begin MEASUREMENT MotTqCmdSca.MotTqCmdMrfScad.Val "MICROSAR RTE" FLOAT32_IEEE NO_COMPU_METHOD 0 0 -3.402823466e+38 3.402823466e+38 ECU_ADDRESS 0 SYMBOL_LINK "Rte_MotTqCmdSca_MotTqCmdMrfScad_Val" 0 DISPLAY_IDENTIFIER MotTqCmdSca.SenderPorts.MotTqCmdMrfScad.Val /end MEASUREMENT
/begin MEASUREMENT MotTqCmdSca.MotTqScaFac "MICROSAR RTE" FLOAT32_IEEE NO_COMPU_METHOD 0 0 -3.402823466e+38 3.402823466e+38 ECU_ADDRESS 0 SYMBOL_LINK "Rte_MotTqCmdSca_MotTqScaFac" 0 DISPLAY_IDENTIFIER MotTqCmdSca.PerInstanceMemories.MotTqScaFac /end MEASUREMENT
/begin MEASUREMENT MotTqTranlDampg.AssiMechPolarity.Val "MICROSAR RTE" SBYTE NO_COMPU_METHOD 0 0 -128 127 ECU_ADDRESS 0 SYMBOL_LINK "Rte_PolarityCfg_AssiMechPolarity_Val" 0 DISPLAY_IDENTIFIER MotTqTranlDampg.ReceiverPorts.AssiMechPolarity.Val /end MEASUREMENT
/begin MEASUREMENT MotTqTranlDampg.DiagStsPrev "MICROSAR RTE" UBYTE RTE_CM_BOOLEAN 0 0 0 255 ECU_ADDRESS 0 SYMBOL_LINK "Rte_MotTqTranlDampg_DiagStsPrev" 0 DISPLAY_IDENTIFIER MotTqTranlDampg.PerInstanceMemories.DiagStsPrev /end MEASUREMENT
/begin MEASUREMENT MotTqTranlDampg.DiagcStsCtrldShtDwnFltPrsnt.Logl "MICROSAR RTE" UBYTE RTE_CM_BOOLEAN 0 0 0 255 ECU_ADDRESS 0 SYMBOL_LINK "Rte_DiagcMgr_DiagcStsCtrldShtDwnFltPrsnt_Logl" 0 DISPLAY_IDENTIFIER MotTqTranlDampg.ReceiverPorts.DiagcStsCtrldShtDwnFltPrsnt.Logl /end MEASUREMENT
/begin MEASUREMENT MotTqTranlDampg.HwAg.Val "MICROSAR RTE" FLOAT32_IEEE NO_COMPU_METHOD 0 0 -3.402823466e+38 3.402823466e+38 ECU_ADDRESS 0 SYMBOL_LINK "Rte_HwAgSysArbn_PinionAg_Val" 0 DISPLAY_IDENTIFIER MotTqTranlDampg.ReceiverPorts.HwAg.Val /end MEASUREMENT
/begin MEASUREMENT MotTqTranlDampg.LoaSt.Val "MICROSAR RTE" UBYTE RTE_CM_ENUM_LoaSt1 0 0 0 255 ECU_ADDRESS 0 SYMBOL_LINK "Rte_LoaMgr_LoaSt_Val" 0 DISPLAY_IDENTIFIER MotTqTranlDampg.ReceiverPorts.LoaSt.Val /end MEASUREMENT
/begin MEASUREMENT MotTqTranlDampg.LoaStPrev "MICROSAR RTE" UBYTE RTE_CM_ENUM_LoaSt1 0 0 0 255 ECU_ADDRESS 0 SYMBOL_LINK "Rte_MotTqTranlDampg_LoaStPrev" 0 DISPLAY_IDENTIFIER MotTqTranlDampg.PerInstanceMemories.LoaStPrev /end MEASUREMENT
/begin MEASUREMENT MotTqTranlDampg.MotTqCmdCrf.Val "MICROSAR RTE" FLOAT32_IEEE NO_COMPU_METHOD 0 0 -3.402823466e+38 3.402823466e+38 ECU_ADDRESS 0 SYMBOL_LINK "Rte_Swp_MotTqCmdSwp_Val" 0 DISPLAY_IDENTIFIER MotTqTranlDampg.ReceiverPorts.MotTqCmdCrf.Val /end MEASUREMENT
/begin MEASUREMENT MotTqTranlDampg.MotTqCmdCrfDampd.Val "MICROSAR RTE" FLOAT32_IEEE NO_COMPU_METHOD 0 0 -3.402823466e+38 3.402823466e+38 ECU_ADDRESS 0 SYMBOL_LINK "Rte_MotTqTranlDampg_MotTqCmdCrfDampd_Val" 0 DISPLAY_IDENTIFIER MotTqTranlDampg.SenderPorts.MotTqCmdCrfDampd.Val /end MEASUREMENT
/begin MEASUREMENT MotTqTranlDampg.MotTqCmdMrfDampd.Val "MICROSAR RTE" FLOAT32_IEEE NO_COMPU_METHOD 0 0 -3.402823466e+38 3.402823466e+38 ECU_ADDRESS 0 SYMBOL_LINK "Rte_MotTqTranlDampg_MotTqCmdMrfDampd_Val" 0 DISPLAY_IDENTIFIER MotTqTranlDampg.SenderPorts.MotTqCmdMrfDampd.Val /end MEASUREMENT
/begin MEASUREMENT MotTqTranlDampg.MotTqTranlDampgCmpl.Logl "MICROSAR RTE" UBYTE RTE_CM_BOOLEAN 0 0 0 255 ECU_ADDRESS 0 SYMBOL_LINK "Rte_MotTqTranlDampg_MotTqTranlDampgCmpl_Logl" 0 DISPLAY_IDENTIFIER MotTqTranlDampg.SenderPorts.MotTqTranlDampgCmpl.Logl /end MEASUREMENT
/begin MEASUREMENT MotTqTranlDampg.MotVelCrf.Val "MICROSAR RTE" FLOAT32_IEEE NO_COMPU_METHOD 0 0 -3.402823466e+38 3.402823466e+38 ECU_ADDRESS 0 SYMBOL_LINK "Rte_CDD_MotVel_MotVelCrf_Val" 0 DISPLAY_IDENTIFIER MotTqTranlDampg.ReceiverPorts.MotVelCrf.Val /end MEASUREMENT
/begin MEASUREMENT MotTqTranlDampg.StLtch "MICROSAR RTE" UBYTE RTE_CM_BOOLEAN 0 0 0 255 ECU_ADDRESS 0 SYMBOL_LINK "Rte_MotTqTranlDampg_StLtch" 0 DISPLAY_IDENTIFIER MotTqTranlDampg.PerInstanceMemories.StLtch /end MEASUREMENT
/begin MEASUREMENT MotTqTranlDampg.SysSt.Val "MICROSAR RTE" UBYTE RTE_CM_ENUM_SysSt1 0 0 0 255 ECU_ADDRESS 0 SYMBOL_LINK "Rte_SysStMod_SysSt_Val" 0 DISPLAY_IDENTIFIER MotTqTranlDampg.ReceiverPorts.SysSt.Val /end MEASUREMENT
/begin MEASUREMENT MotTqTranlDampg.TmrRefTi "MICROSAR RTE" ULONG NO_COMPU_METHOD 0 0 0 4294967295 ECU_ADDRESS 0 SYMBOL_LINK "Rte_MotTqTranlDampg_TmrRefTi" 0 DISPLAY_IDENTIFIER MotTqTranlDampg.PerInstanceMemories.TmrRefTi /end MEASUREMENT
/begin MEASUREMENT MotTqTranlDampg.VehSpd.Val "MICROSAR RTE" FLOAT32_IEEE NO_COMPU_METHOD 0 0 -3.402823466e+38 3.402823466e+38 ECU_ADDRESS 0 SYMBOL_LINK "Rte_VehSigCdng_VehSpd_Val" 0 DISPLAY_IDENTIFIER MotTqTranlDampg.ReceiverPorts.VehSpd.Val /end MEASUREMENT
/begin MEASUREMENT MotTqTranlDampg.dMotTqTranlDampgCmdCtrld "MICROSAR RTE" FLOAT32_IEEE NO_COMPU_METHOD 0 0 -3.402823466e+38 3.402823466e+38 ECU_ADDRESS 0 SYMBOL_LINK "Rte_MotTqTranlDampg_dMotTqTranlDampgCmdCtrld" 0 DISPLAY_IDENTIFIER MotTqTranlDampg.PerInstanceMemories.dMotTqTranlDampgCmdCtrld /end MEASUREMENT
/begin MEASUREMENT MotTqTranlDampg.dMotTqTranlDampgSignPhaSca "MICROSAR RTE" FLOAT32_IEEE NO_COMPU_METHOD 0 0 -3.402823466e+38 3.402823466e+38 ECU_ADDRESS 0 SYMBOL_LINK "Rte_MotTqTranlDampg_dMotTqTranlDampgSignPhaSca" 0 DISPLAY_IDENTIFIER MotTqTranlDampg.PerInstanceMemories.dMotTqTranlDampgSignPhaSca /end MEASUREMENT
/begin MEASUREMENT MotTqTranlDampg.dMotTqTranlDampgTiElpd "MICROSAR RTE" FLOAT32_IEEE NO_COMPU_METHOD 0 0 -3.402823466e+38 3.402823466e+38 ECU_ADDRESS 0 SYMBOL_LINK "Rte_MotTqTranlDampg_dMotTqTranlDampgTiElpd" 0 DISPLAY_IDENTIFIER MotTqTranlDampg.PerInstanceMemories.dMotTqTranlDampgTiElpd /end MEASUREMENT
/begin MEASUREMENT MotTqTranlDampg.dMotTqTranlDampgTmrEna "MICROSAR RTE" UBYTE RTE_CM_BOOLEAN 0 0 0 255 ECU_ADDRESS 0 SYMBOL_LINK "Rte_MotTqTranlDampg_dMotTqTranlDampgTmrEna" 0 DISPLAY_IDENTIFIER MotTqTranlDampg.PerInstanceMemories.dMotTqTranlDampgTmrEna /end MEASUREMENT
/begin MEASUREMENT MotTqTranlDampg.dMotTqTranlDampgVelDampgCmd "MICROSAR RTE" FLOAT32_IEEE NO_COMPU_METHOD 0 0 -3.402823466e+38 3.402823466e+38 ECU_ADDRESS 0 SYMBOL_LINK "Rte_MotTqTranlDampg_dMotTqTranlDampgVelDampgCmd" 0 DISPLAY_IDENTIFIER MotTqTranlDampg.PerInstanceMemories.dMotTqTranlDampgVelDampgCmd /end MEASUREMENT
/begin MEASUREMENT MotVelCtrl.EnaCtrl "MICROSAR RTE" UBYTE RTE_CM_BOOLEAN 0 0 0 255 ECU_ADDRESS 0 SYMBOL_LINK "Rte_MotVelCtrl_EnaCtrl" 0 DISPLAY_IDENTIFIER MotVelCtrl.PerInstanceMemories.EnaCtrl /end MEASUREMENT
/begin MEASUREMENT MotVelCtrl.EnaCtrlStVari "MICROSAR RTE" UBYTE RTE_CM_BOOLEAN 0 0 0 255 ECU_ADDRESS 0 SYMBOL_LINK "Rte_MotVelCtrl_EnaCtrlStVari" 0 DISPLAY_IDENTIFIER MotVelCtrl.PerInstanceMemories.EnaCtrlStVari /end MEASUREMENT
/begin MEASUREMENT MotVelCtrl.FctActvSts "MICROSAR RTE" UBYTE RTE_CM_BOOLEAN 0 0 0 255 ECU_ADDRESS 0 SYMBOL_LINK "Rte_MotVelCtrl_FctActvSts" 0 DISPLAY_IDENTIFIER MotVelCtrl.PerInstanceMemories.FctActvSts /end MEASUREMENT
/begin MEASUREMENT MotVelCtrl.MotVelCrf.Val "MICROSAR RTE" FLOAT32_IEEE NO_COMPU_METHOD 0 0 -3.402823466e+38 3.402823466e+38 ECU_ADDRESS 0 SYMBOL_LINK "Rte_CDD_MotVel_MotVelCrf_Val" 0 DISPLAY_IDENTIFIER MotVelCtrl.ReceiverPorts.MotVelCrf.Val /end MEASUREMENT
/begin MEASUREMENT MotVelCtrl.MotVelTar "MICROSAR RTE" FLOAT32_IEEE NO_COMPU_METHOD 0 0 -3.402823466e+38 3.402823466e+38 ECU_ADDRESS 0 SYMBOL_LINK "Rte_MotVelCtrl_MotVelTar" 0 DISPLAY_IDENTIFIER MotVelCtrl.PerInstanceMemories.MotVelTar /end MEASUREMENT
/begin MEASUREMENT MotVelCtrl.PrevAntiWdupCmd "MICROSAR RTE" FLOAT32_IEEE NO_COMPU_METHOD 0 0 -3.402823466e+38 3.402823466e+38 ECU_ADDRESS 0 SYMBOL_LINK "Rte_MotVelCtrl_PrevAntiWdupCmd" 0 DISPLAY_IDENTIFIER MotVelCtrl.PerInstanceMemories.PrevAntiWdupCmd /end MEASUREMENT
/begin MEASUREMENT MotVelCtrl.PrevDerivtvOutp "MICROSAR RTE" FLOAT32_IEEE NO_COMPU_METHOD 0 0 -3.402823466e+38 3.402823466e+38 ECU_ADDRESS 0 SYMBOL_LINK "Rte_MotVelCtrl_PrevDerivtvOutp" 0 DISPLAY_IDENTIFIER MotVelCtrl.PerInstanceMemories.PrevDerivtvOutp /end MEASUREMENT
/begin MEASUREMENT MotVelCtrl.PrevIntgtrInp "MICROSAR RTE" FLOAT32_IEEE NO_COMPU_METHOD 0 0 -3.402823466e+38 3.402823466e+38 ECU_ADDRESS 0 SYMBOL_LINK "Rte_MotVelCtrl_PrevIntgtrInp" 0 DISPLAY_IDENTIFIER MotVelCtrl.PerInstanceMemories.PrevIntgtrInp /end MEASUREMENT
/begin MEASUREMENT MotVelCtrl.PrevIntgtrOutp "MICROSAR RTE" FLOAT32_IEEE NO_COMPU_METHOD 0 0 -3.402823466e+38 3.402823466e+38 ECU_ADDRESS 0 SYMBOL_LINK "Rte_MotVelCtrl_PrevIntgtrOutp" 0 DISPLAY_IDENTIFIER MotVelCtrl.PerInstanceMemories.PrevIntgtrOutp /end MEASUREMENT
/begin MEASUREMENT MotVelCtrl.PrevMotVelErr "MICROSAR RTE" FLOAT32_IEEE NO_COMPU_METHOD 0 0 -3.402823466e+38 3.402823466e+38 ECU_ADDRESS 0 SYMBOL_LINK "Rte_MotVelCtrl_PrevMotVelErr" 0 DISPLAY_IDENTIFIER MotVelCtrl.PerInstanceMemories.PrevMotVelErr /end MEASUREMENT
/begin MEASUREMENT MotVelCtrl.PrevMotVelTar "MICROSAR RTE" FLOAT32_IEEE NO_COMPU_METHOD 0 0 -3.402823466e+38 3.402823466e+38 ECU_ADDRESS 0 SYMBOL_LINK "Rte_MotVelCtrl_PrevMotVelTar" 0 DISPLAY_IDENTIFIER MotVelCtrl.PerInstanceMemories.PrevMotVelTar /end MEASUREMENT
/begin MEASUREMENT MotVelCtrl.RampDwnCmpl "MICROSAR RTE" UBYTE RTE_CM_BOOLEAN 0 0 0 255 ECU_ADDRESS 0 SYMBOL_LINK "Rte_MotVelCtrl_RampDwnCmpl" 0 DISPLAY_IDENTIFIER MotVelCtrl.PerInstanceMemories.RampDwnCmpl /end MEASUREMENT
/begin MEASUREMENT MotVelCtrl.RefTiRampDwn "MICROSAR RTE" ULONG NO_COMPU_METHOD 0 0 0 4294967295 ECU_ADDRESS 0 SYMBOL_LINK "Rte_MotVelCtrl_RefTiRampDwn" 0 DISPLAY_IDENTIFIER MotVelCtrl.PerInstanceMemories.RefTiRampDwn /end MEASUREMENT
/begin MEASUREMENT MotVelCtrl.VelSlewRate "MICROSAR RTE" FLOAT32_IEEE NO_COMPU_METHOD 0 0 -3.402823466e+38 3.402823466e+38 ECU_ADDRESS 0 SYMBOL_LINK "Rte_MotVelCtrl_VelSlewRate" 0 DISPLAY_IDENTIFIER MotVelCtrl.PerInstanceMemories.VelSlewRate /end MEASUREMENT
/begin MEASUREMENT PartNr.PartNrBasMdlPartNr "MICROSAR RTE" UBYTE NO_COMPU_METHOD 0 0 0 255 MATRIX_DIM 6 1 1 ECU_ADDRESS 0 SYMBOL_LINK "Rte_PartNr_PartNrBasMdlPartNr" 0 DISPLAY_IDENTIFIER PartNr.PerInstanceMemories.PartNrBasMdlPartNr /end MEASUREMENT
/begin MEASUREMENT PartNr.PartNrCalProgdSts "MICROSAR RTE" UBYTE NO_COMPU_METHOD 0 0 0 255 ECU_ADDRESS 0 SYMBOL_LINK "Rte_PartNr_PartNrCalProgdSts" 0 DISPLAY_IDENTIFIER PartNr.PerInstanceMemories.PartNrCalProgdSts /end MEASUREMENT
/begin MEASUREMENT PartNr.PartNrCcaMfgTrakg "MICROSAR RTE" UBYTE NO_COMPU_METHOD 0 0 0 255 MATRIX_DIM 9 1 1 ECU_ADDRESS 0 SYMBOL_LINK "Rte_PartNr_PartNrCcaMfgTrakg" 0 DISPLAY_IDENTIFIER PartNr.PerInstanceMemories.PartNrCcaMfgTrakg /end MEASUREMENT
/begin MEASUREMENT PartNr.PartNrCtrlPidSeedKey "MICROSAR RTE" UBYTE NO_COMPU_METHOD 0 0 0 255 MATRIX_DIM 10 1 1 ECU_ADDRESS 0 SYMBOL_LINK "Rte_PartNr_PartNrCtrlPidSeedKey" 0 DISPLAY_IDENTIFIER PartNr.PerInstanceMemories.PartNrCtrlPidSeedKey /end MEASUREMENT
/begin MEASUREMENT PartNr.PartNrCustMfgEnaCntr "MICROSAR RTE" UBYTE NO_COMPU_METHOD 0 0 0 255 ECU_ADDRESS 0 SYMBOL_LINK "Rte_PartNr_PartNrCustMfgEnaCntr" 0 DISPLAY_IDENTIFIER PartNr.PerInstanceMemories.PartNrCustMfgEnaCntr /end MEASUREMENT
/begin MEASUREMENT PartNr.PartNrDataUniversalNrSysId "MICROSAR RTE" UBYTE NO_COMPU_METHOD 0 0 0 255 MATRIX_DIM 9 1 1 ECU_ADDRESS 0 SYMBOL_LINK "Rte_PartNr_PartNrDataUniversalNrSysId" 0 DISPLAY_IDENTIFIER PartNr.PerInstanceMemories.PartNrDataUniversalNrSysId /end MEASUREMENT
/begin MEASUREMENT PartNr.PartNrEcuId "MICROSAR RTE" UBYTE NO_COMPU_METHOD 0 0 0 255 MATRIX_DIM 16 1 1 ECU_ADDRESS 0 SYMBOL_LINK "Rte_PartNr_PartNrEcuId" 0 DISPLAY_IDENTIFIER PartNr.PerInstanceMemories.PartNrEcuId /end MEASUREMENT
/begin MEASUREMENT PartNr.PartNrEndMdlPartNr "MICROSAR RTE" UBYTE NO_COMPU_METHOD 0 0 0 255 MATRIX_DIM 6 1 1 ECU_ADDRESS 0 SYMBOL_LINK "Rte_PartNr_PartNrEndMdlPartNr" 0 DISPLAY_IDENTIFIER PartNr.PerInstanceMemories.PartNrEndMdlPartNr /end MEASUREMENT
/begin MEASUREMENT PartNr.PartNrNxtrMfgTrakg "MICROSAR RTE" UBYTE NO_COMPU_METHOD 0 0 0 255 MATRIX_DIM 7 1 1 ECU_ADDRESS 0 SYMBOL_LINK "Rte_PartNr_PartNrNxtrMfgTrakg" 0 DISPLAY_IDENTIFIER PartNr.PerInstanceMemories.PartNrNxtrMfgTrakg /end MEASUREMENT
/begin MEASUREMENT PartNr.PartNrPrevSysPwrModRun "MICROSAR RTE" UBYTE RTE_CM_BOOLEAN 0 0 0 255 ECU_ADDRESS 0 SYMBOL_LINK "Rte_PartNr_PartNrPrevSysPwrModRun" 0 DISPLAY_IDENTIFIER PartNr.PerInstanceMemories.PartNrPrevSysPwrModRun /end MEASUREMENT
/begin MEASUREMENT PartNr.PartNrProgmDate "MICROSAR RTE" UBYTE NO_COMPU_METHOD 0 0 0 255 MATRIX_DIM 4 1 1 ECU_ADDRESS 0 SYMBOL_LINK "Rte_PartNr_PartNrProgmDate" 0 DISPLAY_IDENTIFIER PartNr.PerInstanceMemories.PartNrProgmDate /end MEASUREMENT
/begin MEASUREMENT PartNr.PartNrProgmSessionSeedKey "MICROSAR RTE" UBYTE NO_COMPU_METHOD 0 0 0 255 MATRIX_DIM 10 1 1 ECU_ADDRESS 0 SYMBOL_LINK "Rte_PartNr_PartNrProgmSessionSeedKey" 0 DISPLAY_IDENTIFIER PartNr.PerInstanceMemories.PartNrProgmSessionSeedKey /end MEASUREMENT
/begin MEASUREMENT PartNr.PartNrRepairShopCod "MICROSAR RTE" UBYTE NO_COMPU_METHOD 0 0 0 255 MATRIX_DIM 20 1 1 ECU_ADDRESS 0 SYMBOL_LINK "Rte_PartNr_PartNrRepairShopCod" 0 DISPLAY_IDENTIFIER PartNr.PerInstanceMemories.PartNrRepairShopCod /end MEASUREMENT
/begin MEASUREMENT PartNr.PartNrSecuBypAuthn "MICROSAR RTE" UBYTE NO_COMPU_METHOD 0 0 0 255 MATRIX_DIM 822 1 1 ECU_ADDRESS 0 SYMBOL_LINK "Rte_PartNr_PartNrSecuBypAuthn" 0 DISPLAY_IDENTIFIER PartNr.PerInstanceMemories.PartNrSecuBypAuthn /end MEASUREMENT
/begin MEASUREMENT PartNr.PartNrSysCodVersNr "MICROSAR RTE" UBYTE NO_COMPU_METHOD 0 0 0 255 MATRIX_DIM 2 1 1 ECU_ADDRESS 0 SYMBOL_LINK "Rte_PartNr_PartNrSysCodVersNr" 0 DISPLAY_IDENTIFIER PartNr.PerInstanceMemories.PartNrSysCodVersNr /end MEASUREMENT
/begin MEASUREMENT PartNr.PartNrSysName "MICROSAR RTE" UBYTE NO_COMPU_METHOD 0 0 0 255 MATRIX_DIM 20 1 1 ECU_ADDRESS 0 SYMBOL_LINK "Rte_PartNr_PartNrSysName" 0 DISPLAY_IDENTIFIER PartNr.PerInstanceMemories.PartNrSysName /end MEASUREMENT
/begin MEASUREMENT PartNr.PartNrVinData "MICROSAR RTE" UBYTE NO_COMPU_METHOD 0 0 0 255 MATRIX_DIM 17 1 1 ECU_ADDRESS 0 SYMBOL_LINK "Rte_PartNr_PartNrVinData" 0 DISPLAY_IDENTIFIER PartNr.PerInstanceMemories.PartNrVinData /end MEASUREMENT
/begin MEASUREMENT PartNr.SysPwrModRun.Logl "MICROSAR RTE" UBYTE RTE_CM_BOOLEAN 0 0 0 255 ECU_ADDRESS 0 SYMBOL_LINK "Rte_GmMsg1F1BusHiSpd_SysPwrModRun_Logl" 0 DISPLAY_IDENTIFIER PartNr.ReceiverPorts.SysPwrModRun.Logl /end MEASUREMENT
/begin MEASUREMENT PolarityCfg.AssiMechPolarity.Val "MICROSAR RTE" SBYTE NO_COMPU_METHOD 0 0 -1.0 1.0 ECU_ADDRESS 0 SYMBOL_LINK "Rte_PolarityCfg_AssiMechPolarity_Val" 0 DISPLAY_IDENTIFIER PolarityCfg.SenderPorts.AssiMechPolarity.Val /end MEASUREMENT
/begin MEASUREMENT PolarityCfg.HwAg0Polarity.Val "MICROSAR RTE" SBYTE NO_COMPU_METHOD 0 0 -1.0 1.0 ECU_ADDRESS 0 SYMBOL_LINK "Rte_PolarityCfg_HwAg0Polarity_Val" 0 DISPLAY_IDENTIFIER PolarityCfg.SenderPorts.HwAg0Polarity.Val /end MEASUREMENT
/begin MEASUREMENT PolarityCfg.HwAg1Polarity.Val "MICROSAR RTE" SBYTE NO_COMPU_METHOD 0 0 -1.0 1.0 ECU_ADDRESS 0 SYMBOL_LINK "Rte_PolarityCfg_HwAg1Polarity_Val" 0 DISPLAY_IDENTIFIER PolarityCfg.SenderPorts.HwAg1Polarity.Val /end MEASUREMENT
/begin MEASUREMENT PolarityCfg.HwAg2Polarity.Val "MICROSAR RTE" SBYTE NO_COMPU_METHOD 0 0 -1.0 1.0 ECU_ADDRESS 0 SYMBOL_LINK "Rte_PolarityCfg_HwAg2Polarity_Val" 0 DISPLAY_IDENTIFIER PolarityCfg.SenderPorts.HwAg2Polarity.Val /end MEASUREMENT
/begin MEASUREMENT PolarityCfg.HwAg3Polarity.Val "MICROSAR RTE" SBYTE NO_COMPU_METHOD 0 0 -1.0 1.0 ECU_ADDRESS 0 SYMBOL_LINK "Rte_PolarityCfg_HwAg3Polarity_Val" 0 DISPLAY_IDENTIFIER PolarityCfg.SenderPorts.HwAg3Polarity.Val /end MEASUREMENT
/begin MEASUREMENT PolarityCfg.HwAg4Polarity.Val "MICROSAR RTE" SBYTE NO_COMPU_METHOD 0 0 -1.0 1.0 ECU_ADDRESS 0 SYMBOL_LINK "Rte_PolarityCfg_HwAg4Polarity_Val" 0 DISPLAY_IDENTIFIER PolarityCfg.SenderPorts.HwAg4Polarity.Val /end MEASUREMENT
/begin MEASUREMENT PolarityCfg.HwAg5Polarity.Val "MICROSAR RTE" SBYTE NO_COMPU_METHOD 0 0 -1.0 1.0 ECU_ADDRESS 0 SYMBOL_LINK "Rte_PolarityCfg_HwAg5Polarity_Val" 0 DISPLAY_IDENTIFIER PolarityCfg.SenderPorts.HwAg5Polarity.Val /end MEASUREMENT
/begin MEASUREMENT PolarityCfg.HwAg6Polarity.Val "MICROSAR RTE" SBYTE NO_COMPU_METHOD 0 0 -1.0 1.0 ECU_ADDRESS 0 SYMBOL_LINK "Rte_PolarityCfg_HwAg6Polarity_Val" 0 DISPLAY_IDENTIFIER PolarityCfg.SenderPorts.HwAg6Polarity.Val /end MEASUREMENT
/begin MEASUREMENT PolarityCfg.HwAg7Polarity.Val "MICROSAR RTE" SBYTE NO_COMPU_METHOD 0 0 -1.0 1.0 ECU_ADDRESS 0 SYMBOL_LINK "Rte_PolarityCfg_HwAg7Polarity_Val" 0 DISPLAY_IDENTIFIER PolarityCfg.SenderPorts.HwAg7Polarity.Val /end MEASUREMENT
/begin MEASUREMENT PolarityCfg.HwTq0Polarity.Val "MICROSAR RTE" SBYTE NO_COMPU_METHOD 0 0 -1.0 1.0 ECU_ADDRESS 0 SYMBOL_LINK "Rte_PolarityCfg_HwTq0Polarity_Val" 0 DISPLAY_IDENTIFIER PolarityCfg.SenderPorts.HwTq0Polarity.Val /end MEASUREMENT
/begin MEASUREMENT PolarityCfg.HwTq1Polarity.Val "MICROSAR RTE" SBYTE NO_COMPU_METHOD 0 0 -1.0 1.0 ECU_ADDRESS 0 SYMBOL_LINK "Rte_PolarityCfg_HwTq1Polarity_Val" 0 DISPLAY_IDENTIFIER PolarityCfg.SenderPorts.HwTq1Polarity.Val /end MEASUREMENT
/begin MEASUREMENT PolarityCfg.HwTq2Polarity.Val "MICROSAR RTE" SBYTE NO_COMPU_METHOD 0 0 -1.0 1.0 ECU_ADDRESS 0 SYMBOL_LINK "Rte_PolarityCfg_HwTq2Polarity_Val" 0 DISPLAY_IDENTIFIER PolarityCfg.SenderPorts.HwTq2Polarity.Val /end MEASUREMENT
/begin MEASUREMENT PolarityCfg.HwTq3Polarity.Val "MICROSAR RTE" SBYTE NO_COMPU_METHOD 0 0 -1.0 1.0 ECU_ADDRESS 0 SYMBOL_LINK "Rte_PolarityCfg_HwTq3Polarity_Val" 0 DISPLAY_IDENTIFIER PolarityCfg.SenderPorts.HwTq3Polarity.Val /end MEASUREMENT
/begin MEASUREMENT PolarityCfg.HwTq4Polarity.Val "MICROSAR RTE" SBYTE NO_COMPU_METHOD 0 0 -1.0 1.0 ECU_ADDRESS 0 SYMBOL_LINK "Rte_PolarityCfg_HwTq4Polarity_Val" 0 DISPLAY_IDENTIFIER PolarityCfg.SenderPorts.HwTq4Polarity.Val /end MEASUREMENT
/begin MEASUREMENT PolarityCfg.HwTq5Polarity.Val "MICROSAR RTE" SBYTE NO_COMPU_METHOD 0 0 -1.0 1.0 ECU_ADDRESS 0 SYMBOL_LINK "Rte_PolarityCfg_HwTq5Polarity_Val" 0 DISPLAY_IDENTIFIER PolarityCfg.SenderPorts.HwTq5Polarity.Val /end MEASUREMENT
/begin MEASUREMENT PolarityCfg.HwTq6Polarity.Val "MICROSAR RTE" SBYTE NO_COMPU_METHOD 0 0 -1.0 1.0 ECU_ADDRESS 0 SYMBOL_LINK "Rte_PolarityCfg_HwTq6Polarity_Val" 0 DISPLAY_IDENTIFIER PolarityCfg.SenderPorts.HwTq6Polarity.Val /end MEASUREMENT
/begin MEASUREMENT PolarityCfg.HwTq7Polarity.Val "MICROSAR RTE" SBYTE NO_COMPU_METHOD 0 0 -1.0 1.0 ECU_ADDRESS 0 SYMBOL_LINK "Rte_PolarityCfg_HwTq7Polarity_Val" 0 DISPLAY_IDENTIFIER PolarityCfg.SenderPorts.HwTq7Polarity.Val /end MEASUREMENT
/begin MEASUREMENT PolarityCfg.MotAgMecl0Polarity.Val "MICROSAR RTE" SBYTE NO_COMPU_METHOD 0 0 -1.0 1.0 ECU_ADDRESS 0 SYMBOL_LINK "Rte_PolarityCfg_MotAgMecl0Polarity_Val" 0 DISPLAY_IDENTIFIER PolarityCfg.SenderPorts.MotAgMecl0Polarity.Val /end MEASUREMENT
/begin MEASUREMENT PolarityCfg.MotAgMecl1Polarity.Val "MICROSAR RTE" SBYTE NO_COMPU_METHOD 0 0 -1.0 1.0 ECU_ADDRESS 0 SYMBOL_LINK "Rte_PolarityCfg_MotAgMecl1Polarity_Val" 0 DISPLAY_IDENTIFIER PolarityCfg.SenderPorts.MotAgMecl1Polarity.Val /end MEASUREMENT
/begin MEASUREMENT PolarityCfg.MotAgMecl2Polarity.Val "MICROSAR RTE" SBYTE NO_COMPU_METHOD 0 0 -1.0 1.0 ECU_ADDRESS 0 SYMBOL_LINK "Rte_PolarityCfg_MotAgMecl2Polarity_Val" 0 DISPLAY_IDENTIFIER PolarityCfg.SenderPorts.MotAgMecl2Polarity.Val /end MEASUREMENT
/begin MEASUREMENT PolarityCfg.MotAgMecl3Polarity.Val "MICROSAR RTE" SBYTE NO_COMPU_METHOD 0 0 -1.0 1.0 ECU_ADDRESS 0 SYMBOL_LINK "Rte_PolarityCfg_MotAgMecl3Polarity_Val" 0 DISPLAY_IDENTIFIER PolarityCfg.SenderPorts.MotAgMecl3Polarity.Val /end MEASUREMENT
/begin MEASUREMENT PolarityCfg.MotAgMecl4Polarity.Val "MICROSAR RTE" SBYTE NO_COMPU_METHOD 0 0 -1.0 1.0 ECU_ADDRESS 0 SYMBOL_LINK "Rte_PolarityCfg_MotAgMecl4Polarity_Val" 0 DISPLAY_IDENTIFIER PolarityCfg.SenderPorts.MotAgMecl4Polarity.Val /end MEASUREMENT
/begin MEASUREMENT PolarityCfg.MotAgMecl5Polarity.Val "MICROSAR RTE" SBYTE NO_COMPU_METHOD 0 0 -1.0 1.0 ECU_ADDRESS 0 SYMBOL_LINK "Rte_PolarityCfg_MotAgMecl5Polarity_Val" 0 DISPLAY_IDENTIFIER PolarityCfg.SenderPorts.MotAgMecl5Polarity.Val /end MEASUREMENT
/begin MEASUREMENT PolarityCfg.MotAgMecl6Polarity.Val "MICROSAR RTE" SBYTE NO_COMPU_METHOD 0 0 -1.0 1.0 ECU_ADDRESS 0 SYMBOL_LINK "Rte_PolarityCfg_MotAgMecl6Polarity_Val" 0 DISPLAY_IDENTIFIER PolarityCfg.SenderPorts.MotAgMecl6Polarity.Val /end MEASUREMENT
/begin MEASUREMENT PolarityCfg.MotAgMecl7Polarity.Val "MICROSAR RTE" SBYTE NO_COMPU_METHOD 0 0 -1.0 1.0 ECU_ADDRESS 0 SYMBOL_LINK "Rte_PolarityCfg_MotAgMecl7Polarity_Val" 0 DISPLAY_IDENTIFIER PolarityCfg.SenderPorts.MotAgMecl7Polarity.Val /end MEASUREMENT
/begin MEASUREMENT PolarityCfg.MotElecMeclPolarity.Val "MICROSAR RTE" SBYTE NO_COMPU_METHOD 0 0 -1.0 1.0 ECU_ADDRESS 0 SYMBOL_LINK "Rte_PolarityCfg_MotElecMeclPolarity_Val" 0 DISPLAY_IDENTIFIER PolarityCfg.SenderPorts.MotElecMeclPolarity.Val /end MEASUREMENT
/begin MEASUREMENT PolarityCfg.PolarityCfgSaved "MICROSAR RTE" ULONG NO_COMPU_METHOD 0 0 0 4294967295 ECU_ADDRESS 0 SYMBOL_LINK "Rte_PolarityCfg_PolarityCfgSaved" 0 DISPLAY_IDENTIFIER PolarityCfg.PerInstanceMemories.PolarityCfgSaved /end MEASUREMENT
/begin MEASUREMENT PullCmpActv.CmpLrnTiDecShoTerm "MICROSAR RTE" FLOAT32_IEEE NO_COMPU_METHOD 0 0 -3.402823466e+38 3.402823466e+38 ECU_ADDRESS 0 SYMBOL_LINK "Rte_PullCmpActv_CmpLrnTiDecShoTerm" 0 DISPLAY_IDENTIFIER PullCmpActv.PerInstanceMemories.CmpLrnTiDecShoTerm /end MEASUREMENT
/begin MEASUREMENT PullCmpActv.CmpLrnTiIncShoTerm "MICROSAR RTE" FLOAT32_IEEE NO_COMPU_METHOD 0 0 -3.402823466e+38 3.402823466e+38 ECU_ADDRESS 0 SYMBOL_LINK "Rte_PullCmpActv_CmpLrnTiIncShoTerm" 0 DISPLAY_IDENTIFIER PullCmpActv.PerInstanceMemories.CmpLrnTiIncShoTerm /end MEASUREMENT
/begin MEASUREMENT PullCmpActv.CmpLrnTiLongTerm "MICROSAR RTE" FLOAT32_IEEE NO_COMPU_METHOD 0 0 -3.402823466e+38 3.402823466e+38 ECU_ADDRESS 0 SYMBOL_LINK "Rte_PullCmpActv_CmpLrnTiLongTerm" 0 DISPLAY_IDENTIFIER PullCmpActv.PerInstanceMemories.CmpLrnTiLongTerm /end MEASUREMENT
/begin MEASUREMENT PullCmpActv.HwAg.Val "MICROSAR RTE" FLOAT32_IEEE NO_COMPU_METHOD 0 0 -3.402823466e+38 3.402823466e+38 ECU_ADDRESS 0 SYMBOL_LINK "Rte_HwAgSysArbn_PinionAg_Val" 0 DISPLAY_IDENTIFIER PullCmpActv.ReceiverPorts.HwAg.Val /end MEASUREMENT
/begin MEASUREMENT PullCmpActv.HwTq.Val "MICROSAR RTE" FLOAT32_IEEE NO_COMPU_METHOD 0 0 -3.402823466e+38 3.402823466e+38 ECU_ADDRESS 0 SYMBOL_LINK "Rte_Swp_HwTqSwp_Val" 0 DISPLAY_IDENTIFIER PullCmpActv.ReceiverPorts.HwTq.Val /end MEASUREMENT
/begin MEASUREMENT PullCmpActv.HwTqLpFilLongTerm.FilGain "MICROSAR RTE" FLOAT32_IEEE NO_COMPU_METHOD 0 0 -3.402823466e+38 3.402823466e+38 ECU_ADDRESS 0 SYMBOL_LINK "Rte_PullCmpActv_HwTqLpFilLongTerm.FilGain" 0 DISPLAY_IDENTIFIER PullCmpActv.PerInstanceMemories.HwTqLpFilLongTerm.FilGain /end MEASUREMENT
/begin MEASUREMENT PullCmpActv.HwTqLpFilLongTerm.FilSt "MICROSAR RTE" FLOAT32_IEEE NO_COMPU_METHOD 0 0 -3.402823466e+38 3.402823466e+38 ECU_ADDRESS 0 SYMBOL_LINK "Rte_PullCmpActv_HwTqLpFilLongTerm.FilSt" 0 DISPLAY_IDENTIFIER PullCmpActv.PerInstanceMemories.HwTqLpFilLongTerm.FilSt /end MEASUREMENT
/begin MEASUREMENT PullCmpActv.HwTqLpFilLrngEna.FilGain "MICROSAR RTE" FLOAT32_IEEE NO_COMPU_METHOD 0 0 -3.402823466e+38 3.402823466e+38 ECU_ADDRESS 0 SYMBOL_LINK "Rte_PullCmpActv_HwTqLpFilLrngEna.FilGain" 0 DISPLAY_IDENTIFIER PullCmpActv.PerInstanceMemories.HwTqLpFilLrngEna.FilGain /end MEASUREMENT
/begin MEASUREMENT PullCmpActv.HwTqLpFilLrngEna.FilSt "MICROSAR RTE" FLOAT32_IEEE NO_COMPU_METHOD 0 0 -3.402823466e+38 3.402823466e+38 ECU_ADDRESS 0 SYMBOL_LINK "Rte_PullCmpActv_HwTqLpFilLrngEna.FilSt" 0 DISPLAY_IDENTIFIER PullCmpActv.PerInstanceMemories.HwTqLpFilLrngEna.FilSt /end MEASUREMENT
/begin MEASUREMENT PullCmpActv.HwTqLpFilShoTerm.FilGain "MICROSAR RTE" FLOAT32_IEEE NO_COMPU_METHOD 0 0 -3.402823466e+38 3.402823466e+38 ECU_ADDRESS 0 SYMBOL_LINK "Rte_PullCmpActv_HwTqLpFilShoTerm.FilGain" 0 DISPLAY_IDENTIFIER PullCmpActv.PerInstanceMemories.HwTqLpFilShoTerm.FilGain /end MEASUREMENT
/begin MEASUREMENT PullCmpActv.HwTqLpFilShoTerm.FilSt "MICROSAR RTE" FLOAT32_IEEE NO_COMPU_METHOD 0 0 -3.402823466e+38 3.402823466e+38 ECU_ADDRESS 0 SYMBOL_LINK "Rte_PullCmpActv_HwTqLpFilShoTerm.FilSt" 0 DISPLAY_IDENTIFIER PullCmpActv.PerInstanceMemories.HwTqLpFilShoTerm.FilSt /end MEASUREMENT
/begin MEASUREMENT PullCmpActv.HwVel.Val "MICROSAR RTE" FLOAT32_IEEE NO_COMPU_METHOD 0 0 -3.402823466e+38 3.402823466e+38 ECU_ADDRESS 0 SYMBOL_LINK "Rte_CDD_MotVel_HwVel_Val" 0 DISPLAY_IDENTIFIER PullCmpActv.ReceiverPorts.HwVel.Val /end MEASUREMENT
/begin MEASUREMENT PullCmpActv.IntgtrGainDecShoTerm "MICROSAR RTE" FLOAT32_IEEE NO_COMPU_METHOD 0 0 -3.402823466e+38 3.402823466e+38 ECU_ADDRESS 0 SYMBOL_LINK "Rte_PullCmpActv_IntgtrGainDecShoTerm" 0 DISPLAY_IDENTIFIER PullCmpActv.PerInstanceMemories.IntgtrGainDecShoTerm /end MEASUREMENT
/begin MEASUREMENT PullCmpActv.IntgtrGainIncShoTerm "MICROSAR RTE" FLOAT32_IEEE NO_COMPU_METHOD 0 0 -3.402823466e+38 3.402823466e+38 ECU_ADDRESS 0 SYMBOL_LINK "Rte_PullCmpActv_IntgtrGainIncShoTerm" 0 DISPLAY_IDENTIFIER PullCmpActv.PerInstanceMemories.IntgtrGainIncShoTerm /end MEASUREMENT
/begin MEASUREMENT PullCmpActv.LrngEnaPrev "MICROSAR RTE" UBYTE RTE_CM_BOOLEAN 0 0 0 255 ECU_ADDRESS 0 SYMBOL_LINK "Rte_PullCmpActv_LrngEnaPrev" 0 DISPLAY_IDENTIFIER PullCmpActv.PerInstanceMemories.LrngEnaPrev /end MEASUREMENT
/begin MEASUREMENT PullCmpActv.LrngEnad "MICROSAR RTE" UBYTE RTE_CM_BOOLEAN 0 0 0 255 ECU_ADDRESS 0 SYMBOL_LINK "Rte_PullCmpActv_LrngEnad" 0 DISPLAY_IDENTIFIER PullCmpActv.PerInstanceMemories.LrngEnad /end MEASUREMENT
/begin MEASUREMENT PullCmpActv.OpstSignPrev "MICROSAR RTE" UBYTE RTE_CM_BOOLEAN 0 0 0 255 ECU_ADDRESS 0 SYMBOL_LINK "Rte_PullCmpActv_OpstSignPrev" 0 DISPLAY_IDENTIFIER PullCmpActv.PerInstanceMemories.OpstSignPrev /end MEASUREMENT
/begin MEASUREMENT PullCmpActv.PinionAgConf.Val "MICROSAR RTE" FLOAT32_IEEE NO_COMPU_METHOD 0 0 -3.402823466e+38 3.402823466e+38 ECU_ADDRESS 0 SYMBOL_LINK "Rte_HwAgSysArbn_PinionAgConf_Val" 0 DISPLAY_IDENTIFIER PullCmpActv.ReceiverPorts.PinionAgConf.Val /end MEASUREMENT
/begin MEASUREMENT PullCmpActv.PullCmpActvDi.Logl "MICROSAR RTE" UBYTE RTE_CM_BOOLEAN 0 0 0 255 ECU_ADDRESS 0 SYMBOL_LINK "Rte_GmFctDiArbn_PullCmpActvDi_Logl" 0 DISPLAY_IDENTIFIER PullCmpActv.ReceiverPorts.PullCmpActvDi.Logl /end MEASUREMENT
/begin MEASUREMENT PullCmpActv.PullCmpCmd.Val "MICROSAR RTE" FLOAT32_IEEE NO_COMPU_METHOD 0 0 -3.402823466e+38 3.402823466e+38 ECU_ADDRESS 0 SYMBOL_LINK "Rte_PullCmpActv_PullCmpCmd_Val" 0 DISPLAY_IDENTIFIER PullCmpActv.SenderPorts.PullCmpCmd.Val /end MEASUREMENT
/begin MEASUREMENT PullCmpActv.PullCmpCmdDi.Logl "MICROSAR RTE" UBYTE RTE_CM_BOOLEAN 0 0 0 255 ECU_ADDRESS 0 SYMBOL_LINK "Rte_CmnMfgSrv_PullCmpCmdDi_Logl" 0 DISPLAY_IDENTIFIER PullCmpActv.ReceiverPorts.PullCmpCmdDi.Logl /end MEASUREMENT
/begin MEASUREMENT PullCmpActv.PullCmpCmdRateLimPrev "MICROSAR RTE" FLOAT32_IEEE NO_COMPU_METHOD 0 0 -3.402823466e+38 3.402823466e+38 ECU_ADDRESS 0 SYMBOL_LINK "Rte_PullCmpActv_PullCmpCmdRateLimPrev" 0 DISPLAY_IDENTIFIER PullCmpActv.PerInstanceMemories.PullCmpCmdRateLimPrev /end MEASUREMENT
/begin MEASUREMENT PullCmpActv.PullCmpCmdTot "MICROSAR RTE" FLOAT32_IEEE NO_COMPU_METHOD 0 0 -3.402823466e+38 3.402823466e+38 ECU_ADDRESS 0 SYMBOL_LINK "Rte_PullCmpActv_PullCmpCmdTot" 0 DISPLAY_IDENTIFIER PullCmpActv.PerInstanceMemories.PullCmpCmdTot /end MEASUREMENT
/begin MEASUREMENT PullCmpActv.PullCmpLongTerm "MICROSAR RTE" FLOAT32_IEEE NO_COMPU_METHOD 0 0 -3.402823466e+38 3.402823466e+38 ECU_ADDRESS 0 SYMBOL_LINK "Rte_PullCmpActv_PullCmpLongTerm" 0 DISPLAY_IDENTIFIER PullCmpActv.PerInstanceMemories.PullCmpLongTerm /end MEASUREMENT
/begin MEASUREMENT PullCmpActv.PullCmpLongTermRst "MICROSAR RTE" UBYTE RTE_CM_BOOLEAN 0 0 0 255 ECU_ADDRESS 0 SYMBOL_LINK "Rte_PullCmpActv_PullCmpLongTermRst" 0 DISPLAY_IDENTIFIER PullCmpActv.PerInstanceMemories.PullCmpLongTermRst /end MEASUREMENT
/begin MEASUREMENT PullCmpActv.PullCmpLrngDi.Logl "MICROSAR RTE" UBYTE RTE_CM_BOOLEAN 0 0 0 255 ECU_ADDRESS 0 SYMBOL_LINK "Rte_CmnMfgSrv_PullCmpLrngDi_Logl" 0 DISPLAY_IDENTIFIER PullCmpActv.ReceiverPorts.PullCmpLrngDi.Logl /end MEASUREMENT
/begin MEASUREMENT PullCmpActv.PullCmpShoTerm "MICROSAR RTE" FLOAT32_IEEE NO_COMPU_METHOD 0 0 -3.402823466e+38 3.402823466e+38 ECU_ADDRESS 0 SYMBOL_LINK "Rte_PullCmpActv_PullCmpShoTerm" 0 DISPLAY_IDENTIFIER PullCmpActv.PerInstanceMemories.PullCmpShoTerm /end MEASUREMENT
/begin MEASUREMENT PullCmpActv.PullCmpShoTermRst "MICROSAR RTE" UBYTE RTE_CM_BOOLEAN 0 0 0 255 ECU_ADDRESS 0 SYMBOL_LINK "Rte_PullCmpActv_PullCmpShoTermRst" 0 DISPLAY_IDENTIFIER PullCmpActv.PerInstanceMemories.PullCmpShoTermRst /end MEASUREMENT
/begin MEASUREMENT PullCmpActv.RefTiEnaLrng "MICROSAR RTE" ULONG NO_COMPU_METHOD 0 0 0 4294967295 ECU_ADDRESS 0 SYMBOL_LINK "Rte_PullCmpActv_RefTiEnaLrng" 0 DISPLAY_IDENTIFIER PullCmpActv.PerInstanceMemories.RefTiEnaLrng /end MEASUREMENT
/begin MEASUREMENT PullCmpActv.RefTiOpstSign "MICROSAR RTE" ULONG NO_COMPU_METHOD 0 0 0 4294967295 ECU_ADDRESS 0 SYMBOL_LINK "Rte_PullCmpActv_RefTiOpstSign" 0 DISPLAY_IDENTIFIER PullCmpActv.PerInstanceMemories.RefTiOpstSign /end MEASUREMENT
/begin MEASUREMENT PullCmpActv.VehLatA.Val "MICROSAR RTE" FLOAT32_IEEE NO_COMPU_METHOD 0 0 -3.402823466e+38 3.402823466e+38 ECU_ADDRESS 0 SYMBOL_LINK "Rte_VehSigCdng_VehLatA_Val" 0 DISPLAY_IDENTIFIER PullCmpActv.ReceiverPorts.VehLatA.Val /end MEASUREMENT
/begin MEASUREMENT PullCmpActv.VehSpd.Val "MICROSAR RTE" FLOAT32_IEEE NO_COMPU_METHOD 0 0 -3.402823466e+38 3.402823466e+38 ECU_ADDRESS 0 SYMBOL_LINK "Rte_VehSigCdng_VehSpd_Val" 0 DISPLAY_IDENTIFIER PullCmpActv.ReceiverPorts.VehSpd.Val /end MEASUREMENT
/begin MEASUREMENT PullCmpActv.VehSpdPrev "MICROSAR RTE" FLOAT32_IEEE NO_COMPU_METHOD 0 0 -3.402823466e+38 3.402823466e+38 ECU_ADDRESS 0 SYMBOL_LINK "Rte_PullCmpActv_VehSpdPrev" 0 DISPLAY_IDENTIFIER PullCmpActv.PerInstanceMemories.VehSpdPrev /end MEASUREMENT
/begin MEASUREMENT PullCmpActv.VehSpdRate "MICROSAR RTE" FLOAT32_IEEE NO_COMPU_METHOD 0 0 -3.402823466e+38 3.402823466e+38 ECU_ADDRESS 0 SYMBOL_LINK "Rte_PullCmpActv_VehSpdRate" 0 DISPLAY_IDENTIFIER PullCmpActv.PerInstanceMemories.VehSpdRate /end MEASUREMENT
/begin MEASUREMENT PullCmpActv.VehSpdVld.Logl "MICROSAR RTE" UBYTE RTE_CM_BOOLEAN 0 0 0 255 ECU_ADDRESS 0 SYMBOL_LINK "Rte_VehSigCdng_VehSpdVld_Logl" 0 DISPLAY_IDENTIFIER PullCmpActv.ReceiverPorts.VehSpdVld.Logl /end MEASUREMENT
/begin MEASUREMENT PullCmpActv.VehYawRate.Val "MICROSAR RTE" FLOAT32_IEEE NO_COMPU_METHOD 0 0 -3.402823466e+38 3.402823466e+38 ECU_ADDRESS 0 SYMBOL_LINK "Rte_SnsrOffsCorrn_VehYawRateCorrd_Val" 0 DISPLAY_IDENTIFIER PullCmpActv.ReceiverPorts.VehYawRate.Val /end MEASUREMENT
/begin MEASUREMENT PullCmpActv.VehYawRateLpFil.FilGain "MICROSAR RTE" FLOAT32_IEEE NO_COMPU_METHOD 0 0 -3.402823466e+38 3.402823466e+38 ECU_ADDRESS 0 SYMBOL_LINK "Rte_PullCmpActv_VehYawRateLpFil.FilGain" 0 DISPLAY_IDENTIFIER PullCmpActv.PerInstanceMemories.VehYawRateLpFil.FilGain /end MEASUREMENT
/begin MEASUREMENT PullCmpActv.VehYawRateLpFil.FilSt "MICROSAR RTE" FLOAT32_IEEE NO_COMPU_METHOD 0 0 -3.402823466e+38 3.402823466e+38 ECU_ADDRESS 0 SYMBOL_LINK "Rte_PullCmpActv_VehYawRateLpFil.FilSt" 0 DISPLAY_IDENTIFIER PullCmpActv.PerInstanceMemories.VehYawRateLpFil.FilSt /end MEASUREMENT
/begin MEASUREMENT PullCmpActv.dPullCmpActvIntgtrGainShoTerm "MICROSAR RTE" FLOAT32_IEEE NO_COMPU_METHOD 0 0 -3.402823466e+38 3.402823466e+38 ECU_ADDRESS 0 SYMBOL_LINK "Rte_PullCmpActv_dPullCmpActvIntgtrGainShoTerm" 0 DISPLAY_IDENTIFIER PullCmpActv.PerInstanceMemories.dPullCmpActvIntgtrGainShoTerm /end MEASUREMENT
/begin MEASUREMENT PullCmpActv.dPullCmpActvPullErrLongTerm "MICROSAR RTE" FLOAT32_IEEE NO_COMPU_METHOD 0 0 -3.402823466e+38 3.402823466e+38 ECU_ADDRESS 0 SYMBOL_LINK "Rte_PullCmpActv_dPullCmpActvPullErrLongTerm" 0 DISPLAY_IDENTIFIER PullCmpActv.PerInstanceMemories.dPullCmpActvPullErrLongTerm /end MEASUREMENT
/begin MEASUREMENT PullCmpActv.dPullCmpActvPullErrShoTerm "MICROSAR RTE" FLOAT32_IEEE NO_COMPU_METHOD 0 0 -3.402823466e+38 3.402823466e+38 ECU_ADDRESS 0 SYMBOL_LINK "Rte_PullCmpActv_dPullCmpActvPullErrShoTerm" 0 DISPLAY_IDENTIFIER PullCmpActv.PerInstanceMemories.dPullCmpActvPullErrShoTerm /end MEASUREMENT
/begin MEASUREMENT PullCmpActv.dPullCmpActvShoTermRst "MICROSAR RTE" UBYTE RTE_CM_BOOLEAN 0 0 0 255 ECU_ADDRESS 0 SYMBOL_LINK "Rte_PullCmpActv_dPullCmpActvShoTermRst" 0 DISPLAY_IDENTIFIER PullCmpActv.PerInstanceMemories.dPullCmpActvShoTermRst /end MEASUREMENT
/begin MEASUREMENT PwrDiscnct.BattVltg.Val "MICROSAR RTE" FLOAT32_IEEE NO_COMPU_METHOD 0 0 0.0 40.0 ECU_ADDRESS 0 SYMBOL_LINK "Rte_CDD_GmG2kcaMcuCfg_BattVltg_Val" 0 DISPLAY_IDENTIFIER PwrDiscnct.ReceiverPorts.BattVltg.Val /end MEASUREMENT
/begin MEASUREMENT PwrDiscnct.BattVltgSwd1.Val "MICROSAR RTE" FLOAT32_IEEE NO_COMPU_METHOD 0 0 0.0 40.0 ECU_ADDRESS 0 SYMBOL_LINK "Rte_CDD_GmG2kcaMcuCfg_BattVltgSwd1_Val" 0 DISPLAY_IDENTIFIER PwrDiscnct.ReceiverPorts.BattVltgSwd1.Val /end MEASUREMENT
/begin MEASUREMENT PwrDiscnct.BattVltgSwd2.Val "MICROSAR RTE" FLOAT32_IEEE NO_COMPU_METHOD 0 0 0.0 40.0 ECU_ADDRESS 0 SYMBOL_LINK "Rte_CDD_GmG2kcaMcuCfg_BattVltgSwd2_Val" 0 DISPLAY_IDENTIFIER PwrDiscnct.ReceiverPorts.BattVltgSwd2.Val /end MEASUREMENT
/begin MEASUREMENT PwrDiscnct.PwrDiscnctATestCmpl.Logl "MICROSAR RTE" UBYTE RTE_CM_BOOLEAN 0 0 0 255 ECU_ADDRESS 0 SYMBOL_LINK "Rte_PwrDiscnct_PwrDiscnctATestCmpl_Logl" 0 DISPLAY_IDENTIFIER PwrDiscnct.SenderPorts.PwrDiscnctATestCmpl.Logl /end MEASUREMENT
/begin MEASUREMENT PwrDiscnct.PwrDiscnctBTestCmpl.Logl "MICROSAR RTE" UBYTE RTE_CM_BOOLEAN 0 0 0 255 ECU_ADDRESS 0 SYMBOL_LINK "Rte_PwrDiscnct_PwrDiscnctBTestCmpl_Logl" 0 DISPLAY_IDENTIFIER PwrDiscnct.SenderPorts.PwrDiscnctBTestCmpl.Logl /end MEASUREMENT
/begin MEASUREMENT PwrDiscnct.PwrDiscnctDeltaVltg1 "Difference between Battery and Switched1 Voltage\r\n" FLOAT32_IEEE NO_COMPU_METHOD 0 0 0.0 16.0 ECU_ADDRESS 0 SYMBOL_LINK "Rte_PwrDiscnct_PwrDiscnctDeltaVltg1" 0 DISPLAY_IDENTIFIER PwrDiscnct.PerInstanceMemories.PwrDiscnctDeltaVltg1 /end MEASUREMENT
/begin MEASUREMENT PwrDiscnct.PwrDiscnctDeltaVltg2 "Difference between Battery and Switched2 Voltage\r\n" FLOAT32_IEEE NO_COMPU_METHOD 0 0 0.0 16.0 ECU_ADDRESS 0 SYMBOL_LINK "Rte_PwrDiscnct_PwrDiscnctDeltaVltg2" 0 DISPLAY_IDENTIFIER PwrDiscnct.PerInstanceMemories.PwrDiscnctDeltaVltg2 /end MEASUREMENT
/begin MEASUREMENT PwrDiscnct.PwrDiscnctSeqATestCmplPrev "Power Disconnect First Run Complete - Determines if the PwrDiscnctSequenceA has computes once per IGN Cycle\r\n\r\n" UBYTE RTE_CM_BOOLEAN 0 0 0 255 ECU_ADDRESS 0 SYMBOL_LINK "Rte_PwrDiscnct_PwrDiscnctSeqATestCmplPrev" 0 DISPLAY_IDENTIFIER PwrDiscnct.PerInstanceMemories.PwrDiscnctSeqATestCmplPrev /end MEASUREMENT
/begin MEASUREMENT PwrDiscnct.StrtUpSt.Val "MICROSAR RTE" UBYTE NO_COMPU_METHOD 0 0 0 255 ECU_ADDRESS 0 SYMBOL_LINK "Rte_PwrUpSeq_StrtUpSt_Val" 0 DISPLAY_IDENTIFIER PwrDiscnct.ReceiverPorts.StrtUpSt.Val /end MEASUREMENT
/begin MEASUREMENT PwrDiscnct.SysSt.Val "MICROSAR RTE" UBYTE RTE_CM_ENUM_SysSt1 0 0 0 255 ECU_ADDRESS 0 SYMBOL_LINK "Rte_SysStMod_SysSt_Val" 0 DISPLAY_IDENTIFIER PwrDiscnct.ReceiverPorts.SysSt.Val /end MEASUREMENT
/begin MEASUREMENT PwrLimr.AltFltActv.Logl "MICROSAR RTE" UBYTE RTE_CM_BOOLEAN 0 0 0 255 ECU_ADDRESS 0 SYMBOL_LINK "Rte_PwrLimr_AltFltActv_Logl" 0 DISPLAY_IDENTIFIER PwrLimr.ReceiverPorts.AltFltActv.Logl /end MEASUREMENT
/begin MEASUREMENT PwrLimr.BrdgVltg.Val "MICROSAR RTE" FLOAT32_IEEE NO_COMPU_METHOD 0 0 -3.402823466e+38 3.402823466e+38 ECU_ADDRESS 0 SYMBOL_LINK "Rte_BattVltg_BrdgVltg_Val" 0 DISPLAY_IDENTIFIER PwrLimr.ReceiverPorts.BrdgVltg.Val /end MEASUREMENT
/begin MEASUREMENT PwrLimr.BrdgVltgAdjSlewStVari "MICROSAR RTE" FLOAT32_IEEE NO_COMPU_METHOD 0 0 -3.402823466e+38 3.402823466e+38 ECU_ADDRESS 0 SYMBOL_LINK "Rte_PwrLimr_BrdgVltgAdjSlewStVari" 0 DISPLAY_IDENTIFIER PwrLimr.PerInstanceMemories.BrdgVltgAdjSlewStVari /end MEASUREMENT
/begin MEASUREMENT PwrLimr.DualEcuFltMtgtnSca.Val "MICROSAR RTE" FLOAT32_IEEE NO_COMPU_METHOD 0 0 -3.402823466e+38 3.402823466e+38 ECU_ADDRESS 0 SYMBOL_LINK "Rte_PwrLimr_DualEcuFltMtgtnSca_Val" 0 DISPLAY_IDENTIFIER PwrLimr.ReceiverPorts.DualEcuFltMtgtnSca.Val /end MEASUREMENT
/begin MEASUREMENT PwrLimr.FltRefTi "MICROSAR RTE" ULONG NO_COMPU_METHOD 0 0 0 4294967295 ECU_ADDRESS 0 SYMBOL_LINK "Rte_PwrLimr_FltRefTi" 0 DISPLAY_IDENTIFIER PwrLimr.PerInstanceMemories.FltRefTi /end MEASUREMENT
/begin MEASUREMENT PwrLimr.IvtrLoaMtgtnEna.Logl "MICROSAR RTE" UBYTE RTE_CM_BOOLEAN 0 0 0 255 ECU_ADDRESS 0 SYMBOL_LINK "Rte_LoaMgr_IvtrLoaMtgtnEna_Logl" 0 DISPLAY_IDENTIFIER PwrLimr.ReceiverPorts.IvtrLoaMtgtnEna.Logl /end MEASUREMENT
/begin MEASUREMENT PwrLimr.MotBackEmfConEstimd.Val "MICROSAR RTE" FLOAT32_IEEE NO_COMPU_METHOD 0 0 -3.402823466e+38 3.402823466e+38 ECU_ADDRESS 0 SYMBOL_LINK "Rte_MotCtrlPrmEstimn_MotBackEmfConEstimd_Val" 0 DISPLAY_IDENTIFIER PwrLimr.ReceiverPorts.MotBackEmfConEstimd.Val /end MEASUREMENT
/begin MEASUREMENT PwrLimr.MotTqCmdMrf.Val "MICROSAR RTE" FLOAT32_IEEE NO_COMPU_METHOD 0 0 -3.402823466e+38 3.402823466e+38 ECU_ADDRESS 0 SYMBOL_LINK "Rte_MotTqTranlDampg_MotTqCmdMrfDampd_Val" 0 DISPLAY_IDENTIFIER PwrLimr.ReceiverPorts.MotTqCmdMrf.Val /end MEASUREMENT
/begin MEASUREMENT PwrLimr.MotTqCmdPwrLimd.Val "MICROSAR RTE" FLOAT32_IEEE NO_COMPU_METHOD 0 0 -3.402823466e+38 3.402823466e+38 ECU_ADDRESS 0 SYMBOL_LINK "Rte_PwrLimr_MotTqCmdPwrLimd_Val" 0 DISPLAY_IDENTIFIER PwrLimr.SenderPorts.MotTqCmdPwrLimd.Val /end MEASUREMENT
/begin MEASUREMENT PwrLimr.MotVelLpFil.FilGain "MICROSAR RTE" FLOAT32_IEEE NO_COMPU_METHOD 0 0 -3.402823466e+38 3.402823466e+38 ECU_ADDRESS 0 SYMBOL_LINK "Rte_PwrLimr_MotVelLpFil.FilGain" 0 DISPLAY_IDENTIFIER PwrLimr.PerInstanceMemories.MotVelLpFil.FilGain /end MEASUREMENT
/begin MEASUREMENT PwrLimr.MotVelLpFil.FilSt "MICROSAR RTE" FLOAT32_IEEE NO_COMPU_METHOD 0 0 -3.402823466e+38 3.402823466e+38 ECU_ADDRESS 0 SYMBOL_LINK "Rte_PwrLimr_MotVelLpFil.FilSt" 0 DISPLAY_IDENTIFIER PwrLimr.PerInstanceMemories.MotVelLpFil.FilSt /end MEASUREMENT
/begin MEASUREMENT PwrLimr.MotVelMrf.Val "MICROSAR RTE" FLOAT32_IEEE NO_COMPU_METHOD 0 0 -3.402823466e+38 3.402823466e+38 ECU_ADDRESS 0 SYMBOL_LINK "Rte_CDD_MotVel_MotVelMrf_Val" 0 DISPLAY_IDENTIFIER PwrLimr.ReceiverPorts.MotVelMrf.Val /end MEASUREMENT
/begin MEASUREMENT PwrLimr.PrevBrdgVltgAltFltAdjLim "MICROSAR RTE" FLOAT32_IEEE NO_COMPU_METHOD 0 0 -3.402823466e+38 3.402823466e+38 ECU_ADDRESS 0 SYMBOL_LINK "Rte_PwrLimr_PrevBrdgVltgAltFltAdjLim" 0 DISPLAY_IDENTIFIER PwrLimr.PerInstanceMemories.PrevBrdgVltgAltFltAdjLim /end MEASUREMENT
/begin MEASUREMENT PwrLimr.PrevSpdAdj "MICROSAR RTE" FLOAT32_IEEE NO_COMPU_METHOD 0 0 -3.402823466e+38 3.402823466e+38 ECU_ADDRESS 0 SYMBOL_LINK "Rte_PwrLimr_PrevSpdAdj" 0 DISPLAY_IDENTIFIER PwrLimr.PerInstanceMemories.PrevSpdAdj /end MEASUREMENT
/begin MEASUREMENT PwrLimr.PrevThd "MICROSAR RTE" UBYTE RTE_CM_BOOLEAN 0 0 0 255 ECU_ADDRESS 0 SYMBOL_LINK "Rte_PwrLimr_PrevThd" 0 DISPLAY_IDENTIFIER PwrLimr.PerInstanceMemories.PrevThd /end MEASUREMENT
/begin MEASUREMENT PwrLimr.PwrLimrRednFac.Val "MICROSAR RTE" FLOAT32_IEEE NO_COMPU_METHOD 0 0 -3.402823466e+38 3.402823466e+38 ECU_ADDRESS 0 SYMBOL_LINK "Rte_PwrLimr_PwrLimrRednFac_Val" 0 DISPLAY_IDENTIFIER PwrLimr.SenderPorts.PwrLimrRednFac.Val /end MEASUREMENT
/begin GROUP MotRplCoggCfg.MotRplCoggCfgMotTqRplOrder1X.Ary2D "MICROSAR RTE" /begin SUB_GROUP /end SUB_GROUP /begin FUNCTION_LIST /end FUNCTION_LIST /begin REF_CHARACTERISTIC MotRplCoggCfg.MotRplCoggCfgMotTqRplOrder1X.Ary2D /end REF_CHARACTERISTIC /begin REF_MEASUREMENT /end REF_MEASUREMENT /end GROUP
/begin GROUP MotRplCoggCfg.MotRplCoggCfgMotTqRplOrder1Y.Ary2D "MICROSAR RTE" /begin SUB_GROUP /end SUB_GROUP /begin FUNCTION_LIST /end FUNCTION_LIST /begin REF_CHARACTERISTIC MotRplCoggCfg.MotRplCoggCfgMotTqRplOrder1Y.Ary2D /end REF_CHARACTERISTIC /begin REF_MEASUREMENT /end REF_MEASUREMENT /end GROUP
/begin GROUP MotRplCoggCfg.MotRplCoggCfgMotTqRplOrder2X.Ary2D "MICROSAR RTE" /begin SUB_GROUP /end SUB_GROUP /begin FUNCTION_LIST /end FUNCTION_LIST /begin REF_CHARACTERISTIC MotRplCoggCfg.MotRplCoggCfgMotTqRplOrder2X.Ary2D /end REF_CHARACTERISTIC /begin REF_MEASUREMENT /end REF_MEASUREMENT /end GROUP
/begin GROUP MotRplCoggCfg.MotRplCoggCfgMotTqRplOrder2Y.Ary2D "MICROSAR RTE" /begin SUB_GROUP /end SUB_GROUP /begin FUNCTION_LIST /end FUNCTION_LIST /begin REF_CHARACTERISTIC MotRplCoggCfg.MotRplCoggCfgMotTqRplOrder2Y.Ary2D /end REF_CHARACTERISTIC /begin REF_MEASUREMENT /end REF_MEASUREMENT /end GROUP
/begin GROUP MotRplCoggCfg.MotRplCoggCfgMotTqRplOrder3X.Ary2D "MICROSAR RTE" /begin SUB_GROUP /end SUB_GROUP /begin FUNCTION_LIST /end FUNCTION_LIST /begin REF_CHARACTERISTIC MotRplCoggCfg.MotRplCoggCfgMotTqRplOrder3X.Ary2D /end REF_CHARACTERISTIC /begin REF_MEASUREMENT /end REF_MEASUREMENT /end GROUP
/begin GROUP MotRplCoggCfg.MotRplCoggCfgMotTqRplOrder3Y.Ary2D "MICROSAR RTE" /begin SUB_GROUP /end SUB_GROUP /begin FUNCTION_LIST /end FUNCTION_LIST /begin REF_CHARACTERISTIC MotRplCoggCfg.MotRplCoggCfgMotTqRplOrder3Y.Ary2D /end REF_CHARACTERISTIC /begin REF_MEASUREMENT /end REF_MEASUREMENT /end GROUP
/begin GROUP MotRplCoggCfg.MotRplCoggCfgMotVelBilnrSeln.Ary1D "MICROSAR RTE" /begin SUB_GROUP /end SUB_GROUP /begin FUNCTION_LIST /end FUNCTION_LIST /begin REF_CHARACTERISTIC MotRplCoggCfg.MotRplCoggCfgMotVelBilnrSeln.Ary1D /end REF_CHARACTERISTIC /begin REF_MEASUREMENT /end REF_MEASUREMENT /end GROUP
/begin GROUP MotRplCoggCfg.MotRplCoggCmdHrmncOrder1Elec.Val "MICROSAR RTE" /begin SUB_GROUP /end SUB_GROUP /begin FUNCTION_LIST /end FUNCTION_LIST /begin REF_CHARACTERISTIC MotRplCoggCfg.MotRplCoggCmdHrmncOrder1Elec.Val /end REF_CHARACTERISTIC /begin REF_MEASUREMENT /end REF_MEASUREMENT /end GROUP
/begin GROUP MotRplCoggCfg.MotRplCoggCmdHrmncOrder2Elec.Val "MICROSAR RTE" /begin SUB_GROUP /end SUB_GROUP /begin FUNCTION_LIST /end FUNCTION_LIST /begin REF_CHARACTERISTIC MotRplCoggCfg.MotRplCoggCmdHrmncOrder2Elec.Val /end REF_CHARACTERISTIC /begin REF_MEASUREMENT /end REF_MEASUREMENT /end GROUP
/begin GROUP MotRplCoggCfg.MotRplCoggCmdHrmncOrder3Elec.Val "MICROSAR RTE" /begin SUB_GROUP /end SUB_GROUP /begin FUNCTION_LIST /end FUNCTION_LIST /begin REF_CHARACTERISTIC MotRplCoggCfg.MotRplCoggCmdHrmncOrder3Elec.Val /end REF_CHARACTERISTIC /begin REF_MEASUREMENT /end REF_MEASUREMENT /end GROUP
/begin GROUP MotRplCoggCfg.MotRplCoggPrm "MICROSAR RTE" /begin SUB_GROUP /end SUB_GROUP /begin FUNCTION_LIST /end FUNCTION_LIST /begin REF_CHARACTERISTIC /end REF_CHARACTERISTIC
 /begin REF_MEASUREMENT MotRplCoggCfg.MotRplCoggPrm.CoggOrder1 MotRplCoggCfg.MotRplCoggPrm.CoggOrder1X MotRplCoggCfg.MotRplCoggPrm.CoggOrder1Y MotRplCoggCfg.MotRplCoggPrm.CoggOrder2 MotRplCoggCfg.MotRplCoggPrm.CoggOrder2X MotRplCoggCfg.MotRplCoggPrm.CoggOrder2Y MotRplCoggCfg.MotRplCoggPrm.CoggOrder3 MotRplCoggCfg.MotRplCoggPrm.CoggOrder3X MotRplCoggCfg.MotRplCoggPrm.CoggOrder3Y /end REF_MEASUREMENT
/end GROUP
/begin GROUP MotRplCoggCfg.MotTqCmdMrfScad.Val "MICROSAR RTE" /begin SUB_GROUP /end SUB_GROUP /begin FUNCTION_LIST /end FUNCTION_LIST /begin REF_CHARACTERISTIC /end REF_CHARACTERISTIC /begin REF_MEASUREMENT MotRplCoggCfg.MotTqCmdMrfScad.Val /end REF_MEASUREMENT /end GROUP
/begin GROUP MotRplCoggCfg.MotTqRplCoggOrder1Mgn.Val "MICROSAR RTE" /begin SUB_GROUP /end SUB_GROUP /begin FUNCTION_LIST /end FUNCTION_LIST /begin REF_CHARACTERISTIC /end REF_CHARACTERISTIC /begin REF_MEASUREMENT MotRplCoggCfg.MotTqRplCoggOrder1Mgn.Val /end REF_MEASUREMENT /end GROUP
/begin GROUP MotRplCoggCfg.MotTqRplCoggOrder1Pha.Val "MICROSAR RTE" /begin SUB_GROUP /end SUB_GROUP /begin FUNCTION_LIST /end FUNCTION_LIST /begin REF_CHARACTERISTIC /end REF_CHARACTERISTIC /begin REF_MEASUREMENT MotRplCoggCfg.MotTqRplCoggOrder1Pha.Val /end REF_MEASUREMENT /end GROUP
/begin GROUP MotRplCoggCfg.MotTqRplCoggOrder2Mgn.Val "MICROSAR RTE" /begin SUB_GROUP /end SUB_GROUP /begin FUNCTION_LIST /end FUNCTION_LIST /begin REF_CHARACTERISTIC /end REF_CHARACTERISTIC /begin REF_MEASUREMENT MotRplCoggCfg.MotTqRplCoggOrder2Mgn.Val /end REF_MEASUREMENT /end GROUP
/begin GROUP MotRplCoggCfg.MotTqRplCoggOrder2Pha.Val "MICROSAR RTE" /begin SUB_GROUP /end SUB_GROUP /begin FUNCTION_LIST /end FUNCTION_LIST /begin REF_CHARACTERISTIC /end REF_CHARACTERISTIC /begin REF_MEASUREMENT MotRplCoggCfg.MotTqRplCoggOrder2Pha.Val /end REF_MEASUREMENT /end GROUP
/begin GROUP MotRplCoggCfg.MotTqRplCoggOrder3Mgn.Val "MICROSAR RTE" /begin SUB_GROUP /end SUB_GROUP /begin FUNCTION_LIST /end FUNCTION_LIST /begin REF_CHARACTERISTIC /end REF_CHARACTERISTIC /begin REF_MEASUREMENT MotRplCoggCfg.MotTqRplCoggOrder3Mgn.Val /end REF_MEASUREMENT /end GROUP
/begin GROUP MotRplCoggCfg.MotTqRplCoggOrder3Pha.Val "MICROSAR RTE" /begin SUB_GROUP /end SUB_GROUP /begin FUNCTION_LIST /end FUNCTION_LIST /begin REF_CHARACTERISTIC /end REF_CHARACTERISTIC /begin REF_MEASUREMENT MotRplCoggCfg.MotTqRplCoggOrder3Pha.Val /end REF_MEASUREMENT /end GROUP
/begin GROUP MotRplCoggCfg.MotTqRplOrder1X "MICROSAR RTE" /begin SUB_GROUP /end SUB_GROUP /begin FUNCTION_LIST /end FUNCTION_LIST /begin REF_CHARACTERISTIC /end REF_CHARACTERISTIC /begin REF_MEASUREMENT MotRplCoggCfg.MotTqRplOrder1X /end REF_MEASUREMENT /end GROUP
/begin GROUP MotRplCoggCfg.MotTqRplOrder1Y "MICROSAR RTE" /begin SUB_GROUP /end SUB_GROUP /begin FUNCTION_LIST /end FUNCTION_LIST /begin REF_CHARACTERISTIC /end REF_CHARACTERISTIC /begin REF_MEASUREMENT MotRplCoggCfg.MotTqRplOrder1Y /end REF_MEASUREMENT /end GROUP
/begin GROUP MotRplCoggCfg.MotTqRplOrder2X "MICROSAR RTE" /begin SUB_GROUP /end SUB_GROUP /begin FUNCTION_LIST /end FUNCTION_LIST /begin REF_CHARACTERISTIC /end REF_CHARACTERISTIC /begin REF_MEASUREMENT MotRplCoggCfg.MotTqRplOrder2X /end REF_MEASUREMENT /end GROUP
/begin GROUP MotRplCoggCfg.MotTqRplOrder2Y "MICROSAR RTE" /begin SUB_GROUP /end SUB_GROUP /begin FUNCTION_LIST /end FUNCTION_LIST /begin REF_CHARACTERISTIC /end REF_CHARACTERISTIC /begin REF_MEASUREMENT MotRplCoggCfg.MotTqRplOrder2Y /end REF_MEASUREMENT /end GROUP
/begin GROUP MotRplCoggCfg.MotTqRplOrder3X "MICROSAR RTE" /begin SUB_GROUP /end SUB_GROUP /begin FUNCTION_LIST /end FUNCTION_LIST /begin REF_CHARACTERISTIC /end REF_CHARACTERISTIC /begin REF_MEASUREMENT MotRplCoggCfg.MotTqRplOrder3X /end REF_MEASUREMENT /end GROUP
/begin GROUP MotRplCoggCfg.MotTqRplOrder3Y "MICROSAR RTE" /begin SUB_GROUP /end SUB_GROUP /begin FUNCTION_LIST /end FUNCTION_LIST /begin REF_CHARACTERISTIC /end REF_CHARACTERISTIC /begin REF_MEASUREMENT MotRplCoggCfg.MotTqRplOrder3Y /end REF_MEASUREMENT /end GROUP
/begin GROUP MotRplCoggCfg.MotVelMrf.Val "MICROSAR RTE" /begin SUB_GROUP /end SUB_GROUP /begin FUNCTION_LIST /end FUNCTION_LIST /begin REF_CHARACTERISTIC /end REF_CHARACTERISTIC /begin REF_MEASUREMENT MotRplCoggCfg.MotVelMrf.Val /end REF_MEASUREMENT /end GROUP
/begin GROUP MotRplCoggCfg.PerInstanceMemories "MICROSAR RTE"
 /begin SUB_GROUP MotRplCoggCfg.MotRplCoggPrm MotRplCoggCfg.MotTqRplOrder1X MotRplCoggCfg.MotTqRplOrder1Y MotRplCoggCfg.MotTqRplOrder2X MotRplCoggCfg.MotTqRplOrder2Y MotRplCoggCfg.MotTqRplOrder3X MotRplCoggCfg.MotTqRplOrder3Y MotRplCoggCfg.dMotRplCoggCfgMotAgElecDlyRpl MotRplCoggCfg.dMotRplCoggCfgMotCurrQaxToMotTqGain MotRplCoggCfg.dMotRplCoggCfgMotTqRplOrder1Mgn MotRplCoggCfg.dMotRplCoggCfgMotTqRplOrder1Pha MotRplCoggCfg.dMotRplCoggCfgMotTqRplOrder2Mgn MotRplCoggCfg.dMotRplCoggCfgMotTqRplOrder2Pha MotRplCoggCfg.dMotRplCoggCfgMotTqRplOrder3Mgn MotRplCoggCfg.dMotRplCoggCfgMotTqRplOrder3Pha /end SUB_GROUP
 /begin FUNCTION_LIST /end FUNCTION_LIST
 /begin REF_CHARACTERISTIC /end REF_CHARACTERISTIC
 /begin REF_MEASUREMENT /end REF_MEASUREMENT
/end GROUP
/begin GROUP MotRplCoggCfg.ReceiverPorts "MICROSAR RTE"
 /begin SUB_GROUP MotRplCoggCfg.MotBackEmfConEstimd.Val MotRplCoggCfg.MotCurrDaxCmd.Val MotRplCoggCfg.MotCurrQaxCmd.Val MotRplCoggCfg.MotInduDaxEstimd.Val MotRplCoggCfg.MotInduQaxEstimd.Val MotRplCoggCfg.MotTqCmdMrfScad.Val MotRplCoggCfg.MotVelMrf.Val /end SUB_GROUP
 /begin FUNCTION_LIST /end FUNCTION_LIST
 /begin REF_CHARACTERISTIC /end REF_CHARACTERISTIC
 /begin REF_MEASUREMENT /end REF_MEASUREMENT
/end GROUP
/begin GROUP MotRplCoggCfg.SenderPorts "MICROSAR RTE"
 /begin SUB_GROUP MotRplCoggCfg.MotAgElecDlyRpl.Val MotRplCoggCfg.MotCurrQaxToMotTqGain.Val MotRplCoggCfg.MotTqRplCoggOrder1Mgn.Val MotRplCoggCfg.MotTqRplCoggOrder1Pha.Val MotRplCoggCfg.MotTqRplCoggOrder2Mgn.Val MotRplCoggCfg.MotTqRplCoggOrder2Pha.Val MotRplCoggCfg.MotTqRplCoggOrder3Mgn.Val MotRplCoggCfg.MotTqRplCoggOrder3Pha.Val /end SUB_GROUP
 /begin FUNCTION_LIST /end FUNCTION_LIST
 /begin REF_CHARACTERISTIC /end REF_CHARACTERISTIC
 /begin REF_MEASUREMENT /end REF_MEASUREMENT
/end GROUP
/begin GROUP MotRplCoggCfg.SysGlbPrmMotPoleCnt.Val "MICROSAR RTE" /begin SUB_GROUP /end SUB_GROUP /begin FUNCTION_LIST /end FUNCTION_LIST /begin REF_CHARACTERISTIC MotRplCoggCfg.SysGlbPrmMotPoleCnt.Val /end REF_CHARACTERISTIC /begin REF_MEASUREMENT /end REF_MEASUREMENT /end GROUP
/begin GROUP MotRplCoggCfg.dMotRplCoggCfgMotAgElecDlyRpl "MICROSAR RTE" /begin SUB_GROUP /end SUB_GROUP /begin FUNCTION_LIST /end FUNCTION_LIST /begin REF_CHARACTERISTIC /end REF_CHARACTERISTIC /begin REF_MEASUREMENT MotRplCoggCfg.dMotRplCoggCfgMotAgElecDlyRpl /end REF_MEASUREMENT /end GROUP
/begin GROUP MotRplCoggCfg.dMotRplCoggCfgMotCurrQaxToMotTqGain "MICROSAR RTE" /begin SUB_GROUP /end SUB_GROUP /begin FUNCTION_LIST /end FUNCTION_LIST /begin REF_CHARACTERISTIC /end REF_CHARACTERISTIC /begin REF_MEASUREMENT MotRplCoggCfg.dMotRplCoggCfgMotCurrQaxToMotTqGain /end REF_MEASUREMENT /end GROUP
/begin GROUP MotRplCoggCfg.dMotRplCoggCfgMotTqRplOrder1Mgn "MICROSAR RTE" /begin SUB_GROUP /end SUB_GROUP /begin FUNCTION_LIST /end FUNCTION_LIST /begin REF_CHARACTERISTIC /end REF_CHARACTERISTIC /begin REF_MEASUREMENT MotRplCoggCfg.dMotRplCoggCfgMotTqRplOrder1Mgn /end REF_MEASUREMENT /end GROUP
/begin GROUP MotRplCoggCfg.dMotRplCoggCfgMotTqRplOrder1Pha "MICROSAR RTE" /begin SUB_GROUP /end SUB_GROUP /begin FUNCTION_LIST /end FUNCTION_LIST /begin REF_CHARACTERISTIC /end REF_CHARACTERISTIC /begin REF_MEASUREMENT MotRplCoggCfg.dMotRplCoggCfgMotTqRplOrder1Pha /end REF_MEASUREMENT /end GROUP
/begin GROUP MotRplCoggCfg.dMotRplCoggCfgMotTqRplOrder2Mgn "MICROSAR RTE" /begin SUB_GROUP /end SUB_GROUP /begin FUNCTION_LIST /end FUNCTION_LIST /begin REF_CHARACTERISTIC /end REF_CHARACTERISTIC /begin REF_MEASUREMENT MotRplCoggCfg.dMotRplCoggCfgMotTqRplOrder2Mgn /end REF_MEASUREMENT /end GROUP
/begin GROUP MotRplCoggCfg.dMotRplCoggCfgMotTqRplOrder2Pha "MICROSAR RTE" /begin SUB_GROUP /end SUB_GROUP /begin FUNCTION_LIST /end FUNCTION_LIST /begin REF_CHARACTERISTIC /end REF_CHARACTERISTIC /begin REF_MEASUREMENT MotRplCoggCfg.dMotRplCoggCfgMotTqRplOrder2Pha /end REF_MEASUREMENT /end GROUP
/begin GROUP MotRplCoggCfg.dMotRplCoggCfgMotTqRplOrder3Mgn "MICROSAR RTE" /begin SUB_GROUP /end SUB_GROUP /begin FUNCTION_LIST /end FUNCTION_LIST /begin REF_CHARACTERISTIC /end REF_CHARACTERISTIC /begin REF_MEASUREMENT MotRplCoggCfg.dMotRplCoggCfgMotTqRplOrder3Mgn /end REF_MEASUREMENT /end GROUP
/begin GROUP MotRplCoggCfg.dMotRplCoggCfgMotTqRplOrder3Pha "MICROSAR RTE" /begin SUB_GROUP /end SUB_GROUP /begin FUNCTION_LIST /end FUNCTION_LIST /begin REF_CHARACTERISTIC /end REF_CHARACTERISTIC /begin REF_MEASUREMENT MotRplCoggCfg.dMotRplCoggCfgMotTqRplOrder3Pha /end REF_MEASUREMENT /end GROUP
/begin GROUP MotTqCmdSca "MICROSAR RTE"
 /begin SUB_GROUP MotTqCmdSca.CalibrationPorts MotTqCmdSca.PerInstanceMemories MotTqCmdSca.ReceiverPorts MotTqCmdSca.SenderPorts /end SUB_GROUP
 /begin FUNCTION_LIST /end FUNCTION_LIST
 /begin REF_CHARACTERISTIC /end REF_CHARACTERISTIC
 /begin REF_MEASUREMENT /end REF_MEASUREMENT
/end GROUP
/begin GROUP MotTqCmdSca.CalibrationPorts "MICROSAR RTE"
 /begin SUB_GROUP MotTqCmdSca.MotTqCmdScaMax.Val MotTqCmdSca.MotTqCmdScaMin.Val /end SUB_GROUP
 /begin FUNCTION_LIST /end FUNCTION_LIST
 /begin REF_CHARACTERISTIC /end REF_CHARACTERISTIC
 /begin REF_MEASUREMENT /end REF_MEASUREMENT
/end GROUP
/begin GROUP MotTqCmdSca.MotTqCmdMrf.Val "MICROSAR RTE" /begin SUB_GROUP /end SUB_GROUP /begin FUNCTION_LIST /end FUNCTION_LIST /begin REF_CHARACTERISTIC /end REF_CHARACTERISTIC /begin REF_MEASUREMENT MotTqCmdSca.MotTqCmdMrf.Val /end REF_MEASUREMENT /end GROUP
/begin GROUP MotTqCmdSca.MotTqCmdMrfScad.Val "MICROSAR RTE" /begin SUB_GROUP /end SUB_GROUP /begin FUNCTION_LIST /end FUNCTION_LIST /begin REF_CHARACTERISTIC /end REF_CHARACTERISTIC /begin REF_MEASUREMENT MotTqCmdSca.MotTqCmdMrfScad.Val /end REF_MEASUREMENT /end GROUP
/begin GROUP MotTqCmdSca.MotTqCmdScaMax.Val "MICROSAR RTE" /begin SUB_GROUP /end SUB_GROUP /begin FUNCTION_LIST /end FUNCTION_LIST /begin REF_CHARACTERISTIC MotTqCmdSca.MotTqCmdScaMax.Val /end REF_CHARACTERISTIC /begin REF_MEASUREMENT /end REF_MEASUREMENT /end GROUP
/begin GROUP MotTqCmdSca.MotTqCmdScaMin.Val "MICROSAR RTE" /begin SUB_GROUP /end SUB_GROUP /begin FUNCTION_LIST /end FUNCTION_LIST /begin REF_CHARACTERISTIC MotTqCmdSca.MotTqCmdScaMin.Val /end REF_CHARACTERISTIC /begin REF_MEASUREMENT /end REF_MEASUREMENT /end GROUP
/begin GROUP MotTqCmdSca.MotTqScaFac "MICROSAR RTE" /begin SUB_GROUP /end SUB_GROUP /begin FUNCTION_LIST /end FUNCTION_LIST /begin REF_CHARACTERISTIC /end REF_CHARACTERISTIC /begin REF_MEASUREMENT MotTqCmdSca.MotTqScaFac /end REF_MEASUREMENT /end GROUP
/begin GROUP MotTqCmdSca.PerInstanceMemories "MICROSAR RTE" /begin SUB_GROUP MotTqCmdSca.MotTqScaFac /end SUB_GROUP /begin FUNCTION_LIST /end FUNCTION_LIST /begin REF_CHARACTERISTIC /end REF_CHARACTERISTIC /begin REF_MEASUREMENT /end REF_MEASUREMENT /end GROUP
/begin GROUP MotTqCmdSca.ReceiverPorts "MICROSAR RTE" /begin SUB_GROUP MotTqCmdSca.MotTqCmdMrf.Val /end SUB_GROUP /begin FUNCTION_LIST /end FUNCTION_LIST /begin REF_CHARACTERISTIC /end REF_CHARACTERISTIC /begin REF_MEASUREMENT /end REF_MEASUREMENT /end GROUP
/begin GROUP MotTqCmdSca.SenderPorts "MICROSAR RTE" /begin SUB_GROUP MotTqCmdSca.MotTqCmdMrfScad.Val /end SUB_GROUP /begin FUNCTION_LIST /end FUNCTION_LIST /begin REF_CHARACTERISTIC /end REF_CHARACTERISTIC /begin REF_MEASUREMENT /end REF_MEASUREMENT /end GROUP
/begin GROUP MotTqTranlDampg "MICROSAR RTE"
 /begin SUB_GROUP MotTqTranlDampg.CalibrationPorts MotTqTranlDampg.PerInstanceMemories MotTqTranlDampg.ReceiverPorts MotTqTranlDampg.SenderPorts /end SUB_GROUP
 /begin FUNCTION_LIST /end FUNCTION_LIST
 /begin REF_CHARACTERISTIC /end REF_CHARACTERISTIC
 /begin REF_MEASUREMENT /end REF_MEASUREMENT
/end GROUP
/begin GROUP MotTqTranlDampg.AssiMechPolarity.Val "MICROSAR RTE" /begin SUB_GROUP /end SUB_GROUP /begin FUNCTION_LIST /end FUNCTION_LIST /begin REF_CHARACTERISTIC /end REF_CHARACTERISTIC /begin REF_MEASUREMENT MotTqTranlDampg.AssiMechPolarity.Val /end REF_MEASUREMENT /end GROUP
/begin GROUP MotTqTranlDampg.CalibrationPorts "MICROSAR RTE"
 /begin SUB_GROUP MotTqTranlDampg.MotTqTranlDampgCmdLim.Val MotTqTranlDampg.MotTqTranlDampgDampgCoeff.Val MotTqTranlDampg.MotTqTranlDampgRampEnd.Val MotTqTranlDampg.MotTqTranlDampgTmrPt1.Val MotTqTranlDampg.MotTqTranlDampgTmrPt2.Val MotTqTranlDampg.MotTqTranlDampgVehSpdBlndX.Ary1D MotTqTranlDampg.MotTqTranlDampgVehSpdBlndY.Ary1D MotTqTranlDampg.MotTqTranlDampgVelThd.Val /end SUB_GROUP
 /begin FUNCTION_LIST /end FUNCTION_LIST
 /begin REF_CHARACTERISTIC /end REF_CHARACTERISTIC
 /begin REF_MEASUREMENT /end REF_MEASUREMENT
/end GROUP
/begin GROUP MotTqTranlDampg.DiagStsPrev "MICROSAR RTE" /begin SUB_GROUP /end SUB_GROUP /begin FUNCTION_LIST /end FUNCTION_LIST /begin REF_CHARACTERISTIC /end REF_CHARACTERISTIC /begin REF_MEASUREMENT MotTqTranlDampg.DiagStsPrev /end REF_MEASUREMENT /end GROUP
/begin GROUP MotTqTranlDampg.DiagcStsCtrldShtDwnFltPrsnt.Logl "MICROSAR RTE" /begin SUB_GROUP /end SUB_GROUP /begin FUNCTION_LIST /end FUNCTION_LIST /begin REF_CHARACTERISTIC /end REF_CHARACTERISTIC /begin REF_MEASUREMENT MotTqTranlDampg.DiagcStsCtrldShtDwnFltPrsnt.Logl /end REF_MEASUREMENT /end GROUP
/begin GROUP MotTqTranlDampg.HwAg.Val "MICROSAR RTE" /begin SUB_GROUP /end SUB_GROUP /begin FUNCTION_LIST /end FUNCTION_LIST /begin REF_CHARACTERISTIC /end REF_CHARACTERISTIC /begin REF_MEASUREMENT MotTqTranlDampg.HwAg.Val /end REF_MEASUREMENT /end GROUP
/begin GROUP MotTqTranlDampg.LoaSt.Val "MICROSAR RTE" /begin SUB_GROUP /end SUB_GROUP /begin FUNCTION_LIST /end FUNCTION_LIST /begin REF_CHARACTERISTIC /end REF_CHARACTERISTIC /begin REF_MEASUREMENT MotTqTranlDampg.LoaSt.Val /end REF_MEASUREMENT /end GROUP
/begin GROUP MotTqTranlDampg.LoaStPrev "MICROSAR RTE" /begin SUB_GROUP /end SUB_GROUP /begin FUNCTION_LIST /end FUNCTION_LIST /begin REF_CHARACTERISTIC /end REF_CHARACTERISTIC /begin REF_MEASUREMENT MotTqTranlDampg.LoaStPrev /end REF_MEASUREMENT /end GROUP
/begin GROUP MotTqTranlDampg.MotTqCmdCrf.Val "MICROSAR RTE" /begin SUB_GROUP /end SUB_GROUP /begin FUNCTION_LIST /end FUNCTION_LIST /begin REF_CHARACTERISTIC /end REF_CHARACTERISTIC /begin REF_MEASUREMENT MotTqTranlDampg.MotTqCmdCrf.Val /end REF_MEASUREMENT /end GROUP
/begin GROUP MotTqTranlDampg.MotTqCmdCrfDampd.Val "MICROSAR RTE" /begin SUB_GROUP /end SUB_GROUP /begin FUNCTION_LIST /end FUNCTION_LIST /begin REF_CHARACTERISTIC /end REF_CHARACTERISTIC /begin REF_MEASUREMENT MotTqTranlDampg.MotTqCmdCrfDampd.Val /end REF_MEASUREMENT /end GROUP
/begin GROUP MotTqTranlDampg.MotTqCmdMrfDampd.Val "MICROSAR RTE" /begin SUB_GROUP /end SUB_GROUP /begin FUNCTION_LIST /end FUNCTION_LIST /begin REF_CHARACTERISTIC /end REF_CHARACTERISTIC /begin REF_MEASUREMENT MotTqTranlDampg.MotTqCmdMrfDampd.Val /end REF_MEASUREMENT /end GROUP
/begin GROUP MotTqTranlDampg.MotTqTranlDampgCmdLim.Val "MICROSAR RTE" /begin SUB_GROUP /end SUB_GROUP /begin FUNCTION_LIST /end FUNCTION_LIST /begin REF_CHARACTERISTIC MotTqTranlDampg.MotTqTranlDampgCmdLim.Val /end REF_CHARACTERISTIC /begin REF_MEASUREMENT /end REF_MEASUREMENT /end GROUP
/begin GROUP MotTqTranlDampg.MotTqTranlDampgCmpl.Logl "MICROSAR RTE" /begin SUB_GROUP /end SUB_GROUP /begin FUNCTION_LIST /end FUNCTION_LIST /begin REF_CHARACTERISTIC /end REF_CHARACTERISTIC /begin REF_MEASUREMENT MotTqTranlDampg.MotTqTranlDampgCmpl.Logl /end REF_MEASUREMENT /end GROUP
/begin GROUP MotTqTranlDampg.MotTqTranlDampgDampgCoeff.Val "MICROSAR RTE" /begin SUB_GROUP /end SUB_GROUP /begin FUNCTION_LIST /end FUNCTION_LIST /begin REF_CHARACTERISTIC MotTqTranlDampg.MotTqTranlDampgDampgCoeff.Val /end REF_CHARACTERISTIC /begin REF_MEASUREMENT /end REF_MEASUREMENT /end GROUP
/begin GROUP MotTqTranlDampg.MotTqTranlDampgRampEnd.Val "MICROSAR RTE" /begin SUB_GROUP /end SUB_GROUP /begin FUNCTION_LIST /end FUNCTION_LIST /begin REF_CHARACTERISTIC MotTqTranlDampg.MotTqTranlDampgRampEnd.Val /end REF_CHARACTERISTIC /begin REF_MEASUREMENT /end REF_MEASUREMENT /end GROUP
/begin GROUP MotTqTranlDampg.MotTqTranlDampgTmrPt1.Val "MICROSAR RTE" /begin SUB_GROUP /end SUB_GROUP /begin FUNCTION_LIST /end FUNCTION_LIST /begin REF_CHARACTERISTIC MotTqTranlDampg.MotTqTranlDampgTmrPt1.Val /end REF_CHARACTERISTIC /begin REF_MEASUREMENT /end REF_MEASUREMENT /end GROUP
/begin GROUP MotTqTranlDampg.MotTqTranlDampgTmrPt2.Val "MICROSAR RTE" /begin SUB_GROUP /end SUB_GROUP /begin FUNCTION_LIST /end FUNCTION_LIST /begin REF_CHARACTERISTIC MotTqTranlDampg.MotTqTranlDampgTmrPt2.Val /end REF_CHARACTERISTIC /begin REF_MEASUREMENT /end REF_MEASUREMENT /end GROUP
/begin GROUP MotTqTranlDampg.MotTqTranlDampgVehSpdBlndX.Ary1D "MICROSAR RTE" /begin SUB_GROUP /end SUB_GROUP /begin FUNCTION_LIST /end FUNCTION_LIST /begin REF_CHARACTERISTIC MotTqTranlDampg.MotTqTranlDampgVehSpdBlndX.Ary1D /end REF_CHARACTERISTIC /begin REF_MEASUREMENT /end REF_MEASUREMENT /end GROUP
/begin GROUP MotTqTranlDampg.MotTqTranlDampgVehSpdBlndY.Ary1D "MICROSAR RTE" /begin SUB_GROUP /end SUB_GROUP /begin FUNCTION_LIST /end FUNCTION_LIST /begin REF_CHARACTERISTIC MotTqTranlDampg.MotTqTranlDampgVehSpdBlndY.Ary1D /end REF_CHARACTERISTIC /begin REF_MEASUREMENT /end REF_MEASUREMENT /end GROUP
/begin GROUP MotTqTranlDampg.MotTqTranlDampgVelThd.Val "MICROSAR RTE" /begin SUB_GROUP /end SUB_GROUP /begin FUNCTION_LIST /end FUNCTION_LIST /begin REF_CHARACTERISTIC MotTqTranlDampg.MotTqTranlDampgVelThd.Val /end REF_CHARACTERISTIC /begin REF_MEASUREMENT /end REF_MEASUREMENT /end GROUP
/begin GROUP MotTqTranlDampg.MotVelCrf.Val "MICROSAR RTE" /begin SUB_GROUP /end SUB_GROUP /begin FUNCTION_LIST /end FUNCTION_LIST /begin REF_CHARACTERISTIC /end REF_CHARACTERISTIC /begin REF_MEASUREMENT MotTqTranlDampg.MotVelCrf.Val /end REF_MEASUREMENT /end GROUP
/begin GROUP MotTqTranlDampg.PerInstanceMemories "MICROSAR RTE"
 /begin SUB_GROUP MotTqTranlDampg.DiagStsPrev MotTqTranlDampg.LoaStPrev MotTqTranlDampg.StLtch MotTqTranlDampg.TmrRefTi MotTqTranlDampg.dMotTqTranlDampgCmdCtrld MotTqTranlDampg.dMotTqTranlDampgSignPhaSca MotTqTranlDampg.dMotTqTranlDampgTiElpd MotTqTranlDampg.dMotTqTranlDampgTmrEna MotTqTranlDampg.dMotTqTranlDampgVelDampgCmd /end SUB_GROUP
 /begin FUNCTION_LIST /end FUNCTION_LIST
 /begin REF_CHARACTERISTIC /end REF_CHARACTERISTIC
 /begin REF_MEASUREMENT /end REF_MEASUREMENT
/end GROUP
/begin GROUP MotTqTranlDampg.ReceiverPorts "MICROSAR RTE"
 /begin SUB_GROUP MotTqTranlDampg.AssiMechPolarity.Val MotTqTranlDampg.DiagcStsCtrldShtDwnFltPrsnt.Logl MotTqTranlDampg.HwAg.Val MotTqTranlDampg.LoaSt.Val MotTqTranlDampg.MotTqCmdCrf.Val MotTqTranlDampg.MotVelCrf.Val MotTqTranlDampg.SysSt.Val MotTqTranlDampg.VehSpd.Val /end SUB_GROUP
 /begin FUNCTION_LIST /end FUNCTION_LIST
 /begin REF_CHARACTERISTIC /end REF_CHARACTERISTIC
 /begin REF_MEASUREMENT /end REF_MEASUREMENT
/end GROUP
/begin GROUP MotTqTranlDampg.SenderPorts "MICROSAR RTE"
 /begin SUB_GROUP MotTqTranlDampg.MotTqCmdCrfDampd.Val MotTqTranlDampg.MotTqCmdMrfDampd.Val MotTqTranlDampg.MotTqTranlDampgCmpl.Logl /end SUB_GROUP
 /begin FUNCTION_LIST /end FUNCTION_LIST
 /begin REF_CHARACTERISTIC /end REF_CHARACTERISTIC
 /begin REF_MEASUREMENT /end REF_MEASUREMENT
/end GROUP
/begin GROUP MotTqTranlDampg.StLtch "MICROSAR RTE" /begin SUB_GROUP /end SUB_GROUP /begin FUNCTION_LIST /end FUNCTION_LIST /begin REF_CHARACTERISTIC /end REF_CHARACTERISTIC /begin REF_MEASUREMENT MotTqTranlDampg.StLtch /end REF_MEASUREMENT /end GROUP
/begin GROUP MotTqTranlDampg.SysSt.Val "MICROSAR RTE" /begin SUB_GROUP /end SUB_GROUP /begin FUNCTION_LIST /end FUNCTION_LIST /begin REF_CHARACTERISTIC /end REF_CHARACTERISTIC /begin REF_MEASUREMENT MotTqTranlDampg.SysSt.Val /end REF_MEASUREMENT /end GROUP
/begin GROUP MotTqTranlDampg.TmrRefTi "MICROSAR RTE" /begin SUB_GROUP /end SUB_GROUP /begin FUNCTION_LIST /end FUNCTION_LIST /begin REF_CHARACTERISTIC /end REF_CHARACTERISTIC /begin REF_MEASUREMENT MotTqTranlDampg.TmrRefTi /end REF_MEASUREMENT /end GROUP
/begin GROUP MotTqTranlDampg.VehSpd.Val "MICROSAR RTE" /begin SUB_GROUP /end SUB_GROUP /begin FUNCTION_LIST /end FUNCTION_LIST /begin REF_CHARACTERISTIC /end REF_CHARACTERISTIC /begin REF_MEASUREMENT MotTqTranlDampg.VehSpd.Val /end REF_MEASUREMENT /end GROUP
/begin GROUP MotTqTranlDampg.dMotTqTranlDampgCmdCtrld "MICROSAR RTE" /begin SUB_GROUP /end SUB_GROUP /begin FUNCTION_LIST /end FUNCTION_LIST /begin REF_CHARACTERISTIC /end REF_CHARACTERISTIC /begin REF_MEASUREMENT MotTqTranlDampg.dMotTqTranlDampgCmdCtrld /end REF_MEASUREMENT /end GROUP
/begin GROUP MotTqTranlDampg.dMotTqTranlDampgSignPhaSca "MICROSAR RTE" /begin SUB_GROUP /end SUB_GROUP /begin FUNCTION_LIST /end FUNCTION_LIST /begin REF_CHARACTERISTIC /end REF_CHARACTERISTIC /begin REF_MEASUREMENT MotTqTranlDampg.dMotTqTranlDampgSignPhaSca /end REF_MEASUREMENT /end GROUP
/begin GROUP MotTqTranlDampg.dMotTqTranlDampgTiElpd "MICROSAR RTE" /begin SUB_GROUP /end SUB_GROUP /begin FUNCTION_LIST /end FUNCTION_LIST /begin REF_CHARACTERISTIC /end REF_CHARACTERISTIC /begin REF_MEASUREMENT MotTqTranlDampg.dMotTqTranlDampgTiElpd /end REF_MEASUREMENT /end GROUP
/begin GROUP MotTqTranlDampg.dMotTqTranlDampgTmrEna "MICROSAR RTE" /begin SUB_GROUP /end SUB_GROUP /begin FUNCTION_LIST /end FUNCTION_LIST /begin REF_CHARACTERISTIC /end REF_CHARACTERISTIC /begin REF_MEASUREMENT MotTqTranlDampg.dMotTqTranlDampgTmrEna /end REF_MEASUREMENT /end GROUP
/begin GROUP MotTqTranlDampg.dMotTqTranlDampgVelDampgCmd "MICROSAR RTE" /begin SUB_GROUP /end SUB_GROUP /begin FUNCTION_LIST /end FUNCTION_LIST /begin REF_CHARACTERISTIC /end REF_CHARACTERISTIC /begin REF_MEASUREMENT MotTqTranlDampg.dMotTqTranlDampgVelDampgCmd /end REF_MEASUREMENT /end GROUP
/begin GROUP MotVelCtrl "MICROSAR RTE" /begin SUB_GROUP MotVelCtrl.PerInstanceMemories MotVelCtrl.ReceiverPorts /end SUB_GROUP /begin FUNCTION_LIST /end FUNCTION_LIST /begin REF_CHARACTERISTIC /end REF_CHARACTERISTIC /begin REF_MEASUREMENT /end REF_MEASUREMENT /end GROUP
/begin GROUP MotVelCtrl.EnaCtrl "MICROSAR RTE" /begin SUB_GROUP /end SUB_GROUP /begin FUNCTION_LIST /end FUNCTION_LIST /begin REF_CHARACTERISTIC /end REF_CHARACTERISTIC /begin REF_MEASUREMENT MotVelCtrl.EnaCtrl /end REF_MEASUREMENT /end GROUP
/begin GROUP MotVelCtrl.EnaCtrlStVari "MICROSAR RTE" /begin SUB_GROUP /end SUB_GROUP /begin FUNCTION_LIST /end FUNCTION_LIST /begin REF_CHARACTERISTIC /end REF_CHARACTERISTIC /begin REF_MEASUREMENT MotVelCtrl.EnaCtrlStVari /end REF_MEASUREMENT /end GROUP
/begin GROUP MotVelCtrl.FctActvSts "MICROSAR RTE" /begin SUB_GROUP /end SUB_GROUP /begin FUNCTION_LIST /end FUNCTION_LIST /begin REF_CHARACTERISTIC /end REF_CHARACTERISTIC /begin REF_MEASUREMENT MotVelCtrl.FctActvSts /end REF_MEASUREMENT /end GROUP
/begin GROUP MotVelCtrl.MotVelCrf.Val "MICROSAR RTE" /begin SUB_GROUP /end SUB_GROUP /begin FUNCTION_LIST /end FUNCTION_LIST /begin REF_CHARACTERISTIC /end REF_CHARACTERISTIC /begin REF_MEASUREMENT MotVelCtrl.MotVelCrf.Val /end REF_MEASUREMENT /end GROUP
/begin GROUP MotVelCtrl.MotVelTar "MICROSAR RTE" /begin SUB_GROUP /end SUB_GROUP /begin FUNCTION_LIST /end FUNCTION_LIST /begin REF_CHARACTERISTIC /end REF_CHARACTERISTIC /begin REF_MEASUREMENT MotVelCtrl.MotVelTar /end REF_MEASUREMENT /end GROUP
/begin GROUP MotVelCtrl.PerInstanceMemories "MICROSAR RTE"
 /begin SUB_GROUP MotVelCtrl.EnaCtrl MotVelCtrl.EnaCtrlStVari MotVelCtrl.FctActvSts MotVelCtrl.MotVelTar MotVelCtrl.PrevAntiWdupCmd MotVelCtrl.PrevDerivtvOutp MotVelCtrl.PrevIntgtrInp MotVelCtrl.PrevIntgtrOutp MotVelCtrl.PrevMotVelErr MotVelCtrl.PrevMotVelTar MotVelCtrl.RampDwnCmpl MotVelCtrl.RefTiRampDwn MotVelCtrl.VelSlewRate /end SUB_GROUP
 /begin FUNCTION_LIST /end FUNCTION_LIST
 /begin REF_CHARACTERISTIC /end REF_CHARACTERISTIC
 /begin REF_MEASUREMENT /end REF_MEASUREMENT
/end GROUP
/begin GROUP MotVelCtrl.PrevAntiWdupCmd "MICROSAR RTE" /begin SUB_GROUP /end SUB_GROUP /begin FUNCTION_LIST /end FUNCTION_LIST /begin REF_CHARACTERISTIC /end REF_CHARACTERISTIC /begin REF_MEASUREMENT MotVelCtrl.PrevAntiWdupCmd /end REF_MEASUREMENT /end GROUP
/begin GROUP MotVelCtrl.PrevDerivtvOutp "MICROSAR RTE" /begin SUB_GROUP /end SUB_GROUP /begin FUNCTION_LIST /end FUNCTION_LIST /begin REF_CHARACTERISTIC /end REF_CHARACTERISTIC /begin REF_MEASUREMENT MotVelCtrl.PrevDerivtvOutp /end REF_MEASUREMENT /end GROUP
/begin GROUP MotVelCtrl.PrevIntgtrInp "MICROSAR RTE" /begin SUB_GROUP /end SUB_GROUP /begin FUNCTION_LIST /end FUNCTION_LIST /begin REF_CHARACTERISTIC /end REF_CHARACTERISTIC /begin REF_MEASUREMENT MotVelCtrl.PrevIntgtrInp /end REF_MEASUREMENT /end GROUP
/begin GROUP MotVelCtrl.PrevIntgtrOutp "MICROSAR RTE" /begin SUB_GROUP /end SUB_GROUP /begin FUNCTION_LIST /end FUNCTION_LIST /begin REF_CHARACTERISTIC /end REF_CHARACTERISTIC /begin REF_MEASUREMENT MotVelCtrl.PrevIntgtrOutp /end REF_MEASUREMENT /end GROUP
/begin GROUP MotVelCtrl.PrevMotVelErr "MICROSAR RTE" /begin SUB_GROUP /end SUB_GROUP /begin FUNCTION_LIST /end FUNCTION_LIST /begin REF_CHARACTERISTIC /end REF_CHARACTERISTIC /begin REF_MEASUREMENT MotVelCtrl.PrevMotVelErr /end REF_MEASUREMENT /end GROUP
/begin GROUP MotVelCtrl.PrevMotVelTar "MICROSAR RTE" /begin SUB_GROUP /end SUB_GROUP /begin FUNCTION_LIST /end FUNCTION_LIST /begin REF_CHARACTERISTIC /end REF_CHARACTERISTIC /begin REF_MEASUREMENT MotVelCtrl.PrevMotVelTar /end REF_MEASUREMENT /end GROUP
/begin GROUP MotVelCtrl.RampDwnCmpl "MICROSAR RTE" /begin SUB_GROUP /end SUB_GROUP /begin FUNCTION_LIST /end FUNCTION_LIST /begin REF_CHARACTERISTIC /end REF_CHARACTERISTIC /begin REF_MEASUREMENT MotVelCtrl.RampDwnCmpl /end REF_MEASUREMENT /end GROUP
/begin GROUP MotVelCtrl.ReceiverPorts "MICROSAR RTE" /begin SUB_GROUP MotVelCtrl.MotVelCrf.Val /end SUB_GROUP /begin FUNCTION_LIST /end FUNCTION_LIST /begin REF_CHARACTERISTIC /end REF_CHARACTERISTIC /begin REF_MEASUREMENT /end REF_MEASUREMENT /end GROUP
/begin GROUP MotVelCtrl.RefTiRampDwn "MICROSAR RTE" /begin SUB_GROUP /end SUB_GROUP /begin FUNCTION_LIST /end FUNCTION_LIST /begin REF_CHARACTERISTIC /end REF_CHARACTERISTIC /begin REF_MEASUREMENT MotVelCtrl.RefTiRampDwn /end REF_MEASUREMENT /end GROUP
/begin GROUP MotVelCtrl.VelSlewRate "MICROSAR RTE" /begin SUB_GROUP /end SUB_GROUP /begin FUNCTION_LIST /end FUNCTION_LIST /begin REF_CHARACTERISTIC /end REF_CHARACTERISTIC /begin REF_MEASUREMENT MotVelCtrl.VelSlewRate /end REF_MEASUREMENT /end GROUP
/begin GROUP NxtrCalIds "MICROSAR RTE" /begin SUB_GROUP NxtrCalIds.CalibrationPorts /end SUB_GROUP /begin FUNCTION_LIST /end FUNCTION_LIST /begin REF_CHARACTERISTIC /end REF_CHARACTERISTIC /begin REF_MEASUREMENT /end REF_MEASUREMENT /end GROUP
/begin GROUP NxtrCalIds.CalibrationPorts "MICROSAR RTE"
 /begin SUB_GROUP NxtrCalIds.NxtrCalIdsCal0DevlpAuthor.Ary1D NxtrCalIds.NxtrCalIdsCal0DevlpDescr.Ary1D NxtrCalIds.NxtrCalIdsCal0DevlpRelNr.Val NxtrCalIds.NxtrCalIdsCal0DevlpRelSt.Val NxtrCalIds.NxtrCalIdsCal0DevlpTiStamp.Val NxtrCalIds.NxtrCalIdsCal0DevlpVers.Val NxtrCalIds.NxtrCalIdsCal1DevlpAuthor.Ary1D NxtrCalIds.NxtrCalIdsCal1DevlpDescr.Ary1D NxtrCalIds.NxtrCalIdsCal1DevlpRelNr.Val NxtrCalIds.NxtrCalIdsCal1DevlpRelSt.Val NxtrCalIds.NxtrCalIdsCal1DevlpTiStamp.Val NxtrCalIds.NxtrCalIdsCal1DevlpVers.Val NxtrCalIds.NxtrCalIdsCal2DevlpAuthor.Ary1D NxtrCalIds.NxtrCalIdsCal2DevlpDescr.Ary1D NxtrCalIds.NxtrCalIdsCal2DevlpRelNr.Val NxtrCalIds.NxtrCalIdsCal2DevlpRelSt.Val NxtrCalIds.NxtrCalIdsCal2DevlpTiStamp.Val NxtrCalIds.NxtrCalIdsCal2DevlpVers.Val /end SUB_GROUP
 /begin FUNCTION_LIST /end FUNCTION_LIST
 /begin REF_CHARACTERISTIC /end REF_CHARACTERISTIC
 /begin REF_MEASUREMENT /end REF_MEASUREMENT
/end GROUP
/begin GROUP NxtrCalIds.NxtrCalIdsCal0DevlpAuthor.Ary1D "MICROSAR RTE" /begin SUB_GROUP /end SUB_GROUP /begin FUNCTION_LIST /end FUNCTION_LIST /begin REF_CHARACTERISTIC NxtrCalIds.NxtrCalIdsCal0DevlpAuthor.Ary1D /end REF_CHARACTERISTIC /begin REF_MEASUREMENT /end REF_MEASUREMENT /end GROUP
/begin GROUP NxtrCalIds.NxtrCalIdsCal0DevlpDescr.Ary1D "MICROSAR RTE" /begin SUB_GROUP /end SUB_GROUP /begin FUNCTION_LIST /end FUNCTION_LIST /begin REF_CHARACTERISTIC NxtrCalIds.NxtrCalIdsCal0DevlpDescr.Ary1D /end REF_CHARACTERISTIC /begin REF_MEASUREMENT /end REF_MEASUREMENT /end GROUP
/begin GROUP NxtrCalIds.NxtrCalIdsCal0DevlpRelNr.Val "MICROSAR RTE" /begin SUB_GROUP /end SUB_GROUP /begin FUNCTION_LIST /end FUNCTION_LIST /begin REF_CHARACTERISTIC NxtrCalIds.NxtrCalIdsCal0DevlpRelNr.Val /end REF_CHARACTERISTIC /begin REF_MEASUREMENT /end REF_MEASUREMENT /end GROUP
/begin GROUP NxtrCalIds.NxtrCalIdsCal0DevlpRelSt.Val "MICROSAR RTE" /begin SUB_GROUP /end SUB_GROUP /begin FUNCTION_LIST /end FUNCTION_LIST /begin REF_CHARACTERISTIC NxtrCalIds.NxtrCalIdsCal0DevlpRelSt.Val /end REF_CHARACTERISTIC /begin REF_MEASUREMENT /end REF_MEASUREMENT /end GROUP
/begin GROUP NxtrCalIds.NxtrCalIdsCal0DevlpTiStamp.Val "MICROSAR RTE" /begin SUB_GROUP /end SUB_GROUP /begin FUNCTION_LIST /end FUNCTION_LIST /begin REF_CHARACTERISTIC NxtrCalIds.NxtrCalIdsCal0DevlpTiStamp.Val /end REF_CHARACTERISTIC /begin REF_MEASUREMENT /end REF_MEASUREMENT /end GROUP
/begin GROUP NxtrCalIds.NxtrCalIdsCal0DevlpVers.Val "MICROSAR RTE" /begin SUB_GROUP /end SUB_GROUP /begin FUNCTION_LIST /end FUNCTION_LIST /begin REF_CHARACTERISTIC NxtrCalIds.NxtrCalIdsCal0DevlpVers.Val /end REF_CHARACTERISTIC /begin REF_MEASUREMENT /end REF_MEASUREMENT /end GROUP
/begin GROUP NxtrCalIds.NxtrCalIdsCal1DevlpAuthor.Ary1D "MICROSAR RTE" /begin SUB_GROUP /end SUB_GROUP /begin FUNCTION_LIST /end FUNCTION_LIST /begin REF_CHARACTERISTIC NxtrCalIds.NxtrCalIdsCal1DevlpAuthor.Ary1D /end REF_CHARACTERISTIC /begin REF_MEASUREMENT /end REF_MEASUREMENT /end GROUP
/begin GROUP NxtrCalIds.NxtrCalIdsCal1DevlpDescr.Ary1D "MICROSAR RTE" /begin SUB_GROUP /end SUB_GROUP /begin FUNCTION_LIST /end FUNCTION_LIST /begin REF_CHARACTERISTIC NxtrCalIds.NxtrCalIdsCal1DevlpDescr.Ary1D /end REF_CHARACTERISTIC /begin REF_MEASUREMENT /end REF_MEASUREMENT /end GROUP
/begin GROUP NxtrCalIds.NxtrCalIdsCal1DevlpRelNr.Val "MICROSAR RTE" /begin SUB_GROUP /end SUB_GROUP /begin FUNCTION_LIST /end FUNCTION_LIST /begin REF_CHARACTERISTIC NxtrCalIds.NxtrCalIdsCal1DevlpRelNr.Val /end REF_CHARACTERISTIC /begin REF_MEASUREMENT /end REF_MEASUREMENT /end GROUP
/begin GROUP NxtrCalIds.NxtrCalIdsCal1DevlpRelSt.Val "MICROSAR RTE" /begin SUB_GROUP /end SUB_GROUP /begin FUNCTION_LIST /end FUNCTION_LIST /begin REF_CHARACTERISTIC NxtrCalIds.NxtrCalIdsCal1DevlpRelSt.Val /end REF_CHARACTERISTIC /begin REF_MEASUREMENT /end REF_MEASUREMENT /end GROUP
/begin GROUP NxtrCalIds.NxtrCalIdsCal1DevlpTiStamp.Val "MICROSAR RTE" /begin SUB_GROUP /end SUB_GROUP /begin FUNCTION_LIST /end FUNCTION_LIST /begin REF_CHARACTERISTIC NxtrCalIds.NxtrCalIdsCal1DevlpTiStamp.Val /end REF_CHARACTERISTIC /begin REF_MEASUREMENT /end REF_MEASUREMENT /end GROUP
/begin GROUP NxtrCalIds.NxtrCalIdsCal1DevlpVers.Val "MICROSAR RTE" /begin SUB_GROUP /end SUB_GROUP /begin FUNCTION_LIST /end FUNCTION_LIST /begin REF_CHARACTERISTIC NxtrCalIds.NxtrCalIdsCal1DevlpVers.Val /end REF_CHARACTERISTIC /begin REF_MEASUREMENT /end REF_MEASUREMENT /end GROUP
/begin GROUP NxtrCalIds.NxtrCalIdsCal2DevlpAuthor.Ary1D "MICROSAR RTE" /begin SUB_GROUP /end SUB_GROUP /begin FUNCTION_LIST /end FUNCTION_LIST /begin REF_CHARACTERISTIC NxtrCalIds.NxtrCalIdsCal2DevlpAuthor.Ary1D /end REF_CHARACTERISTIC /begin REF_MEASUREMENT /end REF_MEASUREMENT /end GROUP
/begin GROUP NxtrCalIds.NxtrCalIdsCal2DevlpDescr.Ary1D "MICROSAR RTE" /begin SUB_GROUP /end SUB_GROUP /begin FUNCTION_LIST /end FUNCTION_LIST /begin REF_CHARACTERISTIC NxtrCalIds.NxtrCalIdsCal2DevlpDescr.Ary1D /end REF_CHARACTERISTIC /begin REF_MEASUREMENT /end REF_MEASUREMENT /end GROUP
/begin GROUP NxtrCalIds.NxtrCalIdsCal2DevlpRelNr.Val "MICROSAR RTE" /begin SUB_GROUP /end SUB_GROUP /begin FUNCTION_LIST /end FUNCTION_LIST /begin REF_CHARACTERISTIC NxtrCalIds.NxtrCalIdsCal2DevlpRelNr.Val /end REF_CHARACTERISTIC /begin REF_MEASUREMENT /end REF_MEASUREMENT /end GROUP
/begin GROUP NxtrCalIds.NxtrCalIdsCal2DevlpRelSt.Val "MICROSAR RTE" /begin SUB_GROUP /end SUB_GROUP /begin FUNCTION_LIST /end FUNCTION_LIST /begin REF_CHARACTERISTIC NxtrCalIds.NxtrCalIdsCal2DevlpRelSt.Val /end REF_CHARACTERISTIC /begin REF_MEASUREMENT /end REF_MEASUREMENT /end GROUP
/begin GROUP NxtrCalIds.NxtrCalIdsCal2DevlpTiStamp.Val "MICROSAR RTE" /begin SUB_GROUP /end SUB_GROUP /begin FUNCTION_LIST /end FUNCTION_LIST /begin REF_CHARACTERISTIC NxtrCalIds.NxtrCalIdsCal2DevlpTiStamp.Val /end REF_CHARACTERISTIC /begin REF_MEASUREMENT /end REF_MEASUREMENT /end GROUP
/begin GROUP NxtrCalIds.NxtrCalIdsCal2DevlpVers.Val "MICROSAR RTE" /begin SUB_GROUP /end SUB_GROUP /begin FUNCTION_LIST /end FUNCTION_LIST /begin REF_CHARACTERISTIC NxtrCalIds.NxtrCalIdsCal2DevlpVers.Val /end REF_CHARACTERISTIC /begin REF_MEASUREMENT /end REF_MEASUREMENT /end GROUP
/begin GROUP PartNr "MICROSAR RTE"
 /begin SUB_GROUP PartNr.CalibrationParameters PartNr.PerInstanceMemories PartNr.ReceiverPorts /end SUB_GROUP
 /begin FUNCTION_LIST /end FUNCTION_LIST
 /begin REF_CHARACTERISTIC /end REF_CHARACTERISTIC
 /begin REF_MEASUREMENT /end REF_MEASUREMENT
/end GROUP
/begin GROUP PartNr.CalibrationParameters "MICROSAR RTE"
 /begin SUB_GROUP PartNr.PartNrBasMdlPartNrDft PartNr.PartNrCalProgdStsDft PartNr.PartNrCcaMfgTrakgDft PartNr.PartNrCtrlPidSeedKeyDft PartNr.PartNrCustMfgEnaCntrDft PartNr.PartNrDataUniversalNrSysIdDft PartNr.PartNrEndMdlPartNrDft PartNr.PartNrNxtrMfgTrakgDft PartNr.PartNrProgmDateDft PartNr.PartNrProgmSessionSeedKeyDft PartNr.PartNrRepairShopCodDft PartNr.PartNrSysCodVersNrDft PartNr.PartNrSysNameDft PartNr.PartNrVinDataDft /end SUB_GROUP
 /begin FUNCTION_LIST /end FUNCTION_LIST
 /begin REF_CHARACTERISTIC /end REF_CHARACTERISTIC
 /begin REF_MEASUREMENT /end REF_MEASUREMENT
/end GROUP
/begin GROUP PartNr.PartNrBasMdlPartNr "MICROSAR RTE" /begin SUB_GROUP /end SUB_GROUP /begin FUNCTION_LIST /end FUNCTION_LIST /begin REF_CHARACTERISTIC /end REF_CHARACTERISTIC /begin REF_MEASUREMENT PartNr.PartNrBasMdlPartNr /end REF_MEASUREMENT /end GROUP
/begin GROUP PartNr.PartNrBasMdlPartNrDft "MICROSAR RTE" /begin SUB_GROUP /end SUB_GROUP /begin FUNCTION_LIST /end FUNCTION_LIST /begin REF_CHARACTERISTIC PartNr.PartNrBasMdlPartNrDft /end REF_CHARACTERISTIC /begin REF_MEASUREMENT /end REF_MEASUREMENT /end GROUP
/begin GROUP PartNr.PartNrCalProgdSts "MICROSAR RTE" /begin SUB_GROUP /end SUB_GROUP /begin FUNCTION_LIST /end FUNCTION_LIST /begin REF_CHARACTERISTIC /end REF_CHARACTERISTIC /begin REF_MEASUREMENT PartNr.PartNrCalProgdSts /end REF_MEASUREMENT /end GROUP
/begin GROUP PartNr.PartNrCalProgdStsDft "MICROSAR RTE" /begin SUB_GROUP /end SUB_GROUP /begin FUNCTION_LIST /end FUNCTION_LIST /begin REF_CHARACTERISTIC PartNr.PartNrCalProgdStsDft /end REF_CHARACTERISTIC /begin REF_MEASUREMENT /end REF_MEASUREMENT /end GROUP
/begin GROUP PartNr.PartNrCcaMfgTrakg "MICROSAR RTE" /begin SUB_GROUP /end SUB_GROUP /begin FUNCTION_LIST /end FUNCTION_LIST /begin REF_CHARACTERISTIC /end REF_CHARACTERISTIC /begin REF_MEASUREMENT PartNr.PartNrCcaMfgTrakg /end REF_MEASUREMENT /end GROUP
/begin GROUP PartNr.PartNrCcaMfgTrakgDft "MICROSAR RTE" /begin SUB_GROUP /end SUB_GROUP /begin FUNCTION_LIST /end FUNCTION_LIST /begin REF_CHARACTERISTIC PartNr.PartNrCcaMfgTrakgDft /end REF_CHARACTERISTIC /begin REF_MEASUREMENT /end REF_MEASUREMENT /end GROUP
/begin GROUP PartNr.PartNrCtrlPidSeedKey "MICROSAR RTE" /begin SUB_GROUP /end SUB_GROUP /begin FUNCTION_LIST /end FUNCTION_LIST /begin REF_CHARACTERISTIC /end REF_CHARACTERISTIC /begin REF_MEASUREMENT PartNr.PartNrCtrlPidSeedKey /end REF_MEASUREMENT /end GROUP
/begin GROUP PartNr.PartNrCtrlPidSeedKeyDft "MICROSAR RTE" /begin SUB_GROUP /end SUB_GROUP /begin FUNCTION_LIST /end FUNCTION_LIST /begin REF_CHARACTERISTIC PartNr.PartNrCtrlPidSeedKeyDft /end REF_CHARACTERISTIC /begin REF_MEASUREMENT /end REF_MEASUREMENT /end GROUP
/begin GROUP PartNr.PartNrCustMfgEnaCntr "MICROSAR RTE" /begin SUB_GROUP /end SUB_GROUP /begin FUNCTION_LIST /end FUNCTION_LIST /begin REF_CHARACTERISTIC /end REF_CHARACTERISTIC /begin REF_MEASUREMENT PartNr.PartNrCustMfgEnaCntr /end REF_MEASUREMENT /end GROUP
/begin GROUP PartNr.PartNrCustMfgEnaCntrDft "MICROSAR RTE" /begin SUB_GROUP /end SUB_GROUP /begin FUNCTION_LIST /end FUNCTION_LIST /begin REF_CHARACTERISTIC PartNr.PartNrCustMfgEnaCntrDft /end REF_CHARACTERISTIC /begin REF_MEASUREMENT /end REF_MEASUREMENT /end GROUP
/begin GROUP PartNr.PartNrDataUniversalNrSysId "MICROSAR RTE" /begin SUB_GROUP /end SUB_GROUP /begin FUNCTION_LIST /end FUNCTION_LIST /begin REF_CHARACTERISTIC /end REF_CHARACTERISTIC /begin REF_MEASUREMENT PartNr.PartNrDataUniversalNrSysId /end REF_MEASUREMENT /end GROUP
/begin GROUP PartNr.PartNrDataUniversalNrSysIdDft "MICROSAR RTE" /begin SUB_GROUP /end SUB_GROUP /begin FUNCTION_LIST /end FUNCTION_LIST /begin REF_CHARACTERISTIC PartNr.PartNrDataUniversalNrSysIdDft /end REF_CHARACTERISTIC /begin REF_MEASUREMENT /end REF_MEASUREMENT /end GROUP
/begin GROUP PartNr.PartNrEcuId "MICROSAR RTE" /begin SUB_GROUP /end SUB_GROUP /begin FUNCTION_LIST /end FUNCTION_LIST /begin REF_CHARACTERISTIC /end REF_CHARACTERISTIC /begin REF_MEASUREMENT PartNr.PartNrEcuId /end REF_MEASUREMENT /end GROUP
/begin GROUP PartNr.PartNrEndMdlPartNr "MICROSAR RTE" /begin SUB_GROUP /end SUB_GROUP /begin FUNCTION_LIST /end FUNCTION_LIST /begin REF_CHARACTERISTIC /end REF_CHARACTERISTIC /begin REF_MEASUREMENT PartNr.PartNrEndMdlPartNr /end REF_MEASUREMENT /end GROUP
/begin GROUP PartNr.PartNrEndMdlPartNrDft "MICROSAR RTE" /begin SUB_GROUP /end SUB_GROUP /begin FUNCTION_LIST /end FUNCTION_LIST /begin REF_CHARACTERISTIC PartNr.PartNrEndMdlPartNrDft /end REF_CHARACTERISTIC /begin REF_MEASUREMENT /end REF_MEASUREMENT /end GROUP
/begin GROUP PartNr.PartNrNxtrMfgTrakg "MICROSAR RTE" /begin SUB_GROUP /end SUB_GROUP /begin FUNCTION_LIST /end FUNCTION_LIST /begin REF_CHARACTERISTIC /end REF_CHARACTERISTIC /begin REF_MEASUREMENT PartNr.PartNrNxtrMfgTrakg /end REF_MEASUREMENT /end GROUP
/begin GROUP PartNr.PartNrNxtrMfgTrakgDft "MICROSAR RTE" /begin SUB_GROUP /end SUB_GROUP /begin FUNCTION_LIST /end FUNCTION_LIST /begin REF_CHARACTERISTIC PartNr.PartNrNxtrMfgTrakgDft /end REF_CHARACTERISTIC /begin REF_MEASUREMENT /end REF_MEASUREMENT /end GROUP
/begin GROUP PartNr.PartNrPrevSysPwrModRun "MICROSAR RTE" /begin SUB_GROUP /end SUB_GROUP /begin FUNCTION_LIST /end FUNCTION_LIST /begin REF_CHARACTERISTIC /end REF_CHARACTERISTIC /begin REF_MEASUREMENT PartNr.PartNrPrevSysPwrModRun /end REF_MEASUREMENT /end GROUP
/begin GROUP PartNr.PartNrProgmDate "MICROSAR RTE" /begin SUB_GROUP /end SUB_GROUP /begin FUNCTION_LIST /end FUNCTION_LIST /begin REF_CHARACTERISTIC /end REF_CHARACTERISTIC /begin REF_MEASUREMENT PartNr.PartNrProgmDate /end REF_MEASUREMENT /end GROUP
/begin GROUP PartNr.PartNrProgmDateDft "MICROSAR RTE" /begin SUB_GROUP /end SUB_GROUP /begin FUNCTION_LIST /end FUNCTION_LIST /begin REF_CHARACTERISTIC PartNr.PartNrProgmDateDft /end REF_CHARACTERISTIC /begin REF_MEASUREMENT /end REF_MEASUREMENT /end GROUP
/begin GROUP PartNr.PartNrProgmSessionSeedKey "MICROSAR RTE" /begin SUB_GROUP /end SUB_GROUP /begin FUNCTION_LIST /end FUNCTION_LIST /begin REF_CHARACTERISTIC /end REF_CHARACTERISTIC /begin REF_MEASUREMENT PartNr.PartNrProgmSessionSeedKey /end REF_MEASUREMENT /end GROUP
/begin GROUP PartNr.PartNrProgmSessionSeedKeyDft "MICROSAR RTE" /begin SUB_GROUP /end SUB_GROUP /begin FUNCTION_LIST /end FUNCTION_LIST /begin REF_CHARACTERISTIC PartNr.PartNrProgmSessionSeedKeyDft /end REF_CHARACTERISTIC /begin REF_MEASUREMENT /end REF_MEASUREMENT /end GROUP
/begin GROUP PartNr.PartNrRepairShopCod "MICROSAR RTE" /begin SUB_GROUP /end SUB_GROUP /begin FUNCTION_LIST /end FUNCTION_LIST /begin REF_CHARACTERISTIC /end REF_CHARACTERISTIC /begin REF_MEASUREMENT PartNr.PartNrRepairShopCod /end REF_MEASUREMENT /end GROUP
/begin GROUP PartNr.PartNrRepairShopCodDft "MICROSAR RTE" /begin SUB_GROUP /end SUB_GROUP /begin FUNCTION_LIST /end FUNCTION_LIST /begin REF_CHARACTERISTIC PartNr.PartNrRepairShopCodDft /end REF_CHARACTERISTIC /begin REF_MEASUREMENT /end REF_MEASUREMENT /end GROUP
/begin GROUP PartNr.PartNrSecuBypAuthn "MICROSAR RTE" /begin SUB_GROUP /end SUB_GROUP /begin FUNCTION_LIST /end FUNCTION_LIST /begin REF_CHARACTERISTIC /end REF_CHARACTERISTIC /begin REF_MEASUREMENT PartNr.PartNrSecuBypAuthn /end REF_MEASUREMENT /end GROUP
/begin GROUP PartNr.PartNrSysCodVersNr "MICROSAR RTE" /begin SUB_GROUP /end SUB_GROUP /begin FUNCTION_LIST /end FUNCTION_LIST /begin REF_CHARACTERISTIC /end REF_CHARACTERISTIC /begin REF_MEASUREMENT PartNr.PartNrSysCodVersNr /end REF_MEASUREMENT /end GROUP
/begin GROUP PartNr.PartNrSysCodVersNrDft "MICROSAR RTE" /begin SUB_GROUP /end SUB_GROUP /begin FUNCTION_LIST /end FUNCTION_LIST /begin REF_CHARACTERISTIC PartNr.PartNrSysCodVersNrDft /end REF_CHARACTERISTIC /begin REF_MEASUREMENT /end REF_MEASUREMENT /end GROUP
/begin GROUP PartNr.PartNrSysName "MICROSAR RTE" /begin SUB_GROUP /end SUB_GROUP /begin FUNCTION_LIST /end FUNCTION_LIST /begin REF_CHARACTERISTIC /end REF_CHARACTERISTIC /begin REF_MEASUREMENT PartNr.PartNrSysName /end REF_MEASUREMENT /end GROUP
/begin GROUP PartNr.PartNrSysNameDft "MICROSAR RTE" /begin SUB_GROUP /end SUB_GROUP /begin FUNCTION_LIST /end FUNCTION_LIST /begin REF_CHARACTERISTIC PartNr.PartNrSysNameDft /end REF_CHARACTERISTIC /begin REF_MEASUREMENT /end REF_MEASUREMENT /end GROUP
/begin GROUP PartNr.PartNrVinData "MICROSAR RTE" /begin SUB_GROUP /end SUB_GROUP /begin FUNCTION_LIST /end FUNCTION_LIST /begin REF_CHARACTERISTIC /end REF_CHARACTERISTIC /begin REF_MEASUREMENT PartNr.PartNrVinData /end REF_MEASUREMENT /end GROUP
/begin GROUP PartNr.PartNrVinDataDft "MICROSAR RTE" /begin SUB_GROUP /end SUB_GROUP /begin FUNCTION_LIST /end FUNCTION_LIST /begin REF_CHARACTERISTIC PartNr.PartNrVinDataDft /end REF_CHARACTERISTIC /begin REF_MEASUREMENT /end REF_MEASUREMENT /end GROUP
/begin GROUP PartNr.PerInstanceMemories "MICROSAR RTE"
 /begin SUB_GROUP PartNr.PartNrBasMdlPartNr PartNr.PartNrCalProgdSts PartNr.PartNrCcaMfgTrakg PartNr.PartNrCtrlPidSeedKey PartNr.PartNrCustMfgEnaCntr PartNr.PartNrDataUniversalNrSysId PartNr.PartNrEcuId PartNr.PartNrEndMdlPartNr PartNr.PartNrNxtrMfgTrakg PartNr.PartNrPrevSysPwrModRun PartNr.PartNrProgmDate PartNr.PartNrProgmSessionSeedKey PartNr.PartNrRepairShopCod PartNr.PartNrSecuBypAuthn PartNr.PartNrSysCodVersNr PartNr.PartNrSysName PartNr.PartNrVinData /end SUB_GROUP
 /begin FUNCTION_LIST /end FUNCTION_LIST
 /begin REF_CHARACTERISTIC /end REF_CHARACTERISTIC
 /begin REF_MEASUREMENT /end REF_MEASUREMENT
/end GROUP
/begin GROUP PartNr.ReceiverPorts "MICROSAR RTE" /begin SUB_GROUP PartNr.SysPwrModRun.Logl /end SUB_GROUP /begin FUNCTION_LIST /end FUNCTION_LIST /begin REF_CHARACTERISTIC /end REF_CHARACTERISTIC /begin REF_MEASUREMENT /end REF_MEASUREMENT /end GROUP
/begin GROUP PartNr.SysPwrModRun.Logl "MICROSAR RTE" /begin SUB_GROUP /end SUB_GROUP /begin FUNCTION_LIST /end FUNCTION_LIST /begin REF_CHARACTERISTIC /end REF_CHARACTERISTIC /begin REF_MEASUREMENT PartNr.SysPwrModRun.Logl /end REF_MEASUREMENT /end GROUP
/begin GROUP PolarityCfg "MICROSAR RTE" /begin SUB_GROUP PolarityCfg.PerInstanceMemories PolarityCfg.SenderPorts /end SUB_GROUP /begin FUNCTION_LIST /end FUNCTION_LIST /begin REF_CHARACTERISTIC /end REF_CHARACTERISTIC /begin REF_MEASUREMENT /end REF_MEASUREMENT /end GROUP
/begin GROUP PolarityCfg.AssiMechPolarity.Val "MICROSAR RTE" /begin SUB_GROUP /end SUB_GROUP /begin FUNCTION_LIST /end FUNCTION_LIST /begin REF_CHARACTERISTIC /end REF_CHARACTERISTIC /begin REF_MEASUREMENT PolarityCfg.AssiMechPolarity.Val /end REF_MEASUREMENT /end GROUP
/begin GROUP PolarityCfg.HwAg0Polarity.Val "MICROSAR RTE" /begin SUB_GROUP /end SUB_GROUP /begin FUNCTION_LIST /end FUNCTION_LIST /begin REF_CHARACTERISTIC /end REF_CHARACTERISTIC /begin REF_MEASUREMENT PolarityCfg.HwAg0Polarity.Val /end REF_MEASUREMENT /end GROUP
/begin GROUP PolarityCfg.HwAg1Polarity.Val "MICROSAR RTE" /begin SUB_GROUP /end SUB_GROUP /begin FUNCTION_LIST /end FUNCTION_LIST /begin REF_CHARACTERISTIC /end REF_CHARACTERISTIC /begin REF_MEASUREMENT PolarityCfg.HwAg1Polarity.Val /end REF_MEASUREMENT /end GROUP
/begin GROUP PolarityCfg.HwAg2Polarity.Val "MICROSAR RTE" /begin SUB_GROUP /end SUB_GROUP /begin FUNCTION_LIST /end FUNCTION_LIST /begin REF_CHARACTERISTIC /end REF_CHARACTERISTIC /begin REF_MEASUREMENT PolarityCfg.HwAg2Polarity.Val /end REF_MEASUREMENT /end GROUP
/begin GROUP PolarityCfg.HwAg3Polarity.Val "MICROSAR RTE" /begin SUB_GROUP /end SUB_GROUP /begin FUNCTION_LIST /end FUNCTION_LIST /begin REF_CHARACTERISTIC /end REF_CHARACTERISTIC /begin REF_MEASUREMENT PolarityCfg.HwAg3Polarity.Val /end REF_MEASUREMENT /end GROUP
/begin GROUP PolarityCfg.HwAg4Polarity.Val "MICROSAR RTE" /begin SUB_GROUP /end SUB_GROUP /begin FUNCTION_LIST /end FUNCTION_LIST /begin REF_CHARACTERISTIC /end REF_CHARACTERISTIC /begin REF_MEASUREMENT PolarityCfg.HwAg4Polarity.Val /end REF_MEASUREMENT /end GROUP
/begin GROUP PolarityCfg.HwAg5Polarity.Val "MICROSAR RTE" /begin SUB_GROUP /end SUB_GROUP /begin FUNCTION_LIST /end FUNCTION_LIST /begin REF_CHARACTERISTIC /end REF_CHARACTERISTIC /begin REF_MEASUREMENT PolarityCfg.HwAg5Polarity.Val /end REF_MEASUREMENT /end GROUP
/begin GROUP PolarityCfg.HwAg6Polarity.Val "MICROSAR RTE" /begin SUB_GROUP /end SUB_GROUP /begin FUNCTION_LIST /end FUNCTION_LIST /begin REF_CHARACTERISTIC /end REF_CHARACTERISTIC /begin REF_MEASUREMENT PolarityCfg.HwAg6Polarity.Val /end REF_MEASUREMENT /end GROUP
/begin GROUP PolarityCfg.HwAg7Polarity.Val "MICROSAR RTE" /begin SUB_GROUP /end SUB_GROUP /begin FUNCTION_LIST /end FUNCTION_LIST /begin REF_CHARACTERISTIC /end REF_CHARACTERISTIC /begin REF_MEASUREMENT PolarityCfg.HwAg7Polarity.Val /end REF_MEASUREMENT /end GROUP
/begin GROUP PolarityCfg.HwTq0Polarity.Val "MICROSAR RTE" /begin SUB_GROUP /end SUB_GROUP /begin FUNCTION_LIST /end FUNCTION_LIST /begin REF_CHARACTERISTIC /end REF_CHARACTERISTIC /begin REF_MEASUREMENT PolarityCfg.HwTq0Polarity.Val /end REF_MEASUREMENT /end GROUP
/begin GROUP PolarityCfg.HwTq1Polarity.Val "MICROSAR RTE" /begin SUB_GROUP /end SUB_GROUP /begin FUNCTION_LIST /end FUNCTION_LIST /begin REF_CHARACTERISTIC /end REF_CHARACTERISTIC /begin REF_MEASUREMENT PolarityCfg.HwTq1Polarity.Val /end REF_MEASUREMENT /end GROUP
/begin GROUP PolarityCfg.HwTq2Polarity.Val "MICROSAR RTE" /begin SUB_GROUP /end SUB_GROUP /begin FUNCTION_LIST /end FUNCTION_LIST /begin REF_CHARACTERISTIC /end REF_CHARACTERISTIC /begin REF_MEASUREMENT PolarityCfg.HwTq2Polarity.Val /end REF_MEASUREMENT /end GROUP
/begin GROUP PolarityCfg.HwTq3Polarity.Val "MICROSAR RTE" /begin SUB_GROUP /end SUB_GROUP /begin FUNCTION_LIST /end FUNCTION_LIST /begin REF_CHARACTERISTIC /end REF_CHARACTERISTIC /begin REF_MEASUREMENT PolarityCfg.HwTq3Polarity.Val /end REF_MEASUREMENT /end GROUP
/begin GROUP PolarityCfg.HwTq4Polarity.Val "MICROSAR RTE" /begin SUB_GROUP /end SUB_GROUP /begin FUNCTION_LIST /end FUNCTION_LIST /begin REF_CHARACTERISTIC /end REF_CHARACTERISTIC /begin REF_MEASUREMENT PolarityCfg.HwTq4Polarity.Val /end REF_MEASUREMENT /end GROUP
/begin GROUP PolarityCfg.HwTq5Polarity.Val "MICROSAR RTE" /begin SUB_GROUP /end SUB_GROUP /begin FUNCTION_LIST /end FUNCTION_LIST /begin REF_CHARACTERISTIC /end REF_CHARACTERISTIC /begin REF_MEASUREMENT PolarityCfg.HwTq5Polarity.Val /end REF_MEASUREMENT /end GROUP
/begin GROUP PolarityCfg.HwTq6Polarity.Val "MICROSAR RTE" /begin SUB_GROUP /end SUB_GROUP /begin FUNCTION_LIST /end FUNCTION_LIST /begin REF_CHARACTERISTIC /end REF_CHARACTERISTIC /begin REF_MEASUREMENT PolarityCfg.HwTq6Polarity.Val /end REF_MEASUREMENT /end GROUP
/begin GROUP PolarityCfg.HwTq7Polarity.Val "MICROSAR RTE" /begin SUB_GROUP /end SUB_GROUP /begin FUNCTION_LIST /end FUNCTION_LIST /begin REF_CHARACTERISTIC /end REF_CHARACTERISTIC /begin REF_MEASUREMENT PolarityCfg.HwTq7Polarity.Val /end REF_MEASUREMENT /end GROUP
/begin GROUP PolarityCfg.MotAgMecl0Polarity.Val "MICROSAR RTE" /begin SUB_GROUP /end SUB_GROUP /begin FUNCTION_LIST /end FUNCTION_LIST /begin REF_CHARACTERISTIC /end REF_CHARACTERISTIC /begin REF_MEASUREMENT PolarityCfg.MotAgMecl0Polarity.Val /end REF_MEASUREMENT /end GROUP
/begin GROUP PolarityCfg.MotAgMecl1Polarity.Val "MICROSAR RTE" /begin SUB_GROUP /end SUB_GROUP /begin FUNCTION_LIST /end FUNCTION_LIST /begin REF_CHARACTERISTIC /end REF_CHARACTERISTIC /begin REF_MEASUREMENT PolarityCfg.MotAgMecl1Polarity.Val /end REF_MEASUREMENT /end GROUP
/begin GROUP PolarityCfg.MotAgMecl2Polarity.Val "MICROSAR RTE" /begin SUB_GROUP /end SUB_GROUP /begin FUNCTION_LIST /end FUNCTION_LIST /begin REF_CHARACTERISTIC /end REF_CHARACTERISTIC /begin REF_MEASUREMENT PolarityCfg.MotAgMecl2Polarity.Val /end REF_MEASUREMENT /end GROUP
/begin GROUP PolarityCfg.MotAgMecl3Polarity.Val "MICROSAR RTE" /begin SUB_GROUP /end SUB_GROUP /begin FUNCTION_LIST /end FUNCTION_LIST /begin REF_CHARACTERISTIC /end REF_CHARACTERISTIC /begin REF_MEASUREMENT PolarityCfg.MotAgMecl3Polarity.Val /end REF_MEASUREMENT /end GROUP
/begin GROUP PolarityCfg.MotAgMecl4Polarity.Val "MICROSAR RTE" /begin SUB_GROUP /end SUB_GROUP /begin FUNCTION_LIST /end FUNCTION_LIST /begin REF_CHARACTERISTIC /end REF_CHARACTERISTIC /begin REF_MEASUREMENT PolarityCfg.MotAgMecl4Polarity.Val /end REF_MEASUREMENT /end GROUP
/begin GROUP PolarityCfg.MotAgMecl5Polarity.Val "MICROSAR RTE" /begin SUB_GROUP /end SUB_GROUP /begin FUNCTION_LIST /end FUNCTION_LIST /begin REF_CHARACTERISTIC /end REF_CHARACTERISTIC /begin REF_MEASUREMENT PolarityCfg.MotAgMecl5Polarity.Val /end REF_MEASUREMENT /end GROUP
/begin GROUP PolarityCfg.MotAgMecl6Polarity.Val "MICROSAR RTE" /begin SUB_GROUP /end SUB_GROUP /begin FUNCTION_LIST /end FUNCTION_LIST /begin REF_CHARACTERISTIC /end REF_CHARACTERISTIC /begin REF_MEASUREMENT PolarityCfg.MotAgMecl6Polarity.Val /end REF_MEASUREMENT /end GROUP
/begin GROUP PolarityCfg.MotAgMecl7Polarity.Val "MICROSAR RTE" /begin SUB_GROUP /end SUB_GROUP /begin FUNCTION_LIST /end FUNCTION_LIST /begin REF_CHARACTERISTIC /end REF_CHARACTERISTIC /begin REF_MEASUREMENT PolarityCfg.MotAgMecl7Polarity.Val /end REF_MEASUREMENT /end GROUP
/begin GROUP PolarityCfg.MotElecMeclPolarity.Val "MICROSAR RTE" /begin SUB_GROUP /end SUB_GROUP /begin FUNCTION_LIST /end FUNCTION_LIST /begin REF_CHARACTERISTIC /end REF_CHARACTERISTIC /begin REF_MEASUREMENT PolarityCfg.MotElecMeclPolarity.Val /end REF_MEASUREMENT /end GROUP
/begin GROUP PolarityCfg.PerInstanceMemories "MICROSAR RTE" /begin SUB_GROUP PolarityCfg.PolarityCfgSaved /end SUB_GROUP /begin FUNCTION_LIST /end FUNCTION_LIST /begin REF_CHARACTERISTIC /end REF_CHARACTERISTIC /begin REF_MEASUREMENT /end REF_MEASUREMENT /end GROUP
/begin GROUP PolarityCfg.PolarityCfgSaved "MICROSAR RTE" /begin SUB_GROUP /end SUB_GROUP /begin FUNCTION_LIST /end FUNCTION_LIST /begin REF_CHARACTERISTIC /end REF_CHARACTERISTIC /begin REF_MEASUREMENT PolarityCfg.PolarityCfgSaved /end REF_MEASUREMENT /end GROUP
/begin GROUP PolarityCfg.SenderPorts "MICROSAR RTE"
 /begin SUB_GROUP PolarityCfg.AssiMechPolarity.Val PolarityCfg.HwAg0Polarity.Val PolarityCfg.HwAg1Polarity.Val PolarityCfg.HwAg2Polarity.Val PolarityCfg.HwAg3Polarity.Val PolarityCfg.HwAg4Polarity.Val PolarityCfg.HwAg5Polarity.Val PolarityCfg.HwAg6Polarity.Val PolarityCfg.HwAg7Polarity.Val PolarityCfg.HwTq0Polarity.Val PolarityCfg.HwTq1Polarity.Val PolarityCfg.HwTq2Polarity.Val PolarityCfg.HwTq3Polarity.Val PolarityCfg.HwTq4Polarity.Val PolarityCfg.HwTq5Polarity.Val PolarityCfg.HwTq6Polarity.Val PolarityCfg.HwTq7Polarity.Val PolarityCfg.MotAgMecl0Polarity.Val PolarityCfg.MotAgMecl1Polarity.Val PolarityCfg.MotAgMecl2Polarity.Val PolarityCfg.MotAgMecl3Polarity.Val PolarityCfg.MotAgMecl4Polarity.Val PolarityCfg.MotAgMecl5Polarity.Val PolarityCfg.MotAgMecl6Polarity.Val PolarityCfg.MotAgMecl7Polarity.Val PolarityCfg.MotElecMeclPolarity.Val /end SUB_GROUP
 /begin FUNCTION_LIST /end FUNCTION_LIST
 /begin REF_CHARACTERISTIC /end REF_CHARACTERISTIC
 /begin REF_MEASUREMENT /end REF_MEASUREMENT
/end GROUP
/begin GROUP PullCmpActv "MICROSAR RTE"
 /begin SUB_GROUP PullCmpActv.CalibrationParameters PullCmpActv.CalibrationPorts PullCmpActv.PerInstanceMemories PullCmpActv.ReceiverPorts PullCmpActv.SenderPorts /end SUB_GROUP
 /begin FUNCTION_LIST /end FUNCTION_LIST
 /begin REF_CHARACTERISTIC /end REF_CHARACTERISTIC
 /begin REF_MEASUREMENT /end REF_MEASUREMENT
/end GROUP
/begin GROUP PullCmpActv.CalibrationParameters "MICROSAR RTE" /begin SUB_GROUP PullCmpActv.PullCmpLongTermDft /end SUB_GROUP /begin FUNCTION_LIST /end FUNCTION_LIST /begin REF_CHARACTERISTIC /end REF_CHARACTERISTIC /begin REF_MEASUREMENT /end REF_MEASUREMENT /end GROUP
/begin GROUP PullCmpActv.CalibrationPorts "MICROSAR RTE"
 /begin SUB_GROUP PullCmpActv.PullCmpActvCmpLrnTiDecShoTerm.Val PullCmpActv.PullCmpActvCmpLrnTiIncShoTerm.Val PullCmpActv.PullCmpActvCmpLrnTiLongTerm.Val PullCmpActv.PullCmpActvCmpShoTermRstHwAgThd.Val PullCmpActv.PullCmpActvCmpShoTermRstHwTqThd.Val PullCmpActv.PullCmpActvCmpShoTermRstLatAThd.Val PullCmpActv.PullCmpActvCmpShoTermRstYawRate.Val PullCmpActv.PullCmpActvCmpShoTermRstYawRateThd.Val PullCmpActv.PullCmpActvEna.Logl PullCmpActv.PullCmpActvHwTqFilFrqLongTerm.Val PullCmpActv.PullCmpActvHwTqFilFrqLrngEna.Val PullCmpActv.PullCmpActvHwTqFilFrqShoTerm.Val PullCmpActv.PullCmpActvLongTermLim.Val PullCmpActv.PullCmpActvLrngEnaAgConfMinMgn.Val PullCmpActv.PullCmpActvLrngEnaHwAgMaxMgn.Val PullCmpActv.PullCmpActvLrngEnaHwTqMaxMgn.Val PullCmpActv.PullCmpActvLrngEnaHwVelMaxMgn.Val PullCmpActv.PullCmpActvLrngEnaLatAMaxMgn.Val PullCmpActv.PullCmpActvLrngEnaTiThd.Val PullCmpActv.PullCmpActvLrngEnaVehSpdMaxMgn.Val PullCmpActv.PullCmpActvLrngEnaVehSpdMinMgn.Val PullCmpActv.PullCmpActvLrngEnaVehSpdRateMaxMgn.Val PullCmpActv.PullCmpActvLrngEnaYawRateMaxMgn.Val PullCmpActv.PullCmpActvOpstSignTiShoTerm.Val PullCmpActv.PullCmpActvOutpMaxRate.Val PullCmpActv.PullCmpActvPullCmpShoTermLim.Val PullCmpActv.PullCmpActvPullCmpTotLim.Val PullCmpActv.PullCmpActvPullErrLimLongTerm.Val PullCmpActv.PullCmpActvPullErrMgnThd.Val PullCmpActv.PullCmpActvPullErrShoTermLim.Val PullCmpActv.PullCmpActvShoTermRampTi.Val PullCmpActv.PullCmpActvVehSpdScaTblX.Ary1D PullCmpActv.PullCmpActvVehSpdScaTblY.Ary1D PullCmpActv.PullCmpActvYawRateFilFrq.Val PullCmpActv.SysGlbPrmSysTqRat.Val /end SUB_GROUP
 /begin FUNCTION_LIST /end FUNCTION_LIST
 /begin REF_CHARACTERISTIC /end REF_CHARACTERISTIC
 /begin REF_MEASUREMENT /end REF_MEASUREMENT
/end GROUP
/begin GROUP PullCmpActv.CmpLrnTiDecShoTerm "MICROSAR RTE" /begin SUB_GROUP /end SUB_GROUP /begin FUNCTION_LIST /end FUNCTION_LIST /begin REF_CHARACTERISTIC /end REF_CHARACTERISTIC /begin REF_MEASUREMENT PullCmpActv.CmpLrnTiDecShoTerm /end REF_MEASUREMENT /end GROUP
/begin GROUP PullCmpActv.CmpLrnTiIncShoTerm "MICROSAR RTE" /begin SUB_GROUP /end SUB_GROUP /begin FUNCTION_LIST /end FUNCTION_LIST /begin REF_CHARACTERISTIC /end REF_CHARACTERISTIC /begin REF_MEASUREMENT PullCmpActv.CmpLrnTiIncShoTerm /end REF_MEASUREMENT /end GROUP
/begin GROUP PullCmpActv.CmpLrnTiLongTerm "MICROSAR RTE" /begin SUB_GROUP /end SUB_GROUP /begin FUNCTION_LIST /end FUNCTION_LIST /begin REF_CHARACTERISTIC /end REF_CHARACTERISTIC /begin REF_MEASUREMENT PullCmpActv.CmpLrnTiLongTerm /end REF_MEASUREMENT /end GROUP
/begin GROUP PullCmpActv.HwAg.Val "MICROSAR RTE" /begin SUB_GROUP /end SUB_GROUP /begin FUNCTION_LIST /end FUNCTION_LIST /begin REF_CHARACTERISTIC /end REF_CHARACTERISTIC /begin REF_MEASUREMENT PullCmpActv.HwAg.Val /end REF_MEASUREMENT /end GROUP
/begin GROUP PullCmpActv.HwTq.Val "MICROSAR RTE" /begin SUB_GROUP /end SUB_GROUP /begin FUNCTION_LIST /end FUNCTION_LIST /begin REF_CHARACTERISTIC /end REF_CHARACTERISTIC /begin REF_MEASUREMENT PullCmpActv.HwTq.Val /end REF_MEASUREMENT /end GROUP
/begin GROUP PullCmpActv.HwTqLpFilLongTerm "MICROSAR RTE" /begin SUB_GROUP /end SUB_GROUP /begin FUNCTION_LIST /end FUNCTION_LIST /begin REF_CHARACTERISTIC /end REF_CHARACTERISTIC
 /begin REF_MEASUREMENT PullCmpActv.HwTqLpFilLongTerm.FilGain PullCmpActv.HwTqLpFilLongTerm.FilSt /end REF_MEASUREMENT
/end GROUP
/begin GROUP PullCmpActv.HwTqLpFilLrngEna "MICROSAR RTE" /begin SUB_GROUP /end SUB_GROUP /begin FUNCTION_LIST /end FUNCTION_LIST /begin REF_CHARACTERISTIC /end REF_CHARACTERISTIC
 /begin REF_MEASUREMENT PullCmpActv.HwTqLpFilLrngEna.FilGain PullCmpActv.HwTqLpFilLrngEna.FilSt /end REF_MEASUREMENT
/end GROUP
/begin GROUP PullCmpActv.HwTqLpFilShoTerm "MICROSAR RTE" /begin SUB_GROUP /end SUB_GROUP /begin FUNCTION_LIST /end FUNCTION_LIST /begin REF_CHARACTERISTIC /end REF_CHARACTERISTIC
 /begin REF_MEASUREMENT PullCmpActv.HwTqLpFilShoTerm.FilGain PullCmpActv.HwTqLpFilShoTerm.FilSt /end REF_MEASUREMENT
/end GROUP
/begin GROUP PullCmpActv.HwVel.Val "MICROSAR RTE" /begin SUB_GROUP /end SUB_GROUP /begin FUNCTION_LIST /end FUNCTION_LIST /begin REF_CHARACTERISTIC /end REF_CHARACTERISTIC /begin REF_MEASUREMENT PullCmpActv.HwVel.Val /end REF_MEASUREMENT /end GROUP
/begin GROUP PullCmpActv.IntgtrGainDecShoTerm "MICROSAR RTE" /begin SUB_GROUP /end SUB_GROUP /begin FUNCTION_LIST /end FUNCTION_LIST /begin REF_CHARACTERISTIC /end REF_CHARACTERISTIC /begin REF_MEASUREMENT PullCmpActv.IntgtrGainDecShoTerm /end REF_MEASUREMENT /end GROUP
/begin GROUP PullCmpActv.IntgtrGainIncShoTerm "MICROSAR RTE" /begin SUB_GROUP /end SUB_GROUP /begin FUNCTION_LIST /end FUNCTION_LIST /begin REF_CHARACTERISTIC /end REF_CHARACTERISTIC /begin REF_MEASUREMENT PullCmpActv.IntgtrGainIncShoTerm /end REF_MEASUREMENT /end GROUP
/begin GROUP PullCmpActv.LrngEnaPrev "MICROSAR RTE" /begin SUB_GROUP /end SUB_GROUP /begin FUNCTION_LIST /end FUNCTION_LIST /begin REF_CHARACTERISTIC /end REF_CHARACTERISTIC /begin REF_MEASUREMENT PullCmpActv.LrngEnaPrev /end REF_MEASUREMENT /end GROUP
/begin GROUP PullCmpActv.LrngEnad "MICROSAR RTE" /begin SUB_GROUP /end SUB_GROUP /begin FUNCTION_LIST /end FUNCTION_LIST /begin REF_CHARACTERISTIC /end REF_CHARACTERISTIC /begin REF_MEASUREMENT PullCmpActv.LrngEnad /end REF_MEASUREMENT /end GROUP
/begin GROUP PullCmpActv.OpstSignPrev "MICROSAR RTE" /begin SUB_GROUP /end SUB_GROUP /begin FUNCTION_LIST /end FUNCTION_LIST /begin REF_CHARACTERISTIC /end REF_CHARACTERISTIC /begin REF_MEASUREMENT PullCmpActv.OpstSignPrev /end REF_MEASUREMENT /end GROUP
/begin GROUP PullCmpActv.PerInstanceMemories "MICROSAR RTE"
 /begin SUB_GROUP PullCmpActv.CmpLrnTiDecShoTerm PullCmpActv.CmpLrnTiIncShoTerm PullCmpActv.CmpLrnTiLongTerm PullCmpActv.HwTqLpFilLongTerm PullCmpActv.HwTqLpFilLrngEna PullCmpActv.HwTqLpFilShoTerm PullCmpActv.IntgtrGainDecShoTerm PullCmpActv.IntgtrGainIncShoTerm PullCmpActv.LrngEnaPrev PullCmpActv.LrngEnad PullCmpActv.OpstSignPrev PullCmpActv.PullCmpCmdRateLimPrev PullCmpActv.PullCmpCmdTot PullCmpActv.PullCmpLongTerm PullCmpActv.PullCmpLongTermRst PullCmpActv.PullCmpShoTerm PullCmpActv.PullCmpShoTermRst PullCmpActv.RefTiEnaLrng PullCmpActv.RefTiOpstSign PullCmpActv.VehSpdPrev PullCmpActv.VehSpdRate PullCmpActv.VehYawRateLpFil PullCmpActv.dPullCmpActvIntgtrGainShoTerm PullCmpActv.dPullCmpActvPullErrLongTerm PullCmpActv.dPullCmpActvPullErrShoTerm PullCmpActv.dPullCmpActvShoTermRst /end SUB_GROUP
 /begin FUNCTION_LIST /end FUNCTION_LIST
 /begin REF_CHARACTERISTIC /end REF_CHARACTERISTIC
 /begin REF_MEASUREMENT /end REF_MEASUREMENT
/end GROUP
/begin GROUP PullCmpActv.PinionAgConf.Val "MICROSAR RTE" /begin SUB_GROUP /end SUB_GROUP /begin FUNCTION_LIST /end FUNCTION_LIST /begin REF_CHARACTERISTIC /end REF_CHARACTERISTIC /begin REF_MEASUREMENT PullCmpActv.PinionAgConf.Val /end REF_MEASUREMENT /end GROUP
/begin GROUP PullCmpActv.PullCmpActvCmpLrnTiDecShoTerm.Val "MICROSAR RTE" /begin SUB_GROUP /end SUB_GROUP /begin FUNCTION_LIST /end FUNCTION_LIST /begin REF_CHARACTERISTIC PullCmpActv.PullCmpActvCmpLrnTiDecShoTerm.Val /end REF_CHARACTERISTIC /begin REF_MEASUREMENT /end REF_MEASUREMENT /end GROUP
/begin GROUP PullCmpActv.PullCmpActvCmpLrnTiIncShoTerm.Val "MICROSAR RTE" /begin SUB_GROUP /end SUB_GROUP /begin FUNCTION_LIST /end FUNCTION_LIST /begin REF_CHARACTERISTIC PullCmpActv.PullCmpActvCmpLrnTiIncShoTerm.Val /end REF_CHARACTERISTIC /begin REF_MEASUREMENT /end REF_MEASUREMENT /end GROUP
/begin GROUP PullCmpActv.PullCmpActvCmpLrnTiLongTerm.Val "MICROSAR RTE" /begin SUB_GROUP /end SUB_GROUP /begin FUNCTION_LIST /end FUNCTION_LIST /begin REF_CHARACTERISTIC PullCmpActv.PullCmpActvCmpLrnTiLongTerm.Val /end REF_CHARACTERISTIC /begin REF_MEASUREMENT /end REF_MEASUREMENT /end GROUP
/begin GROUP PullCmpActv.PullCmpActvCmpShoTermRstHwAgThd.Val "MICROSAR RTE" /begin SUB_GROUP /end SUB_GROUP /begin FUNCTION_LIST /end FUNCTION_LIST /begin REF_CHARACTERISTIC PullCmpActv.PullCmpActvCmpShoTermRstHwAgThd.Val /end REF_CHARACTERISTIC /begin REF_MEASUREMENT /end REF_MEASUREMENT /end GROUP
/begin GROUP PullCmpActv.PullCmpActvCmpShoTermRstHwTqThd.Val "MICROSAR RTE" /begin SUB_GROUP /end SUB_GROUP /begin FUNCTION_LIST /end FUNCTION_LIST /begin REF_CHARACTERISTIC PullCmpActv.PullCmpActvCmpShoTermRstHwTqThd.Val /end REF_CHARACTERISTIC /begin REF_MEASUREMENT /end REF_MEASUREMENT /end GROUP
/begin GROUP PullCmpActv.PullCmpActvCmpShoTermRstLatAThd.Val "MICROSAR RTE" /begin SUB_GROUP /end SUB_GROUP /begin FUNCTION_LIST /end FUNCTION_LIST /begin REF_CHARACTERISTIC PullCmpActv.PullCmpActvCmpShoTermRstLatAThd.Val /end REF_CHARACTERISTIC /begin REF_MEASUREMENT /end REF_MEASUREMENT /end GROUP
/begin GROUP PullCmpActv.PullCmpActvCmpShoTermRstYawRate.Val "MICROSAR RTE" /begin SUB_GROUP /end SUB_GROUP /begin FUNCTION_LIST /end FUNCTION_LIST /begin REF_CHARACTERISTIC PullCmpActv.PullCmpActvCmpShoTermRstYawRate.Val /end REF_CHARACTERISTIC /begin REF_MEASUREMENT /end REF_MEASUREMENT /end GROUP
/begin GROUP PullCmpActv.PullCmpActvCmpShoTermRstYawRateThd.Val "MICROSAR RTE" /begin SUB_GROUP /end SUB_GROUP /begin FUNCTION_LIST /end FUNCTION_LIST /begin REF_CHARACTERISTIC PullCmpActv.PullCmpActvCmpShoTermRstYawRateThd.Val /end REF_CHARACTERISTIC /begin REF_MEASUREMENT /end REF_MEASUREMENT /end GROUP
/begin GROUP PullCmpActv.PullCmpActvDi.Logl "MICROSAR RTE" /begin SUB_GROUP /end SUB_GROUP /begin FUNCTION_LIST /end FUNCTION_LIST /begin REF_CHARACTERISTIC /end REF_CHARACTERISTIC /begin REF_MEASUREMENT PullCmpActv.PullCmpActvDi.Logl /end REF_MEASUREMENT /end GROUP
/begin GROUP PullCmpActv.PullCmpActvEna.Logl "MICROSAR RTE" /begin SUB_GROUP /end SUB_GROUP /begin FUNCTION_LIST /end FUNCTION_LIST /begin REF_CHARACTERISTIC PullCmpActv.PullCmpActvEna.Logl /end REF_CHARACTERISTIC /begin REF_MEASUREMENT /end REF_MEASUREMENT /end GROUP
/begin GROUP PullCmpActv.PullCmpActvHwTqFilFrqLongTerm.Val "MICROSAR RTE" /begin SUB_GROUP /end SUB_GROUP /begin FUNCTION_LIST /end FUNCTION_LIST /begin REF_CHARACTERISTIC PullCmpActv.PullCmpActvHwTqFilFrqLongTerm.Val /end REF_CHARACTERISTIC /begin REF_MEASUREMENT /end REF_MEASUREMENT /end GROUP
/begin GROUP PullCmpActv.PullCmpActvHwTqFilFrqLrngEna.Val "MICROSAR RTE" /begin SUB_GROUP /end SUB_GROUP /begin FUNCTION_LIST /end FUNCTION_LIST /begin REF_CHARACTERISTIC PullCmpActv.PullCmpActvHwTqFilFrqLrngEna.Val /end REF_CHARACTERISTIC /begin REF_MEASUREMENT /end REF_MEASUREMENT /end GROUP
/begin GROUP PullCmpActv.PullCmpActvHwTqFilFrqShoTerm.Val "MICROSAR RTE" /begin SUB_GROUP /end SUB_GROUP /begin FUNCTION_LIST /end FUNCTION_LIST /begin REF_CHARACTERISTIC PullCmpActv.PullCmpActvHwTqFilFrqShoTerm.Val /end REF_CHARACTERISTIC /begin REF_MEASUREMENT /end REF_MEASUREMENT /end GROUP
/begin GROUP PullCmpActv.PullCmpActvLongTermLim.Val "MICROSAR RTE" /begin SUB_GROUP /end SUB_GROUP /begin FUNCTION_LIST /end FUNCTION_LIST /begin REF_CHARACTERISTIC PullCmpActv.PullCmpActvLongTermLim.Val /end REF_CHARACTERISTIC /begin REF_MEASUREMENT /end REF_MEASUREMENT /end GROUP
/begin GROUP PullCmpActv.PullCmpActvLrngEnaAgConfMinMgn.Val "MICROSAR RTE" /begin SUB_GROUP /end SUB_GROUP /begin FUNCTION_LIST /end FUNCTION_LIST /begin REF_CHARACTERISTIC PullCmpActv.PullCmpActvLrngEnaAgConfMinMgn.Val /end REF_CHARACTERISTIC /begin REF_MEASUREMENT /end REF_MEASUREMENT /end GROUP
/begin GROUP PullCmpActv.PullCmpActvLrngEnaHwAgMaxMgn.Val "MICROSAR RTE" /begin SUB_GROUP /end SUB_GROUP /begin FUNCTION_LIST /end FUNCTION_LIST /begin REF_CHARACTERISTIC PullCmpActv.PullCmpActvLrngEnaHwAgMaxMgn.Val /end REF_CHARACTERISTIC /begin REF_MEASUREMENT /end REF_MEASUREMENT /end GROUP
/begin GROUP PullCmpActv.PullCmpActvLrngEnaHwTqMaxMgn.Val "MICROSAR RTE" /begin SUB_GROUP /end SUB_GROUP /begin FUNCTION_LIST /end FUNCTION_LIST /begin REF_CHARACTERISTIC PullCmpActv.PullCmpActvLrngEnaHwTqMaxMgn.Val /end REF_CHARACTERISTIC /begin REF_MEASUREMENT /end REF_MEASUREMENT /end GROUP
/begin GROUP PullCmpActv.PullCmpActvLrngEnaHwVelMaxMgn.Val "MICROSAR RTE" /begin SUB_GROUP /end SUB_GROUP /begin FUNCTION_LIST /end FUNCTION_LIST /begin REF_CHARACTERISTIC PullCmpActv.PullCmpActvLrngEnaHwVelMaxMgn.Val /end REF_CHARACTERISTIC /begin REF_MEASUREMENT /end REF_MEASUREMENT /end GROUP
/begin GROUP PullCmpActv.PullCmpActvLrngEnaLatAMaxMgn.Val "MICROSAR RTE" /begin SUB_GROUP /end SUB_GROUP /begin FUNCTION_LIST /end FUNCTION_LIST /begin REF_CHARACTERISTIC PullCmpActv.PullCmpActvLrngEnaLatAMaxMgn.Val /end REF_CHARACTERISTIC /begin REF_MEASUREMENT /end REF_MEASUREMENT /end GROUP
/begin GROUP PullCmpActv.PullCmpActvLrngEnaTiThd.Val "MICROSAR RTE" /begin SUB_GROUP /end SUB_GROUP /begin FUNCTION_LIST /end FUNCTION_LIST /begin REF_CHARACTERISTIC PullCmpActv.PullCmpActvLrngEnaTiThd.Val /end REF_CHARACTERISTIC /begin REF_MEASUREMENT /end REF_MEASUREMENT /end GROUP
/begin GROUP PullCmpActv.PullCmpActvLrngEnaVehSpdMaxMgn.Val "MICROSAR RTE" /begin SUB_GROUP /end SUB_GROUP /begin FUNCTION_LIST /end FUNCTION_LIST /begin REF_CHARACTERISTIC PullCmpActv.PullCmpActvLrngEnaVehSpdMaxMgn.Val /end REF_CHARACTERISTIC /begin REF_MEASUREMENT /end REF_MEASUREMENT /end GROUP
/begin GROUP PullCmpActv.PullCmpActvLrngEnaVehSpdMinMgn.Val "MICROSAR RTE" /begin SUB_GROUP /end SUB_GROUP /begin FUNCTION_LIST /end FUNCTION_LIST /begin REF_CHARACTERISTIC PullCmpActv.PullCmpActvLrngEnaVehSpdMinMgn.Val /end REF_CHARACTERISTIC /begin REF_MEASUREMENT /end REF_MEASUREMENT /end GROUP
/begin GROUP PullCmpActv.PullCmpActvLrngEnaVehSpdRateMaxMgn.Val "MICROSAR RTE" /begin SUB_GROUP /end SUB_GROUP /begin FUNCTION_LIST /end FUNCTION_LIST /begin REF_CHARACTERISTIC PullCmpActv.PullCmpActvLrngEnaVehSpdRateMaxMgn.Val /end REF_CHARACTERISTIC /begin REF_MEASUREMENT /end REF_MEASUREMENT /end GROUP
/begin GROUP PullCmpActv.PullCmpActvLrngEnaYawRateMaxMgn.Val "MICROSAR RTE" /begin SUB_GROUP /end SUB_GROUP /begin FUNCTION_LIST /end FUNCTION_LIST /begin REF_CHARACTERISTIC PullCmpActv.PullCmpActvLrngEnaYawRateMaxMgn.Val /end REF_CHARACTERISTIC /begin REF_MEASUREMENT /end REF_MEASUREMENT /end GROUP
/begin GROUP PullCmpActv.PullCmpActvOpstSignTiShoTerm.Val "MICROSAR RTE" /begin SUB_GROUP /end SUB_GROUP /begin FUNCTION_LIST /end FUNCTION_LIST /begin REF_CHARACTERISTIC PullCmpActv.PullCmpActvOpstSignTiShoTerm.Val /end REF_CHARACTERISTIC /begin REF_MEASUREMENT /end REF_MEASUREMENT /end GROUP
/begin GROUP PullCmpActv.PullCmpActvOutpMaxRate.Val "MICROSAR RTE" /begin SUB_GROUP /end SUB_GROUP /begin FUNCTION_LIST /end FUNCTION_LIST /begin REF_CHARACTERISTIC PullCmpActv.PullCmpActvOutpMaxRate.Val /end REF_CHARACTERISTIC /begin REF_MEASUREMENT /end REF_MEASUREMENT /end GROUP
/begin GROUP PullCmpActv.PullCmpActvPullCmpShoTermLim.Val "MICROSAR RTE" /begin SUB_GROUP /end SUB_GROUP /begin FUNCTION_LIST /end FUNCTION_LIST /begin REF_CHARACTERISTIC PullCmpActv.PullCmpActvPullCmpShoTermLim.Val /end REF_CHARACTERISTIC /begin REF_MEASUREMENT /end REF_MEASUREMENT /end GROUP
/begin GROUP PullCmpActv.PullCmpActvPullCmpTotLim.Val "MICROSAR RTE" /begin SUB_GROUP /end SUB_GROUP /begin FUNCTION_LIST /end FUNCTION_LIST /begin REF_CHARACTERISTIC PullCmpActv.PullCmpActvPullCmpTotLim.Val /end REF_CHARACTERISTIC /begin REF_MEASUREMENT /end REF_MEASUREMENT /end GROUP
/begin GROUP PullCmpActv.PullCmpActvPullErrLimLongTerm.Val "MICROSAR RTE" /begin SUB_GROUP /end SUB_GROUP /begin FUNCTION_LIST /end FUNCTION_LIST /begin REF_CHARACTERISTIC PullCmpActv.PullCmpActvPullErrLimLongTerm.Val /end REF_CHARACTERISTIC /begin REF_MEASUREMENT /end REF_MEASUREMENT /end GROUP
/begin GROUP PullCmpActv.PullCmpActvPullErrMgnThd.Val "MICROSAR RTE" /begin SUB_GROUP /end SUB_GROUP /begin FUNCTION_LIST /end FUNCTION_LIST /begin REF_CHARACTERISTIC PullCmpActv.PullCmpActvPullErrMgnThd.Val /end REF_CHARACTERISTIC /begin REF_MEASUREMENT /end REF_MEASUREMENT /end GROUP
/begin GROUP PullCmpActv.PullCmpActvPullErrShoTermLim.Val "MICROSAR RTE" /begin SUB_GROUP /end SUB_GROUP /begin FUNCTION_LIST /end FUNCTION_LIST /begin REF_CHARACTERISTIC PullCmpActv.PullCmpActvPullErrShoTermLim.Val /end REF_CHARACTERISTIC /begin REF_MEASUREMENT /end REF_MEASUREMENT /end GROUP
/begin GROUP PullCmpActv.PullCmpActvShoTermRampTi.Val "MICROSAR RTE" /begin SUB_GROUP /end SUB_GROUP /begin FUNCTION_LIST /end FUNCTION_LIST /begin REF_CHARACTERISTIC PullCmpActv.PullCmpActvShoTermRampTi.Val /end REF_CHARACTERISTIC /begin REF_MEASUREMENT /end REF_MEASUREMENT /end GROUP
/begin GROUP PullCmpActv.PullCmpActvVehSpdScaTblX.Ary1D "MICROSAR RTE" /begin SUB_GROUP /end SUB_GROUP /begin FUNCTION_LIST /end FUNCTION_LIST /begin REF_CHARACTERISTIC PullCmpActv.PullCmpActvVehSpdScaTblX.Ary1D /end REF_CHARACTERISTIC /begin REF_MEASUREMENT /end REF_MEASUREMENT /end GROUP
/begin GROUP PullCmpActv.PullCmpActvVehSpdScaTblY.Ary1D "MICROSAR RTE" /begin SUB_GROUP /end SUB_GROUP /begin FUNCTION_LIST /end FUNCTION_LIST /begin REF_CHARACTERISTIC PullCmpActv.PullCmpActvVehSpdScaTblY.Ary1D /end REF_CHARACTERISTIC /begin REF_MEASUREMENT /end REF_MEASUREMENT /end GROUP
/begin GROUP PullCmpActv.PullCmpActvYawRateFilFrq.Val "MICROSAR RTE" /begin SUB_GROUP /end SUB_GROUP /begin FUNCTION_LIST /end FUNCTION_LIST /begin REF_CHARACTERISTIC PullCmpActv.PullCmpActvYawRateFilFrq.Val /end REF_CHARACTERISTIC /begin REF_MEASUREMENT /end REF_MEASUREMENT /end GROUP
/begin GROUP PullCmpActv.PullCmpCmd.Val "MICROSAR RTE" /begin SUB_GROUP /end SUB_GROUP /begin FUNCTION_LIST /end FUNCTION_LIST /begin REF_CHARACTERISTIC /end REF_CHARACTERISTIC /begin REF_MEASUREMENT PullCmpActv.PullCmpCmd.Val /end REF_MEASUREMENT /end GROUP
/begin GROUP PullCmpActv.PullCmpCmdDi.Logl "MICROSAR RTE" /begin SUB_GROUP /end SUB_GROUP /begin FUNCTION_LIST /end FUNCTION_LIST /begin REF_CHARACTERISTIC /end REF_CHARACTERISTIC /begin REF_MEASUREMENT PullCmpActv.PullCmpCmdDi.Logl /end REF_MEASUREMENT /end GROUP
/begin GROUP PullCmpActv.PullCmpCmdRateLimPrev "MICROSAR RTE" /begin SUB_GROUP /end SUB_GROUP /begin FUNCTION_LIST /end FUNCTION_LIST /begin REF_CHARACTERISTIC /end REF_CHARACTERISTIC /begin REF_MEASUREMENT PullCmpActv.PullCmpCmdRateLimPrev /end REF_MEASUREMENT /end GROUP
/begin GROUP PullCmpActv.PullCmpCmdTot "MICROSAR RTE" /begin SUB_GROUP /end SUB_GROUP /begin FUNCTION_LIST /end FUNCTION_LIST /begin REF_CHARACTERISTIC /end REF_CHARACTERISTIC /begin REF_MEASUREMENT PullCmpActv.PullCmpCmdTot /end REF_MEASUREMENT /end GROUP
/begin GROUP PullCmpActv.PullCmpLongTerm "MICROSAR RTE" /begin SUB_GROUP /end SUB_GROUP /begin FUNCTION_LIST /end FUNCTION_LIST /begin REF_CHARACTERISTIC /end REF_CHARACTERISTIC /begin REF_MEASUREMENT PullCmpActv.PullCmpLongTerm /end REF_MEASUREMENT /end GROUP
/begin GROUP PullCmpActv.PullCmpLongTermDft "MICROSAR RTE" /begin SUB_GROUP /end SUB_GROUP /begin FUNCTION_LIST /end FUNCTION_LIST /begin REF_CHARACTERISTIC PullCmpActv.PullCmpLongTermDft /end REF_CHARACTERISTIC /begin REF_MEASUREMENT /end REF_MEASUREMENT /end GROUP
/begin GROUP PullCmpActv.PullCmpLongTermRst "MICROSAR RTE" /begin SUB_GROUP /end SUB_GROUP /begin FUNCTION_LIST /end FUNCTION_LIST /begin REF_CHARACTERISTIC /end REF_CHARACTERISTIC /begin REF_MEASUREMENT PullCmpActv.PullCmpLongTermRst /end REF_MEASUREMENT /end GROUP
/begin GROUP PullCmpActv.PullCmpLrngDi.Logl "MICROSAR RTE" /begin SUB_GROUP /end SUB_GROUP /begin FUNCTION_LIST /end FUNCTION_LIST /begin REF_CHARACTERISTIC /end REF_CHARACTERISTIC /begin REF_MEASUREMENT PullCmpActv.PullCmpLrngDi.Logl /end REF_MEASUREMENT /end GROUP
/begin GROUP PullCmpActv.PullCmpShoTerm "MICROSAR RTE" /begin SUB_GROUP /end SUB_GROUP /begin FUNCTION_LIST /end FUNCTION_LIST /begin REF_CHARACTERISTIC /end REF_CHARACTERISTIC /begin REF_MEASUREMENT PullCmpActv.PullCmpShoTerm /end REF_MEASUREMENT /end GROUP
/begin GROUP PullCmpActv.PullCmpShoTermRst "MICROSAR RTE" /begin SUB_GROUP /end SUB_GROUP /begin FUNCTION_LIST /end FUNCTION_LIST /begin REF_CHARACTERISTIC /end REF_CHARACTERISTIC /begin REF_MEASUREMENT PullCmpActv.PullCmpShoTermRst /end REF_MEASUREMENT /end GROUP
/begin GROUP PullCmpActv.ReceiverPorts "MICROSAR RTE"
 /begin SUB_GROUP PullCmpActv.HwAg.Val PullCmpActv.HwTq.Val PullCmpActv.HwVel.Val PullCmpActv.PinionAgConf.Val PullCmpActv.PullCmpActvDi.Logl PullCmpActv.PullCmpCmdDi.Logl PullCmpActv.PullCmpLrngDi.Logl PullCmpActv.VehLatA.Val PullCmpActv.VehSpd.Val PullCmpActv.VehSpdVld.Logl PullCmpActv.VehYawRate.Val /end SUB_GROUP
 /begin FUNCTION_LIST /end FUNCTION_LIST
 /begin REF_CHARACTERISTIC /end REF_CHARACTERISTIC
 /begin REF_MEASUREMENT /end REF_MEASUREMENT
/end GROUP
/begin GROUP PullCmpActv.RefTiEnaLrng "MICROSAR RTE" /begin SUB_GROUP /end SUB_GROUP /begin FUNCTION_LIST /end FUNCTION_LIST /begin REF_CHARACTERISTIC /end REF_CHARACTERISTIC /begin REF_MEASUREMENT PullCmpActv.RefTiEnaLrng /end REF_MEASUREMENT /end GROUP
/begin GROUP PullCmpActv.RefTiOpstSign "MICROSAR RTE" /begin SUB_GROUP /end SUB_GROUP /begin FUNCTION_LIST /end FUNCTION_LIST /begin REF_CHARACTERISTIC /end REF_CHARACTERISTIC /begin REF_MEASUREMENT PullCmpActv.RefTiOpstSign /end REF_MEASUREMENT /end GROUP
/begin GROUP PullCmpActv.SenderPorts "MICROSAR RTE" /begin SUB_GROUP PullCmpActv.PullCmpCmd.Val /end SUB_GROUP /begin FUNCTION_LIST /end FUNCTION_LIST /begin REF_CHARACTERISTIC /end REF_CHARACTERISTIC /begin REF_MEASUREMENT /end REF_MEASUREMENT /end GROUP
/begin GROUP PullCmpActv.SysGlbPrmSysTqRat.Val "MICROSAR RTE" /begin SUB_GROUP /end SUB_GROUP /begin FUNCTION_LIST /end FUNCTION_LIST /begin REF_CHARACTERISTIC PullCmpActv.SysGlbPrmSysTqRat.Val /end REF_CHARACTERISTIC /begin REF_MEASUREMENT /end REF_MEASUREMENT /end GROUP
/begin GROUP PullCmpActv.VehLatA.Val "MICROSAR RTE" /begin SUB_GROUP /end SUB_GROUP /begin FUNCTION_LIST /end FUNCTION_LIST /begin REF_CHARACTERISTIC /end REF_CHARACTERISTIC /begin REF_MEASUREMENT PullCmpActv.VehLatA.Val /end REF_MEASUREMENT /end GROUP
/begin GROUP PullCmpActv.VehSpd.Val "MICROSAR RTE" /begin SUB_GROUP /end SUB_GROUP /begin FUNCTION_LIST /end FUNCTION_LIST /begin REF_CHARACTERISTIC /end REF_CHARACTERISTIC /begin REF_MEASUREMENT PullCmpActv.VehSpd.Val /end REF_MEASUREMENT /end GROUP
/begin GROUP PullCmpActv.VehSpdPrev "MICROSAR RTE" /begin SUB_GROUP /end SUB_GROUP /begin FUNCTION_LIST /end FUNCTION_LIST /begin REF_CHARACTERISTIC /end REF_CHARACTERISTIC /begin REF_MEASUREMENT PullCmpActv.VehSpdPrev /end REF_MEASUREMENT /end GROUP
/begin GROUP PullCmpActv.VehSpdRate "MICROSAR RTE" /begin SUB_GROUP /end SUB_GROUP /begin FUNCTION_LIST /end FUNCTION_LIST /begin REF_CHARACTERISTIC /end REF_CHARACTERISTIC /begin REF_MEASUREMENT PullCmpActv.VehSpdRate /end REF_MEASUREMENT /end GROUP
/begin GROUP PullCmpActv.VehSpdVld.Logl "MICROSAR RTE" /begin SUB_GROUP /end SUB_GROUP /begin FUNCTION_LIST /end FUNCTION_LIST /begin REF_CHARACTERISTIC /end REF_CHARACTERISTIC /begin REF_MEASUREMENT PullCmpActv.VehSpdVld.Logl /end REF_MEASUREMENT /end GROUP
/begin GROUP PullCmpActv.VehYawRate.Val "MICROSAR RTE" /begin SUB_GROUP /end SUB_GROUP /begin FUNCTION_LIST /end FUNCTION_LIST /begin REF_CHARACTERISTIC /end REF_CHARACTERISTIC /begin REF_MEASUREMENT PullCmpActv.VehYawRate.Val /end REF_MEASUREMENT /end GROUP
/begin GROUP PullCmpActv.VehYawRateLpFil "MICROSAR RTE" /begin SUB_GROUP /end SUB_GROUP /begin FUNCTION_LIST /end FUNCTION_LIST /begin REF_CHARACTERISTIC /end REF_CHARACTERISTIC
 /begin REF_MEASUREMENT PullCmpActv.VehYawRateLpFil.FilGain PullCmpActv.VehYawRateLpFil.FilSt /end REF_MEASUREMENT
/end GROUP
/begin GROUP PullCmpActv.dPullCmpActvIntgtrGainShoTerm "MICROSAR RTE" /begin SUB_GROUP /end SUB_GROUP /begin FUNCTION_LIST /end FUNCTION_LIST /begin REF_CHARACTERISTIC /end REF_CHARACTERISTIC /begin REF_MEASUREMENT PullCmpActv.dPullCmpActvIntgtrGainShoTerm /end REF_MEASUREMENT /end GROUP
/begin GROUP PullCmpActv.dPullCmpActvPullErrLongTerm "MICROSAR RTE" /begin SUB_GROUP /end SUB_GROUP /begin FUNCTION_LIST /end FUNCTION_LIST /begin REF_CHARACTERISTIC /end REF_CHARACTERISTIC /begin REF_MEASUREMENT PullCmpActv.dPullCmpActvPullErrLongTerm /end REF_MEASUREMENT /end GROUP
/begin GROUP PullCmpActv.dPullCmpActvPullErrShoTerm "MICROSAR RTE" /begin SUB_GROUP /end SUB_GROUP /begin FUNCTION_LIST /end FUNCTION_LIST /begin REF_CHARACTERISTIC /end REF_CHARACTERISTIC /begin REF_MEASUREMENT PullCmpActv.dPullCmpActvPullErrShoTerm /end REF_MEASUREMENT /end GROUP
/begin GROUP PullCmpActv.dPullCmpActvShoTermRst "MICROSAR RTE" /begin SUB_GROUP /end SUB_GROUP /begin FUNCTION_LIST /end FUNCTION_LIST /begin REF_CHARACTERISTIC /end REF_CHARACTERISTIC /begin REF_MEASUREMENT PullCmpActv.dPullCmpActvShoTermRst /end REF_MEASUREMENT /end GROUP
/begin GROUP PwrDiscnct "MICROSAR RTE"
 /begin SUB_GROUP PwrDiscnct.CalibrationPorts PwrDiscnct.PerInstanceMemories PwrDiscnct.ReceiverPorts PwrDiscnct.SenderPorts /end SUB_GROUP
 /begin FUNCTION_LIST /end FUNCTION_LIST
 /begin REF_CHARACTERISTIC /end REF_CHARACTERISTIC
 /begin REF_MEASUREMENT /end REF_MEASUREMENT
/end GROUP
/begin GROUP PwrDiscnct.BattVltg.Val "MICROSAR RTE" /begin SUB_GROUP /end SUB_GROUP /begin FUNCTION_LIST /end FUNCTION_LIST /begin REF_CHARACTERISTIC /end REF_CHARACTERISTIC /begin REF_MEASUREMENT PwrDiscnct.BattVltg.Val /end REF_MEASUREMENT /end GROUP
/begin GROUP PwrDiscnct.BattVltgSwd1.Val "MICROSAR RTE" /begin SUB_GROUP /end SUB_GROUP /begin FUNCTION_LIST /end FUNCTION_LIST /begin REF_CHARACTERISTIC /end REF_CHARACTERISTIC /begin REF_MEASUREMENT PwrDiscnct.BattVltgSwd1.Val /end REF_MEASUREMENT /end GROUP
/begin GROUP PwrDiscnct.BattVltgSwd2.Val "MICROSAR RTE" /begin SUB_GROUP /end SUB_GROUP /begin FUNCTION_LIST /end FUNCTION_LIST /begin REF_CHARACTERISTIC /end REF_CHARACTERISTIC /begin REF_MEASUREMENT PwrDiscnct.BattVltgSwd2.Val /end REF_MEASUREMENT /end GROUP
/begin GROUP PwrDiscnct.BattVltgSwdMax.Val "MICROSAR RTE" /begin SUB_GROUP /end SUB_GROUP /begin FUNCTION_LIST /end FUNCTION_LIST /begin REF_CHARACTERISTIC PwrDiscnct.BattVltgSwdMax.Val /end REF_CHARACTERISTIC /begin REF_MEASUREMENT /end REF_MEASUREMENT /end GROUP
/begin GROUP PwrDiscnct.CalibrationPorts "MICROSAR RTE"
 /begin SUB_GROUP PwrDiscnct.BattVltgSwdMax.Val PwrDiscnct.PwrDiscnctNtc0x042FailStep.Val PwrDiscnct.PwrDiscnctNtc0x042PassStep.Val PwrDiscnct.PwrDiscnctNtc0x04AFailStep.Val PwrDiscnct.PwrDiscnctNtc0x04APassStep.Val PwrDiscnct.PwrDiscnctOpenThd.Val /end SUB_GROUP
 /begin FUNCTION_LIST /end FUNCTION_LIST
 /begin REF_CHARACTERISTIC /end REF_CHARACTERISTIC
 /begin REF_MEASUREMENT /end REF_MEASUREMENT
/end GROUP
/begin GROUP PwrDiscnct.PerInstanceMemories "MICROSAR RTE"
 /begin SUB_GROUP PwrDiscnct.PwrDiscnctDeltaVltg1 PwrDiscnct.PwrDiscnctDeltaVltg2 PwrDiscnct.PwrDiscnctSeqATestCmplPrev /end SUB_GROUP
 /begin FUNCTION_LIST /end FUNCTION_LIST
 /begin REF_CHARACTERISTIC /end REF_CHARACTERISTIC
 /begin REF_MEASUREMENT /end REF_MEASUREMENT
/end GROUP
/begin GROUP PwrDiscnct.PwrDiscnctATestCmpl.Logl "MICROSAR RTE" /begin SUB_GROUP /end SUB_GROUP /begin FUNCTION_LIST /end FUNCTION_LIST /begin REF_CHARACTERISTIC /end REF_CHARACTERISTIC /begin REF_MEASUREMENT PwrDiscnct.PwrDiscnctATestCmpl.Logl /end REF_MEASUREMENT /end GROUP
/begin GROUP PwrDiscnct.PwrDiscnctBTestCmpl.Logl "MICROSAR RTE" /begin SUB_GROUP /end SUB_GROUP /begin FUNCTION_LIST /end FUNCTION_LIST /begin REF_CHARACTERISTIC /end REF_CHARACTERISTIC /begin REF_MEASUREMENT PwrDiscnct.PwrDiscnctBTestCmpl.Logl /end REF_MEASUREMENT /end GROUP
/begin GROUP PwrDiscnct.PwrDiscnctDeltaVltg1 "MICROSAR RTE" /begin SUB_GROUP /end SUB_GROUP /begin FUNCTION_LIST /end FUNCTION_LIST /begin REF_CHARACTERISTIC /end REF_CHARACTERISTIC /begin REF_MEASUREMENT PwrDiscnct.PwrDiscnctDeltaVltg1 /end REF_MEASUREMENT /end GROUP
/begin GROUP PwrDiscnct.PwrDiscnctDeltaVltg2 "MICROSAR RTE" /begin SUB_GROUP /end SUB_GROUP /begin FUNCTION_LIST /end FUNCTION_LIST /begin REF_CHARACTERISTIC /end REF_CHARACTERISTIC /begin REF_MEASUREMENT PwrDiscnct.PwrDiscnctDeltaVltg2 /end REF_MEASUREMENT /end GROUP
/begin GROUP PwrDiscnct.PwrDiscnctNtc0x042FailStep.Val "MICROSAR RTE" /begin SUB_GROUP /end SUB_GROUP /begin FUNCTION_LIST /end FUNCTION_LIST /begin REF_CHARACTERISTIC PwrDiscnct.PwrDiscnctNtc0x042FailStep.Val /end REF_CHARACTERISTIC /begin REF_MEASUREMENT /end REF_MEASUREMENT /end GROUP
/begin GROUP PwrDiscnct.PwrDiscnctNtc0x042PassStep.Val "MICROSAR RTE" /begin SUB_GROUP /end SUB_GROUP /begin FUNCTION_LIST /end FUNCTION_LIST /begin REF_CHARACTERISTIC PwrDiscnct.PwrDiscnctNtc0x042PassStep.Val /end REF_CHARACTERISTIC /begin REF_MEASUREMENT /end REF_MEASUREMENT /end GROUP
/begin GROUP PwrDiscnct.PwrDiscnctNtc0x04AFailStep.Val "MICROSAR RTE" /begin SUB_GROUP /end SUB_GROUP /begin FUNCTION_LIST /end FUNCTION_LIST /begin REF_CHARACTERISTIC PwrDiscnct.PwrDiscnctNtc0x04AFailStep.Val /end REF_CHARACTERISTIC /begin REF_MEASUREMENT /end REF_MEASUREMENT /end GROUP
/begin GROUP PwrDiscnct.PwrDiscnctNtc0x04APassStep.Val "MICROSAR RTE" /begin SUB_GROUP /end SUB_GROUP /begin FUNCTION_LIST /end FUNCTION_LIST /begin REF_CHARACTERISTIC PwrDiscnct.PwrDiscnctNtc0x04APassStep.Val /end REF_CHARACTERISTIC /begin REF_MEASUREMENT /end REF_MEASUREMENT /end GROUP
/begin GROUP PwrDiscnct.PwrDiscnctOpenThd.Val "MICROSAR RTE" /begin SUB_GROUP /end SUB_GROUP /begin FUNCTION_LIST /end FUNCTION_LIST /begin REF_CHARACTERISTIC PwrDiscnct.PwrDiscnctOpenThd.Val /end REF_CHARACTERISTIC /begin REF_MEASUREMENT /end REF_MEASUREMENT /end GROUP
/begin GROUP PwrDiscnct.PwrDiscnctSeqATestCmplPrev "MICROSAR RTE" /begin SUB_GROUP /end SUB_GROUP /begin FUNCTION_LIST /end FUNCTION_LIST /begin REF_CHARACTERISTIC /end REF_CHARACTERISTIC /begin REF_MEASUREMENT PwrDiscnct.PwrDiscnctSeqATestCmplPrev /end REF_MEASUREMENT /end GROUP
/begin GROUP PwrDiscnct.ReceiverPorts "MICROSAR RTE"
 /begin SUB_GROUP PwrDiscnct.BattVltg.Val PwrDiscnct.BattVltgSwd1.Val PwrDiscnct.BattVltgSwd2.Val PwrDiscnct.StrtUpSt.Val PwrDiscnct.SysSt.Val /end SUB_GROUP
 /begin FUNCTION_LIST /end FUNCTION_LIST
 /begin REF_CHARACTERISTIC /end REF_CHARACTERISTIC
 /begin REF_MEASUREMENT /end REF_MEASUREMENT
/end GROUP
/begin GROUP PwrDiscnct.SenderPorts "MICROSAR RTE"
 /begin SUB_GROUP PwrDiscnct.PwrDiscnctATestCmpl.Logl PwrDiscnct.PwrDiscnctBTestCmpl.Logl /end SUB_GROUP
 /begin FUNCTION_LIST /end FUNCTION_LIST
 /begin REF_CHARACTERISTIC /end REF_CHARACTERISTIC
 /begin REF_MEASUREMENT /end REF_MEASUREMENT
/end GROUP
/begin GROUP PwrDiscnct.StrtUpSt.Val "MICROSAR RTE" /begin SUB_GROUP /end SUB_GROUP /begin FUNCTION_LIST /end FUNCTION_LIST /begin REF_CHARACTERISTIC /end REF_CHARACTERISTIC /begin REF_MEASUREMENT PwrDiscnct.StrtUpSt.Val /end REF_MEASUREMENT /end GROUP
/begin GROUP PwrDiscnct.SysSt.Val "MICROSAR RTE" /begin SUB_GROUP /end SUB_GROUP /begin FUNCTION_LIST /end FUNCTION_LIST /begin REF_CHARACTERISTIC /end REF_CHARACTERISTIC /begin REF_MEASUREMENT PwrDiscnct.SysSt.Val /end REF_MEASUREMENT /end GROUP
/begin GROUP PwrLimr "MICROSAR RTE"
 /begin SUB_GROUP PwrLimr.CalibrationPorts PwrLimr.PerInstanceMemories PwrLimr.ReceiverPorts PwrLimr.SenderPorts /end SUB_GROUP
 /begin FUNCTION_LIST /end FUNCTION_LIST
 /begin REF_CHARACTERISTIC /end REF_CHARACTERISTIC
 /begin REF_MEASUREMENT /end REF_MEASUREMENT
/end GROUP
/begin GROUP PwrLimr.AltFltActv.Logl "MICROSAR RTE" /begin SUB_GROUP /end SUB_GROUP /begin FUNCTION_LIST /end FUNCTION_LIST /begin REF_CHARACTERISTIC /end REF_CHARACTERISTIC /begin REF_MEASUREMENT PwrLimr.AltFltActv.Logl /end REF_MEASUREMENT /end GROUP
/begin GROUP PwrLimr.BrdgVltg.Val "MICROSAR RTE" /begin SUB_GROUP /end SUB_GROUP /begin FUNCTION_LIST /end FUNCTION_LIST /begin REF_CHARACTERISTIC /end REF_CHARACTERISTIC /begin REF_MEASUREMENT PwrLimr.BrdgVltg.Val /end REF_MEASUREMENT /end GROUP
/begin GROUP PwrLimr.BrdgVltgAdjSlewStVari "MICROSAR RTE" /begin SUB_GROUP /end SUB_GROUP /begin FUNCTION_LIST /end FUNCTION_LIST /begin REF_CHARACTERISTIC /end REF_CHARACTERISTIC /begin REF_MEASUREMENT PwrLimr.BrdgVltgAdjSlewStVari /end REF_MEASUREMENT /end GROUP
/begin GROUP PwrLimr.CalibrationPorts "MICROSAR RTE"
 /begin SUB_GROUP PwrLimr.PwrLimrAssiRednLpFilFrq.Val PwrLimr.PwrLimrBackEmfConStdT.Val PwrLimr.PwrLimrBrdgVltgAdjSlew.Val PwrLimr.PwrLimrBrdgVltgAltFltAdj.Val PwrLimr.PwrLimrFilAssiRednThd.Val PwrLimr.PwrLimrLoVoltAssiRcvrThd.Val PwrLimr.PwrLimrLoVoltAssiRcvrTi.Val PwrLimr.PwrLimrMotEnvlpX.Ary1D PwrLimr.PwrLimrMotEnvlpY.Ary1D PwrLimr.PwrLimrMotVelLpFilFrq.Val PwrLimr.PwrLimrSpdAdjSlewDec.Val PwrLimr.PwrLimrSpdAdjSlewEna.Logl PwrLimr.PwrLimrSpdAdjSlewInc.Val PwrLimr.PwrLimrStdOperMotEnvlpX.Ary1D PwrLimr.PwrLimrStdOperMotEnvlpY.Ary1D PwrLimr.PwrLimrVltgDptMotVelOffsX.Ary1D PwrLimr.PwrLimrVltgDptMotVelOffsY.Ary1D /end SUB_GROUP
 /begin FUNCTION_LIST /end FUNCTION_LIST
 /begin REF_CHARACTERISTIC /end REF_CHARACTERISTIC
 /begin REF_MEASUREMENT /end REF_MEASUREMENT
/end GROUP
/begin GROUP PwrLimr.DualEcuFltMtgtnSca.Val "MICROSAR RTE" /begin SUB_GROUP /end SUB_GROUP /begin FUNCTION_LIST /end FUNCTION_LIST /begin REF_CHARACTERISTIC /end REF_CHARACTERISTIC /begin REF_MEASUREMENT PwrLimr.DualEcuFltMtgtnSca.Val /end REF_MEASUREMENT /end GROUP
/begin GROUP PwrLimr.FltRefTi "MICROSAR RTE" /begin SUB_GROUP /end SUB_GROUP /begin FUNCTION_LIST /end FUNCTION_LIST /begin REF_CHARACTERISTIC /end REF_CHARACTERISTIC /begin REF_MEASUREMENT PwrLimr.FltRefTi /end REF_MEASUREMENT /end GROUP
/begin GROUP PwrLimr.IvtrLoaMtgtnEna.Logl "MICROSAR RTE" /begin SUB_GROUP /end SUB_GROUP /begin FUNCTION_LIST /end FUNCTION_LIST /begin REF_CHARACTERISTIC /end REF_CHARACTERISTIC /begin REF_MEASUREMENT PwrLimr.IvtrLoaMtgtnEna.Logl /end REF_MEASUREMENT /end GROUP
/begin GROUP PwrLimr.MotBackEmfConEstimd.Val "MICROSAR RTE" /begin SUB_GROUP /end SUB_GROUP /begin FUNCTION_LIST /end FUNCTION_LIST /begin REF_CHARACTERISTIC /end REF_CHARACTERISTIC /begin REF_MEASUREMENT PwrLimr.MotBackEmfConEstimd.Val /end REF_MEASUREMENT /end GROUP
/begin GROUP PwrLimr.MotTqCmdMrf.Val "MICROSAR RTE" /begin SUB_GROUP /end SUB_GROUP /begin FUNCTION_LIST /end FUNCTION_LIST /begin REF_CHARACTERISTIC /end REF_CHARACTERISTIC /begin REF_MEASUREMENT PwrLimr.MotTqCmdMrf.Val /end REF_MEASUREMENT /end GROUP
/begin GROUP PwrLimr.MotTqCmdPwrLimd.Val "MICROSAR RTE" /begin SUB_GROUP /end SUB_GROUP /begin FUNCTION_LIST /end FUNCTION_LIST /begin REF_CHARACTERISTIC /end REF_CHARACTERISTIC /begin REF_MEASUREMENT PwrLimr.MotTqCmdPwrLimd.Val /end REF_MEASUREMENT /end GROUP
/begin GROUP PwrLimr.MotVelLpFil "MICROSAR RTE" /begin SUB_GROUP /end SUB_GROUP /begin FUNCTION_LIST /end FUNCTION_LIST /begin REF_CHARACTERISTIC /end REF_CHARACTERISTIC /begin REF_MEASUREMENT PwrLimr.MotVelLpFil.FilGain PwrLimr.MotVelLpFil.FilSt /end REF_MEASUREMENT /end GROUP
/begin GROUP PwrLimr.MotVelMrf.Val "MICROSAR RTE" /begin SUB_GROUP /end SUB_GROUP /begin FUNCTION_LIST /end FUNCTION_LIST /begin REF_CHARACTERISTIC /end REF_CHARACTERISTIC /begin REF_MEASUREMENT PwrLimr.MotVelMrf.Val /end REF_MEASUREMENT /end GROUP
/begin GROUP PwrLimr.PerInstanceMemories "MICROSAR RTE"
 /begin SUB_GROUP PwrLimr.BrdgVltgAdjSlewStVari PwrLimr.FltRefTi PwrLimr.MotVelLpFil PwrLimr.PrevBrdgVltgAltFltAdjLim PwrLimr.PrevSpdAdj PwrLimr.PrevThd PwrLimr.SpdAdjSlewStVari PwrLimr.TqLimAssiRednLpFil PwrLimr.dPwrLimrFildMotVel PwrLimr.dPwrLimrLimDif PwrLimr.dPwrLimrMinStdOperLim PwrLimr.dPwrLimrMotEnvlpSpd PwrLimr.dPwrLimrMotTqCmdIvtrLoaSca PwrLimr.dPwrLimrOutpVelOffs PwrLimr.dPwrLimrSpdAdj PwrLimr.dPwrLimrTLimMaxCurr PwrLimr.dPwrLimrTqEnvlpLim1 PwrLimr.dPwrLimrTqEnvlpLim4 PwrLimr.dPwrLimrTqLim PwrLimr.dPwrLimrTqLim1 PwrLimr.dPwrLimrTqLim4 /end SUB_GROUP
 /begin FUNCTION_LIST /end FUNCTION_LIST
 /begin REF_CHARACTERISTIC /end REF_CHARACTERISTIC
 /begin REF_MEASUREMENT /end REF_MEASUREMENT
/end GROUP
/begin GROUP PwrLimr.PrevBrdgVltgAltFltAdjLim "MICROSAR RTE" /begin SUB_GROUP /end SUB_GROUP /begin FUNCTION_LIST /end FUNCTION_LIST /begin REF_CHARACTERISTIC /end REF_CHARACTERISTIC /begin REF_MEASUREMENT PwrLimr.PrevBrdgVltgAltFltAdjLim /end REF_MEASUREMENT /end GROUP
/begin GROUP PwrLimr.PrevSpdAdj "MICROSAR RTE" /begin SUB_GROUP /end SUB_GROUP /begin FUNCTION_LIST /end FUNCTION_LIST /begin REF_CHARACTERISTIC /end REF_CHARACTERISTIC /begin REF_MEASUREMENT PwrLimr.PrevSpdAdj /end REF_MEASUREMENT /end GROUP
/begin GROUP PwrLimr.PrevThd "MICROSAR RTE" /begin SUB_GROUP /end SUB_GROUP /begin FUNCTION_LIST /end FUNCTION_LIST /begin REF_CHARACTERISTIC /end REF_CHARACTERISTIC /begin REF_MEASUREMENT PwrLimr.PrevThd /end REF_MEASUREMENT /end GROUP
/begin GROUP PwrLimr.PwrLimrAssiRednLpFilFrq.Val "MICROSAR RTE" /begin SUB_GROUP /end SUB_GROUP /begin FUNCTION_LIST /end FUNCTION_LIST /begin REF_CHARACTERISTIC PwrLimr.PwrLimrAssiRednLpFilFrq.Val /end REF_CHARACTERISTIC /begin REF_MEASUREMENT /end REF_MEASUREMENT /end GROUP
/begin GROUP PwrLimr.PwrLimrBackEmfConStdT.Val "MICROSAR RTE" /begin SUB_GROUP /end SUB_GROUP /begin FUNCTION_LIST /end FUNCTION_LIST /begin REF_CHARACTERISTIC PwrLimr.PwrLimrBackEmfConStdT.Val /end REF_CHARACTERISTIC /begin REF_MEASUREMENT /end REF_MEASUREMENT /end GROUP
/begin GROUP PwrLimr.PwrLimrBrdgVltgAdjSlew.Val "MICROSAR RTE" /begin SUB_GROUP /end SUB_GROUP /begin FUNCTION_LIST /end FUNCTION_LIST /begin REF_CHARACTERISTIC PwrLimr.PwrLimrBrdgVltgAdjSlew.Val /end REF_CHARACTERISTIC /begin REF_MEASUREMENT /end REF_MEASUREMENT /end GROUP
/begin GROUP PwrLimr.PwrLimrBrdgVltgAltFltAdj.Val "MICROSAR RTE" /begin SUB_GROUP /end SUB_GROUP /begin FUNCTION_LIST /end FUNCTION_LIST /begin REF_CHARACTERISTIC PwrLimr.PwrLimrBrdgVltgAltFltAdj.Val /end REF_CHARACTERISTIC /begin REF_MEASUREMENT /end REF_MEASUREMENT /end GROUP
/begin GROUP PwrLimr.PwrLimrFilAssiRednThd.Val "MICROSAR RTE" /begin SUB_GROUP /end SUB_GROUP /begin FUNCTION_LIST /end FUNCTION_LIST /begin REF_CHARACTERISTIC PwrLimr.PwrLimrFilAssiRednThd.Val /end REF_CHARACTERISTIC /begin REF_MEASUREMENT /end REF_MEASUREMENT /end GROUP
/begin GROUP PwrLimr.PwrLimrLoVoltAssiRcvrThd.Val "MICROSAR RTE" /begin SUB_GROUP /end SUB_GROUP /begin FUNCTION_LIST /end FUNCTION_LIST /begin REF_CHARACTERISTIC PwrLimr.PwrLimrLoVoltAssiRcvrThd.Val /end REF_CHARACTERISTIC /begin REF_MEASUREMENT /end REF_MEASUREMENT /end GROUP
/begin GROUP PwrLimr.PwrLimrLoVoltAssiRcvrTi.Val "MICROSAR RTE" /begin SUB_GROUP /end SUB_GROUP /begin FUNCTION_LIST /end FUNCTION_LIST /begin REF_CHARACTERISTIC PwrLimr.PwrLimrLoVoltAssiRcvrTi.Val /end REF_CHARACTERISTIC /begin REF_MEASUREMENT /end REF_MEASUREMENT /end GROUP
/begin GROUP PwrLimr.PwrLimrMotEnvlpX.Ary1D "MICROSAR RTE" /begin SUB_GROUP /end SUB_GROUP /begin FUNCTION_LIST /end FUNCTION_LIST /begin REF_CHARACTERISTIC PwrLimr.PwrLimrMotEnvlpX.Ary1D /end REF_CHARACTERISTIC /begin REF_MEASUREMENT /end REF_MEASUREMENT /end GROUP
/begin GROUP PwrLimr.PwrLimrMotEnvlpY.Ary1D "MICROSAR RTE" /begin SUB_GROUP /end SUB_GROUP /begin FUNCTION_LIST /end FUNCTION_LIST /begin REF_CHARACTERISTIC PwrLimr.PwrLimrMotEnvlpY.Ary1D /end REF_CHARACTERISTIC /begin REF_MEASUREMENT /end REF_MEASUREMENT /end GROUP
/begin GROUP PwrLimr.PwrLimrMotVelLpFilFrq.Val "MICROSAR RTE" /begin SUB_GROUP /end SUB_GROUP /begin FUNCTION_LIST /end FUNCTION_LIST /begin REF_CHARACTERISTIC PwrLimr.PwrLimrMotVelLpFilFrq.Val /end REF_CHARACTERISTIC /begin REF_MEASUREMENT /end REF_MEASUREMENT /end GROUP
/begin GROUP PwrLimr.PwrLimrRednFac.Val "MICROSAR RTE" /begin SUB_GROUP /end SUB_GROUP /begin FUNCTION_LIST /end FUNCTION_LIST /begin REF_CHARACTERISTIC /end REF_CHARACTERISTIC /begin REF_MEASUREMENT PwrLimr.PwrLimrRednFac.Val /end REF_MEASUREMENT /end GROUP
/begin GROUP PwrLimr.PwrLimrSpdAdjSlewDec.Val "MICROSAR RTE" /begin SUB_GROUP /end SUB_GROUP /begin FUNCTION_LIST /end FUNCTION_LIST /begin REF_CHARACTERISTIC PwrLimr.PwrLimrSpdAdjSlewDec.Val /end REF_CHARACTERISTIC /begin REF_MEASUREMENT /end REF_MEASUREMENT /end GROUP
/begin GROUP PwrLimr.PwrLimrSpdAdjSlewEna.Logl "MICROSAR RTE" /begin SUB_GROUP /end SUB_GROUP /begin FUNCTION_LIST /end FUNCTION_LIST /begin REF_CHARACTERISTIC PwrLimr.PwrLimrSpdAdjSlewEna.Logl /end REF_CHARACTERISTIC /begin REF_MEASUREMENT /end REF_MEASUREMENT /end GROUP
/begin GROUP PwrLimr.PwrLimrSpdAdjSlewInc.Val "MICROSAR RTE" /begin SUB_GROUP /end SUB_GROUP /begin FUNCTION_LIST /end FUNCTION_LIST /begin REF_CHARACTERISTIC PwrLimr.PwrLimrSpdAdjSlewInc.Val /end REF_CHARACTERISTIC /begin REF_MEASUREMENT /end REF_MEASUREMENT /end GROUP
/begin GROUP PwrLimr.PwrLimrStdOperMotEnvlpX.Ary1D "MICROSAR RTE" /begin SUB_GROUP /end SUB_GROUP /begin FUNCTION_LIST /end FUNCTION_LIST /begin REF_CHARACTERISTIC PwrLimr.PwrLimrStdOperMotEnvlpX.Ary1D /end REF_CHARACTERISTIC /begin REF_MEASUREMENT /end REF_MEASUREMENT /end GROUP
/begin GROUP PwrLimr.PwrLimrStdOperMotEnvlpY.Ary1D "MICROSAR RTE" /begin SUB_GROUP /end SUB_GROUP /begin FUNCTION_LIST /end FUNCTION_LIST /begin REF_CHARACTERISTIC PwrLimr.PwrLimrStdOperMotEnvlpY.Ary1D /end REF_CHARACTERISTIC /begin REF_MEASUREMENT /end REF_MEASUREMENT /end GROUP
/begin GROUP PwrLimr.PwrLimrVltgDptMotVelOffsX.Ary1D "MICROSAR RTE" /begin SUB_GROUP /end SUB_GROUP /begin FUNCTION_LIST /end FUNCTION_LIST /begin REF_CHARACTERISTIC PwrLimr.PwrLimrVltgDptMotVelOffsX.Ary1D /end REF_CHARACTERISTIC /begin REF_MEASUREMENT /end REF_MEASUREMENT /end GROUP
/begin GROUP PwrLimr.PwrLimrVltgDptMotVelOffsY.Ary1D "MICROSAR RTE" /begin SUB_GROUP /end SUB_GROUP /begin FUNCTION_LIST /end FUNCTION_LIST /begin REF_CHARACTERISTIC PwrLimr.PwrLimrVltgDptMotVelOffsY.Ary1D /end REF_CHARACTERISTIC /begin REF_MEASUREMENT /end REF_MEASUREMENT /end GROUP
/**********************************************************************************************************************
* RECORD_LAYOUT
*********************************************************************************************************************/
/begin RECORD_LAYOUT RTE_RL_UBYTE FNC_VALUES 1 UBYTE ROW_DIR DIRECT /end RECORD_LAYOUT
/begin RECORD_LAYOUT RTE_RL_UWORD FNC_VALUES 1 UWORD ROW_DIR DIRECT /end RECORD_LAYOUT
/begin RECORD_LAYOUT RTE_RL_ULONG FNC_VALUES 1 ULONG ROW_DIR DIRECT /end RECORD_LAYOUT
/begin RECORD_LAYOUT RTE_RL_SWORD FNC_VALUES 1 SWORD ROW_DIR DIRECT /end RECORD_LAYOUT
/begin RECORD_LAYOUT RTE_RL_FLOAT32_IEEE FNC_VALUES 1 FLOAT32_IEEE ROW_DIR DIRECT /end RECORD_LAYOUT
/begin RECORD_LAYOUT RTE_RL_BOOLEAN FNC_VALUES 1 UBYTE ROW_DIR DIRECT /end RECORD_LAYOUT
/**********************************************************************************************************************
* COMPU_METHOD / COMPU_VTAB_RANGE
*********************************************************************************************************************/
/begin COMPU_METHOD RTE_CM_BOOLEAN "" TAB_VERB "%3.1" "" COMPU_TAB_REF RTE_CM_BOOLEAN /end COMPU_METHOD
/begin COMPU_VTAB_RANGE RTE_CM_BOOLEAN "" 2 0 0 "false" 1 255 "true" /end COMPU_VTAB_RANGE
/begin COMPU_METHOD RTE_CM_ENUM_SysSt1 "" TAB_VERB "%.1" "" COMPU_TAB_REF RTE_CM_ENUM_SysSt1 /end COMPU_METHOD
/begin COMPU_VTAB_RANGE RTE_CM_ENUM_SysSt1 "" 4 0 0 "SYSST_DI" 1 1 "SYSST_OFF" 2 2 "SYSST_ENA" 3 3 "SYSST_WRMININ" /end COMPU_VTAB_RANGE
/begin COMPU_METHOD RTE_CM_ENUM_LoaSt1 "" TAB_VERB "%.1" "" COMPU_TAB_REF RTE_CM_ENUM_LoaSt1 /end COMPU_METHOD
/begin COMPU_VTAB_RANGE RTE_CM_ENUM_LoaSt1 "" 6 0 0 "LOAST_NORM" 1 1 "LOAST_LIMD" 2 2 "LOAST_SWBASDMTGTN" 3 3 "LOAST_FADEOUT" 4 4 "LOAST_CTRLDSHTDWNREQD" 5 5 "LOAST_IMDTSHTDWNREQD" /end COMPU_VTAB_RANGE
