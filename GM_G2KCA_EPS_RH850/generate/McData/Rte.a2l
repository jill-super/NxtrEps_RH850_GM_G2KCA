/begin CHARACTERISTIC CustDiagc.EotLrngRackTrvlMin.Val "MICROSAR RTE" VALUE 0x0 RTE_RL_FLOAT32_IEEE 0 NO_COMPU_METHOD -3.402823466e+38 3.402823466e+38 SYMBOL_LINK "Rte_CalprmRom_CalRegn03Inin00_DEFAULT_RTE_CALPRM_GROUP.EotLrngRackTrvlMin_Val" 0 DISPLAY_IDENTIFIER CustDiagc.CalibrationPorts.EotLrngRackTrvlMin.Val /end CHARACTERISTIC
/begin CHARACTERISTIC CustDiagc.GmOvrlStMgrApaMfgEna.Logl "MICROSAR RTE" VALUE 0x0 RTE_RL_BOOLEAN 0 RTE_CM_BOOLEAN 0 255 SYMBOL_LINK "Rte_CalprmRom_CalRegn02CmnGroupA_DEFAULT_RTE_CALPRM_GROUP.GmOvrlStMgrApaMfgEna_Logl" 0 DISPLAY_IDENTIFIER CustDiagc.CalibrationPorts.GmOvrlStMgrApaMfgEna.Logl /end CHARACTERISTIC
/begin CHARACTERISTIC CustDiagc.GmOvrlStMgrEscMfgEna.Logl "MICROSAR RTE" VALUE 0x0 RTE_RL_BOOLEAN 0 RTE_CM_BOOLEAN 0 255 SYMBOL_LINK "Rte_CalprmRom_CalRegn02CmnGroupA_DEFAULT_RTE_CALPRM_GROUP.GmOvrlStMgrEscMfgEna_Logl" 0 DISPLAY_IDENTIFIER CustDiagc.CalibrationPorts.GmOvrlStMgrEscMfgEna.Logl /end CHARACTERISTIC
/begin CHARACTERISTIC CustDiagc.GmOvrlStMgrLkaMfgEna.Logl "MICROSAR RTE" VALUE 0x0 RTE_RL_BOOLEAN 0 RTE_CM_BOOLEAN 0 255 SYMBOL_LINK "Rte_CalprmRom_CalRegn02CmnGroupA_DEFAULT_RTE_CALPRM_GROUP.GmOvrlStMgrLkaMfgEna_Logl" 0 DISPLAY_IDENTIFIER CustDiagc.CalibrationPorts.GmOvrlStMgrLkaMfgEna.Logl /end CHARACTERISTIC
/begin CHARACTERISTIC CustDiagc.GmStrtStopEna.Logl "MICROSAR RTE" VALUE 0x0 RTE_RL_BOOLEAN 0 RTE_CM_BOOLEAN 0 255 SYMBOL_LINK "Rte_CalprmRom_CalRegn02Inin00_DEFAULT_RTE_CALPRM_GROUP.GmStrtStopEna_Logl" 0 DISPLAY_IDENTIFIER CustDiagc.CalibrationPorts.GmStrtStopEna.Logl /end CHARACTERISTIC
/begin CHARACTERISTIC Dampg.DampgHwTqX.Ary1D "MICROSAR RTE" VAL_BLK 0x0 RTE_RL_UWORD 0 RTE_CM_Tq6 0 0 MATRIX_DIM 2 1 1 SYMBOL_LINK "Rte_CalprmRom_CalRegn03CmnGroupA_DEFAULT_RTE_CALPRM_GROUP.DampgHwTqX_Ary1D" 0 DISPLAY_IDENTIFIER Dampg.CalibrationPorts.DampgHwTqX.Ary1D /end CHARACTERISTIC
/begin CHARACTERISTIC Dampg.DampgHwTqY.Ary1D "MICROSAR RTE" VAL_BLK 0x0 RTE_RL_UWORD 0 RTE_CM_Uls15 0 0 MATRIX_DIM 2 1 1 SYMBOL_LINK "Rte_CalprmRom_CalRegn03CmnGroupA_DEFAULT_RTE_CALPRM_GROUP.DampgHwTqY_Ary1D" 0 DISPLAY_IDENTIFIER Dampg.CalibrationPorts.DampgHwTqY.Ary1D /end CHARACTERISTIC
/begin CHARACTERISTIC Dampg.DampgHydAssiLim.Ary1D "MICROSAR RTE" VAL_BLK 0x0 RTE_RL_UWORD 0 RTE_CM_Tq13 0 0 MATRIX_DIM 12 1 1 SYMBOL_LINK "Rte_CalprmRom_CalRegn03Inin00_DEFAULT_RTE_CALPRM_GROUP.DampgHydAssiLim_Ary1D" 0 DISPLAY_IDENTIFIER Dampg.CalibrationPorts.DampgHydAssiLim.Ary1D /end CHARACTERISTIC
/begin CHARACTERISTIC Dampg.DampgHydBasCoeff1.Val "MICROSAR RTE" VALUE 0x0 RTE_RL_FLOAT32_IEEE 0 NO_COMPU_METHOD 0.0 0.1 SYMBOL_LINK "Rte_CalprmRom_CalRegn03Inin00_DEFAULT_RTE_CALPRM_GROUP.DampgHydBasCoeff1_Val" 0 DISPLAY_IDENTIFIER Dampg.CalibrationPorts.DampgHydBasCoeff1.Val /end CHARACTERISTIC
/begin CHARACTERISTIC Dampg.DampgHydBasCoeff2.Val "MICROSAR RTE" VALUE 0x0 RTE_RL_FLOAT32_IEEE 0 NO_COMPU_METHOD 0.0 0.1 SYMBOL_LINK "Rte_CalprmRom_CalRegn03Inin00_DEFAULT_RTE_CALPRM_GROUP.DampgHydBasCoeff2_Val" 0 DISPLAY_IDENTIFIER Dampg.CalibrationPorts.DampgHydBasCoeff2.Val /end CHARACTERISTIC
/begin CHARACTERISTIC Dampg.DampgHydBasCoeff3.Val "MICROSAR RTE" VALUE 0x0 RTE_RL_FLOAT32_IEEE 0 NO_COMPU_METHOD 0.0 0.1 SYMBOL_LINK "Rte_CalprmRom_CalRegn03Inin00_DEFAULT_RTE_CALPRM_GROUP.DampgHydBasCoeff3_Val" 0 DISPLAY_IDENTIFIER Dampg.CalibrationPorts.DampgHydBasCoeff3.Val /end CHARACTERISTIC
/begin CHARACTERISTIC Dampg.DampgHydBasCoeff4.Val "MICROSAR RTE" VALUE 0x0 RTE_RL_FLOAT32_IEEE 0 NO_COMPU_METHOD 0.0 0.1 SYMBOL_LINK "Rte_CalprmRom_CalRegn03Inin00_DEFAULT_RTE_CALPRM_GROUP.DampgHydBasCoeff4_Val" 0 DISPLAY_IDENTIFIER Dampg.CalibrationPorts.DampgHydBasCoeff4.Val /end CHARACTERISTIC
/begin CHARACTERISTIC Dampg.DampgHydCoeff1ScaY.Ary1D "MICROSAR RTE" VAL_BLK 0x0 RTE_RL_UWORD 0 RTE_CM_Uls20 0 0 MATRIX_DIM 12 1 1 SYMBOL_LINK "Rte_CalprmRom_CalRegn03Rt00GroupA_DEFAULT_RTE_CALPRM_GROUP.DampgHydCoeff1ScaY_Ary1D" 0 DISPLAY_IDENTIFIER Dampg.CalibrationPorts.DampgHydCoeff1ScaY.Ary1D /end CHARACTERISTIC
/begin CHARACTERISTIC Dampg.DampgHydCoeff2ScaY.Ary1D "MICROSAR RTE" VAL_BLK 0x0 RTE_RL_UWORD 0 RTE_CM_Uls20 0 0 MATRIX_DIM 12 1 1 SYMBOL_LINK "Rte_CalprmRom_CalRegn03Rt00GroupA_DEFAULT_RTE_CALPRM_GROUP.DampgHydCoeff2ScaY_Ary1D" 0 DISPLAY_IDENTIFIER Dampg.CalibrationPorts.DampgHydCoeff2ScaY.Ary1D /end CHARACTERISTIC
/begin CHARACTERISTIC Dampg.DampgHydCoeff3ScaY.Ary1D "MICROSAR RTE" VAL_BLK 0x0 RTE_RL_UWORD 0 RTE_CM_Uls20 0 0 MATRIX_DIM 12 1 1 SYMBOL_LINK "Rte_CalprmRom_CalRegn03Rt00GroupA_DEFAULT_RTE_CALPRM_GROUP.DampgHydCoeff3ScaY_Ary1D" 0 DISPLAY_IDENTIFIER Dampg.CalibrationPorts.DampgHydCoeff3ScaY.Ary1D /end CHARACTERISTIC
/begin CHARACTERISTIC Dampg.DampgHydCoeff4ScaY.Ary1D "MICROSAR RTE" VAL_BLK 0x0 RTE_RL_UWORD 0 RTE_CM_Uls20 0 0 MATRIX_DIM 12 1 1 SYMBOL_LINK "Rte_CalprmRom_CalRegn03Rt00GroupA_DEFAULT_RTE_CALPRM_GROUP.DampgHydCoeff4ScaY_Ary1D" 0 DISPLAY_IDENTIFIER Dampg.CalibrationPorts.DampgHydCoeff4ScaY.Ary1D /end CHARACTERISTIC
/begin CHARACTERISTIC Dampg.DampgHydOutpLim.Val "MICROSAR RTE" VALUE 0x0 RTE_RL_FLOAT32_IEEE 0 NO_COMPU_METHOD -8.8 8.8 SYMBOL_LINK "Rte_CalprmRom_CalRegn03Inin00_DEFAULT_RTE_CALPRM_GROUP.DampgHydOutpLim_Val" 0 DISPLAY_IDENTIFIER Dampg.CalibrationPorts.DampgHydOutpLim.Val /end CHARACTERISTIC
/begin CHARACTERISTIC Dampg.DampgMotVelLpFilFrq.Val "MICROSAR RTE" VALUE 0x0 RTE_RL_FLOAT32_IEEE 0 NO_COMPU_METHOD 5 100 SYMBOL_LINK "Rte_CalprmRom_CalRegn03Inin00_DEFAULT_RTE_CALPRM_GROUP.DampgMotVelLpFilFrq_Val" 0 DISPLAY_IDENTIFIER Dampg.CalibrationPorts.DampgMotVelLpFilFrq.Val /end CHARACTERISTIC
/begin CHARACTERISTIC Dampg.DampgMotVelX.Ary2D "MICROSAR RTE" VAL_BLK 0x0 RTE_RL_UWORD 0 RTE_CM_Vel7 0 0 MATRIX_DIM 13 12 1 SYMBOL_LINK "Rte_CalprmRom_CalRegn03Rt00GroupA_DEFAULT_RTE_CALPRM_GROUP.DampgMotVelX_Ary2D" 0 DISPLAY_IDENTIFIER Dampg.CalibrationPorts.DampgMotVelX.Ary2D /end CHARACTERISTIC
/begin CHARACTERISTIC Dampg.DampgMotVelY.Ary2D "MICROSAR RTE" VAL_BLK 0x0 RTE_RL_UWORD 0 RTE_CM_Tq12 0 0 MATRIX_DIM 13 12 1 SYMBOL_LINK "Rte_CalprmRom_CalRegn03Rt00GroupA_DEFAULT_RTE_CALPRM_GROUP.DampgMotVelY_Ary2D" 0 DISPLAY_IDENTIFIER Dampg.CalibrationPorts.DampgMotVelY.Ary2D /end CHARACTERISTIC
/begin CHARACTERISTIC Dampg.DampgQuad13Mplr.Val "MICROSAR RTE" VALUE 0x0 RTE_RL_FLOAT32_IEEE 0 NO_COMPU_METHOD 0 2 SYMBOL_LINK "Rte_CalprmRom_CalRegn03Inin00_DEFAULT_RTE_CALPRM_GROUP.DampgQuad13Mplr_Val" 0 DISPLAY_IDENTIFIER Dampg.CalibrationPorts.DampgQuad13Mplr.Val /end CHARACTERISTIC
/begin CHARACTERISTIC Dampg.DampgQuad24Mplr.Val "MICROSAR RTE" VALUE 0x0 RTE_RL_FLOAT32_IEEE 0 NO_COMPU_METHOD 0 2 SYMBOL_LINK "Rte_CalprmRom_CalRegn03Inin00_DEFAULT_RTE_CALPRM_GROUP.DampgQuad24Mplr_Val" 0 DISPLAY_IDENTIFIER Dampg.CalibrationPorts.DampgQuad24Mplr.Val /end CHARACTERISTIC
/begin CHARACTERISTIC Dampg.DampgQuadHwTqBacklsh.Val "MICROSAR RTE" VALUE 0x0 RTE_RL_FLOAT32_IEEE 0 NO_COMPU_METHOD 0.0 10.0 SYMBOL_LINK "Rte_CalprmRom_CalRegn03Cmn_DEFAULT_RTE_CALPRM_GROUP.DampgQuadHwTqBacklsh_Val" 0 DISPLAY_IDENTIFIER Dampg.CalibrationPorts.DampgQuadHwTqBacklsh.Val /end CHARACTERISTIC
/begin CHARACTERISTIC Dampg.DampgQuadHwTqLpFilFrq.Val "MICROSAR RTE" VALUE 0x0 RTE_RL_FLOAT32_IEEE 0 NO_COMPU_METHOD 5 31.25 SYMBOL_LINK "Rte_CalprmRom_CalRegn03Inin00_DEFAULT_RTE_CALPRM_GROUP.DampgQuadHwTqLpFilFrq_Val" 0 DISPLAY_IDENTIFIER Dampg.CalibrationPorts.DampgQuadHwTqLpFilFrq.Val /end CHARACTERISTIC
/begin CHARACTERISTIC Dampg.DampgQuadMotVelBacklsh.Val "MICROSAR RTE" VALUE 0x0 RTE_RL_FLOAT32_IEEE 0 NO_COMPU_METHOD 0 128 SYMBOL_LINK "Rte_CalprmRom_CalRegn03Cmn_DEFAULT_RTE_CALPRM_GROUP.DampgQuadMotVelBacklsh_Val" 0 DISPLAY_IDENTIFIER Dampg.CalibrationPorts.DampgQuadMotVelBacklsh.Val /end CHARACTERISTIC
/begin CHARACTERISTIC Dampg.DampgQuadMotVelLpFilFrq.Val "MICROSAR RTE" VALUE 0x0 RTE_RL_FLOAT32_IEEE 0 NO_COMPU_METHOD 5 31.25 SYMBOL_LINK "Rte_CalprmRom_CalRegn03Inin00_DEFAULT_RTE_CALPRM_GROUP.DampgQuadMotVelLpFilFrq_Val" 0 DISPLAY_IDENTIFIER Dampg.CalibrationPorts.DampgQuadMotVelLpFilFrq.Val /end CHARACTERISTIC
/begin CHARACTERISTIC Dampg.DampgQuadScaLpFilFrq.Val "MICROSAR RTE" VALUE 0x0 RTE_RL_FLOAT32_IEEE 0 NO_COMPU_METHOD 0.0039 100 SYMBOL_LINK "Rte_CalprmRom_CalRegn03Inin00_DEFAULT_RTE_CALPRM_GROUP.DampgQuadScaLpFilFrq_Val" 0 DISPLAY_IDENTIFIER Dampg.CalibrationPorts.DampgQuadScaLpFilFrq.Val /end CHARACTERISTIC
/begin CHARACTERISTIC Dampg.DampgTScaX.Ary1D "MICROSAR RTE" VAL_BLK 0x0 RTE_RL_SWORD 0 RTE_CM_T7 0 0 MATRIX_DIM 14 1 1 SYMBOL_LINK "Rte_CalprmRom_CalRegn03Inin00GroupA_DEFAULT_RTE_CALPRM_GROUP.DampgTScaX_Ary1D" 0 DISPLAY_IDENTIFIER Dampg.CalibrationPorts.DampgTScaX.Ary1D /end CHARACTERISTIC
/begin CHARACTERISTIC Dampg.DampgTScaY.Ary1D "MICROSAR RTE" VAL_BLK 0x0 RTE_RL_UWORD 0 RTE_CM_Uls20 0 0 MATRIX_DIM 14 1 1 SYMBOL_LINK "Rte_CalprmRom_CalRegn03Inin00GroupA_DEFAULT_RTE_CALPRM_GROUP.DampgTScaY_Ary1D" 0 DISPLAY_IDENTIFIER Dampg.CalibrationPorts.DampgTScaY.Ary1D /end CHARACTERISTIC
/begin CHARACTERISTIC Dampg.SysGlbPrmVehSpdBilnrSeln.Ary1D "MICROSAR RTE" VAL_BLK 0x0 RTE_RL_UWORD 0 RTE_CM_Spd2 0 0 MATRIX_DIM 12 1 1 SYMBOL_LINK "Rte_CalprmRom_CalRegn01Cmn_DEFAULT_RTE_CALPRM_GROUP.SysGlbPrmVehSpdBilnrSeln_Ary1D" 0 DISPLAY_IDENTIFIER Dampg.CalibrationPorts.SysGlbPrmVehSpdBilnrSeln.Ary1D /end CHARACTERISTIC
/begin CHARACTERISTIC DampgPahFwl.DampgPahFwlActvFwlLpFilFrq.Val "MICROSAR RTE" VALUE 0x0 RTE_RL_FLOAT32_IEEE 0 NO_COMPU_METHOD -3.402823466e+38 3.402823466e+38 SYMBOL_LINK "Rte_CalprmRom_CalRegn01Inin00_DEFAULT_RTE_CALPRM_GROUP.DampgPahFwlActvFwlLpFilFrq_Val" 0 DISPLAY_IDENTIFIER DampgPahFwl.CalibrationPorts.DampgPahFwlActvFwlLpFilFrq.Val /end CHARACTERISTIC
/begin CHARACTERISTIC DampgPahFwl.DampgPahFwlAssiAddlDampgX.Ary1D "MICROSAR RTE" VAL_BLK 0x0 RTE_RL_UWORD 0 NO_COMPU_METHOD 0 65535 MATRIX_DIM 8 1 1 SYMBOL_LINK "Rte_CalprmRom_CalRegn01Cmn_DEFAULT_RTE_CALPRM_GROUP.DampgPahFwlAssiAddlDampgX_Ary1D" 0 DISPLAY_IDENTIFIER DampgPahFwl.CalibrationPorts.DampgPahFwlAssiAddlDampgX.Ary1D /end CHARACTERISTIC
/begin CHARACTERISTIC DampgPahFwl.DampgPahFwlAssiAddlDampgY.Ary1D "MICROSAR RTE" VAL_BLK 0x0 RTE_RL_UWORD 0 NO_COMPU_METHOD 0 65535 MATRIX_DIM 8 1 1 SYMBOL_LINK "Rte_CalprmRom_CalRegn01Cmn_DEFAULT_RTE_CALPRM_GROUP.DampgPahFwlAssiAddlDampgY_Ary1D" 0 DISPLAY_IDENTIFIER DampgPahFwl.CalibrationPorts.DampgPahFwlAssiAddlDampgY.Ary1D /end CHARACTERISTIC
/begin CHARACTERISTIC DampgPahFwl.DampgPahFwlDampgCmdAddlDampgX.Ary1D "MICROSAR RTE" VAL_BLK 0x0 RTE_RL_UWORD 0 NO_COMPU_METHOD 0 65535 MATRIX_DIM 8 1 1 SYMBOL_LINK "Rte_CalprmRom_CalRegn01Cmn_DEFAULT_RTE_CALPRM_GROUP.DampgPahFwlDampgCmdAddlDampgX_Ary1D" 0 DISPLAY_IDENTIFIER DampgPahFwl.CalibrationPorts.DampgPahFwlDampgCmdAddlDampgX.Ary1D /end CHARACTERISTIC
/begin CHARACTERISTIC DampgPahFwl.DampgPahFwlDampgCmdAddlDampgY.Ary1D "MICROSAR RTE" VAL_BLK 0x0 RTE_RL_UWORD 0 NO_COMPU_METHOD 0 65535 MATRIX_DIM 8 1 1 SYMBOL_LINK "Rte_CalprmRom_CalRegn01Cmn_DEFAULT_RTE_CALPRM_GROUP.DampgPahFwlDampgCmdAddlDampgY_Ary1D" 0 DISPLAY_IDENTIFIER DampgPahFwl.CalibrationPorts.DampgPahFwlDampgCmdAddlDampgY.Ary1D /end CHARACTERISTIC
/begin CHARACTERISTIC DampgPahFwl.DampgPahFwlDampgCmdFwlOverLimDiagcFailStep.Val "MICROSAR RTE" VALUE 0x0 RTE_RL_UWORD 0 NO_COMPU_METHOD 0 65535 SYMBOL_LINK "Rte_CalprmRom_CalRegn01Cmn_DEFAULT_RTE_CALPRM_GROUP.DampgPahFwlDampgCmdFwlOverLimDiagcFailStep_Val" 0 DISPLAY_IDENTIFIER DampgPahFwl.CalibrationPorts.DampgPahFwlDampgCmdFwlOverLimDiagcFailStep.Val /end CHARACTERISTIC
/begin CHARACTERISTIC DampgPahFwl.DampgPahFwlDampgCmdFwlOverLimDiagcPassStep.Val "MICROSAR RTE" VALUE 0x0 RTE_RL_UWORD 0 NO_COMPU_METHOD 0 65535 SYMBOL_LINK "Rte_CalprmRom_CalRegn01Cmn_DEFAULT_RTE_CALPRM_GROUP.DampgPahFwlDampgCmdFwlOverLimDiagcPassStep_Val" 0 DISPLAY_IDENTIFIER DampgPahFwl.CalibrationPorts.DampgPahFwlDampgCmdFwlOverLimDiagcPassStep.Val /end CHARACTERISTIC
/begin CHARACTERISTIC DampgPahFwl.DampgPahFwlDampgCmdLpFilFrq.Val "MICROSAR RTE" VALUE 0x0 RTE_RL_FLOAT32_IEEE 0 NO_COMPU_METHOD -3.402823466e+38 3.402823466e+38 SYMBOL_LINK "Rte_CalprmRom_CalRegn01Inin00_DEFAULT_RTE_CALPRM_GROUP.DampgPahFwlDampgCmdLpFilFrq_Val" 0 DISPLAY_IDENTIFIER DampgPahFwl.CalibrationPorts.DampgPahFwlDampgCmdLpFilFrq.Val /end CHARACTERISTIC
/begin CHARACTERISTIC DampgPahFwl.DampgPahFwlDampgCmdUpprLimX.Ary1D "MICROSAR RTE" VAL_BLK 0x0 RTE_RL_SWORD 0 NO_COMPU_METHOD -32768 32767 MATRIX_DIM 11 1 1 SYMBOL_LINK "Rte_CalprmRom_CalRegn01Inin00_DEFAULT_RTE_CALPRM_GROUP.DampgPahFwlDampgCmdUpprLimX_Ary1D" 0 DISPLAY_IDENTIFIER DampgPahFwl.CalibrationPorts.DampgPahFwlDampgCmdUpprLimX.Ary1D /end CHARACTERISTIC
/begin CHARACTERISTIC DampgPahFwl.DampgPahFwlDampgCmdUpprLimY.Ary2D "MICROSAR RTE" VAL_BLK 0x0 RTE_RL_SWORD 0 NO_COMPU_METHOD -32768 32767 MATRIX_DIM 11 12 1 SYMBOL_LINK "Rte_CalprmRom_CalRegn01Inin00_DEFAULT_RTE_CALPRM_GROUP.DampgPahFwlDampgCmdUpprLimY_Ary2D" 0 DISPLAY_IDENTIFIER DampgPahFwl.CalibrationPorts.DampgPahFwlDampgCmdUpprLimY.Ary2D /end CHARACTERISTIC
/begin CHARACTERISTIC DampgPahFwl.DampgPahFwlDftDampgX.Ary1D "MICROSAR RTE" VAL_BLK 0x0 RTE_RL_UWORD 0 NO_COMPU_METHOD 0 65535 MATRIX_DIM 11 1 1 SYMBOL_LINK "Rte_CalprmRom_CalRegn01Cmn_DEFAULT_RTE_CALPRM_GROUP.DampgPahFwlDftDampgX_Ary1D" 0 DISPLAY_IDENTIFIER DampgPahFwl.CalibrationPorts.DampgPahFwlDftDampgX.Ary1D /end CHARACTERISTIC
/begin CHARACTERISTIC DampgPahFwl.DampgPahFwlDftDampgY.Ary1D "MICROSAR RTE" VAL_BLK 0x0 RTE_RL_UWORD 0 NO_COMPU_METHOD 0 65535 MATRIX_DIM 11 1 1 SYMBOL_LINK "Rte_CalprmRom_CalRegn01Inin00_DEFAULT_RTE_CALPRM_GROUP.DampgPahFwlDftDampgY_Ary1D" 0 DISPLAY_IDENTIFIER DampgPahFwl.CalibrationPorts.DampgPahFwlDftDampgY.Ary1D /end CHARACTERISTIC
/begin CHARACTERISTIC DampgPahFwl.DampgPahFwlInertiaCmpCmdFwlOverLimDiagcFailStep.Val "MICROSAR RTE" VALUE 0x0 RTE_RL_UWORD 0 NO_COMPU_METHOD 0 65535 SYMBOL_LINK "Rte_CalprmRom_CalRegn01Cmn_DEFAULT_RTE_CALPRM_GROUP.DampgPahFwlInertiaCmpCmdFwlOverLimDiagcFailStep_Val" 0 DISPLAY_IDENTIFIER DampgPahFwl.CalibrationPorts.DampgPahFwlInertiaCmpCmdFwlOverLimDiagcFailStep.Val /end CHARACTERISTIC
/begin CHARACTERISTIC DampgPahFwl.DampgPahFwlInertiaCmpCmdFwlOverLimDiagcPassStep.Val "MICROSAR RTE" VALUE 0x0 RTE_RL_UWORD 0 NO_COMPU_METHOD 0 65535 SYMBOL_LINK "Rte_CalprmRom_CalRegn01Cmn_DEFAULT_RTE_CALPRM_GROUP.DampgPahFwlInertiaCmpCmdFwlOverLimDiagcPassStep_Val" 0 DISPLAY_IDENTIFIER DampgPahFwl.CalibrationPorts.DampgPahFwlInertiaCmpCmdFwlOverLimDiagcPassStep.Val /end CHARACTERISTIC
/begin CHARACTERISTIC DampgPahFwl.DampgPahFwlInertiaCmpLpFilFrq.Val "MICROSAR RTE" VALUE 0x0 RTE_RL_FLOAT32_IEEE 0 NO_COMPU_METHOD -3.402823466e+38 3.402823466e+38 SYMBOL_LINK "Rte_CalprmRom_CalRegn01Inin00_DEFAULT_RTE_CALPRM_GROUP.DampgPahFwlInertiaCmpLpFilFrq_Val" 0 DISPLAY_IDENTIFIER DampgPahFwl.CalibrationPorts.DampgPahFwlInertiaCmpLpFilFrq.Val /end CHARACTERISTIC
/begin CHARACTERISTIC DampgPahFwl.DampgPahFwlInertiaCmpUpprLimX.Ary1D "MICROSAR RTE" VAL_BLK 0x0 RTE_RL_SWORD 0 NO_COMPU_METHOD -32768 32767 MATRIX_DIM 11 1 1 SYMBOL_LINK "Rte_CalprmRom_CalRegn01Inin00_DEFAULT_RTE_CALPRM_GROUP.DampgPahFwlInertiaCmpUpprLimX_Ary1D" 0 DISPLAY_IDENTIFIER DampgPahFwl.CalibrationPorts.DampgPahFwlInertiaCmpUpprLimX.Ary1D /end CHARACTERISTIC
/begin CHARACTERISTIC DampgPahFwl.DampgPahFwlInertiaCmpUpprLimY.Ary2D "MICROSAR RTE" VAL_BLK 0x0 RTE_RL_SWORD 0 NO_COMPU_METHOD -32768 32767 MATRIX_DIM 11 12 1 SYMBOL_LINK "Rte_CalprmRom_CalRegn01Inin00_DEFAULT_RTE_CALPRM_GROUP.DampgPahFwlInertiaCmpUpprLimY_Ary2D" 0 DISPLAY_IDENTIFIER DampgPahFwl.CalibrationPorts.DampgPahFwlInertiaCmpUpprLimY.Ary2D /end CHARACTERISTIC
/begin CHARACTERISTIC DampgPahFwl.DampgPahFwlVehSpd.Ary1D "MICROSAR RTE" VAL_BLK 0x0 RTE_RL_UWORD 0 NO_COMPU_METHOD 0 65535 MATRIX_DIM 12 1 1 SYMBOL_LINK "Rte_CalprmRom_CalRegn01Cmn_DEFAULT_RTE_CALPRM_GROUP.DampgPahFwlVehSpd_Ary1D" 0 DISPLAY_IDENTIFIER DampgPahFwl.CalibrationPorts.DampgPahFwlVehSpd.Ary1D /end CHARACTERISTIC
/begin CHARACTERISTIC DiagcMgr.DiagcMgrFltResp.Ary1D "MICROSAR RTE" VAL_BLK 0x0 RTE_RL_ULONG 0 NO_COMPU_METHOD 0 4294967295 MATRIX_DIM 512 1 1 SYMBOL_LINK "Rte_CalprmRom_CalRegn02Cmn_DEFAULT_RTE_CALPRM_GROUP.DiagcMgrFltResp_Ary1D" 0 DISPLAY_IDENTIFIER DiagcMgr.CalibrationPorts.DiagcMgrFltResp.Ary1D /end CHARACTERISTIC
/begin CHARACTERISTIC DiagcMgrProxyAppl10.DiagcMgrFltResp.Ary1D "MICROSAR RTE" VAL_BLK 0x0 RTE_RL_ULONG 0 NO_COMPU_METHOD 0 4294967295 MATRIX_DIM 512 1 1 SYMBOL_LINK "Rte_CalprmRom_CalRegn02Cmn_DEFAULT_RTE_CALPRM_GROUP.DiagcMgrFltResp_Ary1D" 0 DISPLAY_IDENTIFIER DiagcMgrProxyAppl10.CalibrationPorts.DiagcMgrFltResp.Ary1D /end CHARACTERISTIC
/begin CHARACTERISTIC DiagcMgrProxyAppl6.DiagcMgrFltResp.Ary1D "MICROSAR RTE" VAL_BLK 0x0 RTE_RL_ULONG 0 NO_COMPU_METHOD 0 4294967295 MATRIX_DIM 512 1 1 SYMBOL_LINK "Rte_CalprmRom_CalRegn02Cmn_DEFAULT_RTE_CALPRM_GROUP.DiagcMgrFltResp_Ary1D" 0 DISPLAY_IDENTIFIER DiagcMgrProxyAppl6.CalibrationPorts.DiagcMgrFltResp.Ary1D /end CHARACTERISTIC
/begin CHARACTERISTIC DutyCycThermProtn.DutyCycThermProtnAbsltCtrlTTblX.Ary1D "MICROSAR RTE" VAL_BLK 0x0 RTE_RL_SWORD 0 NO_COMPU_METHOD -32768 32767 MATRIX_DIM 4 1 1 SYMBOL_LINK "Rte_CalprmRom_CalRegn01Cmn_DEFAULT_RTE_CALPRM_GROUP.DutyCycThermProtnAbsltCtrlTTblX_Ary1D" 0 DISPLAY_IDENTIFIER DutyCycThermProtn.CalibrationPorts.DutyCycThermProtnAbsltCtrlTTblX.Ary1D /end CHARACTERISTIC
/begin CHARACTERISTIC DutyCycThermProtn.DutyCycThermProtnAbsltCtrlTTqTblY.Ary1D "MICROSAR RTE" VAL_BLK 0x0 RTE_RL_UWORD 0 NO_COMPU_METHOD 0 65535 MATRIX_DIM 4 1 1 SYMBOL_LINK "Rte_CalprmRom_CalRegn01Cmn_DEFAULT_RTE_CALPRM_GROUP.DutyCycThermProtnAbsltCtrlTTqTblY_Ary1D" 0 DISPLAY_IDENTIFIER DutyCycThermProtn.CalibrationPorts.DutyCycThermProtnAbsltCtrlTTqTblY.Ary1D /end CHARACTERISTIC
/begin CHARACTERISTIC DutyCycThermProtn.DutyCycThermProtnAbsltCuTTblX.Ary1D "MICROSAR RTE" VAL_BLK 0x0 RTE_RL_SWORD 0 NO_COMPU_METHOD -32768 32767 MATRIX_DIM 4 1 1 SYMBOL_LINK "Rte_CalprmRom_CalRegn01Cmn_DEFAULT_RTE_CALPRM_GROUP.DutyCycThermProtnAbsltCuTTblX_Ary1D" 0 DISPLAY_IDENTIFIER DutyCycThermProtn.CalibrationPorts.DutyCycThermProtnAbsltCuTTblX.Ary1D /end CHARACTERISTIC
/begin CHARACTERISTIC DutyCycThermProtn.DutyCycThermProtnAbsltCuTTqTblY.Ary1D "MICROSAR RTE" VAL_BLK 0x0 RTE_RL_UWORD 0 NO_COMPU_METHOD 0 65535 MATRIX_DIM 4 1 1 SYMBOL_LINK "Rte_CalprmRom_CalRegn01Cmn_DEFAULT_RTE_CALPRM_GROUP.DutyCycThermProtnAbsltCuTTqTblY_Ary1D" 0 DISPLAY_IDENTIFIER DutyCycThermProtn.CalibrationPorts.DutyCycThermProtnAbsltCuTTqTblY.Ary1D /end CHARACTERISTIC
/begin CHARACTERISTIC DutyCycThermProtn.DutyCycThermProtnAbsltMotVelBreakPt.Val "MICROSAR RTE" VALUE 0x0 RTE_RL_FLOAT32_IEEE 0 NO_COMPU_METHOD -3.402823466e+38 3.402823466e+38 SYMBOL_LINK "Rte_CalprmRom_CalRegn01Cmn_DEFAULT_RTE_CALPRM_GROUP.DutyCycThermProtnAbsltMotVelBreakPt_Val" 0 DISPLAY_IDENTIFIER DutyCycThermProtn.CalibrationPorts.DutyCycThermProtnAbsltMotVelBreakPt.Val /end CHARACTERISTIC
/begin CHARACTERISTIC DutyCycThermProtn.DutyCycThermProtnAbsltTTqSlewHiLim.Val "MICROSAR RTE" VALUE 0x0 RTE_RL_FLOAT32_IEEE 0 NO_COMPU_METHOD -3.402823466e+38 3.402823466e+38 SYMBOL_LINK "Rte_CalprmRom_CalRegn01Cmn_DEFAULT_RTE_CALPRM_GROUP.DutyCycThermProtnAbsltTTqSlewHiLim_Val" 0 DISPLAY_IDENTIFIER DutyCycThermProtn.CalibrationPorts.DutyCycThermProtnAbsltTTqSlewHiLim.Val /end CHARACTERISTIC
/begin CHARACTERISTIC DutyCycThermProtn.DutyCycThermProtnAbsltTTqSlewLoLim.Val "MICROSAR RTE" VALUE 0x0 RTE_RL_FLOAT32_IEEE 0 NO_COMPU_METHOD -3.402823466e+38 3.402823466e+38 SYMBOL_LINK "Rte_CalprmRom_CalRegn01Cmn_DEFAULT_RTE_CALPRM_GROUP.DutyCycThermProtnAbsltTTqSlewLoLim_Val" 0 DISPLAY_IDENTIFIER DutyCycThermProtn.CalibrationPorts.DutyCycThermProtnAbsltTTqSlewLoLim.Val /end CHARACTERISTIC
/begin CHARACTERISTIC DutyCycThermProtn.DutyCycThermProtnCtrlT.Val "MICROSAR RTE" VALUE 0x0 RTE_RL_FLOAT32_IEEE 0 NO_COMPU_METHOD -3.402823466e+38 3.402823466e+38 SYMBOL_LINK "Rte_CalprmRom_CalRegn01Cmn_DEFAULT_RTE_CALPRM_GROUP.DutyCycThermProtnCtrlT_Val" 0 DISPLAY_IDENTIFIER DutyCycThermProtn.CalibrationPorts.DutyCycThermProtnCtrlT.Val /end CHARACTERISTIC
/begin CHARACTERISTIC DutyCycThermProtn.DutyCycThermProtnCtrlTSeln.Logl "MICROSAR RTE" VALUE 0x0 RTE_RL_BOOLEAN 0 RTE_CM_BOOLEAN 0 255 SYMBOL_LINK "Rte_CalprmRom_CalRegn01Cmn_DEFAULT_RTE_CALPRM_GROUP.DutyCycThermProtnCtrlTSeln_Logl" 0 DISPLAY_IDENTIFIER DutyCycThermProtn.CalibrationPorts.DutyCycThermProtnCtrlTSeln.Logl /end CHARACTERISTIC
/begin CHARACTERISTIC DutyCycThermProtn.DutyCycThermProtnDutyCycFildThd.Val "MICROSAR RTE" VALUE 0x0 RTE_RL_UWORD 0 NO_COMPU_METHOD 0 65535 SYMBOL_LINK "Rte_CalprmRom_CalRegn01Cmn_DEFAULT_RTE_CALPRM_GROUP.DutyCycThermProtnDutyCycFildThd_Val" 0 DISPLAY_IDENTIFIER DutyCycThermProtn.CalibrationPorts.DutyCycThermProtnDutyCycFildThd.Val /end CHARACTERISTIC
/begin CHARACTERISTIC DutyCycThermProtn.DutyCycThermProtnIgnOffCtrlEna.Logl "MICROSAR RTE" VALUE 0x0 RTE_RL_BOOLEAN 0 RTE_CM_BOOLEAN 0 255 SYMBOL_LINK "Rte_CalprmRom_CalRegn01Cmn_DEFAULT_RTE_CALPRM_GROUP.DutyCycThermProtnIgnOffCtrlEna_Logl" 0 DISPLAY_IDENTIFIER DutyCycThermProtn.CalibrationPorts.DutyCycThermProtnIgnOffCtrlEna.Logl /end CHARACTERISTIC
/begin CHARACTERISTIC DutyCycThermProtn.DutyCycThermProtnIgnOffMsgWaitTi.Val "MICROSAR RTE" VALUE 0x0 RTE_RL_FLOAT32_IEEE 0 NO_COMPU_METHOD -3.402823466e+38 3.402823466e+38 SYMBOL_LINK "Rte_CalprmRom_CalRegn01Cmn_DEFAULT_RTE_CALPRM_GROUP.DutyCycThermProtnIgnOffMsgWaitTi_Val" 0 DISPLAY_IDENTIFIER DutyCycThermProtn.CalibrationPorts.DutyCycThermProtnIgnOffMsgWaitTi.Val /end CHARACTERISTIC
/begin CHARACTERISTIC DutyCycThermProtn.DutyCycThermProtnLstTblValNonStall.Ary1D "MICROSAR RTE" VAL_BLK 0x0 RTE_RL_UWORD 0 NO_COMPU_METHOD 0 65535 MATRIX_DIM 5 1 1 SYMBOL_LINK "Rte_CalprmRom_CalRegn01Cmn_DEFAULT_RTE_CALPRM_GROUP.DutyCycThermProtnLstTblValNonStall_Ary1D" 0 DISPLAY_IDENTIFIER DutyCycThermProtn.CalibrationPorts.DutyCycThermProtnLstTblValNonStall.Ary1D /end CHARACTERISTIC
/begin CHARACTERISTIC DutyCycThermProtn.DutyCycThermProtnLstTblValStall.Ary1D "MICROSAR RTE" VAL_BLK 0x0 RTE_RL_UWORD 0 NO_COMPU_METHOD 0 65535 MATRIX_DIM 5 1 1 SYMBOL_LINK "Rte_CalprmRom_CalRegn01Cmn_DEFAULT_RTE_CALPRM_GROUP.DutyCycThermProtnLstTblValStall_Ary1D" 0 DISPLAY_IDENTIFIER DutyCycThermProtn.CalibrationPorts.DutyCycThermProtnLstTblValStall.Ary1D /end CHARACTERISTIC
/begin CHARACTERISTIC DutyCycThermProtn.DutyCycThermProtnMotPrTSeln.Logl "MICROSAR RTE" VALUE 0x0 RTE_RL_BOOLEAN 0 RTE_CM_BOOLEAN 0 255 SYMBOL_LINK "Rte_CalprmRom_CalRegn01Cmn_DEFAULT_RTE_CALPRM_GROUP.DutyCycThermProtnMotPrTSeln_Logl" 0 DISPLAY_IDENTIFIER DutyCycThermProtn.CalibrationPorts.DutyCycThermProtnMotPrTSeln.Logl /end CHARACTERISTIC
/begin MEASUREMENT CustDiagc.EcuTFild.Val "MICROSAR RTE" FLOAT32_IEEE NO_COMPU_METHOD 0 0 -3.402823466e+38 3.402823466e+38 ECU_ADDRESS 0 SYMBOL_LINK "Rte_EcuTMeas_EcuTFild_Val" 0 DISPLAY_IDENTIFIER CustDiagc.ReceiverPorts.EcuTFild.Val /end MEASUREMENT
/begin MEASUREMENT CustDiagc.EngRunActv.Logl "MICROSAR RTE" UBYTE RTE_CM_BOOLEAN 0 0 0 255 ECU_ADDRESS 0 SYMBOL_LINK "Rte_GmMsg0C9BusHiSpd_EngRunActv_Logl" 0 DISPLAY_IDENTIFIER CustDiagc.ReceiverPorts.EngRunActv.Logl /end MEASUREMENT
/begin MEASUREMENT CustDiagc.EngSpd.Val "MICROSAR RTE" FLOAT32_IEEE NO_COMPU_METHOD 0 0 -3.402823466e+38 3.402823466e+38 ECU_ADDRESS 0 SYMBOL_LINK "Rte_GmMsg0C9BusHiSpd_EngSpd_Val" 0 DISPLAY_IDENTIFIER CustDiagc.ReceiverPorts.EngSpd.Val /end MEASUREMENT
/begin MEASUREMENT CustDiagc.GmDiCtrlPidTstRunng "MICROSAR RTE" UBYTE RTE_CM_BOOLEAN 0 0 0 255 ECU_ADDRESS 0 SYMBOL_LINK "Rte_CustDiagc_GmDiCtrlPidTstRunng" 0 DISPLAY_IDENTIFIER CustDiagc.PerInstanceMemories.GmDiCtrlPidTstRunng /end MEASUREMENT
/begin MEASUREMENT CustDiagc.GmFctDiSts.Val "MICROSAR RTE" UBYTE RTE_CM_ENUM_GmFctDiArbnSts1 0 0 0 255 ECU_ADDRESS 0 SYMBOL_LINK "Rte_GmFctDiArbn_GmFctDiSts_Val" 0 DISPLAY_IDENTIFIER CustDiagc.ReceiverPorts.GmFctDiSts.Val /end MEASUREMENT
/begin MEASUREMENT CustDiagc.GmIgnCntr "MICROSAR RTE" UWORD NO_COMPU_METHOD 0 0 0 65535 ECU_ADDRESS 0 SYMBOL_LINK "Rte_CustDiagc_GmIgnCntr" 0 DISPLAY_IDENTIFIER CustDiagc.PerInstanceMemories.GmIgnCntr /end MEASUREMENT
/begin MEASUREMENT CustDiagc.GmIgnCntr.Val "MICROSAR RTE" UWORD NO_COMPU_METHOD 0 0 0 65535 ECU_ADDRESS 0 SYMBOL_LINK "Rte_CustDiagc_GmIgnCntr_Val" 0 DISPLAY_IDENTIFIER CustDiagc.SenderPorts.GmIgnCntr.Val /end MEASUREMENT
/begin MEASUREMENT CustDiagc.HwAgCcwDetd.Logl "MICROSAR RTE" UBYTE RTE_CM_BOOLEAN 0 0 0 255 ECU_ADDRESS 0 SYMBOL_LINK "Rte_EotLrng_HwAgCcwDetd_Logl" 0 DISPLAY_IDENTIFIER CustDiagc.ReceiverPorts.HwAgCcwDetd.Logl /end MEASUREMENT
/begin MEASUREMENT CustDiagc.HwAgCwDetd.Logl "MICROSAR RTE" UBYTE RTE_CM_BOOLEAN 0 0 0 255 ECU_ADDRESS 0 SYMBOL_LINK "Rte_EotLrng_HwAgCwDetd_Logl" 0 DISPLAY_IDENTIFIER CustDiagc.ReceiverPorts.HwAgCwDetd.Logl /end MEASUREMENT
/begin MEASUREMENT CustDiagc.HwAgEotCcw.Val "MICROSAR RTE" FLOAT32_IEEE NO_COMPU_METHOD 0 0 -3.402823466e+38 3.402823466e+38 ECU_ADDRESS 0 SYMBOL_LINK "Rte_EotLrng_HwAgEotCcw_Val" 0 DISPLAY_IDENTIFIER CustDiagc.ReceiverPorts.HwAgEotCcw.Val /end MEASUREMENT
/begin MEASUREMENT CustDiagc.HwAgEotCw.Val "MICROSAR RTE" FLOAT32_IEEE NO_COMPU_METHOD 0 0 -3.402823466e+38 3.402823466e+38 ECU_ADDRESS 0 SYMBOL_LINK "Rte_EotLrng_HwAgEotCw_Val" 0 DISPLAY_IDENTIFIER CustDiagc.ReceiverPorts.HwAgEotCw.Val /end MEASUREMENT
/begin MEASUREMENT CustDiagc.HwAgTrimPrfmd.Logl "MICROSAR RTE" UBYTE RTE_CM_BOOLEAN 0 0 0 255 ECU_ADDRESS 0 SYMBOL_LINK "Rte_HwAgVehCentrTrim_HwAgTrimPrfmd_Logl" 0 DISPLAY_IDENTIFIER CustDiagc.ReceiverPorts.HwAgTrimPrfmd.Logl /end MEASUREMENT
/begin MEASUREMENT CustDiagc.HwTq.Val "MICROSAR RTE" FLOAT32_IEEE NO_COMPU_METHOD 0 0 -3.402823466e+38 3.402823466e+38 ECU_ADDRESS 0 SYMBOL_LINK "Rte_Swp_HwTqSwp_Val" 0 DISPLAY_IDENTIFIER CustDiagc.ReceiverPorts.HwTq.Val /end MEASUREMENT
/begin MEASUREMENT CustDiagc.HwTqIdptSig.Val "MICROSAR RTE" UBYTE NO_COMPU_METHOD 0 0 0 255 ECU_ADDRESS 0 SYMBOL_LINK "Rte_HwTqCorrln_HwTqIdptSig_Val" 0 DISPLAY_IDENTIFIER CustDiagc.ReceiverPorts.HwTqIdptSig.Val /end MEASUREMENT
/begin MEASUREMENT CustDiagc.LkaCmd.Val "MICROSAR RTE" FLOAT32_IEEE NO_COMPU_METHOD 0 0 -3.402823466e+38 3.402823466e+38 ECU_ADDRESS 0 SYMBOL_LINK "Rte_GmMsg180BusHiSpd_LkaCmd_Val" 0 DISPLAY_IDENTIFIER CustDiagc.ReceiverPorts.LkaCmd.Val /end MEASUREMENT
/begin MEASUREMENT CustDiagc.LkaSt.Val "MICROSAR RTE" UBYTE NO_COMPU_METHOD 0 0 0 255 ECU_ADDRESS 0 SYMBOL_LINK "Rte_GmOvrlStMgr_LkaSt_Val" 0 DISPLAY_IDENTIFIER CustDiagc.ReceiverPorts.LkaSt.Val /end MEASUREMENT
/begin MEASUREMENT CustDiagc.MissMsg0C9.Logl "MICROSAR RTE" UBYTE RTE_CM_BOOLEAN 0 0 0 255 ECU_ADDRESS 0 SYMBOL_LINK "Rte_GmMsg0C9BusHiSpd_MissMsg0C9_Logl" 0 DISPLAY_IDENTIFIER CustDiagc.ReceiverPorts.MissMsg0C9.Logl /end MEASUREMENT
/begin MEASUREMENT CustDiagc.MissMsg1F1.Logl "MICROSAR RTE" UBYTE RTE_CM_BOOLEAN 0 0 0 255 ECU_ADDRESS 0 SYMBOL_LINK "Rte_GmMsg1F1BusHiSpd_MissMsg1F1_Logl" 0 DISPLAY_IDENTIFIER CustDiagc.ReceiverPorts.MissMsg1F1.Logl /end MEASUREMENT
/begin MEASUREMENT CustDiagc.MotCurrDaxCmd.Val "MICROSAR RTE" FLOAT32_IEEE NO_COMPU_METHOD 0 0 -3.402823466e+38 3.402823466e+38 ECU_ADDRESS 0 SYMBOL_LINK "Rte_MotRefMdl_MotCurrDaxCmd_Val" 0 DISPLAY_IDENTIFIER CustDiagc.ReceiverPorts.MotCurrDaxCmd.Val /end MEASUREMENT
/begin MEASUREMENT CustDiagc.MotCurrPeakEstimd.Val "MICROSAR RTE" FLOAT32_IEEE NO_COMPU_METHOD 0 0 -3.402823466e+38 3.402823466e+38 ECU_ADDRESS 0 SYMBOL_LINK "Rte_MotCurrPeakEstimn_MotCurrPeakEstimd_Val" 0 DISPLAY_IDENTIFIER CustDiagc.ReceiverPorts.MotCurrPeakEstimd.Val /end MEASUREMENT
/begin MEASUREMENT CustDiagc.MotTqCmd.Val "MICROSAR RTE" FLOAT32_IEEE NO_COMPU_METHOD 0 0 -3.402823466e+38 3.402823466e+38 ECU_ADDRESS 0 SYMBOL_LINK "Rte_AssiSumLim_MotTqCmd_Val" 0 DISPLAY_IDENTIFIER CustDiagc.ReceiverPorts.MotTqCmd.Val /end MEASUREMENT
/begin MEASUREMENT CustDiagc.MsgCntxt "MICROSAR RTE" ULONG NO_COMPU_METHOD 0 0 0 4294967295 ECU_ADDRESS 0 SYMBOL_LINK "Rte_CustDiagc_MsgCntxt" 0 DISPLAY_IDENTIFIER CustDiagc.PerInstanceMemories.MsgCntxt /end MEASUREMENT
/begin MEASUREMENT CustDiagc.PinionAg.Val "MICROSAR RTE" FLOAT32_IEEE NO_COMPU_METHOD 0 0 -3.402823466e+38 3.402823466e+38 ECU_ADDRESS 0 SYMBOL_LINK "Rte_HwAgSysArbn_PinionAg_Val" 0 DISPLAY_IDENTIFIER CustDiagc.ReceiverPorts.PinionAg.Val /end MEASUREMENT
/begin MEASUREMENT CustDiagc.PinionAgConf.Val "MICROSAR RTE" FLOAT32_IEEE NO_COMPU_METHOD 0 0 -3.402823466e+38 3.402823466e+38 ECU_ADDRESS 0 SYMBOL_LINK "Rte_HwAgSysArbn_PinionAgConf_Val" 0 DISPLAY_IDENTIFIER CustDiagc.ReceiverPorts.PinionAgConf.Val /end MEASUREMENT
/begin MEASUREMENT CustDiagc.PrevGmFctDiArbnSts "MICROSAR RTE" UBYTE RTE_CM_ENUM_GmFctDiArbnSts1 0 0 0 255 ECU_ADDRESS 0 SYMBOL_LINK "Rte_CustDiagc_PrevGmFctDiArbnSts" 0 DISPLAY_IDENTIFIER CustDiagc.PerInstanceMemories.PrevGmFctDiArbnSts /end MEASUREMENT
/begin MEASUREMENT CustDiagc.PrevSysPwrModRun "MICROSAR RTE" UBYTE RTE_CM_BOOLEAN 0 0 0 255 ECU_ADDRESS 0 SYMBOL_LINK "Rte_CustDiagc_PrevSysPwrModRun" 0 DISPLAY_IDENTIFIER CustDiagc.PerInstanceMemories.PrevSysPwrModRun /end MEASUREMENT
/begin MEASUREMENT CustDiagc.SerlComDi.Logl "MICROSAR RTE" UBYTE RTE_CM_BOOLEAN 0 0 0 255 ECU_ADDRESS 0 SYMBOL_LINK "Rte_CustDiagc_SerlComDi_Logl" 0 DISPLAY_IDENTIFIER CustDiagc.SenderPorts.SerlComDi.Logl /end MEASUREMENT
/begin MEASUREMENT CustDiagc.Srv12LoopCntr "MICROSAR RTE" UBYTE NO_COMPU_METHOD 0 0 0 255 ECU_ADDRESS 0 SYMBOL_LINK "Rte_CustDiagc_Srv12LoopCntr" 0 DISPLAY_IDENTIFIER CustDiagc.PerInstanceMemories.Srv12LoopCntr /end MEASUREMENT
/begin MEASUREMENT CustDiagc.SrvCntxt "MICROSAR RTE" UBYTE NO_COMPU_METHOD 0 0 0 255 ECU_ADDRESS 0 SYMBOL_LINK "Rte_CustDiagc_SrvCntxt" 0 DISPLAY_IDENTIFIER CustDiagc.PerInstanceMemories.SrvCntxt /end MEASUREMENT
/begin MEASUREMENT CustDiagc.SteerWhlAgReqTarAg.Val "MICROSAR RTE" FLOAT32_IEEE NO_COMPU_METHOD 0 0 -3.402823466e+38 3.402823466e+38 ECU_ADDRESS 0 SYMBOL_LINK "Rte_GmMsg337BusChassisExp_SteerWhlAgReqTarAg_Val" 0 DISPLAY_IDENTIFIER CustDiagc.ReceiverPorts.SteerWhlAgReqTarAg.Val /end MEASUREMENT
/begin MEASUREMENT CustDiagc.StrtStopSt.Val "MICROSAR RTE" UBYTE NO_COMPU_METHOD 0 0 0 255 ECU_ADDRESS 0 SYMBOL_LINK "Rte_GmStrtStop_VehStrtStopSt_Val" 0 DISPLAY_IDENTIFIER CustDiagc.ReceiverPorts.StrtStopSt.Val /end MEASUREMENT
/begin MEASUREMENT CustDiagc.SysSt.Val "MICROSAR RTE" UBYTE RTE_CM_ENUM_SysSt1 0 0 0 255 ECU_ADDRESS 0 SYMBOL_LINK "Rte_SysStMod_SysSt_Val" 0 DISPLAY_IDENTIFIER CustDiagc.ReceiverPorts.SysSt.Val /end MEASUREMENT
/begin MEASUREMENT CustDiagc.SysStReqEnaOvrdCombd.Logl "MICROSAR RTE" UBYTE RTE_CM_BOOLEAN 0 0 0 255 ECU_ADDRESS 0 SYMBOL_LINK "Rte_CustDiagc_SysStReqEnaOvrdCombd_Logl" 0 DISPLAY_IDENTIFIER CustDiagc.SenderPorts.SysStReqEnaOvrdCombd.Logl /end MEASUREMENT
/begin MEASUREMENT CustDiagc.SysStReqEnaOvrdCust "MICROSAR RTE" UBYTE RTE_CM_BOOLEAN 0 0 0 255 ECU_ADDRESS 0 SYMBOL_LINK "Rte_CustDiagc_SysStReqEnaOvrdCust" 0 DISPLAY_IDENTIFIER CustDiagc.PerInstanceMemories.SysStReqEnaOvrdCust /end MEASUREMENT
/begin MEASUREMENT CustDiagc.SysStReqEnaOvrdNxtr.Logl "MICROSAR RTE" UBYTE RTE_CM_BOOLEAN 0 0 0 255 ECU_ADDRESS 0 SYMBOL_LINK "Rte_CmnMfgSrv_SysStReqEnaOvrd_Logl" 0 DISPLAY_IDENTIFIER CustDiagc.ReceiverPorts.SysStReqEnaOvrdNxtr.Logl /end MEASUREMENT
/begin MEASUREMENT CustDiagc.ThermLimFlgCntr.Val "MICROSAR RTE" UBYTE NO_COMPU_METHOD 0 0 0 255 ECU_ADDRESS 0 SYMBOL_LINK "Rte_CustDiagc_ThermLimFlgCntr_Val" 0 DISPLAY_IDENTIFIER CustDiagc.ReceiverPorts.ThermLimFlgCntr.Val /end MEASUREMENT
/begin MEASUREMENT CustDiagc.VehSpd.Val "MICROSAR RTE" FLOAT32_IEEE NO_COMPU_METHOD 0 0 -3.402823466e+38 3.402823466e+38 ECU_ADDRESS 0 SYMBOL_LINK "Rte_VehSigCdng_VehSpd_Val" 0 DISPLAY_IDENTIFIER CustDiagc.ReceiverPorts.VehSpd.Val /end MEASUREMENT
/begin MEASUREMENT CustDiagc.VehSpdVld.Logl "MICROSAR RTE" UBYTE RTE_CM_BOOLEAN 0 0 0 255 ECU_ADDRESS 0 SYMBOL_LINK "Rte_VehSigCdng_VehSpdVld_Logl" 0 DISPLAY_IDENTIFIER CustDiagc.ReceiverPorts.VehSpdVld.Logl /end MEASUREMENT
/begin MEASUREMENT CustDiagc.VltgRng.Val "MICROSAR RTE" UBYTE NO_COMPU_METHOD 0 0 0 255 ECU_ADDRESS 0 SYMBOL_LINK "Rte_StHlthSigNormn_VltgRng_Val" 0 DISPLAY_IDENTIFIER CustDiagc.ReceiverPorts.VltgRng.Val /end MEASUREMENT
/begin MEASUREMENT Dampg.AssiCmdBas.Val "MICROSAR RTE" FLOAT32_IEEE NO_COMPU_METHOD 0 0 -8.8 8.8 ECU_ADDRESS 0 SYMBOL_LINK "Rte_Assi_AssiCmdBas_Val" 0 DISPLAY_IDENTIFIER Dampg.ReceiverPorts.AssiCmdBas.Val /end MEASUREMENT
/begin MEASUREMENT Dampg.AssiMechT.Val "MICROSAR RTE" FLOAT32_IEEE NO_COMPU_METHOD 0 0 -50.0 150.0 ECU_ADDRESS 0 SYMBOL_LINK "Rte_TEstimn_AssiMechT_Val" 0 DISPLAY_IDENTIFIER Dampg.ReceiverPorts.AssiMechT.Val /end MEASUREMENT
/begin MEASUREMENT Dampg.DampgCmdBas.Val "MICROSAR RTE" FLOAT32_IEEE NO_COMPU_METHOD 0 0 -8.8 8.8 ECU_ADDRESS 0 SYMBOL_LINK "Rte_Dampg_DampgCmdBas_Val" 0 DISPLAY_IDENTIFIER Dampg.SenderPorts.DampgCmdBas.Val /end MEASUREMENT
/begin MEASUREMENT Dampg.DampgCmdBasDi.Logl "MICROSAR RTE" UBYTE RTE_CM_BOOLEAN 0 0 0 255 ECU_ADDRESS 0 SYMBOL_LINK "Rte_CmnMfgSrv_DampgCmdBasDi_Logl" 0 DISPLAY_IDENTIFIER Dampg.ReceiverPorts.DampgCmdBasDi.Logl /end MEASUREMENT
/begin MEASUREMENT Dampg.DampgCmdOvrl.Val "MICROSAR RTE" FLOAT32_IEEE NO_COMPU_METHOD 0 0 -8.8 8.8 ECU_ADDRESS 0 SYMBOL_LINK "Rte_Dampg_DampgCmdOvrl_Val" 0 DISPLAY_IDENTIFIER Dampg.ReceiverPorts.DampgCmdOvrl.Val /end MEASUREMENT
/begin MEASUREMENT Dampg.DampgCmdSca.Val "MICROSAR RTE" FLOAT32_IEEE NO_COMPU_METHOD 0 0 0.0 1.0 ECU_ADDRESS 0 SYMBOL_LINK "Rte_GmTqArbn_DampgCmdSca_Val" 0 DISPLAY_IDENTIFIER Dampg.ReceiverPorts.DampgCmdSca.Val /end MEASUREMENT
/begin MEASUREMENT Dampg.HwTq.Val "MICROSAR RTE" FLOAT32_IEEE NO_COMPU_METHOD 0 0 -10.0 10.0 ECU_ADDRESS 0 SYMBOL_LINK "Rte_Swp_HwTqSwp_Val" 0 DISPLAY_IDENTIFIER Dampg.ReceiverPorts.HwTq.Val /end MEASUREMENT
/begin MEASUREMENT Dampg.MotVelCrf.Val "MICROSAR RTE" FLOAT32_IEEE NO_COMPU_METHOD 0 0 -1350 1350.0 ECU_ADDRESS 0 SYMBOL_LINK "Rte_CDD_MotVel_MotVelCrf_Val" 0 DISPLAY_IDENTIFIER Dampg.ReceiverPorts.MotVelCrf.Val /end MEASUREMENT
/begin MEASUREMENT Dampg.MotVelDampgLpFil.FilGain "MICROSAR RTE" FLOAT32_IEEE NO_COMPU_METHOD 0 0 -3.402823466e+38 3.402823466e+38 ECU_ADDRESS 0 SYMBOL_LINK "Rte_Dampg_MotVelDampgLpFil.FilGain" 0 DISPLAY_IDENTIFIER Dampg.PerInstanceMemories.MotVelDampgLpFil.FilGain /end MEASUREMENT
/begin MEASUREMENT Dampg.MotVelDampgLpFil.FilSt "MICROSAR RTE" FLOAT32_IEEE NO_COMPU_METHOD 0 0 -3.402823466e+38 3.402823466e+38 ECU_ADDRESS 0 SYMBOL_LINK "Rte_Dampg_MotVelDampgLpFil.FilSt" 0 DISPLAY_IDENTIFIER Dampg.PerInstanceMemories.MotVelDampgLpFil.FilSt /end MEASUREMENT
/begin MEASUREMENT Dampg.PrevHwTqBacklshOutp "MICROSAR RTE" FLOAT32_IEEE NO_COMPU_METHOD 0 0 0.0 10.0 ECU_ADDRESS 0 SYMBOL_LINK "Rte_Dampg_PrevHwTqBacklshOutp" 0 DISPLAY_IDENTIFIER Dampg.PerInstanceMemories.PrevHwTqBacklshOutp /end MEASUREMENT
/begin MEASUREMENT Dampg.PrevHydOutpLim "MICROSAR RTE" FLOAT32_IEEE NO_COMPU_METHOD 0 0 -8.8 8.8 ECU_ADDRESS 0 SYMBOL_LINK "Rte_Dampg_PrevHydOutpLim" 0 DISPLAY_IDENTIFIER Dampg.PerInstanceMemories.PrevHydOutpLim /end MEASUREMENT
/begin MEASUREMENT Dampg.PrevMotVelBacklshOutp "MICROSAR RTE" FLOAT32_IEEE NO_COMPU_METHOD 0 0 0 128 ECU_ADDRESS 0 SYMBOL_LINK "Rte_Dampg_PrevMotVelBacklshOutp" 0 DISPLAY_IDENTIFIER Dampg.PerInstanceMemories.PrevMotVelBacklshOutp /end MEASUREMENT
/begin MEASUREMENT Dampg.QuadDampgHwTqLpFil.FilGain "MICROSAR RTE" FLOAT32_IEEE NO_COMPU_METHOD 0 0 -3.402823466e+38 3.402823466e+38 ECU_ADDRESS 0 SYMBOL_LINK "Rte_Dampg_QuadDampgHwTqLpFil.FilGain" 0 DISPLAY_IDENTIFIER Dampg.PerInstanceMemories.QuadDampgHwTqLpFil.FilGain /end MEASUREMENT
/begin MEASUREMENT Dampg.QuadDampgHwTqLpFil.FilSt "MICROSAR RTE" FLOAT32_IEEE NO_COMPU_METHOD 0 0 -3.402823466e+38 3.402823466e+38 ECU_ADDRESS 0 SYMBOL_LINK "Rte_Dampg_QuadDampgHwTqLpFil.FilSt" 0 DISPLAY_IDENTIFIER Dampg.PerInstanceMemories.QuadDampgHwTqLpFil.FilSt /end MEASUREMENT
/begin MEASUREMENT Dampg.QuadDampgMotVelLpFil.FilGain "MICROSAR RTE" FLOAT32_IEEE NO_COMPU_METHOD 0 0 -3.402823466e+38 3.402823466e+38 ECU_ADDRESS 0 SYMBOL_LINK "Rte_Dampg_QuadDampgMotVelLpFil.FilGain" 0 DISPLAY_IDENTIFIER Dampg.PerInstanceMemories.QuadDampgMotVelLpFil.FilGain /end MEASUREMENT
/begin MEASUREMENT Dampg.QuadDampgMotVelLpFil.FilSt "MICROSAR RTE" FLOAT32_IEEE NO_COMPU_METHOD 0 0 -3.402823466e+38 3.402823466e+38 ECU_ADDRESS 0 SYMBOL_LINK "Rte_Dampg_QuadDampgMotVelLpFil.FilSt" 0 DISPLAY_IDENTIFIER Dampg.PerInstanceMemories.QuadDampgMotVelLpFil.FilSt /end MEASUREMENT
/begin MEASUREMENT Dampg.QuadDampgScaLpFil.FilGain "MICROSAR RTE" FLOAT32_IEEE NO_COMPU_METHOD 0 0 -3.402823466e+38 3.402823466e+38 ECU_ADDRESS 0 SYMBOL_LINK "Rte_Dampg_QuadDampgScaLpFil.FilGain" 0 DISPLAY_IDENTIFIER Dampg.PerInstanceMemories.QuadDampgScaLpFil.FilGain /end MEASUREMENT
/begin MEASUREMENT Dampg.QuadDampgScaLpFil.FilSt "MICROSAR RTE" FLOAT32_IEEE NO_COMPU_METHOD 0 0 -3.402823466e+38 3.402823466e+38 ECU_ADDRESS 0 SYMBOL_LINK "Rte_Dampg_QuadDampgScaLpFil.FilSt" 0 DISPLAY_IDENTIFIER Dampg.PerInstanceMemories.QuadDampgScaLpFil.FilSt /end MEASUREMENT
/begin MEASUREMENT Dampg.VehSpd.Val "MICROSAR RTE" FLOAT32_IEEE NO_COMPU_METHOD 0 0 0.0 511.0 ECU_ADDRESS 0 SYMBOL_LINK "Rte_VehSigCdng_VehSpd_Val" 0 DISPLAY_IDENTIFIER Dampg.ReceiverPorts.VehSpd.Val /end MEASUREMENT
/begin MEASUREMENT Dampg.dDampgAssiMechTSca "MICROSAR RTE" FLOAT32_IEEE NO_COMPU_METHOD 0 0 0.0 10.0 ECU_ADDRESS 0 SYMBOL_LINK "Rte_Dampg_dDampgAssiMechTSca" 0 DISPLAY_IDENTIFIER Dampg.PerInstanceMemories.dDampgAssiMechTSca /end MEASUREMENT
/begin MEASUREMENT Dampg.dDampgCoeff1Term "MICROSAR RTE" FLOAT32_IEEE NO_COMPU_METHOD 0 0 0.0 10.0 ECU_ADDRESS 0 SYMBOL_LINK "Rte_Dampg_dDampgCoeff1Term" 0 DISPLAY_IDENTIFIER Dampg.PerInstanceMemories.dDampgCoeff1Term /end MEASUREMENT
/begin MEASUREMENT Dampg.dDampgCoeff2Term "MICROSAR RTE" FLOAT32_IEEE NO_COMPU_METHOD 0 0 0.0 10.0 ECU_ADDRESS 0 SYMBOL_LINK "Rte_Dampg_dDampgCoeff2Term" 0 DISPLAY_IDENTIFIER Dampg.PerInstanceMemories.dDampgCoeff2Term /end MEASUREMENT
/begin MEASUREMENT Dampg.dDampgCoeff3Term "MICROSAR RTE" FLOAT32_IEEE NO_COMPU_METHOD 0 0 0.0 10.0 ECU_ADDRESS 0 SYMBOL_LINK "Rte_Dampg_dDampgCoeff3Term" 0 DISPLAY_IDENTIFIER Dampg.PerInstanceMemories.dDampgCoeff3Term /end MEASUREMENT
/begin MEASUREMENT Dampg.dDampgCoeff4Term "MICROSAR RTE" FLOAT32_IEEE NO_COMPU_METHOD 0 0 0.0 10.0 ECU_ADDRESS 0 SYMBOL_LINK "Rte_Dampg_dDampgCoeff4Term" 0 DISPLAY_IDENTIFIER Dampg.PerInstanceMemories.dDampgCoeff4Term /end MEASUREMENT
/begin MEASUREMENT Dampg.dDampgHwTqSca "MICROSAR RTE" FLOAT32_IEEE NO_COMPU_METHOD 0 0 0.0 1.0 ECU_ADDRESS 0 SYMBOL_LINK "Rte_Dampg_dDampgHwTqSca" 0 DISPLAY_IDENTIFIER Dampg.PerInstanceMemories.dDampgHwTqSca /end MEASUREMENT
/begin MEASUREMENT Dampg.dDampgMotVelDampgCmd "MICROSAR RTE" FLOAT32_IEEE NO_COMPU_METHOD 0 0 -8.8 8.8 ECU_ADDRESS 0 SYMBOL_LINK "Rte_Dampg_dDampgMotVelDampgCmd" 0 DISPLAY_IDENTIFIER Dampg.PerInstanceMemories.dDampgMotVelDampgCmd /end MEASUREMENT
/begin MEASUREMENT Dampg.dDampgQuadHwTqBacklsh "MICROSAR RTE" FLOAT32_IEEE NO_COMPU_METHOD 0 0 0.0 10.0 ECU_ADDRESS 0 SYMBOL_LINK "Rte_Dampg_dDampgQuadHwTqBacklsh" 0 DISPLAY_IDENTIFIER Dampg.PerInstanceMemories.dDampgQuadHwTqBacklsh /end MEASUREMENT
/begin MEASUREMENT Dampg.dDampgQuadMotVelBacklsh "MICROSAR RTE" FLOAT32_IEEE NO_COMPU_METHOD 0 0 0 128 ECU_ADDRESS 0 SYMBOL_LINK "Rte_Dampg_dDampgQuadMotVelBacklsh" 0 DISPLAY_IDENTIFIER Dampg.PerInstanceMemories.dDampgQuadMotVelBacklsh /end MEASUREMENT
/begin MEASUREMENT DampgPahFwl.AssiPahLimrActv.Val "MICROSAR RTE" FLOAT32_IEEE NO_COMPU_METHOD 0 0 -3.402823466e+38 3.402823466e+38 ECU_ADDRESS 0 SYMBOL_LINK "Rte_AssiPahFwl_AssiPahLimrActv_Val" 0 DISPLAY_IDENTIFIER DampgPahFwl.ReceiverPorts.AssiPahLimrActv.Val /end MEASUREMENT
/begin MEASUREMENT DampgPahFwl.DampgCmd.Val "MICROSAR RTE" FLOAT32_IEEE NO_COMPU_METHOD 0 0 -3.402823466e+38 3.402823466e+38 ECU_ADDRESS 0 SYMBOL_LINK "Rte_DampgPahFwl_DampgCmd_Val" 0 DISPLAY_IDENTIFIER DampgPahFwl.SenderPorts.DampgCmd.Val /end MEASUREMENT
/begin MEASUREMENT DampgPahFwl.DampgCmdBas.Val "MICROSAR RTE" FLOAT32_IEEE NO_COMPU_METHOD 0 0 -3.402823466e+38 3.402823466e+38 ECU_ADDRESS 0 SYMBOL_LINK "Rte_Dampg_DampgCmdBas_Val" 0 DISPLAY_IDENTIFIER DampgPahFwl.ReceiverPorts.DampgCmdBas.Val /end MEASUREMENT
/begin MEASUREMENT DampgPahFwl.DampgCmdBasDi.Logl "MICROSAR RTE" UBYTE RTE_CM_BOOLEAN 0 0 0 255 ECU_ADDRESS 0 SYMBOL_LINK "Rte_CmnMfgSrv_DampgCmdBasDi_Logl" 0 DISPLAY_IDENTIFIER DampgPahFwl.ReceiverPorts.DampgCmdBasDi.Logl /end MEASUREMENT
/begin MEASUREMENT DampgPahFwl.DampgCmdLpFilLowrLim.FilGain "MICROSAR RTE" FLOAT32_IEEE NO_COMPU_METHOD 0 0 -3.402823466e+38 3.402823466e+38 ECU_ADDRESS 0 SYMBOL_LINK "Rte_DampgPahFwl_DampgCmdLpFilLowrLim.FilGain" 0 DISPLAY_IDENTIFIER DampgPahFwl.PerInstanceMemories.DampgCmdLpFilLowrLim.FilGain /end MEASUREMENT
/begin MEASUREMENT DampgPahFwl.DampgCmdLpFilLowrLim.FilSt "MICROSAR RTE" FLOAT32_IEEE NO_COMPU_METHOD 0 0 -3.402823466e+38 3.402823466e+38 ECU_ADDRESS 0 SYMBOL_LINK "Rte_DampgPahFwl_DampgCmdLpFilLowrLim.FilSt" 0 DISPLAY_IDENTIFIER DampgPahFwl.PerInstanceMemories.DampgCmdLpFilLowrLim.FilSt /end MEASUREMENT
/begin MEASUREMENT DampgPahFwl.DampgCmdLpFilUpprLim.FilGain "MICROSAR RTE" FLOAT32_IEEE NO_COMPU_METHOD 0 0 -3.402823466e+38 3.402823466e+38 ECU_ADDRESS 0 SYMBOL_LINK "Rte_DampgPahFwl_DampgCmdLpFilUpprLim.FilGain" 0 DISPLAY_IDENTIFIER DampgPahFwl.PerInstanceMemories.DampgCmdLpFilUpprLim.FilGain /end MEASUREMENT
/begin MEASUREMENT DampgPahFwl.DampgCmdLpFilUpprLim.FilSt "MICROSAR RTE" FLOAT32_IEEE NO_COMPU_METHOD 0 0 -3.402823466e+38 3.402823466e+38 ECU_ADDRESS 0 SYMBOL_LINK "Rte_DampgPahFwl_DampgCmdLpFilUpprLim.FilSt" 0 DISPLAY_IDENTIFIER DampgPahFwl.PerInstanceMemories.DampgCmdLpFilUpprLim.FilSt /end MEASUREMENT
/begin MEASUREMENT DampgPahFwl.DampgDecPrfmncPrev "MICROSAR RTE" UBYTE RTE_CM_BOOLEAN 0 0 0 255 ECU_ADDRESS 0 SYMBOL_LINK "Rte_DampgPahFwl_DampgDecPrfmncPrev" 0 DISPLAY_IDENTIFIER DampgPahFwl.PerInstanceMemories.DampgDecPrfmncPrev /end MEASUREMENT
/begin MEASUREMENT DampgPahFwl.FwlActvLpFil.FilGain "MICROSAR RTE" FLOAT32_IEEE NO_COMPU_METHOD 0 0 -3.402823466e+38 3.402823466e+38 ECU_ADDRESS 0 SYMBOL_LINK "Rte_DampgPahFwl_FwlActvLpFil.FilGain" 0 DISPLAY_IDENTIFIER DampgPahFwl.PerInstanceMemories.FwlActvLpFil.FilGain /end MEASUREMENT
/begin MEASUREMENT DampgPahFwl.FwlActvLpFil.FilSt "MICROSAR RTE" FLOAT32_IEEE NO_COMPU_METHOD 0 0 -3.402823466e+38 3.402823466e+38 ECU_ADDRESS 0 SYMBOL_LINK "Rte_DampgPahFwl_FwlActvLpFil.FilSt" 0 DISPLAY_IDENTIFIER DampgPahFwl.PerInstanceMemories.FwlActvLpFil.FilSt /end MEASUREMENT
/begin MEASUREMENT DampgPahFwl.InertiaCmpLpFil.FilGain "MICROSAR RTE" FLOAT32_IEEE NO_COMPU_METHOD 0 0 -3.402823466e+38 3.402823466e+38 ECU_ADDRESS 0 SYMBOL_LINK "Rte_DampgPahFwl_InertiaCmpLpFil.FilGain" 0 DISPLAY_IDENTIFIER DampgPahFwl.PerInstanceMemories.InertiaCmpLpFil.FilGain /end MEASUREMENT
/begin MEASUREMENT DampgPahFwl.InertiaCmpLpFil.FilSt "MICROSAR RTE" FLOAT32_IEEE NO_COMPU_METHOD 0 0 -3.402823466e+38 3.402823466e+38 ECU_ADDRESS 0 SYMBOL_LINK "Rte_DampgPahFwl_InertiaCmpLpFil.FilSt" 0 DISPLAY_IDENTIFIER DampgPahFwl.PerInstanceMemories.InertiaCmpLpFil.FilSt /end MEASUREMENT
/begin MEASUREMENT DampgPahFwl.InertiaCmpLpFilLowrLim.FilGain "MICROSAR RTE" FLOAT32_IEEE NO_COMPU_METHOD 0 0 -3.402823466e+38 3.402823466e+38 ECU_ADDRESS 0 SYMBOL_LINK "Rte_DampgPahFwl_InertiaCmpLpFilLowrLim.FilGain" 0 DISPLAY_IDENTIFIER DampgPahFwl.PerInstanceMemories.InertiaCmpLpFilLowrLim.FilGain /end MEASUREMENT
/begin MEASUREMENT DampgPahFwl.InertiaCmpLpFilLowrLim.FilSt "MICROSAR RTE" FLOAT32_IEEE NO_COMPU_METHOD 0 0 -3.402823466e+38 3.402823466e+38 ECU_ADDRESS 0 SYMBOL_LINK "Rte_DampgPahFwl_InertiaCmpLpFilLowrLim.FilSt" 0 DISPLAY_IDENTIFIER DampgPahFwl.PerInstanceMemories.InertiaCmpLpFilLowrLim.FilSt /end MEASUREMENT
/begin MEASUREMENT DampgPahFwl.InertiaCmpLpFilUpprLim.FilGain "MICROSAR RTE" FLOAT32_IEEE NO_COMPU_METHOD 0 0 -3.402823466e+38 3.402823466e+38 ECU_ADDRESS 0 SYMBOL_LINK "Rte_DampgPahFwl_InertiaCmpLpFilUpprLim.FilGain" 0 DISPLAY_IDENTIFIER DampgPahFwl.PerInstanceMemories.InertiaCmpLpFilUpprLim.FilGain /end MEASUREMENT
/begin MEASUREMENT DampgPahFwl.InertiaCmpLpFilUpprLim.FilSt "MICROSAR RTE" FLOAT32_IEEE NO_COMPU_METHOD 0 0 -3.402823466e+38 3.402823466e+38 ECU_ADDRESS 0 SYMBOL_LINK "Rte_DampgPahFwl_InertiaCmpLpFilUpprLim.FilSt" 0 DISPLAY_IDENTIFIER DampgPahFwl.PerInstanceMemories.InertiaCmpLpFilUpprLim.FilSt /end MEASUREMENT
/begin MEASUREMENT DampgPahFwl.InertiaCmpVelCmd.Val "MICROSAR RTE" FLOAT32_IEEE NO_COMPU_METHOD 0 0 -3.402823466e+38 3.402823466e+38 ECU_ADDRESS 0 SYMBOL_LINK "Rte_InertiaCmpVel_InertiaCmpVelCmd_Val" 0 DISPLAY_IDENTIFIER DampgPahFwl.ReceiverPorts.InertiaCmpVelCmd.Val /end MEASUREMENT
/begin MEASUREMENT DampgPahFwl.MotVelCrf.Val "MICROSAR RTE" FLOAT32_IEEE NO_COMPU_METHOD 0 0 -3.402823466e+38 3.402823466e+38 ECU_ADDRESS 0 SYMBOL_LINK "Rte_CDD_MotVel_MotVelCrf_Val" 0 DISPLAY_IDENTIFIER DampgPahFwl.ReceiverPorts.MotVelCrf.Val /end MEASUREMENT
/begin MEASUREMENT DampgPahFwl.VehSpd.Val "MICROSAR RTE" FLOAT32_IEEE NO_COMPU_METHOD 0 0 -3.402823466e+38 3.402823466e+38 ECU_ADDRESS 0 SYMBOL_LINK "Rte_VehSigCdng_VehSpd_Val" 0 DISPLAY_IDENTIFIER DampgPahFwl.ReceiverPorts.VehSpd.Val /end MEASUREMENT
/begin MEASUREMENT DampgPahFwl.dDampgPahFwlActvRaw "MICROSAR RTE" FLOAT32_IEEE NO_COMPU_METHOD 0 0 -3.402823466e+38 3.402823466e+38 ECU_ADDRESS 0 SYMBOL_LINK "Rte_DampgPahFwl_dDampgPahFwlActvRaw" 0 DISPLAY_IDENTIFIER DampgPahFwl.PerInstanceMemories.dDampgPahFwlActvRaw /end MEASUREMENT
/begin MEASUREMENT DampgPahFwl.dDampgPahFwlAddDampg "MICROSAR RTE" FLOAT32_IEEE NO_COMPU_METHOD 0 0 -3.402823466e+38 3.402823466e+38 ECU_ADDRESS 0 SYMBOL_LINK "Rte_DampgPahFwl_dDampgPahFwlAddDampg" 0 DISPLAY_IDENTIFIER DampgPahFwl.PerInstanceMemories.dDampgPahFwlAddDampg /end MEASUREMENT
/begin MEASUREMENT DampgPahFwl.dDampgPahFwlDampgCmdLimd "MICROSAR RTE" FLOAT32_IEEE NO_COMPU_METHOD 0 0 -3.402823466e+38 3.402823466e+38 ECU_ADDRESS 0 SYMBOL_LINK "Rte_DampgPahFwl_dDampgPahFwlDampgCmdLimd" 0 DISPLAY_IDENTIFIER DampgPahFwl.PerInstanceMemories.dDampgPahFwlDampgCmdLimd /end MEASUREMENT
/begin MEASUREMENT DampgPahFwl.dDampgPahFwlDampgCmdLowrLimFild "MICROSAR RTE" FLOAT32_IEEE NO_COMPU_METHOD 0 0 -3.402823466e+38 3.402823466e+38 ECU_ADDRESS 0 SYMBOL_LINK "Rte_DampgPahFwl_dDampgPahFwlDampgCmdLowrLimFild" 0 DISPLAY_IDENTIFIER DampgPahFwl.PerInstanceMemories.dDampgPahFwlDampgCmdLowrLimFild /end MEASUREMENT
/begin MEASUREMENT DampgPahFwl.dDampgPahFwlDampgCmdOverLim "MICROSAR RTE" UBYTE RTE_CM_BOOLEAN 0 0 0 255 ECU_ADDRESS 0 SYMBOL_LINK "Rte_DampgPahFwl_dDampgPahFwlDampgCmdOverLim" 0 DISPLAY_IDENTIFIER DampgPahFwl.PerInstanceMemories.dDampgPahFwlDampgCmdOverLim /end MEASUREMENT
/begin MEASUREMENT DampgPahFwl.dDampgPahFwlDampgCmdUpprLimFild "MICROSAR RTE" FLOAT32_IEEE NO_COMPU_METHOD 0 0 -3.402823466e+38 3.402823466e+38 ECU_ADDRESS 0 SYMBOL_LINK "Rte_DampgPahFwl_dDampgPahFwlDampgCmdUpprLimFild" 0 DISPLAY_IDENTIFIER DampgPahFwl.PerInstanceMemories.dDampgPahFwlDampgCmdUpprLimFild /end MEASUREMENT
/begin MEASUREMENT DampgPahFwl.dDampgPahFwlInertiaCmpHpPah "MICROSAR RTE" FLOAT32_IEEE NO_COMPU_METHOD 0 0 -3.402823466e+38 3.402823466e+38 ECU_ADDRESS 0 SYMBOL_LINK "Rte_DampgPahFwl_dDampgPahFwlInertiaCmpHpPah" 0 DISPLAY_IDENTIFIER DampgPahFwl.PerInstanceMemories.dDampgPahFwlInertiaCmpHpPah /end MEASUREMENT
/begin MEASUREMENT DampgPahFwl.dDampgPahFwlInertiaCmpLowrLimFild "MICROSAR RTE" FLOAT32_IEEE NO_COMPU_METHOD 0 0 -3.402823466e+38 3.402823466e+38 ECU_ADDRESS 0 SYMBOL_LINK "Rte_DampgPahFwl_dDampgPahFwlInertiaCmpLowrLimFild" 0 DISPLAY_IDENTIFIER DampgPahFwl.PerInstanceMemories.dDampgPahFwlInertiaCmpLowrLimFild /end MEASUREMENT
/begin MEASUREMENT DampgPahFwl.dDampgPahFwlInertiaCmpLpLimd "MICROSAR RTE" FLOAT32_IEEE NO_COMPU_METHOD 0 0 -3.402823466e+38 3.402823466e+38 ECU_ADDRESS 0 SYMBOL_LINK "Rte_DampgPahFwl_dDampgPahFwlInertiaCmpLpLimd" 0 DISPLAY_IDENTIFIER DampgPahFwl.PerInstanceMemories.dDampgPahFwlInertiaCmpLpLimd /end MEASUREMENT
/begin MEASUREMENT DampgPahFwl.dDampgPahFwlInertiaCmpLpPah "MICROSAR RTE" FLOAT32_IEEE NO_COMPU_METHOD 0 0 -3.402823466e+38 3.402823466e+38 ECU_ADDRESS 0 SYMBOL_LINK "Rte_DampgPahFwl_dDampgPahFwlInertiaCmpLpPah" 0 DISPLAY_IDENTIFIER DampgPahFwl.PerInstanceMemories.dDampgPahFwlInertiaCmpLpPah /end MEASUREMENT
/begin MEASUREMENT DampgPahFwl.dDampgPahFwlInertiaCmpOverLim "MICROSAR RTE" UBYTE RTE_CM_BOOLEAN 0 0 0 255 ECU_ADDRESS 0 SYMBOL_LINK "Rte_DampgPahFwl_dDampgPahFwlInertiaCmpOverLim" 0 DISPLAY_IDENTIFIER DampgPahFwl.PerInstanceMemories.dDampgPahFwlInertiaCmpOverLim /end MEASUREMENT
/begin MEASUREMENT DampgPahFwl.dDampgPahFwlInertiaCmpUpprLimFild "MICROSAR RTE" FLOAT32_IEEE NO_COMPU_METHOD 0 0 -3.402823466e+38 3.402823466e+38 ECU_ADDRESS 0 SYMBOL_LINK "Rte_DampgPahFwl_dDampgPahFwlInertiaCmpUpprLimFild" 0 DISPLAY_IDENTIFIER DampgPahFwl.PerInstanceMemories.dDampgPahFwlInertiaCmpUpprLimFild /end MEASUREMENT
/begin MEASUREMENT DiagcMgr.BrdgVltg.Val "MICROSAR RTE" FLOAT32_IEEE NO_COMPU_METHOD 0 0 -3.402823466e+38 3.402823466e+38 ECU_ADDRESS 0 SYMBOL_LINK "Rte_BattVltg_BrdgVltg_Val" 0 DISPLAY_IDENTIFIER DiagcMgr.ReceiverPorts.BrdgVltg.Val /end MEASUREMENT
/begin MEASUREMENT DiagcMgr.ClrDiagcFlg "MICROSAR RTE" UBYTE NO_COMPU_METHOD 0 0 0 255 ECU_ADDRESS 0 SYMBOL_LINK "Rte_DiagcMgr_ClrDiagcFlg" 0 DISPLAY_IDENTIFIER DiagcMgr.PerInstanceMemories.ClrDiagcFlg /end MEASUREMENT
/begin MEASUREMENT DiagcMgr.ClrDiagcFlgProxy.Val "MICROSAR RTE" UBYTE NO_COMPU_METHOD 0 0 0 255 ECU_ADDRESS 0 SYMBOL_LINK "Rte_DiagcMgr_ClrDiagcFlgProxy_Val" 0 DISPLAY_IDENTIFIER DiagcMgr.SenderPorts.ClrDiagcFlgProxy.Val /end MEASUREMENT
/begin MEASUREMENT DiagcMgr.DiagcMgrNtcFltAry[0].AgiCntr "MICROSAR RTE" UBYTE NO_COMPU_METHOD 0 0 0 255 ECU_ADDRESS 0 SYMBOL_LINK "Rte_DiagcMgr_DiagcMgrNtcFltAry[0].AgiCntr" 0 DISPLAY_IDENTIFIER DiagcMgr.PerInstanceMemories.DiagcMgrNtcFltAry[0].AgiCntr /end MEASUREMENT
/begin MEASUREMENT DiagcMgr.DiagcMgrNtcFltAry[0].NtcNr "MICROSAR RTE" UWORD RTE_CM_ENUM_NtcNrWithResd1 0 0 0 65535 ECU_ADDRESS 0 SYMBOL_LINK "Rte_DiagcMgr_DiagcMgrNtcFltAry[0].NtcNr" 0 DISPLAY_IDENTIFIER DiagcMgr.PerInstanceMemories.DiagcMgrNtcFltAry[0].NtcNr /end MEASUREMENT
/begin MEASUREMENT DiagcMgr.DiagcMgrNtcFltAry[0].Sts "MICROSAR RTE" UBYTE NO_COMPU_METHOD 0 0 0 255 ECU_ADDRESS 0 SYMBOL_LINK "Rte_DiagcMgr_DiagcMgrNtcFltAry[0].Sts" 0 DISPLAY_IDENTIFIER DiagcMgr.PerInstanceMemories.DiagcMgrNtcFltAry[0].Sts /end MEASUREMENT
/begin MEASUREMENT DiagcMgr.DiagcMgrNtcFltAry[10].AgiCntr "MICROSAR RTE" UBYTE NO_COMPU_METHOD 0 0 0 255 ECU_ADDRESS 0 SYMBOL_LINK "Rte_DiagcMgr_DiagcMgrNtcFltAry[10].AgiCntr" 0 DISPLAY_IDENTIFIER DiagcMgr.PerInstanceMemories.DiagcMgrNtcFltAry[10].AgiCntr /end MEASUREMENT
/begin MEASUREMENT DiagcMgr.DiagcMgrNtcFltAry[10].NtcNr "MICROSAR RTE" UWORD RTE_CM_ENUM_NtcNrWithResd1 0 0 0 65535 ECU_ADDRESS 0 SYMBOL_LINK "Rte_DiagcMgr_DiagcMgrNtcFltAry[10].NtcNr" 0 DISPLAY_IDENTIFIER DiagcMgr.PerInstanceMemories.DiagcMgrNtcFltAry[10].NtcNr /end MEASUREMENT
/begin MEASUREMENT DiagcMgr.DiagcMgrNtcFltAry[10].Sts "MICROSAR RTE" UBYTE NO_COMPU_METHOD 0 0 0 255 ECU_ADDRESS 0 SYMBOL_LINK "Rte_DiagcMgr_DiagcMgrNtcFltAry[10].Sts" 0 DISPLAY_IDENTIFIER DiagcMgr.PerInstanceMemories.DiagcMgrNtcFltAry[10].Sts /end MEASUREMENT
/begin MEASUREMENT DiagcMgr.DiagcMgrNtcFltAry[11].AgiCntr "MICROSAR RTE" UBYTE NO_COMPU_METHOD 0 0 0 255 ECU_ADDRESS 0 SYMBOL_LINK "Rte_DiagcMgr_DiagcMgrNtcFltAry[11].AgiCntr" 0 DISPLAY_IDENTIFIER DiagcMgr.PerInstanceMemories.DiagcMgrNtcFltAry[11].AgiCntr /end MEASUREMENT
/begin MEASUREMENT DiagcMgr.DiagcMgrNtcFltAry[11].NtcNr "MICROSAR RTE" UWORD RTE_CM_ENUM_NtcNrWithResd1 0 0 0 65535 ECU_ADDRESS 0 SYMBOL_LINK "Rte_DiagcMgr_DiagcMgrNtcFltAry[11].NtcNr" 0 DISPLAY_IDENTIFIER DiagcMgr.PerInstanceMemories.DiagcMgrNtcFltAry[11].NtcNr /end MEASUREMENT
/begin MEASUREMENT DiagcMgr.DiagcMgrNtcFltAry[11].Sts "MICROSAR RTE" UBYTE NO_COMPU_METHOD 0 0 0 255 ECU_ADDRESS 0 SYMBOL_LINK "Rte_DiagcMgr_DiagcMgrNtcFltAry[11].Sts" 0 DISPLAY_IDENTIFIER DiagcMgr.PerInstanceMemories.DiagcMgrNtcFltAry[11].Sts /end MEASUREMENT
/begin MEASUREMENT DiagcMgr.DiagcMgrNtcFltAry[12].AgiCntr "MICROSAR RTE" UBYTE NO_COMPU_METHOD 0 0 0 255 ECU_ADDRESS 0 SYMBOL_LINK "Rte_DiagcMgr_DiagcMgrNtcFltAry[12].AgiCntr" 0 DISPLAY_IDENTIFIER DiagcMgr.PerInstanceMemories.DiagcMgrNtcFltAry[12].AgiCntr /end MEASUREMENT
/begin MEASUREMENT DiagcMgr.DiagcMgrNtcFltAry[12].NtcNr "MICROSAR RTE" UWORD RTE_CM_ENUM_NtcNrWithResd1 0 0 0 65535 ECU_ADDRESS 0 SYMBOL_LINK "Rte_DiagcMgr_DiagcMgrNtcFltAry[12].NtcNr" 0 DISPLAY_IDENTIFIER DiagcMgr.PerInstanceMemories.DiagcMgrNtcFltAry[12].NtcNr /end MEASUREMENT
/begin MEASUREMENT DiagcMgr.DiagcMgrNtcFltAry[12].Sts "MICROSAR RTE" UBYTE NO_COMPU_METHOD 0 0 0 255 ECU_ADDRESS 0 SYMBOL_LINK "Rte_DiagcMgr_DiagcMgrNtcFltAry[12].Sts" 0 DISPLAY_IDENTIFIER DiagcMgr.PerInstanceMemories.DiagcMgrNtcFltAry[12].Sts /end MEASUREMENT
/begin MEASUREMENT DiagcMgr.DiagcMgrNtcFltAry[13].AgiCntr "MICROSAR RTE" UBYTE NO_COMPU_METHOD 0 0 0 255 ECU_ADDRESS 0 SYMBOL_LINK "Rte_DiagcMgr_DiagcMgrNtcFltAry[13].AgiCntr" 0 DISPLAY_IDENTIFIER DiagcMgr.PerInstanceMemories.DiagcMgrNtcFltAry[13].AgiCntr /end MEASUREMENT
/begin MEASUREMENT DiagcMgr.DiagcMgrNtcFltAry[13].NtcNr "MICROSAR RTE" UWORD RTE_CM_ENUM_NtcNrWithResd1 0 0 0 65535 ECU_ADDRESS 0 SYMBOL_LINK "Rte_DiagcMgr_DiagcMgrNtcFltAry[13].NtcNr" 0 DISPLAY_IDENTIFIER DiagcMgr.PerInstanceMemories.DiagcMgrNtcFltAry[13].NtcNr /end MEASUREMENT
/begin MEASUREMENT DiagcMgr.DiagcMgrNtcFltAry[13].Sts "MICROSAR RTE" UBYTE NO_COMPU_METHOD 0 0 0 255 ECU_ADDRESS 0 SYMBOL_LINK "Rte_DiagcMgr_DiagcMgrNtcFltAry[13].Sts" 0 DISPLAY_IDENTIFIER DiagcMgr.PerInstanceMemories.DiagcMgrNtcFltAry[13].Sts /end MEASUREMENT
/begin MEASUREMENT DiagcMgr.DiagcMgrNtcFltAry[14].AgiCntr "MICROSAR RTE" UBYTE NO_COMPU_METHOD 0 0 0 255 ECU_ADDRESS 0 SYMBOL_LINK "Rte_DiagcMgr_DiagcMgrNtcFltAry[14].AgiCntr" 0 DISPLAY_IDENTIFIER DiagcMgr.PerInstanceMemories.DiagcMgrNtcFltAry[14].AgiCntr /end MEASUREMENT
/begin MEASUREMENT DiagcMgr.DiagcMgrNtcFltAry[14].NtcNr "MICROSAR RTE" UWORD RTE_CM_ENUM_NtcNrWithResd1 0 0 0 65535 ECU_ADDRESS 0 SYMBOL_LINK "Rte_DiagcMgr_DiagcMgrNtcFltAry[14].NtcNr" 0 DISPLAY_IDENTIFIER DiagcMgr.PerInstanceMemories.DiagcMgrNtcFltAry[14].NtcNr /end MEASUREMENT
/begin MEASUREMENT DiagcMgr.DiagcMgrNtcFltAry[14].Sts "MICROSAR RTE" UBYTE NO_COMPU_METHOD 0 0 0 255 ECU_ADDRESS 0 SYMBOL_LINK "Rte_DiagcMgr_DiagcMgrNtcFltAry[14].Sts" 0 DISPLAY_IDENTIFIER DiagcMgr.PerInstanceMemories.DiagcMgrNtcFltAry[14].Sts /end MEASUREMENT
/begin MEASUREMENT DiagcMgr.DiagcMgrNtcFltAry[15].AgiCntr "MICROSAR RTE" UBYTE NO_COMPU_METHOD 0 0 0 255 ECU_ADDRESS 0 SYMBOL_LINK "Rte_DiagcMgr_DiagcMgrNtcFltAry[15].AgiCntr" 0 DISPLAY_IDENTIFIER DiagcMgr.PerInstanceMemories.DiagcMgrNtcFltAry[15].AgiCntr /end MEASUREMENT
/begin MEASUREMENT DiagcMgr.DiagcMgrNtcFltAry[15].NtcNr "MICROSAR RTE" UWORD RTE_CM_ENUM_NtcNrWithResd1 0 0 0 65535 ECU_ADDRESS 0 SYMBOL_LINK "Rte_DiagcMgr_DiagcMgrNtcFltAry[15].NtcNr" 0 DISPLAY_IDENTIFIER DiagcMgr.PerInstanceMemories.DiagcMgrNtcFltAry[15].NtcNr /end MEASUREMENT
/begin MEASUREMENT DiagcMgr.DiagcMgrNtcFltAry[15].Sts "MICROSAR RTE" UBYTE NO_COMPU_METHOD 0 0 0 255 ECU_ADDRESS 0 SYMBOL_LINK "Rte_DiagcMgr_DiagcMgrNtcFltAry[15].Sts" 0 DISPLAY_IDENTIFIER DiagcMgr.PerInstanceMemories.DiagcMgrNtcFltAry[15].Sts /end MEASUREMENT
/begin MEASUREMENT DiagcMgr.DiagcMgrNtcFltAry[16].AgiCntr "MICROSAR RTE" UBYTE NO_COMPU_METHOD 0 0 0 255 ECU_ADDRESS 0 SYMBOL_LINK "Rte_DiagcMgr_DiagcMgrNtcFltAry[16].AgiCntr" 0 DISPLAY_IDENTIFIER DiagcMgr.PerInstanceMemories.DiagcMgrNtcFltAry[16].AgiCntr /end MEASUREMENT
/begin MEASUREMENT DiagcMgr.DiagcMgrNtcFltAry[16].NtcNr "MICROSAR RTE" UWORD RTE_CM_ENUM_NtcNrWithResd1 0 0 0 65535 ECU_ADDRESS 0 SYMBOL_LINK "Rte_DiagcMgr_DiagcMgrNtcFltAry[16].NtcNr" 0 DISPLAY_IDENTIFIER DiagcMgr.PerInstanceMemories.DiagcMgrNtcFltAry[16].NtcNr /end MEASUREMENT
/begin MEASUREMENT DiagcMgr.DiagcMgrNtcFltAry[16].Sts "MICROSAR RTE" UBYTE NO_COMPU_METHOD 0 0 0 255 ECU_ADDRESS 0 SYMBOL_LINK "Rte_DiagcMgr_DiagcMgrNtcFltAry[16].Sts" 0 DISPLAY_IDENTIFIER DiagcMgr.PerInstanceMemories.DiagcMgrNtcFltAry[16].Sts /end MEASUREMENT
/begin MEASUREMENT DiagcMgr.DiagcMgrNtcFltAry[17].AgiCntr "MICROSAR RTE" UBYTE NO_COMPU_METHOD 0 0 0 255 ECU_ADDRESS 0 SYMBOL_LINK "Rte_DiagcMgr_DiagcMgrNtcFltAry[17].AgiCntr" 0 DISPLAY_IDENTIFIER DiagcMgr.PerInstanceMemories.DiagcMgrNtcFltAry[17].AgiCntr /end MEASUREMENT
/begin MEASUREMENT DiagcMgr.DiagcMgrNtcFltAry[17].NtcNr "MICROSAR RTE" UWORD RTE_CM_ENUM_NtcNrWithResd1 0 0 0 65535 ECU_ADDRESS 0 SYMBOL_LINK "Rte_DiagcMgr_DiagcMgrNtcFltAry[17].NtcNr" 0 DISPLAY_IDENTIFIER DiagcMgr.PerInstanceMemories.DiagcMgrNtcFltAry[17].NtcNr /end MEASUREMENT
/begin MEASUREMENT DiagcMgr.DiagcMgrNtcFltAry[17].Sts "MICROSAR RTE" UBYTE NO_COMPU_METHOD 0 0 0 255 ECU_ADDRESS 0 SYMBOL_LINK "Rte_DiagcMgr_DiagcMgrNtcFltAry[17].Sts" 0 DISPLAY_IDENTIFIER DiagcMgr.PerInstanceMemories.DiagcMgrNtcFltAry[17].Sts /end MEASUREMENT
/begin MEASUREMENT DiagcMgr.DiagcMgrNtcFltAry[18].AgiCntr "MICROSAR RTE" UBYTE NO_COMPU_METHOD 0 0 0 255 ECU_ADDRESS 0 SYMBOL_LINK "Rte_DiagcMgr_DiagcMgrNtcFltAry[18].AgiCntr" 0 DISPLAY_IDENTIFIER DiagcMgr.PerInstanceMemories.DiagcMgrNtcFltAry[18].AgiCntr /end MEASUREMENT
/begin MEASUREMENT DiagcMgr.DiagcMgrNtcFltAry[18].NtcNr "MICROSAR RTE" UWORD RTE_CM_ENUM_NtcNrWithResd1 0 0 0 65535 ECU_ADDRESS 0 SYMBOL_LINK "Rte_DiagcMgr_DiagcMgrNtcFltAry[18].NtcNr" 0 DISPLAY_IDENTIFIER DiagcMgr.PerInstanceMemories.DiagcMgrNtcFltAry[18].NtcNr /end MEASUREMENT
/begin MEASUREMENT DiagcMgr.DiagcMgrNtcFltAry[18].Sts "MICROSAR RTE" UBYTE NO_COMPU_METHOD 0 0 0 255 ECU_ADDRESS 0 SYMBOL_LINK "Rte_DiagcMgr_DiagcMgrNtcFltAry[18].Sts" 0 DISPLAY_IDENTIFIER DiagcMgr.PerInstanceMemories.DiagcMgrNtcFltAry[18].Sts /end MEASUREMENT
/begin MEASUREMENT DiagcMgr.DiagcMgrNtcFltAry[19].AgiCntr "MICROSAR RTE" UBYTE NO_COMPU_METHOD 0 0 0 255 ECU_ADDRESS 0 SYMBOL_LINK "Rte_DiagcMgr_DiagcMgrNtcFltAry[19].AgiCntr" 0 DISPLAY_IDENTIFIER DiagcMgr.PerInstanceMemories.DiagcMgrNtcFltAry[19].AgiCntr /end MEASUREMENT
/begin MEASUREMENT DiagcMgr.DiagcMgrNtcFltAry[19].NtcNr "MICROSAR RTE" UWORD RTE_CM_ENUM_NtcNrWithResd1 0 0 0 65535 ECU_ADDRESS 0 SYMBOL_LINK "Rte_DiagcMgr_DiagcMgrNtcFltAry[19].NtcNr" 0 DISPLAY_IDENTIFIER DiagcMgr.PerInstanceMemories.DiagcMgrNtcFltAry[19].NtcNr /end MEASUREMENT
/begin MEASUREMENT DiagcMgr.DiagcMgrNtcFltAry[19].Sts "MICROSAR RTE" UBYTE NO_COMPU_METHOD 0 0 0 255 ECU_ADDRESS 0 SYMBOL_LINK "Rte_DiagcMgr_DiagcMgrNtcFltAry[19].Sts" 0 DISPLAY_IDENTIFIER DiagcMgr.PerInstanceMemories.DiagcMgrNtcFltAry[19].Sts /end MEASUREMENT
/begin MEASUREMENT DiagcMgr.DiagcMgrNtcFltAry[1].AgiCntr "MICROSAR RTE" UBYTE NO_COMPU_METHOD 0 0 0 255 ECU_ADDRESS 0 SYMBOL_LINK "Rte_DiagcMgr_DiagcMgrNtcFltAry[1].AgiCntr" 0 DISPLAY_IDENTIFIER DiagcMgr.PerInstanceMemories.DiagcMgrNtcFltAry[1].AgiCntr /end MEASUREMENT
/begin MEASUREMENT DiagcMgr.DiagcMgrNtcFltAry[1].NtcNr "MICROSAR RTE" UWORD RTE_CM_ENUM_NtcNrWithResd1 0 0 0 65535 ECU_ADDRESS 0 SYMBOL_LINK "Rte_DiagcMgr_DiagcMgrNtcFltAry[1].NtcNr" 0 DISPLAY_IDENTIFIER DiagcMgr.PerInstanceMemories.DiagcMgrNtcFltAry[1].NtcNr /end MEASUREMENT
/begin MEASUREMENT DiagcMgr.DiagcMgrNtcFltAry[1].Sts "MICROSAR RTE" UBYTE NO_COMPU_METHOD 0 0 0 255 ECU_ADDRESS 0 SYMBOL_LINK "Rte_DiagcMgr_DiagcMgrNtcFltAry[1].Sts" 0 DISPLAY_IDENTIFIER DiagcMgr.PerInstanceMemories.DiagcMgrNtcFltAry[1].Sts /end MEASUREMENT
/begin MEASUREMENT DiagcMgr.DiagcMgrNtcFltAry[2].AgiCntr "MICROSAR RTE" UBYTE NO_COMPU_METHOD 0 0 0 255 ECU_ADDRESS 0 SYMBOL_LINK "Rte_DiagcMgr_DiagcMgrNtcFltAry[2].AgiCntr" 0 DISPLAY_IDENTIFIER DiagcMgr.PerInstanceMemories.DiagcMgrNtcFltAry[2].AgiCntr /end MEASUREMENT
/begin MEASUREMENT DiagcMgr.DiagcMgrNtcFltAry[2].NtcNr "MICROSAR RTE" UWORD RTE_CM_ENUM_NtcNrWithResd1 0 0 0 65535 ECU_ADDRESS 0 SYMBOL_LINK "Rte_DiagcMgr_DiagcMgrNtcFltAry[2].NtcNr" 0 DISPLAY_IDENTIFIER DiagcMgr.PerInstanceMemories.DiagcMgrNtcFltAry[2].NtcNr /end MEASUREMENT
/begin MEASUREMENT DiagcMgr.DiagcMgrNtcFltAry[2].Sts "MICROSAR RTE" UBYTE NO_COMPU_METHOD 0 0 0 255 ECU_ADDRESS 0 SYMBOL_LINK "Rte_DiagcMgr_DiagcMgrNtcFltAry[2].Sts" 0 DISPLAY_IDENTIFIER DiagcMgr.PerInstanceMemories.DiagcMgrNtcFltAry[2].Sts /end MEASUREMENT
/begin MEASUREMENT DiagcMgr.DiagcMgrNtcFltAry[3].AgiCntr "MICROSAR RTE" UBYTE NO_COMPU_METHOD 0 0 0 255 ECU_ADDRESS 0 SYMBOL_LINK "Rte_DiagcMgr_DiagcMgrNtcFltAry[3].AgiCntr" 0 DISPLAY_IDENTIFIER DiagcMgr.PerInstanceMemories.DiagcMgrNtcFltAry[3].AgiCntr /end MEASUREMENT
/begin MEASUREMENT DiagcMgr.DiagcMgrNtcFltAry[3].NtcNr "MICROSAR RTE" UWORD RTE_CM_ENUM_NtcNrWithResd1 0 0 0 65535 ECU_ADDRESS 0 SYMBOL_LINK "Rte_DiagcMgr_DiagcMgrNtcFltAry[3].NtcNr" 0 DISPLAY_IDENTIFIER DiagcMgr.PerInstanceMemories.DiagcMgrNtcFltAry[3].NtcNr /end MEASUREMENT
/begin MEASUREMENT DiagcMgr.DiagcMgrNtcFltAry[3].Sts "MICROSAR RTE" UBYTE NO_COMPU_METHOD 0 0 0 255 ECU_ADDRESS 0 SYMBOL_LINK "Rte_DiagcMgr_DiagcMgrNtcFltAry[3].Sts" 0 DISPLAY_IDENTIFIER DiagcMgr.PerInstanceMemories.DiagcMgrNtcFltAry[3].Sts /end MEASUREMENT
/begin MEASUREMENT DiagcMgr.DiagcMgrNtcFltAry[4].AgiCntr "MICROSAR RTE" UBYTE NO_COMPU_METHOD 0 0 0 255 ECU_ADDRESS 0 SYMBOL_LINK "Rte_DiagcMgr_DiagcMgrNtcFltAry[4].AgiCntr" 0 DISPLAY_IDENTIFIER DiagcMgr.PerInstanceMemories.DiagcMgrNtcFltAry[4].AgiCntr /end MEASUREMENT
/begin MEASUREMENT DiagcMgr.DiagcMgrNtcFltAry[4].NtcNr "MICROSAR RTE" UWORD RTE_CM_ENUM_NtcNrWithResd1 0 0 0 65535 ECU_ADDRESS 0 SYMBOL_LINK "Rte_DiagcMgr_DiagcMgrNtcFltAry[4].NtcNr" 0 DISPLAY_IDENTIFIER DiagcMgr.PerInstanceMemories.DiagcMgrNtcFltAry[4].NtcNr /end MEASUREMENT
/begin MEASUREMENT DiagcMgr.DiagcMgrNtcFltAry[4].Sts "MICROSAR RTE" UBYTE NO_COMPU_METHOD 0 0 0 255 ECU_ADDRESS 0 SYMBOL_LINK "Rte_DiagcMgr_DiagcMgrNtcFltAry[4].Sts" 0 DISPLAY_IDENTIFIER DiagcMgr.PerInstanceMemories.DiagcMgrNtcFltAry[4].Sts /end MEASUREMENT
/begin MEASUREMENT DiagcMgr.DiagcMgrNtcFltAry[5].AgiCntr "MICROSAR RTE" UBYTE NO_COMPU_METHOD 0 0 0 255 ECU_ADDRESS 0 SYMBOL_LINK "Rte_DiagcMgr_DiagcMgrNtcFltAry[5].AgiCntr" 0 DISPLAY_IDENTIFIER DiagcMgr.PerInstanceMemories.DiagcMgrNtcFltAry[5].AgiCntr /end MEASUREMENT
/begin MEASUREMENT DiagcMgr.DiagcMgrNtcFltAry[5].NtcNr "MICROSAR RTE" UWORD RTE_CM_ENUM_NtcNrWithResd1 0 0 0 65535 ECU_ADDRESS 0 SYMBOL_LINK "Rte_DiagcMgr_DiagcMgrNtcFltAry[5].NtcNr" 0 DISPLAY_IDENTIFIER DiagcMgr.PerInstanceMemories.DiagcMgrNtcFltAry[5].NtcNr /end MEASUREMENT
/begin MEASUREMENT DiagcMgr.DiagcMgrNtcFltAry[5].Sts "MICROSAR RTE" UBYTE NO_COMPU_METHOD 0 0 0 255 ECU_ADDRESS 0 SYMBOL_LINK "Rte_DiagcMgr_DiagcMgrNtcFltAry[5].Sts" 0 DISPLAY_IDENTIFIER DiagcMgr.PerInstanceMemories.DiagcMgrNtcFltAry[5].Sts /end MEASUREMENT
/begin MEASUREMENT DiagcMgr.DiagcMgrNtcFltAry[6].AgiCntr "MICROSAR RTE" UBYTE NO_COMPU_METHOD 0 0 0 255 ECU_ADDRESS 0 SYMBOL_LINK "Rte_DiagcMgr_DiagcMgrNtcFltAry[6].AgiCntr" 0 DISPLAY_IDENTIFIER DiagcMgr.PerInstanceMemories.DiagcMgrNtcFltAry[6].AgiCntr /end MEASUREMENT
/begin MEASUREMENT DiagcMgr.DiagcMgrNtcFltAry[6].NtcNr "MICROSAR RTE" UWORD RTE_CM_ENUM_NtcNrWithResd1 0 0 0 65535 ECU_ADDRESS 0 SYMBOL_LINK "Rte_DiagcMgr_DiagcMgrNtcFltAry[6].NtcNr" 0 DISPLAY_IDENTIFIER DiagcMgr.PerInstanceMemories.DiagcMgrNtcFltAry[6].NtcNr /end MEASUREMENT
/begin MEASUREMENT DiagcMgr.DiagcMgrNtcFltAry[6].Sts "MICROSAR RTE" UBYTE NO_COMPU_METHOD 0 0 0 255 ECU_ADDRESS 0 SYMBOL_LINK "Rte_DiagcMgr_DiagcMgrNtcFltAry[6].Sts" 0 DISPLAY_IDENTIFIER DiagcMgr.PerInstanceMemories.DiagcMgrNtcFltAry[6].Sts /end MEASUREMENT
/begin MEASUREMENT DiagcMgr.DiagcMgrNtcFltAry[7].AgiCntr "MICROSAR RTE" UBYTE NO_COMPU_METHOD 0 0 0 255 ECU_ADDRESS 0 SYMBOL_LINK "Rte_DiagcMgr_DiagcMgrNtcFltAry[7].AgiCntr" 0 DISPLAY_IDENTIFIER DiagcMgr.PerInstanceMemories.DiagcMgrNtcFltAry[7].AgiCntr /end MEASUREMENT
/begin MEASUREMENT DiagcMgr.DiagcMgrNtcFltAry[7].NtcNr "MICROSAR RTE" UWORD RTE_CM_ENUM_NtcNrWithResd1 0 0 0 65535 ECU_ADDRESS 0 SYMBOL_LINK "Rte_DiagcMgr_DiagcMgrNtcFltAry[7].NtcNr" 0 DISPLAY_IDENTIFIER DiagcMgr.PerInstanceMemories.DiagcMgrNtcFltAry[7].NtcNr /end MEASUREMENT
/begin MEASUREMENT DiagcMgr.DiagcMgrNtcFltAry[7].Sts "MICROSAR RTE" UBYTE NO_COMPU_METHOD 0 0 0 255 ECU_ADDRESS 0 SYMBOL_LINK "Rte_DiagcMgr_DiagcMgrNtcFltAry[7].Sts" 0 DISPLAY_IDENTIFIER DiagcMgr.PerInstanceMemories.DiagcMgrNtcFltAry[7].Sts /end MEASUREMENT
/begin MEASUREMENT DiagcMgr.DiagcMgrNtcFltAry[8].AgiCntr "MICROSAR RTE" UBYTE NO_COMPU_METHOD 0 0 0 255 ECU_ADDRESS 0 SYMBOL_LINK "Rte_DiagcMgr_DiagcMgrNtcFltAry[8].AgiCntr" 0 DISPLAY_IDENTIFIER DiagcMgr.PerInstanceMemories.DiagcMgrNtcFltAry[8].AgiCntr /end MEASUREMENT
/begin MEASUREMENT DiagcMgr.DiagcMgrNtcFltAry[8].NtcNr "MICROSAR RTE" UWORD RTE_CM_ENUM_NtcNrWithResd1 0 0 0 65535 ECU_ADDRESS 0 SYMBOL_LINK "Rte_DiagcMgr_DiagcMgrNtcFltAry[8].NtcNr" 0 DISPLAY_IDENTIFIER DiagcMgr.PerInstanceMemories.DiagcMgrNtcFltAry[8].NtcNr /end MEASUREMENT
/begin MEASUREMENT DiagcMgr.DiagcMgrNtcFltAry[8].Sts "MICROSAR RTE" UBYTE NO_COMPU_METHOD 0 0 0 255 ECU_ADDRESS 0 SYMBOL_LINK "Rte_DiagcMgr_DiagcMgrNtcFltAry[8].Sts" 0 DISPLAY_IDENTIFIER DiagcMgr.PerInstanceMemories.DiagcMgrNtcFltAry[8].Sts /end MEASUREMENT
/begin MEASUREMENT DiagcMgr.DiagcMgrNtcFltAry[9].AgiCntr "MICROSAR RTE" UBYTE NO_COMPU_METHOD 0 0 0 255 ECU_ADDRESS 0 SYMBOL_LINK "Rte_DiagcMgr_DiagcMgrNtcFltAry[9].AgiCntr" 0 DISPLAY_IDENTIFIER DiagcMgr.PerInstanceMemories.DiagcMgrNtcFltAry[9].AgiCntr /end MEASUREMENT
/begin MEASUREMENT DiagcMgr.DiagcMgrNtcFltAry[9].NtcNr "MICROSAR RTE" UWORD RTE_CM_ENUM_NtcNrWithResd1 0 0 0 65535 ECU_ADDRESS 0 SYMBOL_LINK "Rte_DiagcMgr_DiagcMgrNtcFltAry[9].NtcNr" 0 DISPLAY_IDENTIFIER DiagcMgr.PerInstanceMemories.DiagcMgrNtcFltAry[9].NtcNr /end MEASUREMENT
/begin MEASUREMENT DiagcMgr.DiagcMgrNtcFltAry[9].Sts "MICROSAR RTE" UBYTE NO_COMPU_METHOD 0 0 0 255 ECU_ADDRESS 0 SYMBOL_LINK "Rte_DiagcMgr_DiagcMgrNtcFltAry[9].Sts" 0 DISPLAY_IDENTIFIER DiagcMgr.PerInstanceMemories.DiagcMgrNtcFltAry[9].Sts /end MEASUREMENT
/begin MEASUREMENT DiagcMgr.DiagcStsCtrldShtDwnFltPrsnt.Logl "MICROSAR RTE" UBYTE RTE_CM_BOOLEAN 0 0 0 255 ECU_ADDRESS 0 SYMBOL_LINK "Rte_DiagcMgr_DiagcStsCtrldShtDwnFltPrsnt_Logl" 0 DISPLAY_IDENTIFIER DiagcMgr.SenderPorts.DiagcStsCtrldShtDwnFltPrsnt.Logl /end MEASUREMENT
/begin MEASUREMENT DiagcMgr.DiagcStsDftHwAg.Logl "MICROSAR RTE" UBYTE RTE_CM_BOOLEAN 0 0 0 255 ECU_ADDRESS 0 SYMBOL_LINK "Rte_DiagcMgr_DiagcStsDftHwAg_Logl" 0 DISPLAY_IDENTIFIER DiagcMgr.SenderPorts.DiagcStsDftHwAg.Logl /end MEASUREMENT
/begin MEASUREMENT DiagcMgr.DiagcStsDftHwAgSerlComExprtVal.Logl "MICROSAR RTE" UBYTE RTE_CM_BOOLEAN 0 0 0 255 ECU_ADDRESS 0 SYMBOL_LINK "Rte_DiagcMgr_DiagcStsDftHwAgSerlComExprtVal_Logl" 0 DISPLAY_IDENTIFIER DiagcMgr.SenderPorts.DiagcStsDftHwAgSerlComExprtVal.Logl /end MEASUREMENT
/begin MEASUREMENT DiagcMgr.DiagcStsDftVehSpd.Logl "MICROSAR RTE" UBYTE RTE_CM_BOOLEAN 0 0 0 255 ECU_ADDRESS 0 SYMBOL_LINK "Rte_DiagcMgr_DiagcStsDftVehSpd_Logl" 0 DISPLAY_IDENTIFIER DiagcMgr.SenderPorts.DiagcStsDftVehSpd.Logl /end MEASUREMENT
/begin MEASUREMENT DiagcMgr.DiagcStsIvtr1Inactv.Logl "MICROSAR RTE" UBYTE RTE_CM_BOOLEAN 0 0 0 255 ECU_ADDRESS 0 SYMBOL_LINK "Rte_DiagcMgr_DiagcStsIvtr1Inactv_Logl" 0 DISPLAY_IDENTIFIER DiagcMgr.SenderPorts.DiagcStsIvtr1Inactv.Logl /end MEASUREMENT
/begin MEASUREMENT DiagcMgr.DiagcStsIvtr2Inactv.Logl "MICROSAR RTE" UBYTE RTE_CM_BOOLEAN 0 0 0 255 ECU_ADDRESS 0 SYMBOL_LINK "Rte_DiagcMgr_DiagcStsIvtr2Inactv_Logl" 0 DISPLAY_IDENTIFIER DiagcMgr.SenderPorts.DiagcStsIvtr2Inactv.Logl /end MEASUREMENT
/begin MEASUREMENT DiagcMgr.DiagcStsLimdTPrfmnc.Logl "MICROSAR RTE" UBYTE RTE_CM_BOOLEAN 0 0 0 255 ECU_ADDRESS 0 SYMBOL_LINK "Rte_DiagcMgr_DiagcStsLimdTPrfmnc_Logl" 0 DISPLAY_IDENTIFIER DiagcMgr.SenderPorts.DiagcStsLimdTPrfmnc.Logl /end MEASUREMENT
/begin MEASUREMENT DiagcMgr.DiagcStsWhlImbRejctnDi.Logl "MICROSAR RTE" UBYTE RTE_CM_BOOLEAN 0 0 0 255 ECU_ADDRESS 0 SYMBOL_LINK "Rte_DiagcMgr_DiagcStsWhlImbRejctnDi_Logl" 0 DISPLAY_IDENTIFIER DiagcMgr.SenderPorts.DiagcStsWhlImbRejctnDi.Logl /end MEASUREMENT
/begin MEASUREMENT DiagcMgr.DtcEnaSts "MICROSAR RTE" UWORD NO_COMPU_METHOD 0 0 0 65535 ECU_ADDRESS 0 SYMBOL_LINK "Rte_DiagcMgr_DtcEnaSts" 0 DISPLAY_IDENTIFIER DiagcMgr.PerInstanceMemories.DtcEnaSts /end MEASUREMENT
/begin MEASUREMENT DiagcMgr.EcuTFild.Val "MICROSAR RTE" FLOAT32_IEEE NO_COMPU_METHOD 0 0 -3.402823466e+38 3.402823466e+38 ECU_ADDRESS 0 SYMBOL_LINK "Rte_EcuTMeas_EcuTFild_Val" 0 DISPLAY_IDENTIFIER DiagcMgr.ReceiverPorts.EcuTFild.Val /end MEASUREMENT
/begin MEASUREMENT DiagcMgr.HwTq.Val "MICROSAR RTE" FLOAT32_IEEE NO_COMPU_METHOD 0 0 -3.402823466e+38 3.402823466e+38 ECU_ADDRESS 0 SYMBOL_LINK "Rte_Swp_HwTqSwp_Val" 0 DISPLAY_IDENTIFIER DiagcMgr.ReceiverPorts.HwTq.Val /end MEASUREMENT
/begin MEASUREMENT DiagcMgr.IgnCntr.Val "MICROSAR RTE" ULONG NO_COMPU_METHOD 0 0 0 4294967295 ECU_ADDRESS 0 SYMBOL_LINK "Rte_CmnMfgSrv_IgnCntr_Val" 0 DISPLAY_IDENTIFIER DiagcMgr.ReceiverPorts.IgnCntr.Val /end MEASUREMENT
/begin MEASUREMENT DiagcMgr.MfgDiagcInhb.Logl "MICROSAR RTE" UBYTE RTE_CM_BOOLEAN 0 0 0 255 ECU_ADDRESS 0 SYMBOL_LINK "Rte_CmnMfgSrv_MfgDiagcInhb_Logl" 0 DISPLAY_IDENTIFIER DiagcMgr.ReceiverPorts.MfgDiagcInhb.Logl /end MEASUREMENT
/begin MEASUREMENT DiagcMgr.MotTqCmdMrfScad.Val "MICROSAR RTE" FLOAT32_IEEE NO_COMPU_METHOD 0 0 -3.402823466e+38 3.402823466e+38 ECU_ADDRESS 0 SYMBOL_LINK "Rte_MotTqCmdSca_MotTqCmdMrfScad_Val" 0 DISPLAY_IDENTIFIER DiagcMgr.ReceiverPorts.MotTqCmdMrfScad.Val /end MEASUREMENT
/begin MEASUREMENT DiagcMgr.PrevClrDtcFlg "MICROSAR RTE" UBYTE NO_COMPU_METHOD 0 0 0 255 ECU_ADDRESS 0 SYMBOL_LINK "Rte_DiagcMgr_PrevClrDtcFlg" 0 DISPLAY_IDENTIFIER DiagcMgr.PerInstanceMemories.PrevClrDtcFlg /end MEASUREMENT
/begin MEASUREMENT DiagcMgr.RegInBRAMDAT1.Val "MICROSAR RTE" ULONG NO_COMPU_METHOD 0 0 0 4294967295 ECU_ADDRESS 0 SYMBOL_LINK "Rte_DiagcMgr_RegInBRAMDAT1_Val" 0 DISPLAY_IDENTIFIER DiagcMgr.ReceiverPorts.RegInBRAMDAT1.Val /end MEASUREMENT
/begin MEASUREMENT DiagcMgr.SnpshtDataAry[0].BrdgVltg "MICROSAR RTE" UWORD NO_COMPU_METHOD 0 0 0 65535 ECU_ADDRESS 0 SYMBOL_LINK "Rte_DiagcMgr_SnpshtDataAry[0].BrdgVltg" 0 DISPLAY_IDENTIFIER DiagcMgr.PerInstanceMemories.SnpshtDataAry[0].BrdgVltg /end MEASUREMENT
/begin MEASUREMENT DiagcMgr.SnpshtDataAry[0].EcuT "MICROSAR RTE" SWORD NO_COMPU_METHOD 0 0 -32768 32767 ECU_ADDRESS 0 SYMBOL_LINK "Rte_DiagcMgr_SnpshtDataAry[0].EcuT" 0 DISPLAY_IDENTIFIER DiagcMgr.PerInstanceMemories.SnpshtDataAry[0].EcuT /end MEASUREMENT
/begin MEASUREMENT DiagcMgr.SnpshtDataAry[0].HwTq "MICROSAR RTE" SWORD NO_COMPU_METHOD 0 0 -32768 32767 ECU_ADDRESS 0 SYMBOL_LINK "Rte_DiagcMgr_SnpshtDataAry[0].HwTq" 0 DISPLAY_IDENTIFIER DiagcMgr.PerInstanceMemories.SnpshtDataAry[0].HwTq /end MEASUREMENT
/begin MEASUREMENT DiagcMgr.SnpshtDataAry[0].IgnCntr "MICROSAR RTE" ULONG NO_COMPU_METHOD 0 0 0 4294967295 ECU_ADDRESS 0 SYMBOL_LINK "Rte_DiagcMgr_SnpshtDataAry[0].IgnCntr" 0 DISPLAY_IDENTIFIER DiagcMgr.PerInstanceMemories.SnpshtDataAry[0].IgnCntr /end MEASUREMENT
/begin MEASUREMENT DiagcMgr.SnpshtDataAry[0].MicroDiagcData "MICROSAR RTE" ULONG NO_COMPU_METHOD 0 0 0 4294967295 ECU_ADDRESS 0 SYMBOL_LINK "Rte_DiagcMgr_SnpshtDataAry[0].MicroDiagcData" 0 DISPLAY_IDENTIFIER DiagcMgr.PerInstanceMemories.SnpshtDataAry[0].MicroDiagcData /end MEASUREMENT
/begin MEASUREMENT DiagcMgr.SnpshtDataAry[0].MotTq "MICROSAR RTE" SWORD NO_COMPU_METHOD 0 0 -32768 32767 ECU_ADDRESS 0 SYMBOL_LINK "Rte_DiagcMgr_SnpshtDataAry[0].MotTq" 0 DISPLAY_IDENTIFIER DiagcMgr.PerInstanceMemories.SnpshtDataAry[0].MotTq /end MEASUREMENT
/begin MEASUREMENT DiagcMgr.SnpshtDataAry[0].NtcNr "MICROSAR RTE" UWORD NO_COMPU_METHOD 0 0 0 65535 ECU_ADDRESS 0 SYMBOL_LINK "Rte_DiagcMgr_SnpshtDataAry[0].NtcNr" 0 DISPLAY_IDENTIFIER DiagcMgr.PerInstanceMemories.SnpshtDataAry[0].NtcNr /end MEASUREMENT
/begin MEASUREMENT DiagcMgr.SnpshtDataAry[0].NtcStInfo "MICROSAR RTE" UBYTE NO_COMPU_METHOD 0 0 0 255 ECU_ADDRESS 0 SYMBOL_LINK "Rte_DiagcMgr_SnpshtDataAry[0].NtcStInfo" 0 DISPLAY_IDENTIFIER DiagcMgr.PerInstanceMemories.SnpshtDataAry[0].NtcStInfo /end MEASUREMENT
/begin MEASUREMENT DiagcMgr.SnpshtDataAry[0].SysSt "MICROSAR RTE" UBYTE RTE_CM_ENUM_SysSt1 0 0 0 255 ECU_ADDRESS 0 SYMBOL_LINK "Rte_DiagcMgr_SnpshtDataAry[0].SysSt" 0 DISPLAY_IDENTIFIER DiagcMgr.PerInstanceMemories.SnpshtDataAry[0].SysSt /end MEASUREMENT
/begin MEASUREMENT DiagcMgr.SnpshtDataAry[0].VehSpd "MICROSAR RTE" UWORD NO_COMPU_METHOD 0 0 0 65535 ECU_ADDRESS 0 SYMBOL_LINK "Rte_DiagcMgr_SnpshtDataAry[0].VehSpd" 0 DISPLAY_IDENTIFIER DiagcMgr.PerInstanceMemories.SnpshtDataAry[0].VehSpd /end MEASUREMENT
/begin MEASUREMENT DiagcMgr.SnpshtDataAry[1].BrdgVltg "MICROSAR RTE" UWORD NO_COMPU_METHOD 0 0 0 65535 ECU_ADDRESS 0 SYMBOL_LINK "Rte_DiagcMgr_SnpshtDataAry[1].BrdgVltg" 0 DISPLAY_IDENTIFIER DiagcMgr.PerInstanceMemories.SnpshtDataAry[1].BrdgVltg /end MEASUREMENT
/begin MEASUREMENT DiagcMgr.SnpshtDataAry[1].EcuT "MICROSAR RTE" SWORD NO_COMPU_METHOD 0 0 -32768 32767 ECU_ADDRESS 0 SYMBOL_LINK "Rte_DiagcMgr_SnpshtDataAry[1].EcuT" 0 DISPLAY_IDENTIFIER DiagcMgr.PerInstanceMemories.SnpshtDataAry[1].EcuT /end MEASUREMENT
/begin MEASUREMENT DiagcMgr.SnpshtDataAry[1].HwTq "MICROSAR RTE" SWORD NO_COMPU_METHOD 0 0 -32768 32767 ECU_ADDRESS 0 SYMBOL_LINK "Rte_DiagcMgr_SnpshtDataAry[1].HwTq" 0 DISPLAY_IDENTIFIER DiagcMgr.PerInstanceMemories.SnpshtDataAry[1].HwTq /end MEASUREMENT
/begin MEASUREMENT DiagcMgr.SnpshtDataAry[1].IgnCntr "MICROSAR RTE" ULONG NO_COMPU_METHOD 0 0 0 4294967295 ECU_ADDRESS 0 SYMBOL_LINK "Rte_DiagcMgr_SnpshtDataAry[1].IgnCntr" 0 DISPLAY_IDENTIFIER DiagcMgr.PerInstanceMemories.SnpshtDataAry[1].IgnCntr /end MEASUREMENT
/begin MEASUREMENT DiagcMgr.SnpshtDataAry[1].MicroDiagcData "MICROSAR RTE" ULONG NO_COMPU_METHOD 0 0 0 4294967295 ECU_ADDRESS 0 SYMBOL_LINK "Rte_DiagcMgr_SnpshtDataAry[1].MicroDiagcData" 0 DISPLAY_IDENTIFIER DiagcMgr.PerInstanceMemories.SnpshtDataAry[1].MicroDiagcData /end MEASUREMENT
/begin MEASUREMENT DiagcMgr.SnpshtDataAry[1].MotTq "MICROSAR RTE" SWORD NO_COMPU_METHOD 0 0 -32768 32767 ECU_ADDRESS 0 SYMBOL_LINK "Rte_DiagcMgr_SnpshtDataAry[1].MotTq" 0 DISPLAY_IDENTIFIER DiagcMgr.PerInstanceMemories.SnpshtDataAry[1].MotTq /end MEASUREMENT
/begin MEASUREMENT DiagcMgr.SnpshtDataAry[1].NtcNr "MICROSAR RTE" UWORD NO_COMPU_METHOD 0 0 0 65535 ECU_ADDRESS 0 SYMBOL_LINK "Rte_DiagcMgr_SnpshtDataAry[1].NtcNr" 0 DISPLAY_IDENTIFIER DiagcMgr.PerInstanceMemories.SnpshtDataAry[1].NtcNr /end MEASUREMENT
/begin MEASUREMENT DiagcMgr.SnpshtDataAry[1].NtcStInfo "MICROSAR RTE" UBYTE NO_COMPU_METHOD 0 0 0 255 ECU_ADDRESS 0 SYMBOL_LINK "Rte_DiagcMgr_SnpshtDataAry[1].NtcStInfo" 0 DISPLAY_IDENTIFIER DiagcMgr.PerInstanceMemories.SnpshtDataAry[1].NtcStInfo /end MEASUREMENT
/begin MEASUREMENT DiagcMgr.SnpshtDataAry[1].SysSt "MICROSAR RTE" UBYTE RTE_CM_ENUM_SysSt1 0 0 0 255 ECU_ADDRESS 0 SYMBOL_LINK "Rte_DiagcMgr_SnpshtDataAry[1].SysSt" 0 DISPLAY_IDENTIFIER DiagcMgr.PerInstanceMemories.SnpshtDataAry[1].SysSt /end MEASUREMENT
/begin MEASUREMENT DiagcMgr.SnpshtDataAry[1].VehSpd "MICROSAR RTE" UWORD NO_COMPU_METHOD 0 0 0 65535 ECU_ADDRESS 0 SYMBOL_LINK "Rte_DiagcMgr_SnpshtDataAry[1].VehSpd" 0 DISPLAY_IDENTIFIER DiagcMgr.PerInstanceMemories.SnpshtDataAry[1].VehSpd /end MEASUREMENT
/begin MEASUREMENT DiagcMgr.SnpshtDataAry[2].BrdgVltg "MICROSAR RTE" UWORD NO_COMPU_METHOD 0 0 0 65535 ECU_ADDRESS 0 SYMBOL_LINK "Rte_DiagcMgr_SnpshtDataAry[2].BrdgVltg" 0 DISPLAY_IDENTIFIER DiagcMgr.PerInstanceMemories.SnpshtDataAry[2].BrdgVltg /end MEASUREMENT
/begin MEASUREMENT DiagcMgr.SnpshtDataAry[2].EcuT "MICROSAR RTE" SWORD NO_COMPU_METHOD 0 0 -32768 32767 ECU_ADDRESS 0 SYMBOL_LINK "Rte_DiagcMgr_SnpshtDataAry[2].EcuT" 0 DISPLAY_IDENTIFIER DiagcMgr.PerInstanceMemories.SnpshtDataAry[2].EcuT /end MEASUREMENT
/begin MEASUREMENT DiagcMgr.SnpshtDataAry[2].HwTq "MICROSAR RTE" SWORD NO_COMPU_METHOD 0 0 -32768 32767 ECU_ADDRESS 0 SYMBOL_LINK "Rte_DiagcMgr_SnpshtDataAry[2].HwTq" 0 DISPLAY_IDENTIFIER DiagcMgr.PerInstanceMemories.SnpshtDataAry[2].HwTq /end MEASUREMENT
/begin MEASUREMENT DiagcMgr.SnpshtDataAry[2].IgnCntr "MICROSAR RTE" ULONG NO_COMPU_METHOD 0 0 0 4294967295 ECU_ADDRESS 0 SYMBOL_LINK "Rte_DiagcMgr_SnpshtDataAry[2].IgnCntr" 0 DISPLAY_IDENTIFIER DiagcMgr.PerInstanceMemories.SnpshtDataAry[2].IgnCntr /end MEASUREMENT
/begin MEASUREMENT DiagcMgr.SnpshtDataAry[2].MicroDiagcData "MICROSAR RTE" ULONG NO_COMPU_METHOD 0 0 0 4294967295 ECU_ADDRESS 0 SYMBOL_LINK "Rte_DiagcMgr_SnpshtDataAry[2].MicroDiagcData" 0 DISPLAY_IDENTIFIER DiagcMgr.PerInstanceMemories.SnpshtDataAry[2].MicroDiagcData /end MEASUREMENT
/begin MEASUREMENT DiagcMgr.SnpshtDataAry[2].MotTq "MICROSAR RTE" SWORD NO_COMPU_METHOD 0 0 -32768 32767 ECU_ADDRESS 0 SYMBOL_LINK "Rte_DiagcMgr_SnpshtDataAry[2].MotTq" 0 DISPLAY_IDENTIFIER DiagcMgr.PerInstanceMemories.SnpshtDataAry[2].MotTq /end MEASUREMENT
/begin MEASUREMENT DiagcMgr.SnpshtDataAry[2].NtcNr "MICROSAR RTE" UWORD NO_COMPU_METHOD 0 0 0 65535 ECU_ADDRESS 0 SYMBOL_LINK "Rte_DiagcMgr_SnpshtDataAry[2].NtcNr" 0 DISPLAY_IDENTIFIER DiagcMgr.PerInstanceMemories.SnpshtDataAry[2].NtcNr /end MEASUREMENT
/begin MEASUREMENT DiagcMgr.SnpshtDataAry[2].NtcStInfo "MICROSAR RTE" UBYTE NO_COMPU_METHOD 0 0 0 255 ECU_ADDRESS 0 SYMBOL_LINK "Rte_DiagcMgr_SnpshtDataAry[2].NtcStInfo" 0 DISPLAY_IDENTIFIER DiagcMgr.PerInstanceMemories.SnpshtDataAry[2].NtcStInfo /end MEASUREMENT
/begin MEASUREMENT DiagcMgr.SnpshtDataAry[2].SysSt "MICROSAR RTE" UBYTE RTE_CM_ENUM_SysSt1 0 0 0 255 ECU_ADDRESS 0 SYMBOL_LINK "Rte_DiagcMgr_SnpshtDataAry[2].SysSt" 0 DISPLAY_IDENTIFIER DiagcMgr.PerInstanceMemories.SnpshtDataAry[2].SysSt /end MEASUREMENT
/begin MEASUREMENT DiagcMgr.SnpshtDataAry[2].VehSpd "MICROSAR RTE" UWORD NO_COMPU_METHOD 0 0 0 65535 ECU_ADDRESS 0 SYMBOL_LINK "Rte_DiagcMgr_SnpshtDataAry[2].VehSpd" 0 DISPLAY_IDENTIFIER DiagcMgr.PerInstanceMemories.SnpshtDataAry[2].VehSpd /end MEASUREMENT
/begin MEASUREMENT DiagcMgr.SnpshtDataAry[3].BrdgVltg "MICROSAR RTE" UWORD NO_COMPU_METHOD 0 0 0 65535 ECU_ADDRESS 0 SYMBOL_LINK "Rte_DiagcMgr_SnpshtDataAry[3].BrdgVltg" 0 DISPLAY_IDENTIFIER DiagcMgr.PerInstanceMemories.SnpshtDataAry[3].BrdgVltg /end MEASUREMENT
/begin MEASUREMENT DiagcMgr.SnpshtDataAry[3].EcuT "MICROSAR RTE" SWORD NO_COMPU_METHOD 0 0 -32768 32767 ECU_ADDRESS 0 SYMBOL_LINK "Rte_DiagcMgr_SnpshtDataAry[3].EcuT" 0 DISPLAY_IDENTIFIER DiagcMgr.PerInstanceMemories.SnpshtDataAry[3].EcuT /end MEASUREMENT
/begin MEASUREMENT DiagcMgr.SnpshtDataAry[3].HwTq "MICROSAR RTE" SWORD NO_COMPU_METHOD 0 0 -32768 32767 ECU_ADDRESS 0 SYMBOL_LINK "Rte_DiagcMgr_SnpshtDataAry[3].HwTq" 0 DISPLAY_IDENTIFIER DiagcMgr.PerInstanceMemories.SnpshtDataAry[3].HwTq /end MEASUREMENT
/begin MEASUREMENT DiagcMgr.SnpshtDataAry[3].IgnCntr "MICROSAR RTE" ULONG NO_COMPU_METHOD 0 0 0 4294967295 ECU_ADDRESS 0 SYMBOL_LINK "Rte_DiagcMgr_SnpshtDataAry[3].IgnCntr" 0 DISPLAY_IDENTIFIER DiagcMgr.PerInstanceMemories.SnpshtDataAry[3].IgnCntr /end MEASUREMENT
/begin MEASUREMENT DiagcMgr.SnpshtDataAry[3].MicroDiagcData "MICROSAR RTE" ULONG NO_COMPU_METHOD 0 0 0 4294967295 ECU_ADDRESS 0 SYMBOL_LINK "Rte_DiagcMgr_SnpshtDataAry[3].MicroDiagcData" 0 DISPLAY_IDENTIFIER DiagcMgr.PerInstanceMemories.SnpshtDataAry[3].MicroDiagcData /end MEASUREMENT
/begin MEASUREMENT DiagcMgr.SnpshtDataAry[3].MotTq "MICROSAR RTE" SWORD NO_COMPU_METHOD 0 0 -32768 32767 ECU_ADDRESS 0 SYMBOL_LINK "Rte_DiagcMgr_SnpshtDataAry[3].MotTq" 0 DISPLAY_IDENTIFIER DiagcMgr.PerInstanceMemories.SnpshtDataAry[3].MotTq /end MEASUREMENT
/begin MEASUREMENT DiagcMgr.SnpshtDataAry[3].NtcNr "MICROSAR RTE" UWORD NO_COMPU_METHOD 0 0 0 65535 ECU_ADDRESS 0 SYMBOL_LINK "Rte_DiagcMgr_SnpshtDataAry[3].NtcNr" 0 DISPLAY_IDENTIFIER DiagcMgr.PerInstanceMemories.SnpshtDataAry[3].NtcNr /end MEASUREMENT
/begin MEASUREMENT DiagcMgr.SnpshtDataAry[3].NtcStInfo "MICROSAR RTE" UBYTE NO_COMPU_METHOD 0 0 0 255 ECU_ADDRESS 0 SYMBOL_LINK "Rte_DiagcMgr_SnpshtDataAry[3].NtcStInfo" 0 DISPLAY_IDENTIFIER DiagcMgr.PerInstanceMemories.SnpshtDataAry[3].NtcStInfo /end MEASUREMENT
/begin MEASUREMENT DiagcMgr.SnpshtDataAry[3].SysSt "MICROSAR RTE" UBYTE RTE_CM_ENUM_SysSt1 0 0 0 255 ECU_ADDRESS 0 SYMBOL_LINK "Rte_DiagcMgr_SnpshtDataAry[3].SysSt" 0 DISPLAY_IDENTIFIER DiagcMgr.PerInstanceMemories.SnpshtDataAry[3].SysSt /end MEASUREMENT
/begin MEASUREMENT DiagcMgr.SnpshtDataAry[3].VehSpd "MICROSAR RTE" UWORD NO_COMPU_METHOD 0 0 0 65535 ECU_ADDRESS 0 SYMBOL_LINK "Rte_DiagcMgr_SnpshtDataAry[3].VehSpd" 0 DISPLAY_IDENTIFIER DiagcMgr.PerInstanceMemories.SnpshtDataAry[3].VehSpd /end MEASUREMENT
/begin MEASUREMENT DiagcMgr.SnpshtDataAry[4].BrdgVltg "MICROSAR RTE" UWORD NO_COMPU_METHOD 0 0 0 65535 ECU_ADDRESS 0 SYMBOL_LINK "Rte_DiagcMgr_SnpshtDataAry[4].BrdgVltg" 0 DISPLAY_IDENTIFIER DiagcMgr.PerInstanceMemories.SnpshtDataAry[4].BrdgVltg /end MEASUREMENT
/begin MEASUREMENT DiagcMgr.SnpshtDataAry[4].EcuT "MICROSAR RTE" SWORD NO_COMPU_METHOD 0 0 -32768 32767 ECU_ADDRESS 0 SYMBOL_LINK "Rte_DiagcMgr_SnpshtDataAry[4].EcuT" 0 DISPLAY_IDENTIFIER DiagcMgr.PerInstanceMemories.SnpshtDataAry[4].EcuT /end MEASUREMENT
/begin MEASUREMENT DiagcMgr.SnpshtDataAry[4].HwTq "MICROSAR RTE" SWORD NO_COMPU_METHOD 0 0 -32768 32767 ECU_ADDRESS 0 SYMBOL_LINK "Rte_DiagcMgr_SnpshtDataAry[4].HwTq" 0 DISPLAY_IDENTIFIER DiagcMgr.PerInstanceMemories.SnpshtDataAry[4].HwTq /end MEASUREMENT
/begin MEASUREMENT DiagcMgr.SnpshtDataAry[4].IgnCntr "MICROSAR RTE" ULONG NO_COMPU_METHOD 0 0 0 4294967295 ECU_ADDRESS 0 SYMBOL_LINK "Rte_DiagcMgr_SnpshtDataAry[4].IgnCntr" 0 DISPLAY_IDENTIFIER DiagcMgr.PerInstanceMemories.SnpshtDataAry[4].IgnCntr /end MEASUREMENT
/begin MEASUREMENT DiagcMgr.SnpshtDataAry[4].MicroDiagcData "MICROSAR RTE" ULONG NO_COMPU_METHOD 0 0 0 4294967295 ECU_ADDRESS 0 SYMBOL_LINK "Rte_DiagcMgr_SnpshtDataAry[4].MicroDiagcData" 0 DISPLAY_IDENTIFIER DiagcMgr.PerInstanceMemories.SnpshtDataAry[4].MicroDiagcData /end MEASUREMENT
/begin MEASUREMENT DiagcMgr.SnpshtDataAry[4].MotTq "MICROSAR RTE" SWORD NO_COMPU_METHOD 0 0 -32768 32767 ECU_ADDRESS 0 SYMBOL_LINK "Rte_DiagcMgr_SnpshtDataAry[4].MotTq" 0 DISPLAY_IDENTIFIER DiagcMgr.PerInstanceMemories.SnpshtDataAry[4].MotTq /end MEASUREMENT
/begin MEASUREMENT DiagcMgr.SnpshtDataAry[4].NtcNr "MICROSAR RTE" UWORD NO_COMPU_METHOD 0 0 0 65535 ECU_ADDRESS 0 SYMBOL_LINK "Rte_DiagcMgr_SnpshtDataAry[4].NtcNr" 0 DISPLAY_IDENTIFIER DiagcMgr.PerInstanceMemories.SnpshtDataAry[4].NtcNr /end MEASUREMENT
/begin MEASUREMENT DiagcMgr.SnpshtDataAry[4].NtcStInfo "MICROSAR RTE" UBYTE NO_COMPU_METHOD 0 0 0 255 ECU_ADDRESS 0 SYMBOL_LINK "Rte_DiagcMgr_SnpshtDataAry[4].NtcStInfo" 0 DISPLAY_IDENTIFIER DiagcMgr.PerInstanceMemories.SnpshtDataAry[4].NtcStInfo /end MEASUREMENT
/begin MEASUREMENT DiagcMgr.SnpshtDataAry[4].SysSt "MICROSAR RTE" UBYTE RTE_CM_ENUM_SysSt1 0 0 0 255 ECU_ADDRESS 0 SYMBOL_LINK "Rte_DiagcMgr_SnpshtDataAry[4].SysSt" 0 DISPLAY_IDENTIFIER DiagcMgr.PerInstanceMemories.SnpshtDataAry[4].SysSt /end MEASUREMENT
/begin MEASUREMENT DiagcMgr.SnpshtDataAry[4].VehSpd "MICROSAR RTE" UWORD NO_COMPU_METHOD 0 0 0 65535 ECU_ADDRESS 0 SYMBOL_LINK "Rte_DiagcMgr_SnpshtDataAry[4].VehSpd" 0 DISPLAY_IDENTIFIER DiagcMgr.PerInstanceMemories.SnpshtDataAry[4].VehSpd /end MEASUREMENT
/begin MEASUREMENT DiagcMgr.SnpshtDataAry[5].BrdgVltg "MICROSAR RTE" UWORD NO_COMPU_METHOD 0 0 0 65535 ECU_ADDRESS 0 SYMBOL_LINK "Rte_DiagcMgr_SnpshtDataAry[5].BrdgVltg" 0 DISPLAY_IDENTIFIER DiagcMgr.PerInstanceMemories.SnpshtDataAry[5].BrdgVltg /end MEASUREMENT
/begin MEASUREMENT DiagcMgr.SnpshtDataAry[5].EcuT "MICROSAR RTE" SWORD NO_COMPU_METHOD 0 0 -32768 32767 ECU_ADDRESS 0 SYMBOL_LINK "Rte_DiagcMgr_SnpshtDataAry[5].EcuT" 0 DISPLAY_IDENTIFIER DiagcMgr.PerInstanceMemories.SnpshtDataAry[5].EcuT /end MEASUREMENT
/begin MEASUREMENT DiagcMgr.SnpshtDataAry[5].HwTq "MICROSAR RTE" SWORD NO_COMPU_METHOD 0 0 -32768 32767 ECU_ADDRESS 0 SYMBOL_LINK "Rte_DiagcMgr_SnpshtDataAry[5].HwTq" 0 DISPLAY_IDENTIFIER DiagcMgr.PerInstanceMemories.SnpshtDataAry[5].HwTq /end MEASUREMENT
/begin MEASUREMENT DiagcMgr.SnpshtDataAry[5].IgnCntr "MICROSAR RTE" ULONG NO_COMPU_METHOD 0 0 0 4294967295 ECU_ADDRESS 0 SYMBOL_LINK "Rte_DiagcMgr_SnpshtDataAry[5].IgnCntr" 0 DISPLAY_IDENTIFIER DiagcMgr.PerInstanceMemories.SnpshtDataAry[5].IgnCntr /end MEASUREMENT
/begin MEASUREMENT DiagcMgr.SnpshtDataAry[5].MicroDiagcData "MICROSAR RTE" ULONG NO_COMPU_METHOD 0 0 0 4294967295 ECU_ADDRESS 0 SYMBOL_LINK "Rte_DiagcMgr_SnpshtDataAry[5].MicroDiagcData" 0 DISPLAY_IDENTIFIER DiagcMgr.PerInstanceMemories.SnpshtDataAry[5].MicroDiagcData /end MEASUREMENT
/begin MEASUREMENT DiagcMgr.SnpshtDataAry[5].MotTq "MICROSAR RTE" SWORD NO_COMPU_METHOD 0 0 -32768 32767 ECU_ADDRESS 0 SYMBOL_LINK "Rte_DiagcMgr_SnpshtDataAry[5].MotTq" 0 DISPLAY_IDENTIFIER DiagcMgr.PerInstanceMemories.SnpshtDataAry[5].MotTq /end MEASUREMENT
/begin MEASUREMENT DiagcMgr.SnpshtDataAry[5].NtcNr "MICROSAR RTE" UWORD NO_COMPU_METHOD 0 0 0 65535 ECU_ADDRESS 0 SYMBOL_LINK "Rte_DiagcMgr_SnpshtDataAry[5].NtcNr" 0 DISPLAY_IDENTIFIER DiagcMgr.PerInstanceMemories.SnpshtDataAry[5].NtcNr /end MEASUREMENT
/begin MEASUREMENT DiagcMgr.SnpshtDataAry[5].NtcStInfo "MICROSAR RTE" UBYTE NO_COMPU_METHOD 0 0 0 255 ECU_ADDRESS 0 SYMBOL_LINK "Rte_DiagcMgr_SnpshtDataAry[5].NtcStInfo" 0 DISPLAY_IDENTIFIER DiagcMgr.PerInstanceMemories.SnpshtDataAry[5].NtcStInfo /end MEASUREMENT
/begin MEASUREMENT DiagcMgr.SnpshtDataAry[5].SysSt "MICROSAR RTE" UBYTE RTE_CM_ENUM_SysSt1 0 0 0 255 ECU_ADDRESS 0 SYMBOL_LINK "Rte_DiagcMgr_SnpshtDataAry[5].SysSt" 0 DISPLAY_IDENTIFIER DiagcMgr.PerInstanceMemories.SnpshtDataAry[5].SysSt /end MEASUREMENT
/begin MEASUREMENT DiagcMgr.SnpshtDataAry[5].VehSpd "MICROSAR RTE" UWORD NO_COMPU_METHOD 0 0 0 65535 ECU_ADDRESS 0 SYMBOL_LINK "Rte_DiagcMgr_SnpshtDataAry[5].VehSpd" 0 DISPLAY_IDENTIFIER DiagcMgr.PerInstanceMemories.SnpshtDataAry[5].VehSpd /end MEASUREMENT
/begin MEASUREMENT DiagcMgr.SnpshtDataAry[6].BrdgVltg "MICROSAR RTE" UWORD NO_COMPU_METHOD 0 0 0 65535 ECU_ADDRESS 0 SYMBOL_LINK "Rte_DiagcMgr_SnpshtDataAry[6].BrdgVltg" 0 DISPLAY_IDENTIFIER DiagcMgr.PerInstanceMemories.SnpshtDataAry[6].BrdgVltg /end MEASUREMENT
/begin MEASUREMENT DiagcMgr.SnpshtDataAry[6].EcuT "MICROSAR RTE" SWORD NO_COMPU_METHOD 0 0 -32768 32767 ECU_ADDRESS 0 SYMBOL_LINK "Rte_DiagcMgr_SnpshtDataAry[6].EcuT" 0 DISPLAY_IDENTIFIER DiagcMgr.PerInstanceMemories.SnpshtDataAry[6].EcuT /end MEASUREMENT
/begin MEASUREMENT DiagcMgr.SnpshtDataAry[6].HwTq "MICROSAR RTE" SWORD NO_COMPU_METHOD 0 0 -32768 32767 ECU_ADDRESS 0 SYMBOL_LINK "Rte_DiagcMgr_SnpshtDataAry[6].HwTq" 0 DISPLAY_IDENTIFIER DiagcMgr.PerInstanceMemories.SnpshtDataAry[6].HwTq /end MEASUREMENT
/begin MEASUREMENT DiagcMgr.SnpshtDataAry[6].IgnCntr "MICROSAR RTE" ULONG NO_COMPU_METHOD 0 0 0 4294967295 ECU_ADDRESS 0 SYMBOL_LINK "Rte_DiagcMgr_SnpshtDataAry[6].IgnCntr" 0 DISPLAY_IDENTIFIER DiagcMgr.PerInstanceMemories.SnpshtDataAry[6].IgnCntr /end MEASUREMENT
/begin MEASUREMENT DiagcMgr.SnpshtDataAry[6].MicroDiagcData "MICROSAR RTE" ULONG NO_COMPU_METHOD 0 0 0 4294967295 ECU_ADDRESS 0 SYMBOL_LINK "Rte_DiagcMgr_SnpshtDataAry[6].MicroDiagcData" 0 DISPLAY_IDENTIFIER DiagcMgr.PerInstanceMemories.SnpshtDataAry[6].MicroDiagcData /end MEASUREMENT
/begin MEASUREMENT DiagcMgr.SnpshtDataAry[6].MotTq "MICROSAR RTE" SWORD NO_COMPU_METHOD 0 0 -32768 32767 ECU_ADDRESS 0 SYMBOL_LINK "Rte_DiagcMgr_SnpshtDataAry[6].MotTq" 0 DISPLAY_IDENTIFIER DiagcMgr.PerInstanceMemories.SnpshtDataAry[6].MotTq /end MEASUREMENT
/begin MEASUREMENT DiagcMgr.SnpshtDataAry[6].NtcNr "MICROSAR RTE" UWORD NO_COMPU_METHOD 0 0 0 65535 ECU_ADDRESS 0 SYMBOL_LINK "Rte_DiagcMgr_SnpshtDataAry[6].NtcNr" 0 DISPLAY_IDENTIFIER DiagcMgr.PerInstanceMemories.SnpshtDataAry[6].NtcNr /end MEASUREMENT
/begin MEASUREMENT DiagcMgr.SnpshtDataAry[6].NtcStInfo "MICROSAR RTE" UBYTE NO_COMPU_METHOD 0 0 0 255 ECU_ADDRESS 0 SYMBOL_LINK "Rte_DiagcMgr_SnpshtDataAry[6].NtcStInfo" 0 DISPLAY_IDENTIFIER DiagcMgr.PerInstanceMemories.SnpshtDataAry[6].NtcStInfo /end MEASUREMENT
/begin MEASUREMENT DiagcMgr.SnpshtDataAry[6].SysSt "MICROSAR RTE" UBYTE RTE_CM_ENUM_SysSt1 0 0 0 255 ECU_ADDRESS 0 SYMBOL_LINK "Rte_DiagcMgr_SnpshtDataAry[6].SysSt" 0 DISPLAY_IDENTIFIER DiagcMgr.PerInstanceMemories.SnpshtDataAry[6].SysSt /end MEASUREMENT
/begin MEASUREMENT DiagcMgr.SnpshtDataAry[6].VehSpd "MICROSAR RTE" UWORD NO_COMPU_METHOD 0 0 0 65535 ECU_ADDRESS 0 SYMBOL_LINK "Rte_DiagcMgr_SnpshtDataAry[6].VehSpd" 0 DISPLAY_IDENTIFIER DiagcMgr.PerInstanceMemories.SnpshtDataAry[6].VehSpd /end MEASUREMENT
/begin MEASUREMENT DiagcMgr.SnpshtDataAry[7].BrdgVltg "MICROSAR RTE" UWORD NO_COMPU_METHOD 0 0 0 65535 ECU_ADDRESS 0 SYMBOL_LINK "Rte_DiagcMgr_SnpshtDataAry[7].BrdgVltg" 0 DISPLAY_IDENTIFIER DiagcMgr.PerInstanceMemories.SnpshtDataAry[7].BrdgVltg /end MEASUREMENT
/begin MEASUREMENT DiagcMgr.SnpshtDataAry[7].EcuT "MICROSAR RTE" SWORD NO_COMPU_METHOD 0 0 -32768 32767 ECU_ADDRESS 0 SYMBOL_LINK "Rte_DiagcMgr_SnpshtDataAry[7].EcuT" 0 DISPLAY_IDENTIFIER DiagcMgr.PerInstanceMemories.SnpshtDataAry[7].EcuT /end MEASUREMENT
/begin MEASUREMENT DiagcMgr.SnpshtDataAry[7].HwTq "MICROSAR RTE" SWORD NO_COMPU_METHOD 0 0 -32768 32767 ECU_ADDRESS 0 SYMBOL_LINK "Rte_DiagcMgr_SnpshtDataAry[7].HwTq" 0 DISPLAY_IDENTIFIER DiagcMgr.PerInstanceMemories.SnpshtDataAry[7].HwTq /end MEASUREMENT
/begin MEASUREMENT DiagcMgr.SnpshtDataAry[7].IgnCntr "MICROSAR RTE" ULONG NO_COMPU_METHOD 0 0 0 4294967295 ECU_ADDRESS 0 SYMBOL_LINK "Rte_DiagcMgr_SnpshtDataAry[7].IgnCntr" 0 DISPLAY_IDENTIFIER DiagcMgr.PerInstanceMemories.SnpshtDataAry[7].IgnCntr /end MEASUREMENT
/begin MEASUREMENT DiagcMgr.SnpshtDataAry[7].MicroDiagcData "MICROSAR RTE" ULONG NO_COMPU_METHOD 0 0 0 4294967295 ECU_ADDRESS 0 SYMBOL_LINK "Rte_DiagcMgr_SnpshtDataAry[7].MicroDiagcData" 0 DISPLAY_IDENTIFIER DiagcMgr.PerInstanceMemories.SnpshtDataAry[7].MicroDiagcData /end MEASUREMENT
/begin MEASUREMENT DiagcMgr.SnpshtDataAry[7].MotTq "MICROSAR RTE" SWORD NO_COMPU_METHOD 0 0 -32768 32767 ECU_ADDRESS 0 SYMBOL_LINK "Rte_DiagcMgr_SnpshtDataAry[7].MotTq" 0 DISPLAY_IDENTIFIER DiagcMgr.PerInstanceMemories.SnpshtDataAry[7].MotTq /end MEASUREMENT
/begin MEASUREMENT DiagcMgr.SnpshtDataAry[7].NtcNr "MICROSAR RTE" UWORD NO_COMPU_METHOD 0 0 0 65535 ECU_ADDRESS 0 SYMBOL_LINK "Rte_DiagcMgr_SnpshtDataAry[7].NtcNr" 0 DISPLAY_IDENTIFIER DiagcMgr.PerInstanceMemories.SnpshtDataAry[7].NtcNr /end MEASUREMENT
/begin MEASUREMENT DiagcMgr.SnpshtDataAry[7].NtcStInfo "MICROSAR RTE" UBYTE NO_COMPU_METHOD 0 0 0 255 ECU_ADDRESS 0 SYMBOL_LINK "Rte_DiagcMgr_SnpshtDataAry[7].NtcStInfo" 0 DISPLAY_IDENTIFIER DiagcMgr.PerInstanceMemories.SnpshtDataAry[7].NtcStInfo /end MEASUREMENT
/begin MEASUREMENT DiagcMgr.SnpshtDataAry[7].SysSt "MICROSAR RTE" UBYTE RTE_CM_ENUM_SysSt1 0 0 0 255 ECU_ADDRESS 0 SYMBOL_LINK "Rte_DiagcMgr_SnpshtDataAry[7].SysSt" 0 DISPLAY_IDENTIFIER DiagcMgr.PerInstanceMemories.SnpshtDataAry[7].SysSt /end MEASUREMENT
/begin MEASUREMENT DiagcMgr.SnpshtDataAry[7].VehSpd "MICROSAR RTE" UWORD NO_COMPU_METHOD 0 0 0 65535 ECU_ADDRESS 0 SYMBOL_LINK "Rte_DiagcMgr_SnpshtDataAry[7].VehSpd" 0 DISPLAY_IDENTIFIER DiagcMgr.PerInstanceMemories.SnpshtDataAry[7].VehSpd /end MEASUREMENT
/begin MEASUREMENT DiagcMgr.SysDiMotTqCmdSca.Val "MICROSAR RTE" FLOAT32_IEEE NO_COMPU_METHOD 0 0 -3.402823466e+38 3.402823466e+38 ECU_ADDRESS 0 SYMBOL_LINK "Rte_DiagcMgr_SysDiMotTqCmdSca_Val" 0 DISPLAY_IDENTIFIER DiagcMgr.SenderPorts.SysDiMotTqCmdSca.Val /end MEASUREMENT
/begin MEASUREMENT DiagcMgr.SysDiRampRate.Val "MICROSAR RTE" FLOAT32_IEEE NO_COMPU_METHOD 0 0 -3.402823466e+38 3.402823466e+38 ECU_ADDRESS 0 SYMBOL_LINK "Rte_DiagcMgr_SysDiRampRate_Val" 0 DISPLAY_IDENTIFIER DiagcMgr.SenderPorts.SysDiRampRate.Val /end MEASUREMENT
/begin MEASUREMENT DiagcMgr.SysSt.Val "MICROSAR RTE" UBYTE RTE_CM_ENUM_SysSt1 0 0 0 255 ECU_ADDRESS 0 SYMBOL_LINK "Rte_SysStMod_SysSt_Val" 0 DISPLAY_IDENTIFIER DiagcMgr.ReceiverPorts.SysSt.Val /end MEASUREMENT
/begin MEASUREMENT DiagcMgr.SysStFltOutpReqDi.Logl "MICROSAR RTE" UBYTE RTE_CM_BOOLEAN 0 0 0 255 ECU_ADDRESS 0 SYMBOL_LINK "Rte_DiagcMgr_SysStFltOutpReqDi_Logl" 0 DISPLAY_IDENTIFIER DiagcMgr.SenderPorts.SysStFltOutpReqDi.Logl /end MEASUREMENT
/begin MEASUREMENT DiagcMgr.VehSpd.Val "MICROSAR RTE" FLOAT32_IEEE NO_COMPU_METHOD 0 0 -3.402823466e+38 3.402823466e+38 ECU_ADDRESS 0 SYMBOL_LINK "Rte_VehSigCdng_VehSpd_Val" 0 DISPLAY_IDENTIFIER DiagcMgr.ReceiverPorts.VehSpd.Val /end MEASUREMENT
/begin MEASUREMENT DiagcMgrProxyAppl10.ClrDiagcFlgProxy.Val "MICROSAR RTE" UBYTE NO_COMPU_METHOD 0 0 0 255 ECU_ADDRESS 0 SYMBOL_LINK "Rte_DiagcMgr_ClrDiagcFlgProxy_Val" 0 DISPLAY_IDENTIFIER DiagcMgrProxyAppl10.ReceiverPorts.ClrDiagcFlgProxy.Val /end MEASUREMENT
/begin MEASUREMENT DiagcMgrProxyAppl10.DiagcData10.ActvMotTqCmdSca "MICROSAR RTE" FLOAT32_IEEE NO_COMPU_METHOD 0 0 -3.402823466e+38 3.402823466e+38 ECU_ADDRESS 0 SYMBOL_LINK "Rte_DiagcMgrProxyAppl10_DiagcData10.ActvMotTqCmdSca" 0 DISPLAY_IDENTIFIER DiagcMgrProxyAppl10.PerInstanceMemories.DiagcData10.ActvMotTqCmdSca /end MEASUREMENT
/begin MEASUREMENT DiagcMgrProxyAppl10.DiagcData10.ActvRampRate "MICROSAR RTE" FLOAT32_IEEE NO_COMPU_METHOD 0 0 -3.402823466e+38 3.402823466e+38 ECU_ADDRESS 0 SYMBOL_LINK "Rte_DiagcMgrProxyAppl10_DiagcData10.ActvRampRate" 0 DISPLAY_IDENTIFIER DiagcMgrProxyAppl10.PerInstanceMemories.DiagcData10.ActvRampRate /end MEASUREMENT
/begin MEASUREMENT DiagcMgrProxyAppl10.DiagcData10.DiagcSts "MICROSAR RTE" UWORD NO_COMPU_METHOD 0 0 0 65535 ECU_ADDRESS 0 SYMBOL_LINK "Rte_DiagcMgrProxyAppl10_DiagcData10.DiagcSts" 0 DISPLAY_IDENTIFIER DiagcMgrProxyAppl10.PerInstanceMemories.DiagcData10.DiagcSts /end MEASUREMENT
/begin MEASUREMENT DiagcMgrProxyAppl10.PrevClrNtcFlg10 "MICROSAR RTE" UBYTE NO_COMPU_METHOD 0 0 0 255 ECU_ADDRESS 0 SYMBOL_LINK "Rte_DiagcMgrProxyAppl10_PrevClrNtcFlg10" 0 DISPLAY_IDENTIFIER DiagcMgrProxyAppl10.PerInstanceMemories.PrevClrNtcFlg10 /end MEASUREMENT
/begin MEASUREMENT DiagcMgrProxyAppl10.ProxySetNtcData10.ActvMotTqCmdSca "MICROSAR RTE" FLOAT32_IEEE NO_COMPU_METHOD 0 0 -3.402823466e+38 3.402823466e+38 ECU_ADDRESS 0 SYMBOL_LINK "Rte_DiagcMgrProxyAppl10_ProxySetNtcData10.ActvMotTqCmdSca" 0 DISPLAY_IDENTIFIER DiagcMgrProxyAppl10.PerInstanceMemories.ProxySetNtcData10.ActvMotTqCmdSca /end MEASUREMENT
/begin MEASUREMENT DiagcMgrProxyAppl10.ProxySetNtcData10.ActvRampRate "MICROSAR RTE" FLOAT32_IEEE NO_COMPU_METHOD 0 0 -3.402823466e+38 3.402823466e+38 ECU_ADDRESS 0 SYMBOL_LINK "Rte_DiagcMgrProxyAppl10_ProxySetNtcData10.ActvRampRate" 0 DISPLAY_IDENTIFIER DiagcMgrProxyAppl10.PerInstanceMemories.ProxySetNtcData10.ActvRampRate /end MEASUREMENT
/begin MEASUREMENT DiagcMgrProxyAppl10.ProxySetNtcData10.DiagcSts "MICROSAR RTE" UWORD NO_COMPU_METHOD 0 0 0 65535 ECU_ADDRESS 0 SYMBOL_LINK "Rte_DiagcMgrProxyAppl10_ProxySetNtcData10.DiagcSts" 0 DISPLAY_IDENTIFIER DiagcMgrProxyAppl10.PerInstanceMemories.ProxySetNtcData10.DiagcSts /end MEASUREMENT
/begin MEASUREMENT DiagcMgrProxyAppl6.ClrDiagcFlgProxy.Val "MICROSAR RTE" UBYTE NO_COMPU_METHOD 0 0 0 255 ECU_ADDRESS 0 SYMBOL_LINK "Rte_DiagcMgr_ClrDiagcFlgProxy_Val" 0 DISPLAY_IDENTIFIER DiagcMgrProxyAppl6.ReceiverPorts.ClrDiagcFlgProxy.Val /end MEASUREMENT
/begin MEASUREMENT DiagcMgrProxyAppl6.DiagcData6.ActvMotTqCmdSca "MICROSAR RTE" FLOAT32_IEEE NO_COMPU_METHOD 0 0 -3.402823466e+38 3.402823466e+38 ECU_ADDRESS 0 SYMBOL_LINK "Rte_DiagcMgrProxyAppl6_DiagcData6.ActvMotTqCmdSca" 0 DISPLAY_IDENTIFIER DiagcMgrProxyAppl6.PerInstanceMemories.DiagcData6.ActvMotTqCmdSca /end MEASUREMENT
/begin MEASUREMENT DiagcMgrProxyAppl6.DiagcData6.ActvRampRate "MICROSAR RTE" FLOAT32_IEEE NO_COMPU_METHOD 0 0 -3.402823466e+38 3.402823466e+38 ECU_ADDRESS 0 SYMBOL_LINK "Rte_DiagcMgrProxyAppl6_DiagcData6.ActvRampRate" 0 DISPLAY_IDENTIFIER DiagcMgrProxyAppl6.PerInstanceMemories.DiagcData6.ActvRampRate /end MEASUREMENT
/begin MEASUREMENT DiagcMgrProxyAppl6.DiagcData6.DiagcSts "MICROSAR RTE" UWORD NO_COMPU_METHOD 0 0 0 65535 ECU_ADDRESS 0 SYMBOL_LINK "Rte_DiagcMgrProxyAppl6_DiagcData6.DiagcSts" 0 DISPLAY_IDENTIFIER DiagcMgrProxyAppl6.PerInstanceMemories.DiagcData6.DiagcSts /end MEASUREMENT
/begin MEASUREMENT DiagcMgrProxyAppl6.PrevClrNtcFlg6 "MICROSAR RTE" UBYTE NO_COMPU_METHOD 0 0 0 255 ECU_ADDRESS 0 SYMBOL_LINK "Rte_DiagcMgrProxyAppl6_PrevClrNtcFlg6" 0 DISPLAY_IDENTIFIER DiagcMgrProxyAppl6.PerInstanceMemories.PrevClrNtcFlg6 /end MEASUREMENT
/begin MEASUREMENT DiagcMgrProxyAppl6.ProxySetNtcData6.ActvMotTqCmdSca "MICROSAR RTE" FLOAT32_IEEE NO_COMPU_METHOD 0 0 -3.402823466e+38 3.402823466e+38 ECU_ADDRESS 0 SYMBOL_LINK "Rte_DiagcMgrProxyAppl6_ProxySetNtcData6.ActvMotTqCmdSca" 0 DISPLAY_IDENTIFIER DiagcMgrProxyAppl6.PerInstanceMemories.ProxySetNtcData6.ActvMotTqCmdSca /end MEASUREMENT
/begin MEASUREMENT DiagcMgrProxyAppl6.ProxySetNtcData6.ActvRampRate "MICROSAR RTE" FLOAT32_IEEE NO_COMPU_METHOD 0 0 -3.402823466e+38 3.402823466e+38 ECU_ADDRESS 0 SYMBOL_LINK "Rte_DiagcMgrProxyAppl6_ProxySetNtcData6.ActvRampRate" 0 DISPLAY_IDENTIFIER DiagcMgrProxyAppl6.PerInstanceMemories.ProxySetNtcData6.ActvRampRate /end MEASUREMENT
/begin MEASUREMENT DiagcMgrProxyAppl6.ProxySetNtcData6.DiagcSts "MICROSAR RTE" UWORD NO_COMPU_METHOD 0 0 0 65535 ECU_ADDRESS 0 SYMBOL_LINK "Rte_DiagcMgrProxyAppl6_ProxySetNtcData6.DiagcSts" 0 DISPLAY_IDENTIFIER DiagcMgrProxyAppl6.PerInstanceMemories.ProxySetNtcData6.DiagcSts /end MEASUREMENT
/begin MEASUREMENT DualEcuIdn.EcuComTiOut.Logl "MICROSAR RTE" UBYTE RTE_CM_BOOLEAN 0 0 0 255 ECU_ADDRESS 0 SYMBOL_LINK "Rte_DualEcuIdn_EcuComTiOut_Logl" 0 DISPLAY_IDENTIFIER DualEcuIdn.ReceiverPorts.EcuComTiOut.Logl /end MEASUREMENT
/begin MEASUREMENT DualEcuIdn.EcuId.Val "MICROSAR RTE" UBYTE NO_COMPU_METHOD 0 0 0 255 ECU_ADDRESS 0 SYMBOL_LINK "Rte_DualEcuIdn_EcuId_Val" 0 DISPLAY_IDENTIFIER DualEcuIdn.SenderPorts.EcuId.Val /end MEASUREMENT
/begin MEASUREMENT DualEcuIdn.EcuIdInt "MICROSAR RTE" UBYTE NO_COMPU_METHOD 0 0 0 255 ECU_ADDRESS 0 SYMBOL_LINK "Rte_DualEcuIdn_EcuIdInt" 0 DISPLAY_IDENTIFIER DualEcuIdn.PerInstanceMemories.EcuIdInt /end MEASUREMENT
/begin MEASUREMENT DualEcuIdn.EcuIdnEvlnCmpl "MICROSAR RTE" UBYTE RTE_CM_BOOLEAN 0 0 0 255 ECU_ADDRESS 0 SYMBOL_LINK "Rte_DualEcuIdn_EcuIdnEvlnCmpl" 0 DISPLAY_IDENTIFIER DualEcuIdn.PerInstanceMemories.EcuIdnEvlnCmpl /end MEASUREMENT
/begin MEASUREMENT DualEcuIdn.SecdryEcuIdnReqTiOutCntr "MICROSAR RTE" UBYTE NO_COMPU_METHOD 0 0 0 255 ECU_ADDRESS 0 SYMBOL_LINK "Rte_DualEcuIdn_SecdryEcuIdnReqTiOutCntr" 0 DISPLAY_IDENTIFIER DualEcuIdn.PerInstanceMemories.SecdryEcuIdnReqTiOutCntr /end MEASUREMENT
/begin MEASUREMENT DutyCycThermProtn.AbsltTLimSlewStVari "MICROSAR RTE" FLOAT32_IEEE NO_COMPU_METHOD 0 0 -3.402823466e+38 3.402823466e+38 ECU_ADDRESS 0 SYMBOL_LINK "Rte_DutyCycThermProtn_AbsltTLimSlewStVari" 0 DISPLAY_IDENTIFIER DutyCycThermProtn.PerInstanceMemories.AbsltTLimSlewStVari /end MEASUREMENT
/begin MEASUREMENT DutyCycThermProtn.DiagcStsLimdTPrfmnc.Logl "MICROSAR RTE" UBYTE RTE_CM_BOOLEAN 0 0 0 255 ECU_ADDRESS 0 SYMBOL_LINK "Rte_DiagcMgr_DiagcStsLimdTPrfmnc_Logl" 0 DISPLAY_IDENTIFIER DutyCycThermProtn.ReceiverPorts.DiagcStsLimdTPrfmnc.Logl /end MEASUREMENT
/begin MEASUREMENT DutyCycThermProtn.DualEcuFltMtgtnEna.Logl "MICROSAR RTE" UBYTE RTE_CM_BOOLEAN 0 0 0 255 ECU_ADDRESS 0 SYMBOL_LINK "Rte_DutyCycThermProtn_DualEcuFltMtgtnEna_Logl" 0 DISPLAY_IDENTIFIER DutyCycThermProtn.ReceiverPorts.DualEcuFltMtgtnEna.Logl /end MEASUREMENT
/begin MEASUREMENT DutyCycThermProtn.DutyCycThermProtnDi.Logl "MICROSAR RTE" UBYTE RTE_CM_BOOLEAN 0 0 0 255 ECU_ADDRESS 0 SYMBOL_LINK "Rte_CmnMfgSrv_DutyCycThermProtnDi_Logl" 0 DISPLAY_IDENTIFIER DutyCycThermProtn.ReceiverPorts.DutyCycThermProtnDi.Logl /end MEASUREMENT
/begin MEASUREMENT DutyCycThermProtn.DutyCycThermProtnMaxOutp.Val "MICROSAR RTE" UWORD NO_COMPU_METHOD 0 0 0 65535 ECU_ADDRESS 0 SYMBOL_LINK "Rte_DutyCycThermProtn_DutyCycThermProtnMaxOutp_Val" 0 DISPLAY_IDENTIFIER DutyCycThermProtn.SenderPorts.DutyCycThermProtnMaxOutp.Val /end MEASUREMENT
/begin GROUP CustDiagc.EcuTFild.Val "MICROSAR RTE" /begin SUB_GROUP /end SUB_GROUP /begin FUNCTION_LIST /end FUNCTION_LIST /begin REF_CHARACTERISTIC /end REF_CHARACTERISTIC /begin REF_MEASUREMENT CustDiagc.EcuTFild.Val /end REF_MEASUREMENT /end GROUP
/begin GROUP CustDiagc.EngRunActv.Logl "MICROSAR RTE" /begin SUB_GROUP /end SUB_GROUP /begin FUNCTION_LIST /end FUNCTION_LIST /begin REF_CHARACTERISTIC /end REF_CHARACTERISTIC /begin REF_MEASUREMENT CustDiagc.EngRunActv.Logl /end REF_MEASUREMENT /end GROUP
/begin GROUP CustDiagc.EngSpd.Val "MICROSAR RTE" /begin SUB_GROUP /end SUB_GROUP /begin FUNCTION_LIST /end FUNCTION_LIST /begin REF_CHARACTERISTIC /end REF_CHARACTERISTIC /begin REF_MEASUREMENT CustDiagc.EngSpd.Val /end REF_MEASUREMENT /end GROUP
/begin GROUP CustDiagc.EotLrngRackTrvlMin.Val "MICROSAR RTE" /begin SUB_GROUP /end SUB_GROUP /begin FUNCTION_LIST /end FUNCTION_LIST /begin REF_CHARACTERISTIC CustDiagc.EotLrngRackTrvlMin.Val /end REF_CHARACTERISTIC /begin REF_MEASUREMENT /end REF_MEASUREMENT /end GROUP
/begin GROUP CustDiagc.GmDiCtrlPidTstRunng "MICROSAR RTE" /begin SUB_GROUP /end SUB_GROUP /begin FUNCTION_LIST /end FUNCTION_LIST /begin REF_CHARACTERISTIC /end REF_CHARACTERISTIC /begin REF_MEASUREMENT CustDiagc.GmDiCtrlPidTstRunng /end REF_MEASUREMENT /end GROUP
/begin GROUP CustDiagc.GmFctDiSts.Val "MICROSAR RTE" /begin SUB_GROUP /end SUB_GROUP /begin FUNCTION_LIST /end FUNCTION_LIST /begin REF_CHARACTERISTIC /end REF_CHARACTERISTIC /begin REF_MEASUREMENT CustDiagc.GmFctDiSts.Val /end REF_MEASUREMENT /end GROUP
/begin GROUP CustDiagc.GmIgnCntr "MICROSAR RTE" /begin SUB_GROUP /end SUB_GROUP /begin FUNCTION_LIST /end FUNCTION_LIST /begin REF_CHARACTERISTIC /end REF_CHARACTERISTIC /begin REF_MEASUREMENT CustDiagc.GmIgnCntr /end REF_MEASUREMENT /end GROUP
/begin GROUP CustDiagc.GmIgnCntr.Val "MICROSAR RTE" /begin SUB_GROUP /end SUB_GROUP /begin FUNCTION_LIST /end FUNCTION_LIST /begin REF_CHARACTERISTIC /end REF_CHARACTERISTIC /begin REF_MEASUREMENT CustDiagc.GmIgnCntr.Val /end REF_MEASUREMENT /end GROUP
/begin GROUP CustDiagc.GmOvrlStMgrApaMfgEna.Logl "MICROSAR RTE" /begin SUB_GROUP /end SUB_GROUP /begin FUNCTION_LIST /end FUNCTION_LIST /begin REF_CHARACTERISTIC CustDiagc.GmOvrlStMgrApaMfgEna.Logl /end REF_CHARACTERISTIC /begin REF_MEASUREMENT /end REF_MEASUREMENT /end GROUP
/begin GROUP CustDiagc.GmOvrlStMgrEscMfgEna.Logl "MICROSAR RTE" /begin SUB_GROUP /end SUB_GROUP /begin FUNCTION_LIST /end FUNCTION_LIST /begin REF_CHARACTERISTIC CustDiagc.GmOvrlStMgrEscMfgEna.Logl /end REF_CHARACTERISTIC /begin REF_MEASUREMENT /end REF_MEASUREMENT /end GROUP
/begin GROUP CustDiagc.GmOvrlStMgrLkaMfgEna.Logl "MICROSAR RTE" /begin SUB_GROUP /end SUB_GROUP /begin FUNCTION_LIST /end FUNCTION_LIST /begin REF_CHARACTERISTIC CustDiagc.GmOvrlStMgrLkaMfgEna.Logl /end REF_CHARACTERISTIC /begin REF_MEASUREMENT /end REF_MEASUREMENT /end GROUP
/begin GROUP CustDiagc.GmStrtStopEna.Logl "MICROSAR RTE" /begin SUB_GROUP /end SUB_GROUP /begin FUNCTION_LIST /end FUNCTION_LIST /begin REF_CHARACTERISTIC CustDiagc.GmStrtStopEna.Logl /end REF_CHARACTERISTIC /begin REF_MEASUREMENT /end REF_MEASUREMENT /end GROUP
/begin GROUP CustDiagc.HwAgCcwDetd.Logl "MICROSAR RTE" /begin SUB_GROUP /end SUB_GROUP /begin FUNCTION_LIST /end FUNCTION_LIST /begin REF_CHARACTERISTIC /end REF_CHARACTERISTIC /begin REF_MEASUREMENT CustDiagc.HwAgCcwDetd.Logl /end REF_MEASUREMENT /end GROUP
/begin GROUP CustDiagc.HwAgCwDetd.Logl "MICROSAR RTE" /begin SUB_GROUP /end SUB_GROUP /begin FUNCTION_LIST /end FUNCTION_LIST /begin REF_CHARACTERISTIC /end REF_CHARACTERISTIC /begin REF_MEASUREMENT CustDiagc.HwAgCwDetd.Logl /end REF_MEASUREMENT /end GROUP
/begin GROUP CustDiagc.HwAgEotCcw.Val "MICROSAR RTE" /begin SUB_GROUP /end SUB_GROUP /begin FUNCTION_LIST /end FUNCTION_LIST /begin REF_CHARACTERISTIC /end REF_CHARACTERISTIC /begin REF_MEASUREMENT CustDiagc.HwAgEotCcw.Val /end REF_MEASUREMENT /end GROUP
/begin GROUP CustDiagc.HwAgEotCw.Val "MICROSAR RTE" /begin SUB_GROUP /end SUB_GROUP /begin FUNCTION_LIST /end FUNCTION_LIST /begin REF_CHARACTERISTIC /end REF_CHARACTERISTIC /begin REF_MEASUREMENT CustDiagc.HwAgEotCw.Val /end REF_MEASUREMENT /end GROUP
/begin GROUP CustDiagc.HwAgTrimPrfmd.Logl "MICROSAR RTE" /begin SUB_GROUP /end SUB_GROUP /begin FUNCTION_LIST /end FUNCTION_LIST /begin REF_CHARACTERISTIC /end REF_CHARACTERISTIC /begin REF_MEASUREMENT CustDiagc.HwAgTrimPrfmd.Logl /end REF_MEASUREMENT /end GROUP
/begin GROUP CustDiagc.HwTq.Val "MICROSAR RTE" /begin SUB_GROUP /end SUB_GROUP /begin FUNCTION_LIST /end FUNCTION_LIST /begin REF_CHARACTERISTIC /end REF_CHARACTERISTIC /begin REF_MEASUREMENT CustDiagc.HwTq.Val /end REF_MEASUREMENT /end GROUP
/begin GROUP CustDiagc.HwTqIdptSig.Val "MICROSAR RTE" /begin SUB_GROUP /end SUB_GROUP /begin FUNCTION_LIST /end FUNCTION_LIST /begin REF_CHARACTERISTIC /end REF_CHARACTERISTIC /begin REF_MEASUREMENT CustDiagc.HwTqIdptSig.Val /end REF_MEASUREMENT /end GROUP
/begin GROUP CustDiagc.LkaCmd.Val "MICROSAR RTE" /begin SUB_GROUP /end SUB_GROUP /begin FUNCTION_LIST /end FUNCTION_LIST /begin REF_CHARACTERISTIC /end REF_CHARACTERISTIC /begin REF_MEASUREMENT CustDiagc.LkaCmd.Val /end REF_MEASUREMENT /end GROUP
/begin GROUP CustDiagc.LkaSt.Val "MICROSAR RTE" /begin SUB_GROUP /end SUB_GROUP /begin FUNCTION_LIST /end FUNCTION_LIST /begin REF_CHARACTERISTIC /end REF_CHARACTERISTIC /begin REF_MEASUREMENT CustDiagc.LkaSt.Val /end REF_MEASUREMENT /end GROUP
/begin GROUP CustDiagc.MissMsg0C9.Logl "MICROSAR RTE" /begin SUB_GROUP /end SUB_GROUP /begin FUNCTION_LIST /end FUNCTION_LIST /begin REF_CHARACTERISTIC /end REF_CHARACTERISTIC /begin REF_MEASUREMENT CustDiagc.MissMsg0C9.Logl /end REF_MEASUREMENT /end GROUP
/begin GROUP CustDiagc.MissMsg1F1.Logl "MICROSAR RTE" /begin SUB_GROUP /end SUB_GROUP /begin FUNCTION_LIST /end FUNCTION_LIST /begin REF_CHARACTERISTIC /end REF_CHARACTERISTIC /begin REF_MEASUREMENT CustDiagc.MissMsg1F1.Logl /end REF_MEASUREMENT /end GROUP
/begin GROUP CustDiagc.MotCurrDaxCmd.Val "MICROSAR RTE" /begin SUB_GROUP /end SUB_GROUP /begin FUNCTION_LIST /end FUNCTION_LIST /begin REF_CHARACTERISTIC /end REF_CHARACTERISTIC /begin REF_MEASUREMENT CustDiagc.MotCurrDaxCmd.Val /end REF_MEASUREMENT /end GROUP
/begin GROUP CustDiagc.MotCurrPeakEstimd.Val "MICROSAR RTE" /begin SUB_GROUP /end SUB_GROUP /begin FUNCTION_LIST /end FUNCTION_LIST /begin REF_CHARACTERISTIC /end REF_CHARACTERISTIC /begin REF_MEASUREMENT CustDiagc.MotCurrPeakEstimd.Val /end REF_MEASUREMENT /end GROUP
/begin GROUP CustDiagc.MotTqCmd.Val "MICROSAR RTE" /begin SUB_GROUP /end SUB_GROUP /begin FUNCTION_LIST /end FUNCTION_LIST /begin REF_CHARACTERISTIC /end REF_CHARACTERISTIC /begin REF_MEASUREMENT CustDiagc.MotTqCmd.Val /end REF_MEASUREMENT /end GROUP
/begin GROUP CustDiagc.MsgCntxt "MICROSAR RTE" /begin SUB_GROUP /end SUB_GROUP /begin FUNCTION_LIST /end FUNCTION_LIST /begin REF_CHARACTERISTIC /end REF_CHARACTERISTIC /begin REF_MEASUREMENT CustDiagc.MsgCntxt /end REF_MEASUREMENT /end GROUP
/begin GROUP CustDiagc.PerInstanceMemories "MICROSAR RTE"
 /begin SUB_GROUP CustDiagc.CpidActv CustDiagc.CustDiagcCtrlPidKeyAtmptCntr CustDiagc.CustDiagcCtrlPidSeedKeyTmr CustDiagc.CustDiagcCtrlPidSeedReqd CustDiagc.CustDiagcCtrlPidSeedTmrActvd CustDiagc.CustDiagcProgmSessionKeyAtmptCntr CustDiagc.CustDiagcProgmSessionSeedKeyTmr CustDiagc.CustDiagcProgmSessionSeedReqd CustDiagc.CustDiagcProgmSessionSeedTmrActvd CustDiagc.DtcNr CustDiagc.GmDiCtrlPidTstRunng CustDiagc.GmIgnCntr CustDiagc.MsgCntxt CustDiagc.PrevGmFctDiArbnSts CustDiagc.PrevSysPwrModRun CustDiagc.Srv12LoopCntr CustDiagc.SrvCntxt CustDiagc.SysStReqEnaOvrdCust /end SUB_GROUP
 /begin FUNCTION_LIST /end FUNCTION_LIST
 /begin REF_CHARACTERISTIC /end REF_CHARACTERISTIC
 /begin REF_MEASUREMENT /end REF_MEASUREMENT
/end GROUP
/begin GROUP CustDiagc.PinionAg.Val "MICROSAR RTE" /begin SUB_GROUP /end SUB_GROUP /begin FUNCTION_LIST /end FUNCTION_LIST /begin REF_CHARACTERISTIC /end REF_CHARACTERISTIC /begin REF_MEASUREMENT CustDiagc.PinionAg.Val /end REF_MEASUREMENT /end GROUP
/begin GROUP CustDiagc.PinionAgConf.Val "MICROSAR RTE" /begin SUB_GROUP /end SUB_GROUP /begin FUNCTION_LIST /end FUNCTION_LIST /begin REF_CHARACTERISTIC /end REF_CHARACTERISTIC /begin REF_MEASUREMENT CustDiagc.PinionAgConf.Val /end REF_MEASUREMENT /end GROUP
/begin GROUP CustDiagc.PrevGmFctDiArbnSts "MICROSAR RTE" /begin SUB_GROUP /end SUB_GROUP /begin FUNCTION_LIST /end FUNCTION_LIST /begin REF_CHARACTERISTIC /end REF_CHARACTERISTIC /begin REF_MEASUREMENT CustDiagc.PrevGmFctDiArbnSts /end REF_MEASUREMENT /end GROUP
/begin GROUP CustDiagc.PrevSysPwrModRun "MICROSAR RTE" /begin SUB_GROUP /end SUB_GROUP /begin FUNCTION_LIST /end FUNCTION_LIST /begin REF_CHARACTERISTIC /end REF_CHARACTERISTIC /begin REF_MEASUREMENT CustDiagc.PrevSysPwrModRun /end REF_MEASUREMENT /end GROUP
/begin GROUP CustDiagc.ReceiverPorts "MICROSAR RTE"
 /begin SUB_GROUP CustDiagc.ApaSt.Val CustDiagc.BattVltg.Val CustDiagc.CtrlrTRng.Val CustDiagc.DesRtIdx.Val CustDiagc.EcuTFild.Val CustDiagc.EngRunActv.Logl CustDiagc.EngSpd.Val CustDiagc.GmFctDiSts.Val CustDiagc.HwAgCcwDetd.Logl CustDiagc.HwAgCwDetd.Logl CustDiagc.HwAgEotCcw.Val CustDiagc.HwAgEotCw.Val CustDiagc.HwAgTrimPrfmd.Logl CustDiagc.HwTq.Val CustDiagc.HwTqIdptSig.Val CustDiagc.LkaCmd.Val CustDiagc.LkaSt.Val CustDiagc.MissMsg0C9.Logl CustDiagc.MissMsg1F1.Logl CustDiagc.MotCurrDaxCmd.Val CustDiagc.MotCurrPeakEstimd.Val CustDiagc.MotTqCmd.Val CustDiagc.PinionAg.Val CustDiagc.PinionAgConf.Val CustDiagc.SteerWhlAgReqTarAg.Val CustDiagc.StrtStopSt.Val CustDiagc.SysSt.Val CustDiagc.SysStReqEnaOvrdNxtr.Logl CustDiagc.ThermLimFlgCntr.Val CustDiagc.VehSpd.Val CustDiagc.VehSpdVld.Logl CustDiagc.VltgRng.Val /end SUB_GROUP
 /begin FUNCTION_LIST /end FUNCTION_LIST
 /begin REF_CHARACTERISTIC /end REF_CHARACTERISTIC
 /begin REF_MEASUREMENT /end REF_MEASUREMENT
/end GROUP
/begin GROUP CustDiagc.SenderPorts "MICROSAR RTE"
 /begin SUB_GROUP CustDiagc.GmIgnCntr.Val CustDiagc.SerlComDi.Logl CustDiagc.SysStReqEnaOvrdCombd.Logl /end SUB_GROUP
 /begin FUNCTION_LIST /end FUNCTION_LIST
 /begin REF_CHARACTERISTIC /end REF_CHARACTERISTIC
 /begin REF_MEASUREMENT /end REF_MEASUREMENT
/end GROUP
/begin GROUP CustDiagc.SerlComDi.Logl "MICROSAR RTE" /begin SUB_GROUP /end SUB_GROUP /begin FUNCTION_LIST /end FUNCTION_LIST /begin REF_CHARACTERISTIC /end REF_CHARACTERISTIC /begin REF_MEASUREMENT CustDiagc.SerlComDi.Logl /end REF_MEASUREMENT /end GROUP
/begin GROUP CustDiagc.Srv12LoopCntr "MICROSAR RTE" /begin SUB_GROUP /end SUB_GROUP /begin FUNCTION_LIST /end FUNCTION_LIST /begin REF_CHARACTERISTIC /end REF_CHARACTERISTIC /begin REF_MEASUREMENT CustDiagc.Srv12LoopCntr /end REF_MEASUREMENT /end GROUP
/begin GROUP CustDiagc.SrvCntxt "MICROSAR RTE" /begin SUB_GROUP /end SUB_GROUP /begin FUNCTION_LIST /end FUNCTION_LIST /begin REF_CHARACTERISTIC /end REF_CHARACTERISTIC /begin REF_MEASUREMENT CustDiagc.SrvCntxt /end REF_MEASUREMENT /end GROUP
/begin GROUP CustDiagc.SteerWhlAgReqTarAg.Val "MICROSAR RTE" /begin SUB_GROUP /end SUB_GROUP /begin FUNCTION_LIST /end FUNCTION_LIST /begin REF_CHARACTERISTIC /end REF_CHARACTERISTIC /begin REF_MEASUREMENT CustDiagc.SteerWhlAgReqTarAg.Val /end REF_MEASUREMENT /end GROUP
/begin GROUP CustDiagc.StrtStopSt.Val "MICROSAR RTE" /begin SUB_GROUP /end SUB_GROUP /begin FUNCTION_LIST /end FUNCTION_LIST /begin REF_CHARACTERISTIC /end REF_CHARACTERISTIC /begin REF_MEASUREMENT CustDiagc.StrtStopSt.Val /end REF_MEASUREMENT /end GROUP
/begin GROUP CustDiagc.SysSt.Val "MICROSAR RTE" /begin SUB_GROUP /end SUB_GROUP /begin FUNCTION_LIST /end FUNCTION_LIST /begin REF_CHARACTERISTIC /end REF_CHARACTERISTIC /begin REF_MEASUREMENT CustDiagc.SysSt.Val /end REF_MEASUREMENT /end GROUP
/begin GROUP CustDiagc.SysStReqEnaOvrdCombd.Logl "MICROSAR RTE" /begin SUB_GROUP /end SUB_GROUP /begin FUNCTION_LIST /end FUNCTION_LIST /begin REF_CHARACTERISTIC /end REF_CHARACTERISTIC /begin REF_MEASUREMENT CustDiagc.SysStReqEnaOvrdCombd.Logl /end REF_MEASUREMENT /end GROUP
/begin GROUP CustDiagc.SysStReqEnaOvrdCust "MICROSAR RTE" /begin SUB_GROUP /end SUB_GROUP /begin FUNCTION_LIST /end FUNCTION_LIST /begin REF_CHARACTERISTIC /end REF_CHARACTERISTIC /begin REF_MEASUREMENT CustDiagc.SysStReqEnaOvrdCust /end REF_MEASUREMENT /end GROUP
/begin GROUP CustDiagc.SysStReqEnaOvrdNxtr.Logl "MICROSAR RTE" /begin SUB_GROUP /end SUB_GROUP /begin FUNCTION_LIST /end FUNCTION_LIST /begin REF_CHARACTERISTIC /end REF_CHARACTERISTIC /begin REF_MEASUREMENT CustDiagc.SysStReqEnaOvrdNxtr.Logl /end REF_MEASUREMENT /end GROUP
/begin GROUP CustDiagc.ThermLimFlgCntr.Val "MICROSAR RTE" /begin SUB_GROUP /end SUB_GROUP /begin FUNCTION_LIST /end FUNCTION_LIST /begin REF_CHARACTERISTIC /end REF_CHARACTERISTIC /begin REF_MEASUREMENT CustDiagc.ThermLimFlgCntr.Val /end REF_MEASUREMENT /end GROUP
/begin GROUP CustDiagc.VehSpd.Val "MICROSAR RTE" /begin SUB_GROUP /end SUB_GROUP /begin FUNCTION_LIST /end FUNCTION_LIST /begin REF_CHARACTERISTIC /end REF_CHARACTERISTIC /begin REF_MEASUREMENT CustDiagc.VehSpd.Val /end REF_MEASUREMENT /end GROUP
/begin GROUP CustDiagc.VehSpdVld.Logl "MICROSAR RTE" /begin SUB_GROUP /end SUB_GROUP /begin FUNCTION_LIST /end FUNCTION_LIST /begin REF_CHARACTERISTIC /end REF_CHARACTERISTIC /begin REF_MEASUREMENT CustDiagc.VehSpdVld.Logl /end REF_MEASUREMENT /end GROUP
/begin GROUP CustDiagc.VltgRng.Val "MICROSAR RTE" /begin SUB_GROUP /end SUB_GROUP /begin FUNCTION_LIST /end FUNCTION_LIST /begin REF_CHARACTERISTIC /end REF_CHARACTERISTIC /begin REF_MEASUREMENT CustDiagc.VltgRng.Val /end REF_MEASUREMENT /end GROUP
/begin GROUP Dampg "MICROSAR RTE"
 /begin SUB_GROUP Dampg.CalibrationPorts Dampg.PerInstanceMemories Dampg.ReceiverPorts Dampg.SenderPorts /end SUB_GROUP
 /begin FUNCTION_LIST /end FUNCTION_LIST
 /begin REF_CHARACTERISTIC /end REF_CHARACTERISTIC
 /begin REF_MEASUREMENT /end REF_MEASUREMENT
/end GROUP
/begin GROUP Dampg.AssiCmdBas.Val "MICROSAR RTE" /begin SUB_GROUP /end SUB_GROUP /begin FUNCTION_LIST /end FUNCTION_LIST /begin REF_CHARACTERISTIC /end REF_CHARACTERISTIC /begin REF_MEASUREMENT Dampg.AssiCmdBas.Val /end REF_MEASUREMENT /end GROUP
/begin GROUP Dampg.AssiMechT.Val "MICROSAR RTE" /begin SUB_GROUP /end SUB_GROUP /begin FUNCTION_LIST /end FUNCTION_LIST /begin REF_CHARACTERISTIC /end REF_CHARACTERISTIC /begin REF_MEASUREMENT Dampg.AssiMechT.Val /end REF_MEASUREMENT /end GROUP
/begin GROUP Dampg.CalibrationPorts "MICROSAR RTE"
 /begin SUB_GROUP Dampg.DampgHwTqX.Ary1D Dampg.DampgHwTqY.Ary1D Dampg.DampgHydAssiLim.Ary1D Dampg.DampgHydBasCoeff1.Val Dampg.DampgHydBasCoeff2.Val Dampg.DampgHydBasCoeff3.Val Dampg.DampgHydBasCoeff4.Val Dampg.DampgHydCoeff1ScaY.Ary1D Dampg.DampgHydCoeff2ScaY.Ary1D Dampg.DampgHydCoeff3ScaY.Ary1D Dampg.DampgHydCoeff4ScaY.Ary1D Dampg.DampgHydOutpLim.Val Dampg.DampgMotVelLpFilFrq.Val Dampg.DampgMotVelX.Ary2D Dampg.DampgMotVelY.Ary2D Dampg.DampgQuad13Mplr.Val Dampg.DampgQuad24Mplr.Val Dampg.DampgQuadHwTqBacklsh.Val Dampg.DampgQuadHwTqLpFilFrq.Val Dampg.DampgQuadMotVelBacklsh.Val Dampg.DampgQuadMotVelLpFilFrq.Val Dampg.DampgQuadScaLpFilFrq.Val Dampg.DampgTScaX.Ary1D Dampg.DampgTScaY.Ary1D Dampg.SysGlbPrmVehSpdBilnrSeln.Ary1D /end SUB_GROUP
 /begin FUNCTION_LIST /end FUNCTION_LIST
 /begin REF_CHARACTERISTIC /end REF_CHARACTERISTIC
 /begin REF_MEASUREMENT /end REF_MEASUREMENT
/end GROUP
/begin GROUP Dampg.DampgCmdBas.Val "MICROSAR RTE" /begin SUB_GROUP /end SUB_GROUP /begin FUNCTION_LIST /end FUNCTION_LIST /begin REF_CHARACTERISTIC /end REF_CHARACTERISTIC /begin REF_MEASUREMENT Dampg.DampgCmdBas.Val /end REF_MEASUREMENT /end GROUP
/begin GROUP Dampg.DampgCmdBasDi.Logl "MICROSAR RTE" /begin SUB_GROUP /end SUB_GROUP /begin FUNCTION_LIST /end FUNCTION_LIST /begin REF_CHARACTERISTIC /end REF_CHARACTERISTIC /begin REF_MEASUREMENT Dampg.DampgCmdBasDi.Logl /end REF_MEASUREMENT /end GROUP
/begin GROUP Dampg.DampgCmdOvrl.Val "MICROSAR RTE" /begin SUB_GROUP /end SUB_GROUP /begin FUNCTION_LIST /end FUNCTION_LIST /begin REF_CHARACTERISTIC /end REF_CHARACTERISTIC /begin REF_MEASUREMENT Dampg.DampgCmdOvrl.Val /end REF_MEASUREMENT /end GROUP
/begin GROUP Dampg.DampgCmdSca.Val "MICROSAR RTE" /begin SUB_GROUP /end SUB_GROUP /begin FUNCTION_LIST /end FUNCTION_LIST /begin REF_CHARACTERISTIC /end REF_CHARACTERISTIC /begin REF_MEASUREMENT Dampg.DampgCmdSca.Val /end REF_MEASUREMENT /end GROUP
/begin GROUP Dampg.DampgHwTqX.Ary1D "MICROSAR RTE" /begin SUB_GROUP /end SUB_GROUP /begin FUNCTION_LIST /end FUNCTION_LIST /begin REF_CHARACTERISTIC Dampg.DampgHwTqX.Ary1D /end REF_CHARACTERISTIC /begin REF_MEASUREMENT /end REF_MEASUREMENT /end GROUP
/begin GROUP Dampg.DampgHwTqY.Ary1D "MICROSAR RTE" /begin SUB_GROUP /end SUB_GROUP /begin FUNCTION_LIST /end FUNCTION_LIST /begin REF_CHARACTERISTIC Dampg.DampgHwTqY.Ary1D /end REF_CHARACTERISTIC /begin REF_MEASUREMENT /end REF_MEASUREMENT /end GROUP
/begin GROUP Dampg.DampgHydAssiLim.Ary1D "MICROSAR RTE" /begin SUB_GROUP /end SUB_GROUP /begin FUNCTION_LIST /end FUNCTION_LIST /begin REF_CHARACTERISTIC Dampg.DampgHydAssiLim.Ary1D /end REF_CHARACTERISTIC /begin REF_MEASUREMENT /end REF_MEASUREMENT /end GROUP
/begin GROUP Dampg.DampgHydBasCoeff1.Val "MICROSAR RTE" /begin SUB_GROUP /end SUB_GROUP /begin FUNCTION_LIST /end FUNCTION_LIST /begin REF_CHARACTERISTIC Dampg.DampgHydBasCoeff1.Val /end REF_CHARACTERISTIC /begin REF_MEASUREMENT /end REF_MEASUREMENT /end GROUP
/begin GROUP Dampg.DampgHydBasCoeff2.Val "MICROSAR RTE" /begin SUB_GROUP /end SUB_GROUP /begin FUNCTION_LIST /end FUNCTION_LIST /begin REF_CHARACTERISTIC Dampg.DampgHydBasCoeff2.Val /end REF_CHARACTERISTIC /begin REF_MEASUREMENT /end REF_MEASUREMENT /end GROUP
/begin GROUP Dampg.DampgHydBasCoeff3.Val "MICROSAR RTE" /begin SUB_GROUP /end SUB_GROUP /begin FUNCTION_LIST /end FUNCTION_LIST /begin REF_CHARACTERISTIC Dampg.DampgHydBasCoeff3.Val /end REF_CHARACTERISTIC /begin REF_MEASUREMENT /end REF_MEASUREMENT /end GROUP
/begin GROUP Dampg.DampgHydBasCoeff4.Val "MICROSAR RTE" /begin SUB_GROUP /end SUB_GROUP /begin FUNCTION_LIST /end FUNCTION_LIST /begin REF_CHARACTERISTIC Dampg.DampgHydBasCoeff4.Val /end REF_CHARACTERISTIC /begin REF_MEASUREMENT /end REF_MEASUREMENT /end GROUP
/begin GROUP Dampg.DampgHydCoeff1ScaY.Ary1D "MICROSAR RTE" /begin SUB_GROUP /end SUB_GROUP /begin FUNCTION_LIST /end FUNCTION_LIST /begin REF_CHARACTERISTIC Dampg.DampgHydCoeff1ScaY.Ary1D /end REF_CHARACTERISTIC /begin REF_MEASUREMENT /end REF_MEASUREMENT /end GROUP
/begin GROUP Dampg.DampgHydCoeff2ScaY.Ary1D "MICROSAR RTE" /begin SUB_GROUP /end SUB_GROUP /begin FUNCTION_LIST /end FUNCTION_LIST /begin REF_CHARACTERISTIC Dampg.DampgHydCoeff2ScaY.Ary1D /end REF_CHARACTERISTIC /begin REF_MEASUREMENT /end REF_MEASUREMENT /end GROUP
/begin GROUP Dampg.DampgHydCoeff3ScaY.Ary1D "MICROSAR RTE" /begin SUB_GROUP /end SUB_GROUP /begin FUNCTION_LIST /end FUNCTION_LIST /begin REF_CHARACTERISTIC Dampg.DampgHydCoeff3ScaY.Ary1D /end REF_CHARACTERISTIC /begin REF_MEASUREMENT /end REF_MEASUREMENT /end GROUP
/begin GROUP Dampg.DampgHydCoeff4ScaY.Ary1D "MICROSAR RTE" /begin SUB_GROUP /end SUB_GROUP /begin FUNCTION_LIST /end FUNCTION_LIST /begin REF_CHARACTERISTIC Dampg.DampgHydCoeff4ScaY.Ary1D /end REF_CHARACTERISTIC /begin REF_MEASUREMENT /end REF_MEASUREMENT /end GROUP
/begin GROUP Dampg.DampgHydOutpLim.Val "MICROSAR RTE" /begin SUB_GROUP /end SUB_GROUP /begin FUNCTION_LIST /end FUNCTION_LIST /begin REF_CHARACTERISTIC Dampg.DampgHydOutpLim.Val /end REF_CHARACTERISTIC /begin REF_MEASUREMENT /end REF_MEASUREMENT /end GROUP
/begin GROUP Dampg.DampgMotVelLpFilFrq.Val "MICROSAR RTE" /begin SUB_GROUP /end SUB_GROUP /begin FUNCTION_LIST /end FUNCTION_LIST /begin REF_CHARACTERISTIC Dampg.DampgMotVelLpFilFrq.Val /end REF_CHARACTERISTIC /begin REF_MEASUREMENT /end REF_MEASUREMENT /end GROUP
/begin GROUP Dampg.DampgMotVelX.Ary2D "MICROSAR RTE" /begin SUB_GROUP /end SUB_GROUP /begin FUNCTION_LIST /end FUNCTION_LIST /begin REF_CHARACTERISTIC Dampg.DampgMotVelX.Ary2D /end REF_CHARACTERISTIC /begin REF_MEASUREMENT /end REF_MEASUREMENT /end GROUP
/begin GROUP Dampg.DampgMotVelY.Ary2D "MICROSAR RTE" /begin SUB_GROUP /end SUB_GROUP /begin FUNCTION_LIST /end FUNCTION_LIST /begin REF_CHARACTERISTIC Dampg.DampgMotVelY.Ary2D /end REF_CHARACTERISTIC /begin REF_MEASUREMENT /end REF_MEASUREMENT /end GROUP
/begin GROUP Dampg.DampgQuad13Mplr.Val "MICROSAR RTE" /begin SUB_GROUP /end SUB_GROUP /begin FUNCTION_LIST /end FUNCTION_LIST /begin REF_CHARACTERISTIC Dampg.DampgQuad13Mplr.Val /end REF_CHARACTERISTIC /begin REF_MEASUREMENT /end REF_MEASUREMENT /end GROUP
/begin GROUP Dampg.DampgQuad24Mplr.Val "MICROSAR RTE" /begin SUB_GROUP /end SUB_GROUP /begin FUNCTION_LIST /end FUNCTION_LIST /begin REF_CHARACTERISTIC Dampg.DampgQuad24Mplr.Val /end REF_CHARACTERISTIC /begin REF_MEASUREMENT /end REF_MEASUREMENT /end GROUP
/begin GROUP Dampg.DampgQuadHwTqBacklsh.Val "MICROSAR RTE" /begin SUB_GROUP /end SUB_GROUP /begin FUNCTION_LIST /end FUNCTION_LIST /begin REF_CHARACTERISTIC Dampg.DampgQuadHwTqBacklsh.Val /end REF_CHARACTERISTIC /begin REF_MEASUREMENT /end REF_MEASUREMENT /end GROUP
/begin GROUP Dampg.DampgQuadHwTqLpFilFrq.Val "MICROSAR RTE" /begin SUB_GROUP /end SUB_GROUP /begin FUNCTION_LIST /end FUNCTION_LIST /begin REF_CHARACTERISTIC Dampg.DampgQuadHwTqLpFilFrq.Val /end REF_CHARACTERISTIC /begin REF_MEASUREMENT /end REF_MEASUREMENT /end GROUP
/begin GROUP Dampg.DampgQuadMotVelBacklsh.Val "MICROSAR RTE" /begin SUB_GROUP /end SUB_GROUP /begin FUNCTION_LIST /end FUNCTION_LIST /begin REF_CHARACTERISTIC Dampg.DampgQuadMotVelBacklsh.Val /end REF_CHARACTERISTIC /begin REF_MEASUREMENT /end REF_MEASUREMENT /end GROUP
/begin GROUP Dampg.DampgQuadMotVelLpFilFrq.Val "MICROSAR RTE" /begin SUB_GROUP /end SUB_GROUP /begin FUNCTION_LIST /end FUNCTION_LIST /begin REF_CHARACTERISTIC Dampg.DampgQuadMotVelLpFilFrq.Val /end REF_CHARACTERISTIC /begin REF_MEASUREMENT /end REF_MEASUREMENT /end GROUP
/begin GROUP Dampg.DampgQuadScaLpFilFrq.Val "MICROSAR RTE" /begin SUB_GROUP /end SUB_GROUP /begin FUNCTION_LIST /end FUNCTION_LIST /begin REF_CHARACTERISTIC Dampg.DampgQuadScaLpFilFrq.Val /end REF_CHARACTERISTIC /begin REF_MEASUREMENT /end REF_MEASUREMENT /end GROUP
/begin GROUP Dampg.DampgTScaX.Ary1D "MICROSAR RTE" /begin SUB_GROUP /end SUB_GROUP /begin FUNCTION_LIST /end FUNCTION_LIST /begin REF_CHARACTERISTIC Dampg.DampgTScaX.Ary1D /end REF_CHARACTERISTIC /begin REF_MEASUREMENT /end REF_MEASUREMENT /end GROUP
/begin GROUP Dampg.DampgTScaY.Ary1D "MICROSAR RTE" /begin SUB_GROUP /end SUB_GROUP /begin FUNCTION_LIST /end FUNCTION_LIST /begin REF_CHARACTERISTIC Dampg.DampgTScaY.Ary1D /end REF_CHARACTERISTIC /begin REF_MEASUREMENT /end REF_MEASUREMENT /end GROUP
/begin GROUP Dampg.HwTq.Val "MICROSAR RTE" /begin SUB_GROUP /end SUB_GROUP /begin FUNCTION_LIST /end FUNCTION_LIST /begin REF_CHARACTERISTIC /end REF_CHARACTERISTIC /begin REF_MEASUREMENT Dampg.HwTq.Val /end REF_MEASUREMENT /end GROUP
/begin GROUP Dampg.MotVelCrf.Val "MICROSAR RTE" /begin SUB_GROUP /end SUB_GROUP /begin FUNCTION_LIST /end FUNCTION_LIST /begin REF_CHARACTERISTIC /end REF_CHARACTERISTIC /begin REF_MEASUREMENT Dampg.MotVelCrf.Val /end REF_MEASUREMENT /end GROUP
/begin GROUP Dampg.MotVelDampgLpFil "MICROSAR RTE" /begin SUB_GROUP /end SUB_GROUP /begin FUNCTION_LIST /end FUNCTION_LIST /begin REF_CHARACTERISTIC /end REF_CHARACTERISTIC
 /begin REF_MEASUREMENT Dampg.MotVelDampgLpFil.FilGain Dampg.MotVelDampgLpFil.FilSt /end REF_MEASUREMENT
/end GROUP
/begin GROUP Dampg.PerInstanceMemories "MICROSAR RTE"
 /begin SUB_GROUP Dampg.MotVelDampgLpFil Dampg.PrevHwTqBacklshOutp Dampg.PrevHydOutpLim Dampg.PrevMotVelBacklshOutp Dampg.QuadDampgHwTqLpFil Dampg.QuadDampgMotVelLpFil Dampg.QuadDampgScaLpFil Dampg.dDampgAssiMechTSca Dampg.dDampgCoeff1Term Dampg.dDampgCoeff2Term Dampg.dDampgCoeff3Term Dampg.dDampgCoeff4Term Dampg.dDampgHwTqSca Dampg.dDampgMotVelDampgCmd Dampg.dDampgQuadHwTqBacklsh Dampg.dDampgQuadMotVelBacklsh /end SUB_GROUP
 /begin FUNCTION_LIST /end FUNCTION_LIST
 /begin REF_CHARACTERISTIC /end REF_CHARACTERISTIC
 /begin REF_MEASUREMENT /end REF_MEASUREMENT
/end GROUP
/begin GROUP Dampg.PrevHwTqBacklshOutp "MICROSAR RTE" /begin SUB_GROUP /end SUB_GROUP /begin FUNCTION_LIST /end FUNCTION_LIST /begin REF_CHARACTERISTIC /end REF_CHARACTERISTIC /begin REF_MEASUREMENT Dampg.PrevHwTqBacklshOutp /end REF_MEASUREMENT /end GROUP
/begin GROUP Dampg.PrevHydOutpLim "MICROSAR RTE" /begin SUB_GROUP /end SUB_GROUP /begin FUNCTION_LIST /end FUNCTION_LIST /begin REF_CHARACTERISTIC /end REF_CHARACTERISTIC /begin REF_MEASUREMENT Dampg.PrevHydOutpLim /end REF_MEASUREMENT /end GROUP
/begin GROUP Dampg.PrevMotVelBacklshOutp "MICROSAR RTE" /begin SUB_GROUP /end SUB_GROUP /begin FUNCTION_LIST /end FUNCTION_LIST /begin REF_CHARACTERISTIC /end REF_CHARACTERISTIC /begin REF_MEASUREMENT Dampg.PrevMotVelBacklshOutp /end REF_MEASUREMENT /end GROUP
/begin GROUP Dampg.QuadDampgHwTqLpFil "MICROSAR RTE" /begin SUB_GROUP /end SUB_GROUP /begin FUNCTION_LIST /end FUNCTION_LIST /begin REF_CHARACTERISTIC /end REF_CHARACTERISTIC
 /begin REF_MEASUREMENT Dampg.QuadDampgHwTqLpFil.FilGain Dampg.QuadDampgHwTqLpFil.FilSt /end REF_MEASUREMENT
/end GROUP
/begin GROUP Dampg.QuadDampgMotVelLpFil "MICROSAR RTE" /begin SUB_GROUP /end SUB_GROUP /begin FUNCTION_LIST /end FUNCTION_LIST /begin REF_CHARACTERISTIC /end REF_CHARACTERISTIC
 /begin REF_MEASUREMENT Dampg.QuadDampgMotVelLpFil.FilGain Dampg.QuadDampgMotVelLpFil.FilSt /end REF_MEASUREMENT
/end GROUP
/begin GROUP Dampg.QuadDampgScaLpFil "MICROSAR RTE" /begin SUB_GROUP /end SUB_GROUP /begin FUNCTION_LIST /end FUNCTION_LIST /begin REF_CHARACTERISTIC /end REF_CHARACTERISTIC
 /begin REF_MEASUREMENT Dampg.QuadDampgScaLpFil.FilGain Dampg.QuadDampgScaLpFil.FilSt /end REF_MEASUREMENT
/end GROUP
/begin GROUP Dampg.ReceiverPorts "MICROSAR RTE"
 /begin SUB_GROUP Dampg.AssiCmdBas.Val Dampg.AssiMechT.Val Dampg.DampgCmdBasDi.Logl Dampg.DampgCmdOvrl.Val Dampg.DampgCmdSca.Val Dampg.HwTq.Val Dampg.MotVelCrf.Val Dampg.VehSpd.Val /end SUB_GROUP
 /begin FUNCTION_LIST /end FUNCTION_LIST
 /begin REF_CHARACTERISTIC /end REF_CHARACTERISTIC
 /begin REF_MEASUREMENT /end REF_MEASUREMENT
/end GROUP
/begin GROUP Dampg.SenderPorts "MICROSAR RTE" /begin SUB_GROUP Dampg.DampgCmdBas.Val /end SUB_GROUP /begin FUNCTION_LIST /end FUNCTION_LIST /begin REF_CHARACTERISTIC /end REF_CHARACTERISTIC /begin REF_MEASUREMENT /end REF_MEASUREMENT /end GROUP
/begin GROUP Dampg.SysGlbPrmVehSpdBilnrSeln.Ary1D "MICROSAR RTE" /begin SUB_GROUP /end SUB_GROUP /begin FUNCTION_LIST /end FUNCTION_LIST /begin REF_CHARACTERISTIC Dampg.SysGlbPrmVehSpdBilnrSeln.Ary1D /end REF_CHARACTERISTIC /begin REF_MEASUREMENT /end REF_MEASUREMENT /end GROUP
/begin GROUP Dampg.VehSpd.Val "MICROSAR RTE" /begin SUB_GROUP /end SUB_GROUP /begin FUNCTION_LIST /end FUNCTION_LIST /begin REF_CHARACTERISTIC /end REF_CHARACTERISTIC /begin REF_MEASUREMENT Dampg.VehSpd.Val /end REF_MEASUREMENT /end GROUP
/begin GROUP Dampg.dDampgAssiMechTSca "MICROSAR RTE" /begin SUB_GROUP /end SUB_GROUP /begin FUNCTION_LIST /end FUNCTION_LIST /begin REF_CHARACTERISTIC /end REF_CHARACTERISTIC /begin REF_MEASUREMENT Dampg.dDampgAssiMechTSca /end REF_MEASUREMENT /end GROUP
/begin GROUP Dampg.dDampgCoeff1Term "MICROSAR RTE" /begin SUB_GROUP /end SUB_GROUP /begin FUNCTION_LIST /end FUNCTION_LIST /begin REF_CHARACTERISTIC /end REF_CHARACTERISTIC /begin REF_MEASUREMENT Dampg.dDampgCoeff1Term /end REF_MEASUREMENT /end GROUP
/begin GROUP Dampg.dDampgCoeff2Term "MICROSAR RTE" /begin SUB_GROUP /end SUB_GROUP /begin FUNCTION_LIST /end FUNCTION_LIST /begin REF_CHARACTERISTIC /end REF_CHARACTERISTIC /begin REF_MEASUREMENT Dampg.dDampgCoeff2Term /end REF_MEASUREMENT /end GROUP
/begin GROUP Dampg.dDampgCoeff3Term "MICROSAR RTE" /begin SUB_GROUP /end SUB_GROUP /begin FUNCTION_LIST /end FUNCTION_LIST /begin REF_CHARACTERISTIC /end REF_CHARACTERISTIC /begin REF_MEASUREMENT Dampg.dDampgCoeff3Term /end REF_MEASUREMENT /end GROUP
/begin GROUP Dampg.dDampgCoeff4Term "MICROSAR RTE" /begin SUB_GROUP /end SUB_GROUP /begin FUNCTION_LIST /end FUNCTION_LIST /begin REF_CHARACTERISTIC /end REF_CHARACTERISTIC /begin REF_MEASUREMENT Dampg.dDampgCoeff4Term /end REF_MEASUREMENT /end GROUP
/begin GROUP Dampg.dDampgHwTqSca "MICROSAR RTE" /begin SUB_GROUP /end SUB_GROUP /begin FUNCTION_LIST /end FUNCTION_LIST /begin REF_CHARACTERISTIC /end REF_CHARACTERISTIC /begin REF_MEASUREMENT Dampg.dDampgHwTqSca /end REF_MEASUREMENT /end GROUP
/begin GROUP Dampg.dDampgMotVelDampgCmd "MICROSAR RTE" /begin SUB_GROUP /end SUB_GROUP /begin FUNCTION_LIST /end FUNCTION_LIST /begin REF_CHARACTERISTIC /end REF_CHARACTERISTIC /begin REF_MEASUREMENT Dampg.dDampgMotVelDampgCmd /end REF_MEASUREMENT /end GROUP
/begin GROUP Dampg.dDampgQuadHwTqBacklsh "MICROSAR RTE" /begin SUB_GROUP /end SUB_GROUP /begin FUNCTION_LIST /end FUNCTION_LIST /begin REF_CHARACTERISTIC /end REF_CHARACTERISTIC /begin REF_MEASUREMENT Dampg.dDampgQuadHwTqBacklsh /end REF_MEASUREMENT /end GROUP
/begin GROUP Dampg.dDampgQuadMotVelBacklsh "MICROSAR RTE" /begin SUB_GROUP /end SUB_GROUP /begin FUNCTION_LIST /end FUNCTION_LIST /begin REF_CHARACTERISTIC /end REF_CHARACTERISTIC /begin REF_MEASUREMENT Dampg.dDampgQuadMotVelBacklsh /end REF_MEASUREMENT /end GROUP
/begin GROUP DampgPahFwl "MICROSAR RTE"
 /begin SUB_GROUP DampgPahFwl.CalibrationPorts DampgPahFwl.PerInstanceMemories DampgPahFwl.ReceiverPorts DampgPahFwl.SenderPorts /end SUB_GROUP
 /begin FUNCTION_LIST /end FUNCTION_LIST
 /begin REF_CHARACTERISTIC /end REF_CHARACTERISTIC
 /begin REF_MEASUREMENT /end REF_MEASUREMENT
/end GROUP
/begin GROUP DampgPahFwl.AssiPahLimrActv.Val "MICROSAR RTE" /begin SUB_GROUP /end SUB_GROUP /begin FUNCTION_LIST /end FUNCTION_LIST /begin REF_CHARACTERISTIC /end REF_CHARACTERISTIC /begin REF_MEASUREMENT DampgPahFwl.AssiPahLimrActv.Val /end REF_MEASUREMENT /end GROUP
/begin GROUP DampgPahFwl.CalibrationPorts "MICROSAR RTE"
 /begin SUB_GROUP DampgPahFwl.DampgPahFwlActvFwlLpFilFrq.Val DampgPahFwl.DampgPahFwlAssiAddlDampgX.Ary1D DampgPahFwl.DampgPahFwlAssiAddlDampgY.Ary1D DampgPahFwl.DampgPahFwlDampgCmdAddlDampgX.Ary1D DampgPahFwl.DampgPahFwlDampgCmdAddlDampgY.Ary1D DampgPahFwl.DampgPahFwlDampgCmdFwlOverLimDiagcFailStep.Val DampgPahFwl.DampgPahFwlDampgCmdFwlOverLimDiagcPassStep.Val DampgPahFwl.DampgPahFwlDampgCmdLpFilFrq.Val DampgPahFwl.DampgPahFwlDampgCmdUpprLimX.Ary1D DampgPahFwl.DampgPahFwlDampgCmdUpprLimY.Ary2D DampgPahFwl.DampgPahFwlDftDampgX.Ary1D DampgPahFwl.DampgPahFwlDftDampgY.Ary1D DampgPahFwl.DampgPahFwlInertiaCmpCmdFwlOverLimDiagcFailStep.Val DampgPahFwl.DampgPahFwlInertiaCmpCmdFwlOverLimDiagcPassStep.Val DampgPahFwl.DampgPahFwlInertiaCmpLpFilFrq.Val DampgPahFwl.DampgPahFwlInertiaCmpUpprLimX.Ary1D DampgPahFwl.DampgPahFwlInertiaCmpUpprLimY.Ary2D DampgPahFwl.DampgPahFwlVehSpd.Ary1D /end SUB_GROUP
 /begin FUNCTION_LIST /end FUNCTION_LIST
 /begin REF_CHARACTERISTIC /end REF_CHARACTERISTIC
 /begin REF_MEASUREMENT /end REF_MEASUREMENT
/end GROUP
/begin GROUP DampgPahFwl.DampgCmd.Val "MICROSAR RTE" /begin SUB_GROUP /end SUB_GROUP /begin FUNCTION_LIST /end FUNCTION_LIST /begin REF_CHARACTERISTIC /end REF_CHARACTERISTIC /begin REF_MEASUREMENT DampgPahFwl.DampgCmd.Val /end REF_MEASUREMENT /end GROUP
/begin GROUP DampgPahFwl.DampgCmdBas.Val "MICROSAR RTE" /begin SUB_GROUP /end SUB_GROUP /begin FUNCTION_LIST /end FUNCTION_LIST /begin REF_CHARACTERISTIC /end REF_CHARACTERISTIC /begin REF_MEASUREMENT DampgPahFwl.DampgCmdBas.Val /end REF_MEASUREMENT /end GROUP
/begin GROUP DampgPahFwl.DampgCmdBasDi.Logl "MICROSAR RTE" /begin SUB_GROUP /end SUB_GROUP /begin FUNCTION_LIST /end FUNCTION_LIST /begin REF_CHARACTERISTIC /end REF_CHARACTERISTIC /begin REF_MEASUREMENT DampgPahFwl.DampgCmdBasDi.Logl /end REF_MEASUREMENT /end GROUP
/begin GROUP DampgPahFwl.DampgCmdLpFilLowrLim "MICROSAR RTE" /begin SUB_GROUP /end SUB_GROUP /begin FUNCTION_LIST /end FUNCTION_LIST /begin REF_CHARACTERISTIC /end REF_CHARACTERISTIC
 /begin REF_MEASUREMENT DampgPahFwl.DampgCmdLpFilLowrLim.FilGain DampgPahFwl.DampgCmdLpFilLowrLim.FilSt /end REF_MEASUREMENT
/end GROUP
/begin GROUP DampgPahFwl.DampgCmdLpFilUpprLim "MICROSAR RTE" /begin SUB_GROUP /end SUB_GROUP /begin FUNCTION_LIST /end FUNCTION_LIST /begin REF_CHARACTERISTIC /end REF_CHARACTERISTIC
 /begin REF_MEASUREMENT DampgPahFwl.DampgCmdLpFilUpprLim.FilGain DampgPahFwl.DampgCmdLpFilUpprLim.FilSt /end REF_MEASUREMENT
/end GROUP
/begin GROUP DampgPahFwl.DampgDecPrfmncPrev "MICROSAR RTE" /begin SUB_GROUP /end SUB_GROUP /begin FUNCTION_LIST /end FUNCTION_LIST /begin REF_CHARACTERISTIC /end REF_CHARACTERISTIC /begin REF_MEASUREMENT DampgPahFwl.DampgDecPrfmncPrev /end REF_MEASUREMENT /end GROUP
/begin GROUP DampgPahFwl.DampgPahFwlActvFwlLpFilFrq.Val "MICROSAR RTE" /begin SUB_GROUP /end SUB_GROUP /begin FUNCTION_LIST /end FUNCTION_LIST /begin REF_CHARACTERISTIC DampgPahFwl.DampgPahFwlActvFwlLpFilFrq.Val /end REF_CHARACTERISTIC /begin REF_MEASUREMENT /end REF_MEASUREMENT /end GROUP
/begin GROUP DampgPahFwl.DampgPahFwlAssiAddlDampgX.Ary1D "MICROSAR RTE" /begin SUB_GROUP /end SUB_GROUP /begin FUNCTION_LIST /end FUNCTION_LIST /begin REF_CHARACTERISTIC DampgPahFwl.DampgPahFwlAssiAddlDampgX.Ary1D /end REF_CHARACTERISTIC /begin REF_MEASUREMENT /end REF_MEASUREMENT /end GROUP
/begin GROUP DampgPahFwl.DampgPahFwlAssiAddlDampgY.Ary1D "MICROSAR RTE" /begin SUB_GROUP /end SUB_GROUP /begin FUNCTION_LIST /end FUNCTION_LIST /begin REF_CHARACTERISTIC DampgPahFwl.DampgPahFwlAssiAddlDampgY.Ary1D /end REF_CHARACTERISTIC /begin REF_MEASUREMENT /end REF_MEASUREMENT /end GROUP
/begin GROUP DampgPahFwl.DampgPahFwlDampgCmdAddlDampgX.Ary1D "MICROSAR RTE" /begin SUB_GROUP /end SUB_GROUP /begin FUNCTION_LIST /end FUNCTION_LIST /begin REF_CHARACTERISTIC DampgPahFwl.DampgPahFwlDampgCmdAddlDampgX.Ary1D /end REF_CHARACTERISTIC /begin REF_MEASUREMENT /end REF_MEASUREMENT /end GROUP
/begin GROUP DampgPahFwl.DampgPahFwlDampgCmdAddlDampgY.Ary1D "MICROSAR RTE" /begin SUB_GROUP /end SUB_GROUP /begin FUNCTION_LIST /end FUNCTION_LIST /begin REF_CHARACTERISTIC DampgPahFwl.DampgPahFwlDampgCmdAddlDampgY.Ary1D /end REF_CHARACTERISTIC /begin REF_MEASUREMENT /end REF_MEASUREMENT /end GROUP
/begin GROUP DampgPahFwl.DampgPahFwlDampgCmdFwlOverLimDiagcFailStep.Val "MICROSAR RTE" /begin SUB_GROUP /end SUB_GROUP /begin FUNCTION_LIST /end FUNCTION_LIST /begin REF_CHARACTERISTIC DampgPahFwl.DampgPahFwlDampgCmdFwlOverLimDiagcFailStep.Val /end REF_CHARACTERISTIC /begin REF_MEASUREMENT /end REF_MEASUREMENT /end GROUP
/begin GROUP DampgPahFwl.DampgPahFwlDampgCmdFwlOverLimDiagcPassStep.Val "MICROSAR RTE" /begin SUB_GROUP /end SUB_GROUP /begin FUNCTION_LIST /end FUNCTION_LIST /begin REF_CHARACTERISTIC DampgPahFwl.DampgPahFwlDampgCmdFwlOverLimDiagcPassStep.Val /end REF_CHARACTERISTIC /begin REF_MEASUREMENT /end REF_MEASUREMENT /end GROUP
/begin GROUP DampgPahFwl.DampgPahFwlDampgCmdLpFilFrq.Val "MICROSAR RTE" /begin SUB_GROUP /end SUB_GROUP /begin FUNCTION_LIST /end FUNCTION_LIST /begin REF_CHARACTERISTIC DampgPahFwl.DampgPahFwlDampgCmdLpFilFrq.Val /end REF_CHARACTERISTIC /begin REF_MEASUREMENT /end REF_MEASUREMENT /end GROUP
/begin GROUP DampgPahFwl.DampgPahFwlDampgCmdUpprLimX.Ary1D "MICROSAR RTE" /begin SUB_GROUP /end SUB_GROUP /begin FUNCTION_LIST /end FUNCTION_LIST /begin REF_CHARACTERISTIC DampgPahFwl.DampgPahFwlDampgCmdUpprLimX.Ary1D /end REF_CHARACTERISTIC /begin REF_MEASUREMENT /end REF_MEASUREMENT /end GROUP
/begin GROUP DampgPahFwl.DampgPahFwlDampgCmdUpprLimY.Ary2D "MICROSAR RTE" /begin SUB_GROUP /end SUB_GROUP /begin FUNCTION_LIST /end FUNCTION_LIST /begin REF_CHARACTERISTIC DampgPahFwl.DampgPahFwlDampgCmdUpprLimY.Ary2D /end REF_CHARACTERISTIC /begin REF_MEASUREMENT /end REF_MEASUREMENT /end GROUP
/begin GROUP DampgPahFwl.DampgPahFwlDftDampgX.Ary1D "MICROSAR RTE" /begin SUB_GROUP /end SUB_GROUP /begin FUNCTION_LIST /end FUNCTION_LIST /begin REF_CHARACTERISTIC DampgPahFwl.DampgPahFwlDftDampgX.Ary1D /end REF_CHARACTERISTIC /begin REF_MEASUREMENT /end REF_MEASUREMENT /end GROUP
/begin GROUP DampgPahFwl.DampgPahFwlDftDampgY.Ary1D "MICROSAR RTE" /begin SUB_GROUP /end SUB_GROUP /begin FUNCTION_LIST /end FUNCTION_LIST /begin REF_CHARACTERISTIC DampgPahFwl.DampgPahFwlDftDampgY.Ary1D /end REF_CHARACTERISTIC /begin REF_MEASUREMENT /end REF_MEASUREMENT /end GROUP
/begin GROUP DampgPahFwl.DampgPahFwlInertiaCmpCmdFwlOverLimDiagcFailStep.Val "MICROSAR RTE" /begin SUB_GROUP /end SUB_GROUP /begin FUNCTION_LIST /end FUNCTION_LIST
 /begin REF_CHARACTERISTIC DampgPahFwl.DampgPahFwlInertiaCmpCmdFwlOverLimDiagcFailStep.Val /end REF_CHARACTERISTIC
 /begin REF_MEASUREMENT /end REF_MEASUREMENT
/end GROUP
/begin GROUP DampgPahFwl.DampgPahFwlInertiaCmpCmdFwlOverLimDiagcPassStep.Val "MICROSAR RTE" /begin SUB_GROUP /end SUB_GROUP /begin FUNCTION_LIST /end FUNCTION_LIST
 /begin REF_CHARACTERISTIC DampgPahFwl.DampgPahFwlInertiaCmpCmdFwlOverLimDiagcPassStep.Val /end REF_CHARACTERISTIC
 /begin REF_MEASUREMENT /end REF_MEASUREMENT
/end GROUP
/begin GROUP DampgPahFwl.DampgPahFwlInertiaCmpLpFilFrq.Val "MICROSAR RTE" /begin SUB_GROUP /end SUB_GROUP /begin FUNCTION_LIST /end FUNCTION_LIST /begin REF_CHARACTERISTIC DampgPahFwl.DampgPahFwlInertiaCmpLpFilFrq.Val /end REF_CHARACTERISTIC /begin REF_MEASUREMENT /end REF_MEASUREMENT /end GROUP
/begin GROUP DampgPahFwl.DampgPahFwlInertiaCmpUpprLimX.Ary1D "MICROSAR RTE" /begin SUB_GROUP /end SUB_GROUP /begin FUNCTION_LIST /end FUNCTION_LIST /begin REF_CHARACTERISTIC DampgPahFwl.DampgPahFwlInertiaCmpUpprLimX.Ary1D /end REF_CHARACTERISTIC /begin REF_MEASUREMENT /end REF_MEASUREMENT /end GROUP
/begin GROUP DampgPahFwl.DampgPahFwlInertiaCmpUpprLimY.Ary2D "MICROSAR RTE" /begin SUB_GROUP /end SUB_GROUP /begin FUNCTION_LIST /end FUNCTION_LIST /begin REF_CHARACTERISTIC DampgPahFwl.DampgPahFwlInertiaCmpUpprLimY.Ary2D /end REF_CHARACTERISTIC /begin REF_MEASUREMENT /end REF_MEASUREMENT /end GROUP
/begin GROUP DampgPahFwl.DampgPahFwlVehSpd.Ary1D "MICROSAR RTE" /begin SUB_GROUP /end SUB_GROUP /begin FUNCTION_LIST /end FUNCTION_LIST /begin REF_CHARACTERISTIC DampgPahFwl.DampgPahFwlVehSpd.Ary1D /end REF_CHARACTERISTIC /begin REF_MEASUREMENT /end REF_MEASUREMENT /end GROUP
/begin GROUP DampgPahFwl.FwlActvLpFil "MICROSAR RTE" /begin SUB_GROUP /end SUB_GROUP /begin FUNCTION_LIST /end FUNCTION_LIST /begin REF_CHARACTERISTIC /end REF_CHARACTERISTIC
 /begin REF_MEASUREMENT DampgPahFwl.FwlActvLpFil.FilGain DampgPahFwl.FwlActvLpFil.FilSt /end REF_MEASUREMENT
/end GROUP
/begin GROUP DampgPahFwl.InertiaCmpLpFil "MICROSAR RTE" /begin SUB_GROUP /end SUB_GROUP /begin FUNCTION_LIST /end FUNCTION_LIST /begin REF_CHARACTERISTIC /end REF_CHARACTERISTIC
 /begin REF_MEASUREMENT DampgPahFwl.InertiaCmpLpFil.FilGain DampgPahFwl.InertiaCmpLpFil.FilSt /end REF_MEASUREMENT
/end GROUP
/begin GROUP DampgPahFwl.InertiaCmpLpFilLowrLim "MICROSAR RTE" /begin SUB_GROUP /end SUB_GROUP /begin FUNCTION_LIST /end FUNCTION_LIST /begin REF_CHARACTERISTIC /end REF_CHARACTERISTIC
 /begin REF_MEASUREMENT DampgPahFwl.InertiaCmpLpFilLowrLim.FilGain DampgPahFwl.InertiaCmpLpFilLowrLim.FilSt /end REF_MEASUREMENT
/end GROUP
/begin GROUP DampgPahFwl.InertiaCmpLpFilUpprLim "MICROSAR RTE" /begin SUB_GROUP /end SUB_GROUP /begin FUNCTION_LIST /end FUNCTION_LIST /begin REF_CHARACTERISTIC /end REF_CHARACTERISTIC
 /begin REF_MEASUREMENT DampgPahFwl.InertiaCmpLpFilUpprLim.FilGain DampgPahFwl.InertiaCmpLpFilUpprLim.FilSt /end REF_MEASUREMENT
/end GROUP
/begin GROUP DampgPahFwl.InertiaCmpVelCmd.Val "MICROSAR RTE" /begin SUB_GROUP /end SUB_GROUP /begin FUNCTION_LIST /end FUNCTION_LIST /begin REF_CHARACTERISTIC /end REF_CHARACTERISTIC /begin REF_MEASUREMENT DampgPahFwl.InertiaCmpVelCmd.Val /end REF_MEASUREMENT /end GROUP
/begin GROUP DampgPahFwl.MotVelCrf.Val "MICROSAR RTE" /begin SUB_GROUP /end SUB_GROUP /begin FUNCTION_LIST /end FUNCTION_LIST /begin REF_CHARACTERISTIC /end REF_CHARACTERISTIC /begin REF_MEASUREMENT DampgPahFwl.MotVelCrf.Val /end REF_MEASUREMENT /end GROUP
/begin GROUP DampgPahFwl.PerInstanceMemories "MICROSAR RTE"
 /begin SUB_GROUP DampgPahFwl.DampgCmdLpFilLowrLim DampgPahFwl.DampgCmdLpFilUpprLim DampgPahFwl.DampgDecPrfmncPrev DampgPahFwl.FwlActvLpFil DampgPahFwl.InertiaCmpLpFil DampgPahFwl.InertiaCmpLpFilLowrLim DampgPahFwl.InertiaCmpLpFilUpprLim DampgPahFwl.dDampgPahFwlActvRaw DampgPahFwl.dDampgPahFwlAddDampg DampgPahFwl.dDampgPahFwlDampgCmdLimd DampgPahFwl.dDampgPahFwlDampgCmdLowrLimFild DampgPahFwl.dDampgPahFwlDampgCmdOverLim DampgPahFwl.dDampgPahFwlDampgCmdUpprLimFild DampgPahFwl.dDampgPahFwlInertiaCmpHpPah DampgPahFwl.dDampgPahFwlInertiaCmpLowrLimFild DampgPahFwl.dDampgPahFwlInertiaCmpLpLimd DampgPahFwl.dDampgPahFwlInertiaCmpLpPah DampgPahFwl.dDampgPahFwlInertiaCmpOverLim DampgPahFwl.dDampgPahFwlInertiaCmpUpprLimFild /end SUB_GROUP
 /begin FUNCTION_LIST /end FUNCTION_LIST
 /begin REF_CHARACTERISTIC /end REF_CHARACTERISTIC
 /begin REF_MEASUREMENT /end REF_MEASUREMENT
/end GROUP
/begin GROUP DampgPahFwl.ReceiverPorts "MICROSAR RTE"
 /begin SUB_GROUP DampgPahFwl.AssiPahLimrActv.Val DampgPahFwl.DampgCmdBas.Val DampgPahFwl.DampgCmdBasDi.Logl DampgPahFwl.InertiaCmpVelCmd.Val DampgPahFwl.MotVelCrf.Val DampgPahFwl.VehSpd.Val /end SUB_GROUP
 /begin FUNCTION_LIST /end FUNCTION_LIST
 /begin REF_CHARACTERISTIC /end REF_CHARACTERISTIC
 /begin REF_MEASUREMENT /end REF_MEASUREMENT
/end GROUP
/begin GROUP DampgPahFwl.SenderPorts "MICROSAR RTE" /begin SUB_GROUP DampgPahFwl.DampgCmd.Val /end SUB_GROUP /begin FUNCTION_LIST /end FUNCTION_LIST /begin REF_CHARACTERISTIC /end REF_CHARACTERISTIC /begin REF_MEASUREMENT /end REF_MEASUREMENT /end GROUP
/begin GROUP DampgPahFwl.VehSpd.Val "MICROSAR RTE" /begin SUB_GROUP /end SUB_GROUP /begin FUNCTION_LIST /end FUNCTION_LIST /begin REF_CHARACTERISTIC /end REF_CHARACTERISTIC /begin REF_MEASUREMENT DampgPahFwl.VehSpd.Val /end REF_MEASUREMENT /end GROUP
/begin GROUP DampgPahFwl.dDampgPahFwlActvRaw "MICROSAR RTE" /begin SUB_GROUP /end SUB_GROUP /begin FUNCTION_LIST /end FUNCTION_LIST /begin REF_CHARACTERISTIC /end REF_CHARACTERISTIC /begin REF_MEASUREMENT DampgPahFwl.dDampgPahFwlActvRaw /end REF_MEASUREMENT /end GROUP
/begin GROUP DampgPahFwl.dDampgPahFwlAddDampg "MICROSAR RTE" /begin SUB_GROUP /end SUB_GROUP /begin FUNCTION_LIST /end FUNCTION_LIST /begin REF_CHARACTERISTIC /end REF_CHARACTERISTIC /begin REF_MEASUREMENT DampgPahFwl.dDampgPahFwlAddDampg /end REF_MEASUREMENT /end GROUP
/begin GROUP DampgPahFwl.dDampgPahFwlDampgCmdLimd "MICROSAR RTE" /begin SUB_GROUP /end SUB_GROUP /begin FUNCTION_LIST /end FUNCTION_LIST /begin REF_CHARACTERISTIC /end REF_CHARACTERISTIC /begin REF_MEASUREMENT DampgPahFwl.dDampgPahFwlDampgCmdLimd /end REF_MEASUREMENT /end GROUP
/begin GROUP DampgPahFwl.dDampgPahFwlDampgCmdLowrLimFild "MICROSAR RTE" /begin SUB_GROUP /end SUB_GROUP /begin FUNCTION_LIST /end FUNCTION_LIST /begin REF_CHARACTERISTIC /end REF_CHARACTERISTIC /begin REF_MEASUREMENT DampgPahFwl.dDampgPahFwlDampgCmdLowrLimFild /end REF_MEASUREMENT /end GROUP
/begin GROUP DampgPahFwl.dDampgPahFwlDampgCmdOverLim "MICROSAR RTE" /begin SUB_GROUP /end SUB_GROUP /begin FUNCTION_LIST /end FUNCTION_LIST /begin REF_CHARACTERISTIC /end REF_CHARACTERISTIC /begin REF_MEASUREMENT DampgPahFwl.dDampgPahFwlDampgCmdOverLim /end REF_MEASUREMENT /end GROUP
/begin GROUP DampgPahFwl.dDampgPahFwlDampgCmdUpprLimFild "MICROSAR RTE" /begin SUB_GROUP /end SUB_GROUP /begin FUNCTION_LIST /end FUNCTION_LIST /begin REF_CHARACTERISTIC /end REF_CHARACTERISTIC /begin REF_MEASUREMENT DampgPahFwl.dDampgPahFwlDampgCmdUpprLimFild /end REF_MEASUREMENT /end GROUP
/begin GROUP DampgPahFwl.dDampgPahFwlInertiaCmpHpPah "MICROSAR RTE" /begin SUB_GROUP /end SUB_GROUP /begin FUNCTION_LIST /end FUNCTION_LIST /begin REF_CHARACTERISTIC /end REF_CHARACTERISTIC /begin REF_MEASUREMENT DampgPahFwl.dDampgPahFwlInertiaCmpHpPah /end REF_MEASUREMENT /end GROUP
/begin GROUP DampgPahFwl.dDampgPahFwlInertiaCmpLowrLimFild "MICROSAR RTE" /begin SUB_GROUP /end SUB_GROUP /begin FUNCTION_LIST /end FUNCTION_LIST /begin REF_CHARACTERISTIC /end REF_CHARACTERISTIC /begin REF_MEASUREMENT DampgPahFwl.dDampgPahFwlInertiaCmpLowrLimFild /end REF_MEASUREMENT /end GROUP
/begin GROUP DampgPahFwl.dDampgPahFwlInertiaCmpLpLimd "MICROSAR RTE" /begin SUB_GROUP /end SUB_GROUP /begin FUNCTION_LIST /end FUNCTION_LIST /begin REF_CHARACTERISTIC /end REF_CHARACTERISTIC /begin REF_MEASUREMENT DampgPahFwl.dDampgPahFwlInertiaCmpLpLimd /end REF_MEASUREMENT /end GROUP
/begin GROUP DampgPahFwl.dDampgPahFwlInertiaCmpLpPah "MICROSAR RTE" /begin SUB_GROUP /end SUB_GROUP /begin FUNCTION_LIST /end FUNCTION_LIST /begin REF_CHARACTERISTIC /end REF_CHARACTERISTIC /begin REF_MEASUREMENT DampgPahFwl.dDampgPahFwlInertiaCmpLpPah /end REF_MEASUREMENT /end GROUP
/begin GROUP DampgPahFwl.dDampgPahFwlInertiaCmpOverLim "MICROSAR RTE" /begin SUB_GROUP /end SUB_GROUP /begin FUNCTION_LIST /end FUNCTION_LIST /begin REF_CHARACTERISTIC /end REF_CHARACTERISTIC /begin REF_MEASUREMENT DampgPahFwl.dDampgPahFwlInertiaCmpOverLim /end REF_MEASUREMENT /end GROUP
/begin GROUP DampgPahFwl.dDampgPahFwlInertiaCmpUpprLimFild "MICROSAR RTE" /begin SUB_GROUP /end SUB_GROUP /begin FUNCTION_LIST /end FUNCTION_LIST /begin REF_CHARACTERISTIC /end REF_CHARACTERISTIC /begin REF_MEASUREMENT DampgPahFwl.dDampgPahFwlInertiaCmpUpprLimFild /end REF_MEASUREMENT /end GROUP
/begin GROUP DiagcMgr "MICROSAR RTE"
 /begin SUB_GROUP DiagcMgr.CalibrationPorts DiagcMgr.PerInstanceMemories DiagcMgr.ReceiverPorts DiagcMgr.SenderPorts /end SUB_GROUP
 /begin FUNCTION_LIST /end FUNCTION_LIST
 /begin REF_CHARACTERISTIC /end REF_CHARACTERISTIC
 /begin REF_MEASUREMENT /end REF_MEASUREMENT
/end GROUP
/begin GROUP DiagcMgr.BrdgVltg.Val "MICROSAR RTE" /begin SUB_GROUP /end SUB_GROUP /begin FUNCTION_LIST /end FUNCTION_LIST /begin REF_CHARACTERISTIC /end REF_CHARACTERISTIC /begin REF_MEASUREMENT DiagcMgr.BrdgVltg.Val /end REF_MEASUREMENT /end GROUP
/begin GROUP DiagcMgr.CalibrationPorts "MICROSAR RTE" /begin SUB_GROUP DiagcMgr.DiagcMgrFltResp.Ary1D /end SUB_GROUP /begin FUNCTION_LIST /end FUNCTION_LIST /begin REF_CHARACTERISTIC /end REF_CHARACTERISTIC /begin REF_MEASUREMENT /end REF_MEASUREMENT /end GROUP
/begin GROUP DiagcMgr.ClrDiagcFlg "MICROSAR RTE" /begin SUB_GROUP /end SUB_GROUP /begin FUNCTION_LIST /end FUNCTION_LIST /begin REF_CHARACTERISTIC /end REF_CHARACTERISTIC /begin REF_MEASUREMENT DiagcMgr.ClrDiagcFlg /end REF_MEASUREMENT /end GROUP
/begin GROUP DiagcMgr.ClrDiagcFlgProxy.Val "MICROSAR RTE" /begin SUB_GROUP /end SUB_GROUP /begin FUNCTION_LIST /end FUNCTION_LIST /begin REF_CHARACTERISTIC /end REF_CHARACTERISTIC /begin REF_MEASUREMENT DiagcMgr.ClrDiagcFlgProxy.Val /end REF_MEASUREMENT /end GROUP
/begin GROUP DiagcMgr.DiagcMgrFltResp.Ary1D "MICROSAR RTE" /begin SUB_GROUP /end SUB_GROUP /begin FUNCTION_LIST /end FUNCTION_LIST /begin REF_CHARACTERISTIC DiagcMgr.DiagcMgrFltResp.Ary1D /end REF_CHARACTERISTIC /begin REF_MEASUREMENT /end REF_MEASUREMENT /end GROUP
/begin GROUP DiagcMgr.DiagcMgrNtcFltAry "MICROSAR RTE" /begin SUB_GROUP /end SUB_GROUP /begin FUNCTION_LIST /end FUNCTION_LIST /begin REF_CHARACTERISTIC /end REF_CHARACTERISTIC
 /begin REF_MEASUREMENT DiagcMgr.DiagcMgrNtcFltAry[0].AgiCntr DiagcMgr.DiagcMgrNtcFltAry[0].NtcNr DiagcMgr.DiagcMgrNtcFltAry[0].Sts DiagcMgr.DiagcMgrNtcFltAry[10].AgiCntr DiagcMgr.DiagcMgrNtcFltAry[10].NtcNr DiagcMgr.DiagcMgrNtcFltAry[10].Sts DiagcMgr.DiagcMgrNtcFltAry[11].AgiCntr DiagcMgr.DiagcMgrNtcFltAry[11].NtcNr DiagcMgr.DiagcMgrNtcFltAry[11].Sts DiagcMgr.DiagcMgrNtcFltAry[12].AgiCntr DiagcMgr.DiagcMgrNtcFltAry[12].NtcNr DiagcMgr.DiagcMgrNtcFltAry[12].Sts DiagcMgr.DiagcMgrNtcFltAry[13].AgiCntr DiagcMgr.DiagcMgrNtcFltAry[13].NtcNr DiagcMgr.DiagcMgrNtcFltAry[13].Sts DiagcMgr.DiagcMgrNtcFltAry[14].AgiCntr DiagcMgr.DiagcMgrNtcFltAry[14].NtcNr DiagcMgr.DiagcMgrNtcFltAry[14].Sts DiagcMgr.DiagcMgrNtcFltAry[15].AgiCntr DiagcMgr.DiagcMgrNtcFltAry[15].NtcNr DiagcMgr.DiagcMgrNtcFltAry[15].Sts DiagcMgr.DiagcMgrNtcFltAry[16].AgiCntr DiagcMgr.DiagcMgrNtcFltAry[16].NtcNr DiagcMgr.DiagcMgrNtcFltAry[16].Sts DiagcMgr.DiagcMgrNtcFltAry[17].AgiCntr DiagcMgr.DiagcMgrNtcFltAry[17].NtcNr DiagcMgr.DiagcMgrNtcFltAry[17].Sts DiagcMgr.DiagcMgrNtcFltAry[18].AgiCntr DiagcMgr.DiagcMgrNtcFltAry[18].NtcNr DiagcMgr.DiagcMgrNtcFltAry[18].Sts DiagcMgr.DiagcMgrNtcFltAry[19].AgiCntr DiagcMgr.DiagcMgrNtcFltAry[19].NtcNr DiagcMgr.DiagcMgrNtcFltAry[19].Sts DiagcMgr.DiagcMgrNtcFltAry[1].AgiCntr DiagcMgr.DiagcMgrNtcFltAry[1].NtcNr DiagcMgr.DiagcMgrNtcFltAry[1].Sts DiagcMgr.DiagcMgrNtcFltAry[2].AgiCntr DiagcMgr.DiagcMgrNtcFltAry[2].NtcNr DiagcMgr.DiagcMgrNtcFltAry[2].Sts DiagcMgr.DiagcMgrNtcFltAry[3].AgiCntr DiagcMgr.DiagcMgrNtcFltAry[3].NtcNr DiagcMgr.DiagcMgrNtcFltAry[3].Sts DiagcMgr.DiagcMgrNtcFltAry[4].AgiCntr DiagcMgr.DiagcMgrNtcFltAry[4].NtcNr DiagcMgr.DiagcMgrNtcFltAry[4].Sts DiagcMgr.DiagcMgrNtcFltAry[5].AgiCntr DiagcMgr.DiagcMgrNtcFltAry[5].NtcNr DiagcMgr.DiagcMgrNtcFltAry[5].Sts DiagcMgr.DiagcMgrNtcFltAry[6].AgiCntr DiagcMgr.DiagcMgrNtcFltAry[6].NtcNr DiagcMgr.DiagcMgrNtcFltAry[6].Sts DiagcMgr.DiagcMgrNtcFltAry[7].AgiCntr DiagcMgr.DiagcMgrNtcFltAry[7].NtcNr DiagcMgr.DiagcMgrNtcFltAry[7].Sts DiagcMgr.DiagcMgrNtcFltAry[8].AgiCntr DiagcMgr.DiagcMgrNtcFltAry[8].NtcNr DiagcMgr.DiagcMgrNtcFltAry[8].Sts DiagcMgr.DiagcMgrNtcFltAry[9].AgiCntr DiagcMgr.DiagcMgrNtcFltAry[9].NtcNr DiagcMgr.DiagcMgrNtcFltAry[9].Sts /end REF_MEASUREMENT
/end GROUP
/begin GROUP DiagcMgr.DiagcStsCtrldShtDwnFltPrsnt.Logl "MICROSAR RTE" /begin SUB_GROUP /end SUB_GROUP /begin FUNCTION_LIST /end FUNCTION_LIST /begin REF_CHARACTERISTIC /end REF_CHARACTERISTIC /begin REF_MEASUREMENT DiagcMgr.DiagcStsCtrldShtDwnFltPrsnt.Logl /end REF_MEASUREMENT /end GROUP
/begin GROUP DiagcMgr.DiagcStsDftHwAg.Logl "MICROSAR RTE" /begin SUB_GROUP /end SUB_GROUP /begin FUNCTION_LIST /end FUNCTION_LIST /begin REF_CHARACTERISTIC /end REF_CHARACTERISTIC /begin REF_MEASUREMENT DiagcMgr.DiagcStsDftHwAg.Logl /end REF_MEASUREMENT /end GROUP
/begin GROUP DiagcMgr.DiagcStsDftHwAgSerlComExprtVal.Logl "MICROSAR RTE" /begin SUB_GROUP /end SUB_GROUP /begin FUNCTION_LIST /end FUNCTION_LIST /begin REF_CHARACTERISTIC /end REF_CHARACTERISTIC /begin REF_MEASUREMENT DiagcMgr.DiagcStsDftHwAgSerlComExprtVal.Logl /end REF_MEASUREMENT /end GROUP
/begin GROUP DiagcMgr.DiagcStsDftVehSpd.Logl "MICROSAR RTE" /begin SUB_GROUP /end SUB_GROUP /begin FUNCTION_LIST /end FUNCTION_LIST /begin REF_CHARACTERISTIC /end REF_CHARACTERISTIC /begin REF_MEASUREMENT DiagcMgr.DiagcStsDftVehSpd.Logl /end REF_MEASUREMENT /end GROUP
/begin GROUP DiagcMgr.DiagcStsIvtr1Inactv.Logl "MICROSAR RTE" /begin SUB_GROUP /end SUB_GROUP /begin FUNCTION_LIST /end FUNCTION_LIST /begin REF_CHARACTERISTIC /end REF_CHARACTERISTIC /begin REF_MEASUREMENT DiagcMgr.DiagcStsIvtr1Inactv.Logl /end REF_MEASUREMENT /end GROUP
/begin GROUP DiagcMgr.DiagcStsIvtr2Inactv.Logl "MICROSAR RTE" /begin SUB_GROUP /end SUB_GROUP /begin FUNCTION_LIST /end FUNCTION_LIST /begin REF_CHARACTERISTIC /end REF_CHARACTERISTIC /begin REF_MEASUREMENT DiagcMgr.DiagcStsIvtr2Inactv.Logl /end REF_MEASUREMENT /end GROUP
/begin GROUP DiagcMgr.DiagcStsLimdTPrfmnc.Logl "MICROSAR RTE" /begin SUB_GROUP /end SUB_GROUP /begin FUNCTION_LIST /end FUNCTION_LIST /begin REF_CHARACTERISTIC /end REF_CHARACTERISTIC /begin REF_MEASUREMENT DiagcMgr.DiagcStsLimdTPrfmnc.Logl /end REF_MEASUREMENT /end GROUP
/begin GROUP DiagcMgr.DiagcStsWhlImbRejctnDi.Logl "MICROSAR RTE" /begin SUB_GROUP /end SUB_GROUP /begin FUNCTION_LIST /end FUNCTION_LIST /begin REF_CHARACTERISTIC /end REF_CHARACTERISTIC /begin REF_MEASUREMENT DiagcMgr.DiagcStsWhlImbRejctnDi.Logl /end REF_MEASUREMENT /end GROUP
/begin GROUP DiagcMgr.DtcEnaSts "MICROSAR RTE" /begin SUB_GROUP /end SUB_GROUP /begin FUNCTION_LIST /end FUNCTION_LIST /begin REF_CHARACTERISTIC /end REF_CHARACTERISTIC /begin REF_MEASUREMENT DiagcMgr.DtcEnaSts /end REF_MEASUREMENT /end GROUP
/begin GROUP DiagcMgr.EcuTFild.Val "MICROSAR RTE" /begin SUB_GROUP /end SUB_GROUP /begin FUNCTION_LIST /end FUNCTION_LIST /begin REF_CHARACTERISTIC /end REF_CHARACTERISTIC /begin REF_MEASUREMENT DiagcMgr.EcuTFild.Val /end REF_MEASUREMENT /end GROUP
/begin GROUP DiagcMgr.HwTq.Val "MICROSAR RTE" /begin SUB_GROUP /end SUB_GROUP /begin FUNCTION_LIST /end FUNCTION_LIST /begin REF_CHARACTERISTIC /end REF_CHARACTERISTIC /begin REF_MEASUREMENT DiagcMgr.HwTq.Val /end REF_MEASUREMENT /end GROUP
/begin GROUP DiagcMgr.IgnCntr.Val "MICROSAR RTE" /begin SUB_GROUP /end SUB_GROUP /begin FUNCTION_LIST /end FUNCTION_LIST /begin REF_CHARACTERISTIC /end REF_CHARACTERISTIC /begin REF_MEASUREMENT DiagcMgr.IgnCntr.Val /end REF_MEASUREMENT /end GROUP
/begin GROUP DiagcMgr.MfgDiagcInhb.Logl "MICROSAR RTE" /begin SUB_GROUP /end SUB_GROUP /begin FUNCTION_LIST /end FUNCTION_LIST /begin REF_CHARACTERISTIC /end REF_CHARACTERISTIC /begin REF_MEASUREMENT DiagcMgr.MfgDiagcInhb.Logl /end REF_MEASUREMENT /end GROUP
/begin GROUP DiagcMgr.MotTqCmdMrfScad.Val "MICROSAR RTE" /begin SUB_GROUP /end SUB_GROUP /begin FUNCTION_LIST /end FUNCTION_LIST /begin REF_CHARACTERISTIC /end REF_CHARACTERISTIC /begin REF_MEASUREMENT DiagcMgr.MotTqCmdMrfScad.Val /end REF_MEASUREMENT /end GROUP
/begin GROUP DiagcMgr.PerInstanceMemories "MICROSAR RTE"
 /begin SUB_GROUP DiagcMgr.ClrDiagcFlg DiagcMgr.DiagcMgrNtcFltAry DiagcMgr.DtcEnaSts DiagcMgr.PrevClrDtcFlg DiagcMgr.SnpshtDataAry /end SUB_GROUP
 /begin FUNCTION_LIST /end FUNCTION_LIST
 /begin REF_CHARACTERISTIC /end REF_CHARACTERISTIC
 /begin REF_MEASUREMENT /end REF_MEASUREMENT
/end GROUP
/begin GROUP DiagcMgr.PrevClrDtcFlg "MICROSAR RTE" /begin SUB_GROUP /end SUB_GROUP /begin FUNCTION_LIST /end FUNCTION_LIST /begin REF_CHARACTERISTIC /end REF_CHARACTERISTIC /begin REF_MEASUREMENT DiagcMgr.PrevClrDtcFlg /end REF_MEASUREMENT /end GROUP
/begin GROUP DiagcMgr.ReceiverPorts "MICROSAR RTE"
 /begin SUB_GROUP DiagcMgr.BrdgVltg.Val DiagcMgr.EcuTFild.Val DiagcMgr.HwTq.Val DiagcMgr.IgnCntr.Val DiagcMgr.MfgDiagcInhb.Logl DiagcMgr.MotTqCmdMrfScad.Val DiagcMgr.RegInBRAMDAT1.Val DiagcMgr.SysSt.Val DiagcMgr.VehSpd.Val /end SUB_GROUP
 /begin FUNCTION_LIST /end FUNCTION_LIST
 /begin REF_CHARACTERISTIC /end REF_CHARACTERISTIC
 /begin REF_MEASUREMENT /end REF_MEASUREMENT
/end GROUP
/begin GROUP DiagcMgr.RegInBRAMDAT1.Val "MICROSAR RTE" /begin SUB_GROUP /end SUB_GROUP /begin FUNCTION_LIST /end FUNCTION_LIST /begin REF_CHARACTERISTIC /end REF_CHARACTERISTIC /begin REF_MEASUREMENT DiagcMgr.RegInBRAMDAT1.Val /end REF_MEASUREMENT /end GROUP
/begin GROUP DiagcMgr.SenderPorts "MICROSAR RTE"
 /begin SUB_GROUP DiagcMgr.ClrDiagcFlgProxy.Val DiagcMgr.DiagcStsCtrldShtDwnFltPrsnt.Logl DiagcMgr.DiagcStsDftHwAg.Logl DiagcMgr.DiagcStsDftHwAgSerlComExprtVal.Logl DiagcMgr.DiagcStsDftVehSpd.Logl DiagcMgr.DiagcStsIvtr1Inactv.Logl DiagcMgr.DiagcStsIvtr2Inactv.Logl DiagcMgr.DiagcStsLimdTPrfmnc.Logl DiagcMgr.DiagcStsWhlImbRejctnDi.Logl DiagcMgr.SysDiMotTqCmdSca.Val DiagcMgr.SysDiRampRate.Val DiagcMgr.SysStFltOutpReqDi.Logl /end SUB_GROUP
 /begin FUNCTION_LIST /end FUNCTION_LIST
 /begin REF_CHARACTERISTIC /end REF_CHARACTERISTIC
 /begin REF_MEASUREMENT /end REF_MEASUREMENT
/end GROUP
/begin GROUP DiagcMgr.SnpshtDataAry "MICROSAR RTE" /begin SUB_GROUP /end SUB_GROUP /begin FUNCTION_LIST /end FUNCTION_LIST /begin REF_CHARACTERISTIC /end REF_CHARACTERISTIC
 /begin REF_MEASUREMENT DiagcMgr.SnpshtDataAry[0].BrdgVltg DiagcMgr.SnpshtDataAry[0].EcuT DiagcMgr.SnpshtDataAry[0].HwTq DiagcMgr.SnpshtDataAry[0].IgnCntr DiagcMgr.SnpshtDataAry[0].MicroDiagcData DiagcMgr.SnpshtDataAry[0].MotTq DiagcMgr.SnpshtDataAry[0].NtcNr DiagcMgr.SnpshtDataAry[0].NtcStInfo DiagcMgr.SnpshtDataAry[0].SysSt DiagcMgr.SnpshtDataAry[0].VehSpd DiagcMgr.SnpshtDataAry[1].BrdgVltg DiagcMgr.SnpshtDataAry[1].EcuT DiagcMgr.SnpshtDataAry[1].HwTq DiagcMgr.SnpshtDataAry[1].IgnCntr DiagcMgr.SnpshtDataAry[1].MicroDiagcData DiagcMgr.SnpshtDataAry[1].MotTq DiagcMgr.SnpshtDataAry[1].NtcNr DiagcMgr.SnpshtDataAry[1].NtcStInfo DiagcMgr.SnpshtDataAry[1].SysSt DiagcMgr.SnpshtDataAry[1].VehSpd DiagcMgr.SnpshtDataAry[2].BrdgVltg DiagcMgr.SnpshtDataAry[2].EcuT DiagcMgr.SnpshtDataAry[2].HwTq DiagcMgr.SnpshtDataAry[2].IgnCntr DiagcMgr.SnpshtDataAry[2].MicroDiagcData DiagcMgr.SnpshtDataAry[2].MotTq DiagcMgr.SnpshtDataAry[2].NtcNr DiagcMgr.SnpshtDataAry[2].NtcStInfo DiagcMgr.SnpshtDataAry[2].SysSt DiagcMgr.SnpshtDataAry[2].VehSpd DiagcMgr.SnpshtDataAry[3].BrdgVltg DiagcMgr.SnpshtDataAry[3].EcuT DiagcMgr.SnpshtDataAry[3].HwTq DiagcMgr.SnpshtDataAry[3].IgnCntr DiagcMgr.SnpshtDataAry[3].MicroDiagcData DiagcMgr.SnpshtDataAry[3].MotTq DiagcMgr.SnpshtDataAry[3].NtcNr DiagcMgr.SnpshtDataAry[3].NtcStInfo DiagcMgr.SnpshtDataAry[3].SysSt DiagcMgr.SnpshtDataAry[3].VehSpd DiagcMgr.SnpshtDataAry[4].BrdgVltg DiagcMgr.SnpshtDataAry[4].EcuT DiagcMgr.SnpshtDataAry[4].HwTq DiagcMgr.SnpshtDataAry[4].IgnCntr DiagcMgr.SnpshtDataAry[4].MicroDiagcData DiagcMgr.SnpshtDataAry[4].MotTq DiagcMgr.SnpshtDataAry[4].NtcNr DiagcMgr.SnpshtDataAry[4].NtcStInfo DiagcMgr.SnpshtDataAry[4].SysSt DiagcMgr.SnpshtDataAry[4].VehSpd DiagcMgr.SnpshtDataAry[5].BrdgVltg DiagcMgr.SnpshtDataAry[5].EcuT DiagcMgr.SnpshtDataAry[5].HwTq DiagcMgr.SnpshtDataAry[5].IgnCntr DiagcMgr.SnpshtDataAry[5].MicroDiagcData DiagcMgr.SnpshtDataAry[5].MotTq DiagcMgr.SnpshtDataAry[5].NtcNr DiagcMgr.SnpshtDataAry[5].NtcStInfo DiagcMgr.SnpshtDataAry[5].SysSt DiagcMgr.SnpshtDataAry[5].VehSpd DiagcMgr.SnpshtDataAry[6].BrdgVltg DiagcMgr.SnpshtDataAry[6].EcuT DiagcMgr.SnpshtDataAry[6].HwTq DiagcMgr.SnpshtDataAry[6].IgnCntr DiagcMgr.SnpshtDataAry[6].MicroDiagcData DiagcMgr.SnpshtDataAry[6].MotTq DiagcMgr.SnpshtDataAry[6].NtcNr DiagcMgr.SnpshtDataAry[6].NtcStInfo DiagcMgr.SnpshtDataAry[6].SysSt DiagcMgr.SnpshtDataAry[6].VehSpd DiagcMgr.SnpshtDataAry[7].BrdgVltg DiagcMgr.SnpshtDataAry[7].EcuT DiagcMgr.SnpshtDataAry[7].HwTq DiagcMgr.SnpshtDataAry[7].IgnCntr DiagcMgr.SnpshtDataAry[7].MicroDiagcData DiagcMgr.SnpshtDataAry[7].MotTq DiagcMgr.SnpshtDataAry[7].NtcNr DiagcMgr.SnpshtDataAry[7].NtcStInfo DiagcMgr.SnpshtDataAry[7].SysSt DiagcMgr.SnpshtDataAry[7].VehSpd /end REF_MEASUREMENT
/end GROUP
/begin GROUP DiagcMgr.SysDiMotTqCmdSca.Val "MICROSAR RTE" /begin SUB_GROUP /end SUB_GROUP /begin FUNCTION_LIST /end FUNCTION_LIST /begin REF_CHARACTERISTIC /end REF_CHARACTERISTIC /begin REF_MEASUREMENT DiagcMgr.SysDiMotTqCmdSca.Val /end REF_MEASUREMENT /end GROUP
/begin GROUP DiagcMgr.SysDiRampRate.Val "MICROSAR RTE" /begin SUB_GROUP /end SUB_GROUP /begin FUNCTION_LIST /end FUNCTION_LIST /begin REF_CHARACTERISTIC /end REF_CHARACTERISTIC /begin REF_MEASUREMENT DiagcMgr.SysDiRampRate.Val /end REF_MEASUREMENT /end GROUP
/begin GROUP DiagcMgr.SysSt.Val "MICROSAR RTE" /begin SUB_GROUP /end SUB_GROUP /begin FUNCTION_LIST /end FUNCTION_LIST /begin REF_CHARACTERISTIC /end REF_CHARACTERISTIC /begin REF_MEASUREMENT DiagcMgr.SysSt.Val /end REF_MEASUREMENT /end GROUP
/begin GROUP DiagcMgr.SysStFltOutpReqDi.Logl "MICROSAR RTE" /begin SUB_GROUP /end SUB_GROUP /begin FUNCTION_LIST /end FUNCTION_LIST /begin REF_CHARACTERISTIC /end REF_CHARACTERISTIC /begin REF_MEASUREMENT DiagcMgr.SysStFltOutpReqDi.Logl /end REF_MEASUREMENT /end GROUP
/begin GROUP DiagcMgr.VehSpd.Val "MICROSAR RTE" /begin SUB_GROUP /end SUB_GROUP /begin FUNCTION_LIST /end FUNCTION_LIST /begin REF_CHARACTERISTIC /end REF_CHARACTERISTIC /begin REF_MEASUREMENT DiagcMgr.VehSpd.Val /end REF_MEASUREMENT /end GROUP
/begin GROUP DiagcMgrProxyAppl10 "MICROSAR RTE"
 /begin SUB_GROUP DiagcMgrProxyAppl10.CalibrationPorts DiagcMgrProxyAppl10.PerInstanceMemories DiagcMgrProxyAppl10.ReceiverPorts /end SUB_GROUP
 /begin FUNCTION_LIST /end FUNCTION_LIST
 /begin REF_CHARACTERISTIC /end REF_CHARACTERISTIC
 /begin REF_MEASUREMENT /end REF_MEASUREMENT
/end GROUP
/begin GROUP DiagcMgrProxyAppl10.CalibrationPorts "MICROSAR RTE" /begin SUB_GROUP DiagcMgrProxyAppl10.DiagcMgrFltResp.Ary1D /end SUB_GROUP /begin FUNCTION_LIST /end FUNCTION_LIST /begin REF_CHARACTERISTIC /end REF_CHARACTERISTIC /begin REF_MEASUREMENT /end REF_MEASUREMENT /end GROUP
/begin GROUP DiagcMgrProxyAppl10.ClrDiagcFlgProxy.Val "MICROSAR RTE" /begin SUB_GROUP /end SUB_GROUP /begin FUNCTION_LIST /end FUNCTION_LIST /begin REF_CHARACTERISTIC /end REF_CHARACTERISTIC /begin REF_MEASUREMENT DiagcMgrProxyAppl10.ClrDiagcFlgProxy.Val /end REF_MEASUREMENT /end GROUP
/begin GROUP DiagcMgrProxyAppl10.DiagcData10 "MICROSAR RTE" /begin SUB_GROUP /end SUB_GROUP /begin FUNCTION_LIST /end FUNCTION_LIST /begin REF_CHARACTERISTIC /end REF_CHARACTERISTIC
 /begin REF_MEASUREMENT DiagcMgrProxyAppl10.DiagcData10.ActvMotTqCmdSca DiagcMgrProxyAppl10.DiagcData10.ActvRampRate DiagcMgrProxyAppl10.DiagcData10.DiagcSts /end REF_MEASUREMENT
/end GROUP
/begin GROUP DiagcMgrProxyAppl10.DiagcMgrFltResp.Ary1D "MICROSAR RTE" /begin SUB_GROUP /end SUB_GROUP /begin FUNCTION_LIST /end FUNCTION_LIST /begin REF_CHARACTERISTIC DiagcMgrProxyAppl10.DiagcMgrFltResp.Ary1D /end REF_CHARACTERISTIC /begin REF_MEASUREMENT /end REF_MEASUREMENT /end GROUP
/begin GROUP DiagcMgrProxyAppl10.PerInstanceMemories "MICROSAR RTE"
 /begin SUB_GROUP DiagcMgrProxyAppl10.DiagcData10 DiagcMgrProxyAppl10.PrevClrNtcFlg10 DiagcMgrProxyAppl10.ProxySetNtcData10 /end SUB_GROUP
 /begin FUNCTION_LIST /end FUNCTION_LIST
 /begin REF_CHARACTERISTIC /end REF_CHARACTERISTIC
 /begin REF_MEASUREMENT /end REF_MEASUREMENT
/end GROUP
/begin GROUP DiagcMgrProxyAppl10.PrevClrNtcFlg10 "MICROSAR RTE" /begin SUB_GROUP /end SUB_GROUP /begin FUNCTION_LIST /end FUNCTION_LIST /begin REF_CHARACTERISTIC /end REF_CHARACTERISTIC /begin REF_MEASUREMENT DiagcMgrProxyAppl10.PrevClrNtcFlg10 /end REF_MEASUREMENT /end GROUP
/begin GROUP DiagcMgrProxyAppl10.ProxySetNtcData10 "MICROSAR RTE" /begin SUB_GROUP /end SUB_GROUP /begin FUNCTION_LIST /end FUNCTION_LIST /begin REF_CHARACTERISTIC /end REF_CHARACTERISTIC
 /begin REF_MEASUREMENT DiagcMgrProxyAppl10.ProxySetNtcData10.ActvMotTqCmdSca DiagcMgrProxyAppl10.ProxySetNtcData10.ActvRampRate DiagcMgrProxyAppl10.ProxySetNtcData10.DiagcSts /end REF_MEASUREMENT
/end GROUP
/begin GROUP DiagcMgrProxyAppl10.ReceiverPorts "MICROSAR RTE" /begin SUB_GROUP DiagcMgrProxyAppl10.ClrDiagcFlgProxy.Val /end SUB_GROUP /begin FUNCTION_LIST /end FUNCTION_LIST /begin REF_CHARACTERISTIC /end REF_CHARACTERISTIC /begin REF_MEASUREMENT /end REF_MEASUREMENT /end GROUP
/begin GROUP DiagcMgrProxyAppl6 "MICROSAR RTE"
 /begin SUB_GROUP DiagcMgrProxyAppl6.CalibrationPorts DiagcMgrProxyAppl6.PerInstanceMemories DiagcMgrProxyAppl6.ReceiverPorts /end SUB_GROUP
 /begin FUNCTION_LIST /end FUNCTION_LIST
 /begin REF_CHARACTERISTIC /end REF_CHARACTERISTIC
 /begin REF_MEASUREMENT /end REF_MEASUREMENT
/end GROUP
/begin GROUP DiagcMgrProxyAppl6.CalibrationPorts "MICROSAR RTE" /begin SUB_GROUP DiagcMgrProxyAppl6.DiagcMgrFltResp.Ary1D /end SUB_GROUP /begin FUNCTION_LIST /end FUNCTION_LIST /begin REF_CHARACTERISTIC /end REF_CHARACTERISTIC /begin REF_MEASUREMENT /end REF_MEASUREMENT /end GROUP
/begin GROUP DiagcMgrProxyAppl6.ClrDiagcFlgProxy.Val "MICROSAR RTE" /begin SUB_GROUP /end SUB_GROUP /begin FUNCTION_LIST /end FUNCTION_LIST /begin REF_CHARACTERISTIC /end REF_CHARACTERISTIC /begin REF_MEASUREMENT DiagcMgrProxyAppl6.ClrDiagcFlgProxy.Val /end REF_MEASUREMENT /end GROUP
/begin GROUP DiagcMgrProxyAppl6.DiagcData6 "MICROSAR RTE" /begin SUB_GROUP /end SUB_GROUP /begin FUNCTION_LIST /end FUNCTION_LIST /begin REF_CHARACTERISTIC /end REF_CHARACTERISTIC
 /begin REF_MEASUREMENT DiagcMgrProxyAppl6.DiagcData6.ActvMotTqCmdSca DiagcMgrProxyAppl6.DiagcData6.ActvRampRate DiagcMgrProxyAppl6.DiagcData6.DiagcSts /end REF_MEASUREMENT
/end GROUP
/begin GROUP DiagcMgrProxyAppl6.DiagcMgrFltResp.Ary1D "MICROSAR RTE" /begin SUB_GROUP /end SUB_GROUP /begin FUNCTION_LIST /end FUNCTION_LIST /begin REF_CHARACTERISTIC DiagcMgrProxyAppl6.DiagcMgrFltResp.Ary1D /end REF_CHARACTERISTIC /begin REF_MEASUREMENT /end REF_MEASUREMENT /end GROUP
/begin GROUP DiagcMgrProxyAppl6.PerInstanceMemories "MICROSAR RTE"
 /begin SUB_GROUP DiagcMgrProxyAppl6.DiagcData6 DiagcMgrProxyAppl6.PrevClrNtcFlg6 DiagcMgrProxyAppl6.ProxySetNtcData6 /end SUB_GROUP
 /begin FUNCTION_LIST /end FUNCTION_LIST
 /begin REF_CHARACTERISTIC /end REF_CHARACTERISTIC
 /begin REF_MEASUREMENT /end REF_MEASUREMENT
/end GROUP
/begin GROUP DiagcMgrProxyAppl6.PrevClrNtcFlg6 "MICROSAR RTE" /begin SUB_GROUP /end SUB_GROUP /begin FUNCTION_LIST /end FUNCTION_LIST /begin REF_CHARACTERISTIC /end REF_CHARACTERISTIC /begin REF_MEASUREMENT DiagcMgrProxyAppl6.PrevClrNtcFlg6 /end REF_MEASUREMENT /end GROUP
/begin GROUP DiagcMgrProxyAppl6.ProxySetNtcData6 "MICROSAR RTE" /begin SUB_GROUP /end SUB_GROUP /begin FUNCTION_LIST /end FUNCTION_LIST /begin REF_CHARACTERISTIC /end REF_CHARACTERISTIC
 /begin REF_MEASUREMENT DiagcMgrProxyAppl6.ProxySetNtcData6.ActvMotTqCmdSca DiagcMgrProxyAppl6.ProxySetNtcData6.ActvRampRate DiagcMgrProxyAppl6.ProxySetNtcData6.DiagcSts /end REF_MEASUREMENT
/end GROUP
/begin GROUP DiagcMgrProxyAppl6.ReceiverPorts "MICROSAR RTE" /begin SUB_GROUP DiagcMgrProxyAppl6.ClrDiagcFlgProxy.Val /end SUB_GROUP /begin FUNCTION_LIST /end FUNCTION_LIST /begin REF_CHARACTERISTIC /end REF_CHARACTERISTIC /begin REF_MEASUREMENT /end REF_MEASUREMENT /end GROUP
/begin GROUP DualEcuIdn "MICROSAR RTE"
 /begin SUB_GROUP DualEcuIdn.PerInstanceMemories DualEcuIdn.ReceiverPorts DualEcuIdn.SenderPorts /end SUB_GROUP
 /begin FUNCTION_LIST /end FUNCTION_LIST
 /begin REF_CHARACTERISTIC /end REF_CHARACTERISTIC
 /begin REF_MEASUREMENT /end REF_MEASUREMENT
/end GROUP
/begin GROUP DualEcuIdn.EcuComTiOut.Logl "MICROSAR RTE" /begin SUB_GROUP /end SUB_GROUP /begin FUNCTION_LIST /end FUNCTION_LIST /begin REF_CHARACTERISTIC /end REF_CHARACTERISTIC /begin REF_MEASUREMENT DualEcuIdn.EcuComTiOut.Logl /end REF_MEASUREMENT /end GROUP
/begin GROUP DualEcuIdn.EcuId.Val "MICROSAR RTE" /begin SUB_GROUP /end SUB_GROUP /begin FUNCTION_LIST /end FUNCTION_LIST /begin REF_CHARACTERISTIC /end REF_CHARACTERISTIC /begin REF_MEASUREMENT DualEcuIdn.EcuId.Val /end REF_MEASUREMENT /end GROUP
/begin GROUP DualEcuIdn.EcuIdInt "MICROSAR RTE" /begin SUB_GROUP /end SUB_GROUP /begin FUNCTION_LIST /end FUNCTION_LIST /begin REF_CHARACTERISTIC /end REF_CHARACTERISTIC /begin REF_MEASUREMENT DualEcuIdn.EcuIdInt /end REF_MEASUREMENT /end GROUP
/begin GROUP DualEcuIdn.EcuIdnEvlnCmpl "MICROSAR RTE" /begin SUB_GROUP /end SUB_GROUP /begin FUNCTION_LIST /end FUNCTION_LIST /begin REF_CHARACTERISTIC /end REF_CHARACTERISTIC /begin REF_MEASUREMENT DualEcuIdn.EcuIdnEvlnCmpl /end REF_MEASUREMENT /end GROUP
/begin GROUP DualEcuIdn.PerInstanceMemories "MICROSAR RTE"
 /begin SUB_GROUP DualEcuIdn.EcuIdInt DualEcuIdn.EcuIdnEvlnCmpl DualEcuIdn.SecdryEcuIdnReqTiOutCntr /end SUB_GROUP
 /begin FUNCTION_LIST /end FUNCTION_LIST
 /begin REF_CHARACTERISTIC /end REF_CHARACTERISTIC
 /begin REF_MEASUREMENT /end REF_MEASUREMENT
/end GROUP
/begin GROUP DualEcuIdn.ReceiverPorts "MICROSAR RTE" /begin SUB_GROUP DualEcuIdn.EcuComTiOut.Logl /end SUB_GROUP /begin FUNCTION_LIST /end FUNCTION_LIST /begin REF_CHARACTERISTIC /end REF_CHARACTERISTIC /begin REF_MEASUREMENT /end REF_MEASUREMENT /end GROUP
/begin GROUP DualEcuIdn.SecdryEcuIdnReqTiOutCntr "MICROSAR RTE" /begin SUB_GROUP /end SUB_GROUP /begin FUNCTION_LIST /end FUNCTION_LIST /begin REF_CHARACTERISTIC /end REF_CHARACTERISTIC /begin REF_MEASUREMENT DualEcuIdn.SecdryEcuIdnReqTiOutCntr /end REF_MEASUREMENT /end GROUP
/begin GROUP DualEcuIdn.SenderPorts "MICROSAR RTE" /begin SUB_GROUP DualEcuIdn.EcuId.Val /end SUB_GROUP /begin FUNCTION_LIST /end FUNCTION_LIST /begin REF_CHARACTERISTIC /end REF_CHARACTERISTIC /begin REF_MEASUREMENT /end REF_MEASUREMENT /end GROUP
/begin GROUP DutyCycThermProtn "MICROSAR RTE"
 /begin SUB_GROUP DutyCycThermProtn.CalibrationPorts DutyCycThermProtn.PerInstanceMemories DutyCycThermProtn.ReceiverPorts DutyCycThermProtn.SenderPorts /end SUB_GROUP
 /begin FUNCTION_LIST /end FUNCTION_LIST
 /begin REF_CHARACTERISTIC /end REF_CHARACTERISTIC
 /begin REF_MEASUREMENT /end REF_MEASUREMENT
/end GROUP
/begin GROUP DutyCycThermProtn.AbsltTLimSlewStVari "MICROSAR RTE" /begin SUB_GROUP /end SUB_GROUP /begin FUNCTION_LIST /end FUNCTION_LIST /begin REF_CHARACTERISTIC /end REF_CHARACTERISTIC /begin REF_MEASUREMENT DutyCycThermProtn.AbsltTLimSlewStVari /end REF_MEASUREMENT /end GROUP
/begin GROUP DutyCycThermProtn.CalibrationPorts "MICROSAR RTE"
 /begin SUB_GROUP DutyCycThermProtn.DutyCycThermProtnAbsltCtrlTTblX.Ary1D DutyCycThermProtn.DutyCycThermProtnAbsltCtrlTTqTblY.Ary1D DutyCycThermProtn.DutyCycThermProtnAbsltCuTTblX.Ary1D DutyCycThermProtn.DutyCycThermProtnAbsltCuTTqTblY.Ary1D DutyCycThermProtn.DutyCycThermProtnAbsltMotVelBreakPt.Val DutyCycThermProtn.DutyCycThermProtnAbsltTTqSlewHiLim.Val DutyCycThermProtn.DutyCycThermProtnAbsltTTqSlewLoLim.Val DutyCycThermProtn.DutyCycThermProtnCtrlT.Val DutyCycThermProtn.DutyCycThermProtnCtrlTSeln.Logl DutyCycThermProtn.DutyCycThermProtnDutyCycFildThd.Val DutyCycThermProtn.DutyCycThermProtnIgnOffCtrlEna.Logl DutyCycThermProtn.DutyCycThermProtnIgnOffMsgWaitTi.Val DutyCycThermProtn.DutyCycThermProtnLstTblValNonStall.Ary1D DutyCycThermProtn.DutyCycThermProtnLstTblValStall.Ary1D DutyCycThermProtn.DutyCycThermProtnMotPrTSeln.Logl DutyCycThermProtn.DutyCycThermProtnMplr1NonStallTblY.Ary1D DutyCycThermProtn.DutyCycThermProtnMplr1StallTblY.Ary1D DutyCycThermProtn.DutyCycThermProtnMplr2NonStallTblY.Ary1D DutyCycThermProtn.DutyCycThermProtnMplr2StallTblY.Ary1D DutyCycThermProtn.DutyCycThermProtnMplr3NonStallTblY.Ary1D DutyCycThermProtn.DutyCycThermProtnMplr3StallTblY.Ary1D DutyCycThermProtn.DutyCycThermProtnMplr4NonStallTblY.Ary1D DutyCycThermProtn.DutyCycThermProtnMplr4StallTblY.Ary1D DutyCycThermProtn.DutyCycThermProtnMplr5NonStallTblY.Ary1D DutyCycThermProtn.DutyCycThermProtnMplr5StallTblY.Ary1D DutyCycThermProtn.DutyCycThermProtnMplr6NonStallTblY.Ary1D DutyCycThermProtn.DutyCycThermProtnMplr6StallTblY.Ary1D DutyCycThermProtn.DutyCycThermProtnMplrTSeln.Logl DutyCycThermProtn.DutyCycThermProtnMplrTblX.Ary1D DutyCycThermProtn.DutyCycThermProtnSlowFilTSeln.Logl DutyCycThermProtn.DutyCycThermProtnThermLimScaFac.Val DutyCycThermProtn.DutyCycThermProtnThermLoadLimTblX.Ary1D DutyCycThermProtn.DutyCycThermProtnThermLoadLimTblY.Ary1D DutyCycThermProtn.DutyCycThermProtnTqCmdSlewDwn.Val DutyCycThermProtn.DutyCycThermProtnTqCmdSlewUp.Val /end SUB_GROUP
 /begin FUNCTION_LIST /end FUNCTION_LIST
 /begin REF_CHARACTERISTIC /end REF_CHARACTERISTIC
 /begin REF_MEASUREMENT /end REF_MEASUREMENT
/end GROUP
/begin GROUP DutyCycThermProtn.DiagcStsLimdTPrfmnc.Logl "MICROSAR RTE" /begin SUB_GROUP /end SUB_GROUP /begin FUNCTION_LIST /end FUNCTION_LIST /begin REF_CHARACTERISTIC /end REF_CHARACTERISTIC /begin REF_MEASUREMENT DutyCycThermProtn.DiagcStsLimdTPrfmnc.Logl /end REF_MEASUREMENT /end GROUP
/begin GROUP DutyCycThermProtn.DualEcuFltMtgtnEna.Logl "MICROSAR RTE" /begin SUB_GROUP /end SUB_GROUP /begin FUNCTION_LIST /end FUNCTION_LIST /begin REF_CHARACTERISTIC /end REF_CHARACTERISTIC /begin REF_MEASUREMENT DutyCycThermProtn.DualEcuFltMtgtnEna.Logl /end REF_MEASUREMENT /end GROUP
/begin GROUP DutyCycThermProtn.DutyCycThermProtnAbsltCtrlTTblX.Ary1D "MICROSAR RTE" /begin SUB_GROUP /end SUB_GROUP /begin FUNCTION_LIST /end FUNCTION_LIST /begin REF_CHARACTERISTIC DutyCycThermProtn.DutyCycThermProtnAbsltCtrlTTblX.Ary1D /end REF_CHARACTERISTIC /begin REF_MEASUREMENT /end REF_MEASUREMENT /end GROUP
/begin GROUP DutyCycThermProtn.DutyCycThermProtnAbsltCtrlTTqTblY.Ary1D "MICROSAR RTE" /begin SUB_GROUP /end SUB_GROUP /begin FUNCTION_LIST /end FUNCTION_LIST /begin REF_CHARACTERISTIC DutyCycThermProtn.DutyCycThermProtnAbsltCtrlTTqTblY.Ary1D /end REF_CHARACTERISTIC /begin REF_MEASUREMENT /end REF_MEASUREMENT /end GROUP
/begin GROUP DutyCycThermProtn.DutyCycThermProtnAbsltCuTTblX.Ary1D "MICROSAR RTE" /begin SUB_GROUP /end SUB_GROUP /begin FUNCTION_LIST /end FUNCTION_LIST /begin REF_CHARACTERISTIC DutyCycThermProtn.DutyCycThermProtnAbsltCuTTblX.Ary1D /end REF_CHARACTERISTIC /begin REF_MEASUREMENT /end REF_MEASUREMENT /end GROUP
/begin GROUP DutyCycThermProtn.DutyCycThermProtnAbsltCuTTqTblY.Ary1D "MICROSAR RTE" /begin SUB_GROUP /end SUB_GROUP /begin FUNCTION_LIST /end FUNCTION_LIST /begin REF_CHARACTERISTIC DutyCycThermProtn.DutyCycThermProtnAbsltCuTTqTblY.Ary1D /end REF_CHARACTERISTIC /begin REF_MEASUREMENT /end REF_MEASUREMENT /end GROUP
/begin GROUP DutyCycThermProtn.DutyCycThermProtnAbsltMotVelBreakPt.Val "MICROSAR RTE" /begin SUB_GROUP /end SUB_GROUP /begin FUNCTION_LIST /end FUNCTION_LIST /begin REF_CHARACTERISTIC DutyCycThermProtn.DutyCycThermProtnAbsltMotVelBreakPt.Val /end REF_CHARACTERISTIC /begin REF_MEASUREMENT /end REF_MEASUREMENT /end GROUP
/begin GROUP DutyCycThermProtn.DutyCycThermProtnAbsltTTqSlewHiLim.Val "MICROSAR RTE" /begin SUB_GROUP /end SUB_GROUP /begin FUNCTION_LIST /end FUNCTION_LIST /begin REF_CHARACTERISTIC DutyCycThermProtn.DutyCycThermProtnAbsltTTqSlewHiLim.Val /end REF_CHARACTERISTIC /begin REF_MEASUREMENT /end REF_MEASUREMENT /end GROUP
/begin GROUP DutyCycThermProtn.DutyCycThermProtnAbsltTTqSlewLoLim.Val "MICROSAR RTE" /begin SUB_GROUP /end SUB_GROUP /begin FUNCTION_LIST /end FUNCTION_LIST /begin REF_CHARACTERISTIC DutyCycThermProtn.DutyCycThermProtnAbsltTTqSlewLoLim.Val /end REF_CHARACTERISTIC /begin REF_MEASUREMENT /end REF_MEASUREMENT /end GROUP
/begin GROUP DutyCycThermProtn.DutyCycThermProtnCtrlT.Val "MICROSAR RTE" /begin SUB_GROUP /end SUB_GROUP /begin FUNCTION_LIST /end FUNCTION_LIST /begin REF_CHARACTERISTIC DutyCycThermProtn.DutyCycThermProtnCtrlT.Val /end REF_CHARACTERISTIC /begin REF_MEASUREMENT /end REF_MEASUREMENT /end GROUP
/begin GROUP DutyCycThermProtn.DutyCycThermProtnCtrlTSeln.Logl "MICROSAR RTE" /begin SUB_GROUP /end SUB_GROUP /begin FUNCTION_LIST /end FUNCTION_LIST /begin REF_CHARACTERISTIC DutyCycThermProtn.DutyCycThermProtnCtrlTSeln.Logl /end REF_CHARACTERISTIC /begin REF_MEASUREMENT /end REF_MEASUREMENT /end GROUP
/begin GROUP DutyCycThermProtn.DutyCycThermProtnDi.Logl "MICROSAR RTE" /begin SUB_GROUP /end SUB_GROUP /begin FUNCTION_LIST /end FUNCTION_LIST /begin REF_CHARACTERISTIC /end REF_CHARACTERISTIC /begin REF_MEASUREMENT DutyCycThermProtn.DutyCycThermProtnDi.Logl /end REF_MEASUREMENT /end GROUP
/begin GROUP DutyCycThermProtn.DutyCycThermProtnDutyCycFildThd.Val "MICROSAR RTE" /begin SUB_GROUP /end SUB_GROUP /begin FUNCTION_LIST /end FUNCTION_LIST /begin REF_CHARACTERISTIC DutyCycThermProtn.DutyCycThermProtnDutyCycFildThd.Val /end REF_CHARACTERISTIC /begin REF_MEASUREMENT /end REF_MEASUREMENT /end GROUP
/begin GROUP DutyCycThermProtn.DutyCycThermProtnIgnOffCtrlEna.Logl "MICROSAR RTE" /begin SUB_GROUP /end SUB_GROUP /begin FUNCTION_LIST /end FUNCTION_LIST /begin REF_CHARACTERISTIC DutyCycThermProtn.DutyCycThermProtnIgnOffCtrlEna.Logl /end REF_CHARACTERISTIC /begin REF_MEASUREMENT /end REF_MEASUREMENT /end GROUP
/begin GROUP DutyCycThermProtn.DutyCycThermProtnIgnOffMsgWaitTi.Val "MICROSAR RTE" /begin SUB_GROUP /end SUB_GROUP /begin FUNCTION_LIST /end FUNCTION_LIST /begin REF_CHARACTERISTIC DutyCycThermProtn.DutyCycThermProtnIgnOffMsgWaitTi.Val /end REF_CHARACTERISTIC /begin REF_MEASUREMENT /end REF_MEASUREMENT /end GROUP
/begin GROUP DutyCycThermProtn.DutyCycThermProtnLstTblValNonStall.Ary1D "MICROSAR RTE" /begin SUB_GROUP /end SUB_GROUP /begin FUNCTION_LIST /end FUNCTION_LIST /begin REF_CHARACTERISTIC DutyCycThermProtn.DutyCycThermProtnLstTblValNonStall.Ary1D /end REF_CHARACTERISTIC /begin REF_MEASUREMENT /end REF_MEASUREMENT /end GROUP
/begin GROUP DutyCycThermProtn.DutyCycThermProtnLstTblValStall.Ary1D "MICROSAR RTE" /begin SUB_GROUP /end SUB_GROUP /begin FUNCTION_LIST /end FUNCTION_LIST /begin REF_CHARACTERISTIC DutyCycThermProtn.DutyCycThermProtnLstTblValStall.Ary1D /end REF_CHARACTERISTIC /begin REF_MEASUREMENT /end REF_MEASUREMENT /end GROUP
/begin GROUP DutyCycThermProtn.DutyCycThermProtnMaxOutp.Val "MICROSAR RTE" /begin SUB_GROUP /end SUB_GROUP /begin FUNCTION_LIST /end FUNCTION_LIST /begin REF_CHARACTERISTIC /end REF_CHARACTERISTIC /begin REF_MEASUREMENT DutyCycThermProtn.DutyCycThermProtnMaxOutp.Val /end REF_MEASUREMENT /end GROUP
/begin GROUP DutyCycThermProtn.DutyCycThermProtnMotPrTSeln.Logl "MICROSAR RTE" /begin SUB_GROUP /end SUB_GROUP /begin FUNCTION_LIST /end FUNCTION_LIST /begin REF_CHARACTERISTIC DutyCycThermProtn.DutyCycThermProtnMotPrTSeln.Logl /end REF_CHARACTERISTIC /begin REF_MEASUREMENT /end REF_MEASUREMENT /end GROUP
/begin RECORD_LAYOUT RTE_RL_UWORD FNC_VALUES 1 UWORD ROW_DIR DIRECT /end RECORD_LAYOUT
/begin RECORD_LAYOUT RTE_RL_ULONG FNC_VALUES 1 ULONG ROW_DIR DIRECT /end RECORD_LAYOUT
/begin RECORD_LAYOUT RTE_RL_SWORD FNC_VALUES 1 SWORD ROW_DIR DIRECT /end RECORD_LAYOUT
/begin RECORD_LAYOUT RTE_RL_FLOAT32_IEEE FNC_VALUES 1 FLOAT32_IEEE ROW_DIR DIRECT /end RECORD_LAYOUT
/begin RECORD_LAYOUT RTE_RL_BOOLEAN FNC_VALUES 1 UBYTE ROW_DIR DIRECT /end RECORD_LAYOUT
/**********************************************************************************************************************
* COMPU_METHOD / COMPU_VTAB_RANGE
*********************************************************************************************************************/
/begin COMPU_METHOD RTE_CM_BOOLEAN "" TAB_VERB "%3.1" "" COMPU_TAB_REF RTE_CM_BOOLEAN /end COMPU_METHOD
/begin COMPU_VTAB_RANGE RTE_CM_BOOLEAN "" 2 0 0 "false" 1 255 "true" /end COMPU_VTAB_RANGE
/begin COMPU_METHOD RTE_CM_ENUM_SysSt1 "" TAB_VERB "%.1" "" COMPU_TAB_REF RTE_CM_ENUM_SysSt1 /end COMPU_METHOD
/begin COMPU_VTAB_RANGE RTE_CM_ENUM_SysSt1 "" 4 0 0 "SYSST_DI" 1 1 "SYSST_OFF" 2 2 "SYSST_ENA" 3 3 "SYSST_WRMININ" /end COMPU_VTAB_RANGE
/begin COMPU_METHOD RTE_CM_ENUM_GmFctDiArbnSts1 "" TAB_VERB "%.1" "" COMPU_TAB_REF RTE_CM_ENUM_GmFctDiArbnSts1 /end COMPU_METHOD
/begin COMPU_VTAB_RANGE RTE_CM_ENUM_GmFctDiArbnSts1 "" 5 0 0 "GMFCTDIARBNSTS_WAIT" 1 1 "GMFCTDIARBNSTS_INPROC" 2 2 "GMFCTDIARBNSTS_PASSD" 3 3 "GMFCTDIARBNSTS_SWBASDMTGTNFAIL" 4 4 "GMFCTDIARBNSTS_TIMEOUTFAIL" /end COMPU_VTAB_RANGE
/begin COMPU_METHOD RTE_CM_ENUM_NtcNrWithResd1 "" TAB_VERB "%.1" "" COMPU_TAB_REF RTE_CM_ENUM_NtcNrWithResd1 /end COMPU_METHOD
/begin COMPU_VTAB_RANGE RTE_CM_ENUM_NtcNrWithResd1 "" 512 0 0 "NTCNR_RESD" 1 1 "NTCNR_0X001" 2 2 "NTCNR_0X002" 3 3 "NTCNR_0X003" 4 4 "NTCNR_0X004" 5 5 "NTCNR_0X005" 6 6 "NTCNR_0X006" 7 7 "NTCNR_0X007" 8 8 "NTCNR_0X008" 9 9 "NTCNR_0X009" 10 10 "NTCNR_0X00A" 11 11 "NTCNR_0X00B" 12 12 "NTCNR_0X00C" 13 13 "NTCNR_0X00D" 14 14 "NTCNR_0X00E" 15 15 "NTCNR_0X00F" 16 16 "NTCNR_0X010" 17 17 "NTCNR_0X011" 18 18 "NTCNR_0X012" 19 19 "NTCNR_0X013" 20 20 "NTCNR_0X014" 21 21 "NTCNR_0X015" 22 22 "NTCNR_0X016" 23 23 "NTCNR_0X017" 24 24 "NTCNR_0X018" 25 25 "NTCNR_0X019" 26 26 "NTCNR_0X01A" 27 27 "NTCNR_0X01B" 28 28 "NTCNR_0X01C" 29 29 "NTCNR_0X01D" 30 30 "NTCNR_0X01E" 31 31 "NTCNR_0X01F" 32 32 "NTCNR_0X020" 33 33 "NTCNR_0X021" 34 34 "NTCNR_0X022" 35 35 "NTCNR_0X023" 36 36 "NTCNR_0X024" 37 37 "NTCNR_0X025" 38 38 "NTCNR_0X026" 39 39 "NTCNR_0X027" 40 40 "NTCNR_0X028" 41 41 "NTCNR_0X029" 42 42 "NTCNR_0X02A" 43 43 "NTCNR_0X02B" 44 44 "NTCNR_0X02C" 45 45 "NTCNR_0X02D" 46 46 "NTCNR_0X02E" 47 47 "NTCNR_0X02F" 48 48 "NTCNR_0X030" 49 49 "NTCNR_0X031" 50 50 "NTCNR_0X032" 51 51 "NTCNR_0X033" 52 52 "NTCNR_0X034" 53 53 "NTCNR_0X035" 54 54 "NTCNR_0X036" 55 55 "NTCNR_0X037" 56 56 "NTCNR_0X038" 57 57 "NTCNR_0X039" 58 58 "NTCNR_0X03A" 59 59 "NTCNR_0X03B" 60 60 "NTCNR_0X03C" 61 61 "NTCNR_0X03D" 62 62 "NTCNR_0X03E" 63 63 "NTCNR_0X03F" 64 64 "NTCNR_0X040" 65 65 "NTCNR_0X041" 66 66 "NTCNR_0X042" 67 67 "NTCNR_0X043" 68 68 "NTCNR_0X044" 69 69 "NTCNR_0X045" 70 70 "NTCNR_0X046" 71 71 "NTCNR_0X047" 72 72 "NTCNR_0X048" 73 73 "NTCNR_0X049" 74 74 "NTCNR_0X04A" 75 75 "NTCNR_0X04B" 76 76 "NTCNR_0X04C" 77 77 "NTCNR_0X04D" 78 78 "NTCNR_0X04E" 79 79 "NTCNR_0X04F" 80 80 "NTCNR_0X050" 81 81 "NTCNR_0X051" 82 82 "NTCNR_0X052" 83 83 "NTCNR_0X053" 84 84 "NTCNR_0X054" 85 85 "NTCNR_0X055" 86 86 "NTCNR_0X056" 87 87 "NTCNR_0X057" 88 88 "NTCNR_0X058" 89 89 "NTCNR_0X059" 90 90 "NTCNR_0X05A" 91 91 "NTCNR_0X05B" 92 92 "NTCNR_0X05C" 93 93 "NTCNR_0X05D" 94 94 "NTCNR_0X05E" 95 95 "NTCNR_0X05F" 96 96 "NTCNR_0X060" 97 97 "NTCNR_0X061" 98 98 "NTCNR_0X062" 99 99 "NTCNR_0X063" 100 100 "NTCNR_0X064" 101 101 "NTCNR_0X065" 102 102 "NTCNR_0X066" 103 103 "NTCNR_0X067" 104 104 "NTCNR_0X068" 105 105 "NTCNR_0X069" 106 106 "NTCNR_0X06A" 107 107 "NTCNR_0X06B" 108 108 "NTCNR_0X06C" 109 109 "NTCNR_0X06D" 110 110 "NTCNR_0X06E" 111 111 "NTCNR_0X06F" 112 112 "NTCNR_0X070" 113 113 "NTCNR_0X071" 114 114 "NTCNR_0X072" 115 115 "NTCNR_0X073" 116 116 "NTCNR_0X074" 117 117 "NTCNR_0X075" 118 118 "NTCNR_0X076" 119 119 "NTCNR_0X077" 120 120 "NTCNR_0X078" 121 121 "NTCNR_0X079" 122 122 "NTCNR_0X07A" 123 123 "NTCNR_0X07B" 124 124 "NTCNR_0X07C" 125 125 "NTCNR_0X07D" 126 126 "NTCNR_0X07E" 127 127 "NTCNR_0X07F" 128 128 "NTCNR_0X080" 129 129 "NTCNR_0X081" 130 130 "NTCNR_0X082" 131 131 "NTCNR_0X083" 132 132 "NTCNR_0X084" 133 133 "NTCNR_0X085" 134 134 "NTCNR_0X086" 135 135 "NTCNR_0X087" 136 136 "NTCNR_0X088" 137 137 "NTCNR_0X089" 138 138 "NTCNR_0X08A" 139 139 "NTCNR_0X08B" 140 140 "NTCNR_0X08C" 141 141 "NTCNR_0X08D" 142 142 "NTCNR_0X08E" 143 143 "NTCNR_0X08F" 144 144 "NTCNR_0X090" 145 145 "NTCNR_0X091" 146 146 "NTCNR_0X092" 147 147 "NTCNR_0X093" 148 148 "NTCNR_0X094" 149 149 "NTCNR_0X095" 150 150 "NTCNR_0X096" 151 151 "NTCNR_0X097" 152 152 "NTCNR_0X098" 153 153 "NTCNR_0X099" 154 154 "NTCNR_0X09A" 155 155 "NTCNR_0X09B" 156 156 "NTCNR_0X09C" 157 157 "NTCNR_0X09D" 158 158 "NTCNR_0X09E" 159 159 "NTCNR_0X09F" 160 160 "NTCNR_0X0A0" 161 161 "NTCNR_0X0A1" 162 162 "NTCNR_0X0A2" 163 163 "NTCNR_0X0A3" 164 164 "NTCNR_0X0A4" 165 165 "NTCNR_0X0A5" 166 166 "NTCNR_0X0A6" 167 167 "NTCNR_0X0A7" 168 168 "NTCNR_0X0A8" 169 169 "NTCNR_0X0A9" 170 170 "NTCNR_0X0AA" 171 171 "NTCNR_0X0AB" 172 172 "NTCNR_0X0AC" 173 173 "NTCNR_0X0AD" 174 174 "NTCNR_0X0AE" 175 175 "NTCNR_0X0AF" 176 176 "NTCNR_0X0B0" 177 177 "NTCNR_0X0B1" 178 178 "NTCNR_0X0B2" 179 179 "NTCNR_0X0B3" 180 180 "NTCNR_0X0B4" 181 181 "NTCNR_0X0B5" 182 182 "NTCNR_0X0B6" 183 183 "NTCNR_0X0B7" 184 184 "NTCNR_0X0B8" 185 185 "NTCNR_0X0B9" 186 186 "NTCNR_0X0BA" 187 187 "NTCNR_0X0BB" 188 188 "NTCNR_0X0BC" 189 189 "NTCNR_0X0BD" 190 190 "NTCNR_0X0BE" 191 191 "NTCNR_0X0BF" 192 192 "NTCNR_0X0C0" 193 193 "NTCNR_0X0C1" 194 194 "NTCNR_0X0C2" 195 195 "NTCNR_0X0C3" 196 196 "NTCNR_0X0C4" 197 197 "NTCNR_0X0C5" 198 198 "NTCNR_0X0C6" 199 199 "NTCNR_0X0C7" 200 200 "NTCNR_0X0C8" 201 201 "NTCNR_0X0C9" 202 202 "NTCNR_0X0CA" 203 203 "NTCNR_0X0CB" 204 204 "NTCNR_0X0CC" 205 205 "NTCNR_0X0CD" 206 206 "NTCNR_0X0CE" 207 207 "NTCNR_0X0CF" 208 208 "NTCNR_0X0D0" 209 209 "NTCNR_0X0D1" 210 210 "NTCNR_0X0D2" 211 211 "NTCNR_0X0D3" 212 212 "NTCNR_0X0D4" 213 213 "NTCNR_0X0D5" 214 214 "NTCNR_0X0D6" 215 215 "NTCNR_0X0D7" 216 216 "NTCNR_0X0D8" 217 217 "NTCNR_0X0D9" 218 218 "NTCNR_0X0DA" 219 219 "NTCNR_0X0DB" 220 220 "NTCNR_0X0DC" 221 221 "NTCNR_0X0DD" 222 222 "NTCNR_0X0DE" 223 223 "NTCNR_0X0DF" 224 224 "NTCNR_0X0E0" 225 225 "NTCNR_0X0E1" 226 226 "NTCNR_0X0E2" 227 227 "NTCNR_0X0E3" 228 228 "NTCNR_0X0E4" 229 229 "NTCNR_0X0E5" 230 230 "NTCNR_0X0E6" 231 231 "NTCNR_0X0E7" 232 232 "NTCNR_0X0E8" 233 233 "NTCNR_0X0E9" 234 234 "NTCNR_0X0EA" 235 235 "NTCNR_0X0EB" 236 236 "NTCNR_0X0EC" 237 237 "NTCNR_0X0ED" 238 238 "NTCNR_0X0EE" 239 239 "NTCNR_0X0EF" 240 240 "NTCNR_0X0F0" 241 241 "NTCNR_0X0F1" 242 242 "NTCNR_0X0F2" 243 243 "NTCNR_0X0F3" 244 244 "NTCNR_0X0F4" 245 245 "NTCNR_0X0F5" 246 246 "NTCNR_0X0F6" 247 247 "NTCNR_0X0F7" 248 248 "NTCNR_0X0F8" 249 249 "NTCNR_0X0F9" 250 250 "NTCNR_0X0FA" 251 251 "NTCNR_0X0FB" 252 252 "NTCNR_0X0FC" 253 253 "NTCNR_0X0FD" 254 254 "NTCNR_0X0FE" 255 255 "NTCNR_0X0FF" 256 256 "NTCNR_0X100" 257 257 "NTCNR_0X101" 258 258 "NTCNR_0X102" 259 259 "NTCNR_0X103" 260 260 "NTCNR_0X104" 261 261 "NTCNR_0X105" 262 262 "NTCNR_0X106" 263 263 "NTCNR_0X107" 264 264 "NTCNR_0X108" 265 265 "NTCNR_0X109" 266 266 "NTCNR_0X10A" 267 267 "NTCNR_0X10B" 268 268 "NTCNR_0X10C" 269 269 "NTCNR_0X10D" 270 270 "NTCNR_0X10E" 271 271 "NTCNR_0X10F" 272 272 "NTCNR_0X110" 273 273 "NTCNR_0X111" 274 274 "NTCNR_0X112" 275 275 "NTCNR_0X113" 276 276 "NTCNR_0X114" 277 277 "NTCNR_0X115" 278 278 "NTCNR_0X116" 279 279 "NTCNR_0X117" 280 280 "NTCNR_0X118" 281 281 "NTCNR_0X119" 282 282 "NTCNR_0X11A" 283 283 "NTCNR_0X11B" 284 284 "NTCNR_0X11C" 285 285 "NTCNR_0X11D" 286 286 "NTCNR_0X11E" 287 287 "NTCNR_0X11F" 288 288 "NTCNR_0X120" 289 289 "NTCNR_0X121" 290 290 "NTCNR_0X122" 291 291 "NTCNR_0X123" 292 292 "NTCNR_0X124" 293 293 "NTCNR_0X125" 294 294 "NTCNR_0X126" 295 295 "NTCNR_0X127" 296 296 "NTCNR_0X128" 297 297 "NTCNR_0X129" 298 298 "NTCNR_0X12A" 299 299 "NTCNR_0X12B" 300 300 "NTCNR_0X12C" 301 301 "NTCNR_0X12D" 302 302 "NTCNR_0X12E" 303 303 "NTCNR_0X12F" 304 304 "NTCNR_0X130" 305 305 "NTCNR_0X131" 306 306 "NTCNR_0X132" 307 307 "NTCNR_0X133" 308 308 "NTCNR_0X134" 309 309 "NTCNR_0X135" 310 310 "NTCNR_0X136" 311 311 "NTCNR_0X137" 312 312 "NTCNR_0X138" 313 313 "NTCNR_0X139" 314 314 "NTCNR_0X13A" 315 315 "NTCNR_0X13B" 316 316 "NTCNR_0X13C" 317 317 "NTCNR_0X13D" 318 318 "NTCNR_0X13E" 319 319 "NTCNR_0X13F" 320 320 "NTCNR_0X140" 321 321 "NTCNR_0X141" 322 322 "NTCNR_0X142" 323 323 "NTCNR_0X143" 324 324 "NTCNR_0X144" 325 325 "NTCNR_0X145" 326 326 "NTCNR_0X146" 327 327 "NTCNR_0X147" 328 328 "NTCNR_0X148" 329 329 "NTCNR_0X149" 330 330 "NTCNR_0X14A" 331 331 "NTCNR_0X14B" 332 332 "NTCNR_0X14C" 333 333 "NTCNR_0X14D" 334 334 "NTCNR_0X14E" 335 335 "NTCNR_0X14F" 336 336 "NTCNR_0X150" 337 337 "NTCNR_0X151" 338 338 "NTCNR_0X152" 339 339 "NTCNR_0X153" 340 340 "NTCNR_0X154" 341 341 "NTCNR_0X155" 342 342 "NTCNR_0X156" 343 343 "NTCNR_0X157" 344 344 "NTCNR_0X158" 345 345 "NTCNR_0X159" 346 346 "NTCNR_0X15A" 347 347 "NTCNR_0X15B" 348 348 "NTCNR_0X15C" 349 349 "NTCNR_0X15D" 350 350 "NTCNR_0X15E" 351 351 "NTCNR_0X15F" 352 352 "NTCNR_0X160" 353 353 "NTCNR_0X161" 354 354 "NTCNR_0X162" 355 355 "NTCNR_0X163" 356 356 "NTCNR_0X164" 357 357 "NTCNR_0X165" 358 358 "NTCNR_0X166" 359 359 "NTCNR_0X167" 360 360 "NTCNR_0X168" 361 361 "NTCNR_0X169" 362 362 "NTCNR_0X16A" 363 363 "NTCNR_0X16B" 364 364 "NTCNR_0X16C" 365 365 "NTCNR_0X16D" 366 366 "NTCNR_0X16E" 367 367 "NTCNR_0X16F" 368 368 "NTCNR_0X170" 369 369 "NTCNR_0X171" 370 370 "NTCNR_0X172" 371 371 "NTCNR_0X173" 372 372 "NTCNR_0X174" 373 373 "NTCNR_0X175" 374 374 "NTCNR_0X176" 375 375 "NTCNR_0X177" 376 376 "NTCNR_0X178" 377 377 "NTCNR_0X179" 378 378 "NTCNR_0X17A" 379 379 "NTCNR_0X17B" 380 380 "NTCNR_0X17C" 381 381 "NTCNR_0X17D" 382 382 "NTCNR_0X17E" 383 383 "NTCNR_0X17F" 384 384 "NTCNR_0X180" 385 385 "NTCNR_0X181" 386 386 "NTCNR_0X182" 387 387 "NTCNR_0X183" 388 388 "NTCNR_0X184" 389 389 "NTCNR_0X185" 390 390 "NTCNR_0X186" 391 391 "NTCNR_0X187" 392 392 "NTCNR_0X188" 393 393 "NTCNR_0X189" 394 394 "NTCNR_0X18A" 395 395 "NTCNR_0X18B" 396 396 "NTCNR_0X18C" 397 397 "NTCNR_0X18D" 398 398 "NTCNR_0X18E" 399 399 "NTCNR_0X18F" 400 400 "NTCNR_0X190" 401 401 "NTCNR_0X191" 402 402 "NTCNR_0X192" 403 403 "NTCNR_0X193" 404 404 "NTCNR_0X194" 405 405 "NTCNR_0X195" 406 406 "NTCNR_0X196" 407 407 "NTCNR_0X197" 408 408 "NTCNR_0X198" 409 409 "NTCNR_0X199" 410 410 "NTCNR_0X19A" 411 411 "NTCNR_0X19B" 412 412 "NTCNR_0X19C" 413 413 "NTCNR_0X19D" 414 414 "NTCNR_0X19E" 415 415 "NTCNR_0X19F" 416 416 "NTCNR_0X1A0" 417 417 "NTCNR_0X1A1" 418 418 "NTCNR_0X1A2" 419 419 "NTCNR_0X1A3" 420 420 "NTCNR_0X1A4" 421 421 "NTCNR_0X1A5" 422 422 "NTCNR_0X1A6" 423 423 "NTCNR_0X1A7" 424 424 "NTCNR_0X1A8" 425 425 "NTCNR_0X1A9" 426 426 "NTCNR_0X1AA" 427 427 "NTCNR_0X1AB" 428 428 "NTCNR_0X1AC" 429 429 "NTCNR_0X1AD" 430 430 "NTCNR_0X1AE" 431 431 "NTCNR_0X1AF" 432 432 "NTCNR_0X1B0" 433 433 "NTCNR_0X1B1" 434 434 "NTCNR_0X1B2" 435 435 "NTCNR_0X1B3" 436 436 "NTCNR_0X1B4" 437 437 "NTCNR_0X1B5" 438 438 "NTCNR_0X1B6" 439 439 "NTCNR_0X1B7" 440 440 "NTCNR_0X1B8" 441 441 "NTCNR_0X1B9" 442 442 "NTCNR_0X1BA" 443 443 "NTCNR_0X1BB" 444 444 "NTCNR_0X1BC" 445 445 "NTCNR_0X1BD" 446 446 "NTCNR_0X1BE" 447 447 "NTCNR_0X1BF" 448 448 "NTCNR_0X1C0" 449 449 "NTCNR_0X1C1" 450 450 "NTCNR_0X1C2" 451 451 "NTCNR_0X1C3" 452 452 "NTCNR_0X1C4" 453 453 "NTCNR_0X1C5" 454 454 "NTCNR_0X1C6" 455 455 "NTCNR_0X1C7" 456 456 "NTCNR_0X1C8" 457 457 "NTCNR_0X1C9" 458 458 "NTCNR_0X1CA" 459 459 "NTCNR_0X1CB" 460 460 "NTCNR_0X1CC" 461 461 "NTCNR_0X1CD" 462 462 "NTCNR_0X1CE" 463 463 "NTCNR_0X1CF" 464 464 "NTCNR_0X1D0" 465 465 "NTCNR_0X1D1" 466 466 "NTCNR_0X1D2" 467 467 "NTCNR_0X1D3" 468 468 "NTCNR_0X1D4" 469 469 "NTCNR_0X1D5" 470 470 "NTCNR_0X1D6" 471 471 "NTCNR_0X1D7" 472 472 "NTCNR_0X1D8" 473 473 "NTCNR_0X1D9" 474 474 "NTCNR_0X1DA" 475 475 "NTCNR_0X1DB" 476 476 "NTCNR_0X1DC" 477 477 "NTCNR_0X1DD" 478 478 "NTCNR_0X1DE" 479 479 "NTCNR_0X1DF" 480 480 "NTCNR_0X1E0" 481 481 "NTCNR_0X1E1" 482 482 "NTCNR_0X1E2" 483 483 "NTCNR_0X1E3" 484 484 "NTCNR_0X1E4" 485 485 "NTCNR_0X1E5" 486 486 "NTCNR_0X1E6" 487 487 "NTCNR_0X1E7" 488 488 "NTCNR_0X1E8" 489 489 "NTCNR_0X1E9" 490 490 "NTCNR_0X1EA" 491 491 "NTCNR_0X1EB" 492 492 "NTCNR_0X1EC" 493 493 "NTCNR_0X1ED" 494 494 "NTCNR_0X1EE" 495 495 "NTCNR_0X1EF" 496 496 "NTCNR_0X1F0" 497 497 "NTCNR_0X1F1" 498 498 "NTCNR_0X1F2" 499 499 "NTCNR_0X1F3" 500 500 "NTCNR_0X1F4" 501 501 "NTCNR_0X1F5" 502 502 "NTCNR_0X1F6" 503 503 "NTCNR_0X1F7" 504 504 "NTCNR_0X1F8" 505 505 "NTCNR_0X1F9" 506 506 "NTCNR_0X1FA" 507 507 "NTCNR_0X1FB" 508 508 "NTCNR_0X1FC" 509 509 "NTCNR_0X1FD" 510 510 "NTCNR_0X1FE" 511 511 "NTCNR_0X1FF" /end COMPU_VTAB_RANGE
/begin COMPU_METHOD RTE_CM_Tq6 "" RAT_FUNC "%.1" "HwNm" COEFFS 0 256 0 0 0 1 /end COMPU_METHOD
/begin COMPU_METHOD RTE_CM_Tq12 "" RAT_FUNC "%.1" "MotNm" COEFFS 0 2048 0 0 0 1 /end COMPU_METHOD
/begin COMPU_METHOD RTE_CM_Spd2 "" RAT_FUNC "%.1" "kph" COEFFS 0 128 0 0 0 1 /end COMPU_METHOD
/begin COMPU_METHOD RTE_CM_Tq13 "" RAT_FUNC "%.1" "MotNm" COEFFS 0 0.000244140625 0 0 0 1 /end COMPU_METHOD
/begin COMPU_METHOD RTE_CM_Uls15 "" RAT_FUNC "%.1" "Uls" COEFFS 0 3.0517578125e-005 0 0 0 1 /end COMPU_METHOD
/begin COMPU_METHOD RTE_CM_T7 "" RAT_FUNC "%.1" "degC" COEFFS 0 128 0 0 0 1 /end COMPU_METHOD
/begin COMPU_METHOD RTE_CM_Uls20 "" RAT_FUNC "%.1" "Uls" COEFFS 0 0.000244140625 0 0 0 1 /end COMPU_METHOD
/begin COMPU_METHOD RTE_CM_Vel7 "" RAT_FUNC "%.1" "MotRad/s" COEFFS 0 0.0625 0 0 0 1 /end COMPU_METHOD
