/*
COPYRIGHT
Copyright (c) 2006-2015 by Vector Informatik GmbH. All rights reserved.
This software is copyright protected and proprietary to Vector Informatik GmbH.
Vector Informatik GmbH grants to you only those rights as set out in the license conditions.
License:  Unlimited license CBD1400351 for Nexteer Automotive Corporation
*/
/begin CHARACTERISTIC CalRegn01Inin00.GmVehPwrModOperRampRate.Val "MICROSAR RTE" VALUE 0x0 RTE_RL_FLOAT32_IEEE 0 NO_COMPU_METHOD -3.402823466e+38 3.402823466e+38 SYMBOL_LINK "Rte_CalprmRom_CalRegn01Inin00_DEFAULT_RTE_CALPRM_GROUP.GmVehPwrModOperRampRate_Val" 0 DISPLAY_IDENTIFIER CalRegn01Inin00.CalibrationPorts.GmVehPwrModOperRampRate.Val /end CHARACTERISTIC
/begin CHARACTERISTIC CalRegn01Inin00.HiLoadStallLimrMotTqCmdFilFrq.Val "MICROSAR RTE" VALUE 0x0 RTE_RL_FLOAT32_IEEE 0 NO_COMPU_METHOD -3.402823466e+38 3.402823466e+38 SYMBOL_LINK "Rte_CalprmRom_CalRegn01Inin00_DEFAULT_RTE_CALPRM_GROUP.HiLoadStallLimrMotTqCmdFilFrq_Val" 0 DISPLAY_IDENTIFIER CalRegn01Inin00.CalibrationPorts.HiLoadStallLimrMotTqCmdFilFrq.Val /end CHARACTERISTIC
/begin CHARACTERISTIC CalRegn01Inin00.HiLoadStallLimrMotVelMgnThd.Val "MICROSAR RTE" VALUE 0x0 RTE_RL_FLOAT32_IEEE 0 NO_COMPU_METHOD -3.402823466e+38 3.402823466e+38 SYMBOL_LINK "Rte_CalprmRom_CalRegn01Inin00_DEFAULT_RTE_CALPRM_GROUP.HiLoadStallLimrMotVelMgnThd_Val" 0 DISPLAY_IDENTIFIER CalRegn01Inin00.CalibrationPorts.HiLoadStallLimrMotVelMgnThd.Val /end CHARACTERISTIC
/begin CHARACTERISTIC CalRegn01Inin00.HiLoadStallLimrStallMotTqCmdLimX.Ary1D "MICROSAR RTE" VAL_BLK 0x0 RTE_RL_UWORD 0 NO_COMPU_METHOD 0 65535 MATRIX_DIM 6 1 1 SYMBOL_LINK "Rte_CalprmRom_CalRegn01Inin00_DEFAULT_RTE_CALPRM_GROUP.HiLoadStallLimrStallMotTqCmdLimX_Ary1D" 0 DISPLAY_IDENTIFIER CalRegn01Inin00.CalibrationPorts.HiLoadStallLimrStallMotTqCmdLimX.Ary1D /end CHARACTERISTIC
/begin CHARACTERISTIC CalRegn01Inin00.HiLoadStallLimrStallMotTqCmdLimY.Ary1D "MICROSAR RTE" VAL_BLK 0x0 RTE_RL_UWORD 0 NO_COMPU_METHOD 0 65535 MATRIX_DIM 6 1 1 SYMBOL_LINK "Rte_CalprmRom_CalRegn01Inin00_DEFAULT_RTE_CALPRM_GROUP.HiLoadStallLimrStallMotTqCmdLimY_Ary1D" 0 DISPLAY_IDENTIFIER CalRegn01Inin00.CalibrationPorts.HiLoadStallLimrStallMotTqCmdLimY.Ary1D /end CHARACTERISTIC
/begin CHARACTERISTIC CalRegn01Inin00.HiLoadStallLimrStallMotTqLimSlewRate.Val "MICROSAR RTE" VALUE 0x0 RTE_RL_FLOAT32_IEEE 0 NO_COMPU_METHOD -3.402823466e+38 3.402823466e+38 SYMBOL_LINK "Rte_CalprmRom_CalRegn01Inin00_DEFAULT_RTE_CALPRM_GROUP.HiLoadStallLimrStallMotTqLimSlewRate_Val" 0 DISPLAY_IDENTIFIER CalRegn01Inin00.CalibrationPorts.HiLoadStallLimrStallMotTqLimSlewRate.Val /end CHARACTERISTIC
/begin CHARACTERISTIC CalRegn01Inin00.HwAg0MeasHwAg0IfFltFailStep.Val "MICROSAR RTE" VALUE 0x0 RTE_RL_UWORD 0 NO_COMPU_METHOD 0 65535 SYMBOL_LINK "Rte_CalprmRom_CalRegn01Inin00_DEFAULT_RTE_CALPRM_GROUP.HwAg0MeasHwAg0IfFltFailStep_Val" 0 DISPLAY_IDENTIFIER CalRegn01Inin00.CalibrationPorts.HwAg0MeasHwAg0IfFltFailStep.Val /end CHARACTERISTIC
/begin CHARACTERISTIC CalRegn01Inin00.HwAg0MeasHwAg0IfFltPassStep.Val "MICROSAR RTE" VALUE 0x0 RTE_RL_UWORD 0 NO_COMPU_METHOD 0 65535 SYMBOL_LINK "Rte_CalprmRom_CalRegn01Inin00_DEFAULT_RTE_CALPRM_GROUP.HwAg0MeasHwAg0IfFltPassStep_Val" 0 DISPLAY_IDENTIFIER CalRegn01Inin00.CalibrationPorts.HwAg0MeasHwAg0IfFltPassStep.Val /end CHARACTERISTIC
/begin CHARACTERISTIC CalRegn01Inin00.HwAg0MeasHwAg0Snsr0PrtclFltFailStep.Val "MICROSAR RTE" VALUE 0x0 RTE_RL_UWORD 0 NO_COMPU_METHOD 0 65535 SYMBOL_LINK "Rte_CalprmRom_CalRegn01Inin00_DEFAULT_RTE_CALPRM_GROUP.HwAg0MeasHwAg0Snsr0PrtclFltFailStep_Val" 0 DISPLAY_IDENTIFIER CalRegn01Inin00.CalibrationPorts.HwAg0MeasHwAg0Snsr0PrtclFltFailStep.Val /end CHARACTERISTIC
/begin CHARACTERISTIC CalRegn01Inin00.HwAg0MeasHwAg0Snsr0PrtclFltPassStep.Val "MICROSAR RTE" VALUE 0x0 RTE_RL_UWORD 0 NO_COMPU_METHOD 0 65535 SYMBOL_LINK "Rte_CalprmRom_CalRegn01Inin00_DEFAULT_RTE_CALPRM_GROUP.HwAg0MeasHwAg0Snsr0PrtclFltPassStep_Val" 0 DISPLAY_IDENTIFIER CalRegn01Inin00.CalibrationPorts.HwAg0MeasHwAg0Snsr0PrtclFltPassStep.Val /end CHARACTERISTIC
/begin CHARACTERISTIC CalRegn01Inin00.HwAg0MeasHwAg0Snsr1PrtclFltFailStep.Val "MICROSAR RTE" VALUE 0x0 RTE_RL_UWORD 0 NO_COMPU_METHOD 0 65535 SYMBOL_LINK "Rte_CalprmRom_CalRegn01Inin00_DEFAULT_RTE_CALPRM_GROUP.HwAg0MeasHwAg0Snsr1PrtclFltFailStep_Val" 0 DISPLAY_IDENTIFIER CalRegn01Inin00.CalibrationPorts.HwAg0MeasHwAg0Snsr1PrtclFltFailStep.Val /end CHARACTERISTIC
/begin CHARACTERISTIC CalRegn01Inin00.HwAg0MeasHwAg0Snsr1PrtclFltPassStep.Val "MICROSAR RTE" VALUE 0x0 RTE_RL_UWORD 0 NO_COMPU_METHOD 0 65535 SYMBOL_LINK "Rte_CalprmRom_CalRegn01Inin00_DEFAULT_RTE_CALPRM_GROUP.HwAg0MeasHwAg0Snsr1PrtclFltPassStep_Val" 0 DISPLAY_IDENTIFIER CalRegn01Inin00.CalibrationPorts.HwAg0MeasHwAg0Snsr1PrtclFltPassStep.Val /end CHARACTERISTIC
/begin CHARACTERISTIC CalRegn01Inin00.HwAg0MeasSnsr0Rev.Ary1D "MICROSAR RTE" VAL_BLK 0x0 RTE_RL_UBYTE 0 NO_COMPU_METHOD 0.0 255.0 MATRIX_DIM 22 1 1 SYMBOL_LINK "Rte_CalprmRom_CalRegn01Inin00_DEFAULT_RTE_CALPRM_GROUP.HwAg0MeasSnsr0Rev_Ary1D" 0 DISPLAY_IDENTIFIER CalRegn01Inin00.CalibrationPorts.HwAg0MeasSnsr0Rev.Ary1D /end CHARACTERISTIC
/begin CHARACTERISTIC CalRegn01Inin00.HwAg0MeasSnsr1Rev.Ary1D "MICROSAR RTE" VAL_BLK 0x0 RTE_RL_UBYTE 0 NO_COMPU_METHOD 0.0 255.0 MATRIX_DIM 22 1 1 SYMBOL_LINK "Rte_CalprmRom_CalRegn01Inin00_DEFAULT_RTE_CALPRM_GROUP.HwAg0MeasSnsr1Rev_Ary1D" 0 DISPLAY_IDENTIFIER CalRegn01Inin00.CalibrationPorts.HwAg0MeasSnsr1Rev.Ary1D /end CHARACTERISTIC
/begin CHARACTERISTIC CalRegn01Inin00.HwAg0MeasStep.Ary1D "MICROSAR RTE" VAL_BLK 0x0 RTE_RL_SWORD 0 NO_COMPU_METHOD -500.0 500.0 MATRIX_DIM 22 1 1 SYMBOL_LINK "Rte_CalprmRom_CalRegn01Inin00_DEFAULT_RTE_CALPRM_GROUP.HwAg0MeasStep_Ary1D" 0 DISPLAY_IDENTIFIER CalRegn01Inin00.CalibrationPorts.HwAg0MeasStep.Ary1D /end CHARACTERISTIC
/begin CHARACTERISTIC CalRegn01Inin00.HwAg0MeasVrnrErrThd.Val "MICROSAR RTE" VALUE 0x0 RTE_RL_UBYTE 0 NO_COMPU_METHOD 0.0 20.0 SYMBOL_LINK "Rte_CalprmRom_CalRegn01Inin00_DEFAULT_RTE_CALPRM_GROUP.HwAg0MeasVrnrErrThd_Val" 0 DISPLAY_IDENTIFIER CalRegn01Inin00.CalibrationPorts.HwAg0MeasVrnrErrThd.Val /end CHARACTERISTIC
/begin CHARACTERISTIC CalRegn01Inin00.HwAg1MeasHwAg1IfFltFailStep.Val "MICROSAR RTE" VALUE 0x0 RTE_RL_UWORD 0 NO_COMPU_METHOD 0 65535 SYMBOL_LINK "Rte_CalprmRom_CalRegn01Inin00_DEFAULT_RTE_CALPRM_GROUP.HwAg1MeasHwAg1IfFltFailStep_Val" 0 DISPLAY_IDENTIFIER CalRegn01Inin00.CalibrationPorts.HwAg1MeasHwAg1IfFltFailStep.Val /end CHARACTERISTIC
/begin CHARACTERISTIC CalRegn01Inin00.HwAg1MeasHwAg1IfFltPassStep.Val "MICROSAR RTE" VALUE 0x0 RTE_RL_UWORD 0 NO_COMPU_METHOD 0 65535 SYMBOL_LINK "Rte_CalprmRom_CalRegn01Inin00_DEFAULT_RTE_CALPRM_GROUP.HwAg1MeasHwAg1IfFltPassStep_Val" 0 DISPLAY_IDENTIFIER CalRegn01Inin00.CalibrationPorts.HwAg1MeasHwAg1IfFltPassStep.Val /end CHARACTERISTIC
/begin CHARACTERISTIC CalRegn01Inin00.HwAg1MeasHwAg1Snsr0PrtclFltFailStep.Val "MICROSAR RTE" VALUE 0x0 RTE_RL_UWORD 0 NO_COMPU_METHOD 0 65535 SYMBOL_LINK "Rte_CalprmRom_CalRegn01Inin00_DEFAULT_RTE_CALPRM_GROUP.HwAg1MeasHwAg1Snsr0PrtclFltFailStep_Val" 0 DISPLAY_IDENTIFIER CalRegn01Inin00.CalibrationPorts.HwAg1MeasHwAg1Snsr0PrtclFltFailStep.Val /end CHARACTERISTIC
/begin CHARACTERISTIC CalRegn01Inin00.HwAg1MeasHwAg1Snsr0PrtclFltPassStep.Val "MICROSAR RTE" VALUE 0x0 RTE_RL_UWORD 0 NO_COMPU_METHOD 0 65535 SYMBOL_LINK "Rte_CalprmRom_CalRegn01Inin00_DEFAULT_RTE_CALPRM_GROUP.HwAg1MeasHwAg1Snsr0PrtclFltPassStep_Val" 0 DISPLAY_IDENTIFIER CalRegn01Inin00.CalibrationPorts.HwAg1MeasHwAg1Snsr0PrtclFltPassStep.Val /end CHARACTERISTIC
/begin CHARACTERISTIC CalRegn01Inin00.HwAg1MeasHwAg1Snsr1PrtclFltFailStep.Val "MICROSAR RTE" VALUE 0x0 RTE_RL_UWORD 0 NO_COMPU_METHOD 0 65535 SYMBOL_LINK "Rte_CalprmRom_CalRegn01Inin00_DEFAULT_RTE_CALPRM_GROUP.HwAg1MeasHwAg1Snsr1PrtclFltFailStep_Val" 0 DISPLAY_IDENTIFIER CalRegn01Inin00.CalibrationPorts.HwAg1MeasHwAg1Snsr1PrtclFltFailStep.Val /end CHARACTERISTIC
/begin CHARACTERISTIC CalRegn01Inin00.HwAg1MeasHwAg1Snsr1PrtclFltPassStep.Val "MICROSAR RTE" VALUE 0x0 RTE_RL_UWORD 0 NO_COMPU_METHOD 0 65535 SYMBOL_LINK "Rte_CalprmRom_CalRegn01Inin00_DEFAULT_RTE_CALPRM_GROUP.HwAg1MeasHwAg1Snsr1PrtclFltPassStep_Val" 0 DISPLAY_IDENTIFIER CalRegn01Inin00.CalibrationPorts.HwAg1MeasHwAg1Snsr1PrtclFltPassStep.Val /end CHARACTERISTIC
/begin CHARACTERISTIC CalRegn01Inin00.HwAg1MeasSnsr0Rev.Ary1D "MICROSAR RTE" VAL_BLK 0x0 RTE_RL_UBYTE 0 NO_COMPU_METHOD 0.0 255.0 MATRIX_DIM 22 1 1 SYMBOL_LINK "Rte_CalprmRom_CalRegn01Inin00_DEFAULT_RTE_CALPRM_GROUP.HwAg1MeasSnsr0Rev_Ary1D" 0 DISPLAY_IDENTIFIER CalRegn01Inin00.CalibrationPorts.HwAg1MeasSnsr0Rev.Ary1D /end CHARACTERISTIC
/begin CHARACTERISTIC CalRegn01Inin00.HwAg1MeasSnsr1Rev.Ary1D "MICROSAR RTE" VAL_BLK 0x0 RTE_RL_UBYTE 0 NO_COMPU_METHOD 0.0 255.0 MATRIX_DIM 22 1 1 SYMBOL_LINK "Rte_CalprmRom_CalRegn01Inin00_DEFAULT_RTE_CALPRM_GROUP.HwAg1MeasSnsr1Rev_Ary1D" 0 DISPLAY_IDENTIFIER CalRegn01Inin00.CalibrationPorts.HwAg1MeasSnsr1Rev.Ary1D /end CHARACTERISTIC
/begin CHARACTERISTIC CalRegn01Inin00.HwAg1MeasStep.Ary1D "MICROSAR RTE" VAL_BLK 0x0 RTE_RL_SWORD 0 NO_COMPU_METHOD -500.0 500.0 MATRIX_DIM 22 1 1 SYMBOL_LINK "Rte_CalprmRom_CalRegn01Inin00_DEFAULT_RTE_CALPRM_GROUP.HwAg1MeasStep_Ary1D" 0 DISPLAY_IDENTIFIER CalRegn01Inin00.CalibrationPorts.HwAg1MeasStep.Ary1D /end CHARACTERISTIC
/begin CHARACTERISTIC CalRegn01Inin00.HwAg1MeasVrnrErrThd.Val "MICROSAR RTE" VALUE 0x0 RTE_RL_UBYTE 0 NO_COMPU_METHOD 0.0 20.0 SYMBOL_LINK "Rte_CalprmRom_CalRegn01Inin00_DEFAULT_RTE_CALPRM_GROUP.HwAg1MeasVrnrErrThd_Val" 0 DISPLAY_IDENTIFIER CalRegn01Inin00.CalibrationPorts.HwAg1MeasVrnrErrThd.Val /end CHARACTERISTIC
/begin CHARACTERISTIC CalRegn01Inin00.HwAgSnsrlsVehDynVehSpdThd.Val "MICROSAR RTE" VALUE 0x0 RTE_RL_FLOAT32_IEEE 0 NO_COMPU_METHOD -3.402823466e+38 3.402823466e+38 SYMBOL_LINK "Rte_CalprmRom_CalRegn01Inin00_DEFAULT_RTE_CALPRM_GROUP.HwAgSnsrlsVehDynVehSpdThd_Val" 0 DISPLAY_IDENTIFIER CalRegn01Inin00.CalibrationPorts.HwAgSnsrlsVehDynVehSpdThd.Val /end CHARACTERISTIC
/begin CHARACTERISTIC CalRegn01Inin00.HwAgSnsrlsVehDynYawRateThd.Val "MICROSAR RTE" VALUE 0x0 RTE_RL_FLOAT32_IEEE 0 NO_COMPU_METHOD -3.402823466e+38 3.402823466e+38 SYMBOL_LINK "Rte_CalprmRom_CalRegn01Inin00_DEFAULT_RTE_CALPRM_GROUP.HwAgSnsrlsVehDynYawRateThd_Val" 0 DISPLAY_IDENTIFIER CalRegn01Inin00.CalibrationPorts.HwAgSnsrlsVehDynYawRateThd.Val /end CHARACTERISTIC
/begin CHARACTERISTIC CalRegn01Inin00.HwAgSnsrlsYawRateFilFrq.Val "MICROSAR RTE" VALUE 0x0 RTE_RL_FLOAT32_IEEE 0 NO_COMPU_METHOD -3.402823466e+38 3.402823466e+38 SYMBOL_LINK "Rte_CalprmRom_CalRegn01Inin00_DEFAULT_RTE_CALPRM_GROUP.HwAgSnsrlsYawRateFilFrq_Val" 0 DISPLAY_IDENTIFIER CalRegn01Inin00.CalibrationPorts.HwAgSnsrlsYawRateFilFrq.Val /end CHARACTERISTIC
/begin CHARACTERISTIC CalRegn01Inin00.HwTq0MeasHwTq0PrtclFltFailStep.Val "MICROSAR RTE" VALUE 0x0 RTE_RL_UWORD 0 NO_COMPU_METHOD 0 65535 SYMBOL_LINK "Rte_CalprmRom_CalRegn01Inin00_DEFAULT_RTE_CALPRM_GROUP.HwTq0MeasHwTq0PrtclFltFailStep_Val" 0 DISPLAY_IDENTIFIER CalRegn01Inin00.CalibrationPorts.HwTq0MeasHwTq0PrtclFltFailStep.Val /end CHARACTERISTIC
/begin CHARACTERISTIC CalRegn01Inin00.HwTq0MeasHwTq0PrtclFltPassStep.Val "MICROSAR RTE" VALUE 0x0 RTE_RL_UWORD 0 NO_COMPU_METHOD 0 65535 SYMBOL_LINK "Rte_CalprmRom_CalRegn01Inin00_DEFAULT_RTE_CALPRM_GROUP.HwTq0MeasHwTq0PrtclFltPassStep_Val" 0 DISPLAY_IDENTIFIER CalRegn01Inin00.CalibrationPorts.HwTq0MeasHwTq0PrtclFltPassStep.Val /end CHARACTERISTIC
/begin CHARACTERISTIC CalRegn01Inin00.HwTq1MeasHwTq1PrtclFltFailStep.Val "MICROSAR RTE" VALUE 0x0 RTE_RL_UWORD 0 NO_COMPU_METHOD 0 65535 SYMBOL_LINK "Rte_CalprmRom_CalRegn01Inin00_DEFAULT_RTE_CALPRM_GROUP.HwTq1MeasHwTq1PrtclFltFailStep_Val" 0 DISPLAY_IDENTIFIER CalRegn01Inin00.CalibrationPorts.HwTq1MeasHwTq1PrtclFltFailStep.Val /end CHARACTERISTIC
/begin CHARACTERISTIC CalRegn01Inin00.HwTq1MeasHwTq1PrtclFltPassStep.Val "MICROSAR RTE" VALUE 0x0 RTE_RL_UWORD 0 NO_COMPU_METHOD 0 65535 SYMBOL_LINK "Rte_CalprmRom_CalRegn01Inin00_DEFAULT_RTE_CALPRM_GROUP.HwTq1MeasHwTq1PrtclFltPassStep_Val" 0 DISPLAY_IDENTIFIER CalRegn01Inin00.CalibrationPorts.HwTq1MeasHwTq1PrtclFltPassStep.Val /end CHARACTERISTIC
/begin CHARACTERISTIC CalRegn01Inin00.LimrCdngGainDecSlew.Val "MICROSAR RTE" VALUE 0x0 RTE_RL_FLOAT32_IEEE 0 NO_COMPU_METHOD -3.402823466e+38 3.402823466e+38 SYMBOL_LINK "Rte_CalprmRom_CalRegn01Inin00_DEFAULT_RTE_CALPRM_GROUP.LimrCdngGainDecSlew_Val" 0 DISPLAY_IDENTIFIER CalRegn01Inin00.CalibrationPorts.LimrCdngGainDecSlew.Val /end CHARACTERISTIC
/begin CHARACTERISTIC CalRegn01Inin00.LimrCdngGainIncSlewX.Ary1D "MICROSAR RTE" VAL_BLK 0x0 RTE_RL_UWORD 0 NO_COMPU_METHOD 0 65535 MATRIX_DIM 2 1 1 SYMBOL_LINK "Rte_CalprmRom_CalRegn01Inin00_DEFAULT_RTE_CALPRM_GROUP.LimrCdngGainIncSlewX_Ary1D" 0 DISPLAY_IDENTIFIER CalRegn01Inin00.CalibrationPorts.LimrCdngGainIncSlewX.Ary1D /end CHARACTERISTIC
/begin CHARACTERISTIC CalRegn01Inin00.LimrCdngGainIncSlewY.Ary1D "MICROSAR RTE" VAL_BLK 0x0 RTE_RL_UWORD 0 NO_COMPU_METHOD 0 65535 MATRIX_DIM 2 1 1 SYMBOL_LINK "Rte_CalprmRom_CalRegn01Inin00_DEFAULT_RTE_CALPRM_GROUP.LimrCdngGainIncSlewY_Ary1D" 0 DISPLAY_IDENTIFIER CalRegn01Inin00.CalibrationPorts.LimrCdngGainIncSlewY.Ary1D /end CHARACTERISTIC
/begin CHARACTERISTIC CalRegn01Inin00.LimrCdngTqDecSlew.Val "MICROSAR RTE" VALUE 0x0 RTE_RL_FLOAT32_IEEE 0 NO_COMPU_METHOD -3.402823466e+38 3.402823466e+38 SYMBOL_LINK "Rte_CalprmRom_CalRegn01Inin00_DEFAULT_RTE_CALPRM_GROUP.LimrCdngTqDecSlew_Val" 0 DISPLAY_IDENTIFIER CalRegn01Inin00.CalibrationPorts.LimrCdngTqDecSlew.Val /end CHARACTERISTIC
/begin CHARACTERISTIC CalRegn01Inin00.LimrCdngTqIncSlewX.Ary1D "MICROSAR RTE" VAL_BLK 0x0 RTE_RL_UWORD 0 NO_COMPU_METHOD 0 65535 MATRIX_DIM 2 1 1 SYMBOL_LINK "Rte_CalprmRom_CalRegn01Inin00_DEFAULT_RTE_CALPRM_GROUP.LimrCdngTqIncSlewX_Ary1D" 0 DISPLAY_IDENTIFIER CalRegn01Inin00.CalibrationPorts.LimrCdngTqIncSlewX.Ary1D /end CHARACTERISTIC
/begin CHARACTERISTIC CalRegn01Inin00.LimrCdngTqIncSlewY.Ary1D "MICROSAR RTE" VAL_BLK 0x0 RTE_RL_UWORD 0 NO_COMPU_METHOD 0 65535 MATRIX_DIM 2 1 1 SYMBOL_LINK "Rte_CalprmRom_CalRegn01Inin00_DEFAULT_RTE_CALPRM_GROUP.LimrCdngTqIncSlewY_Ary1D" 0 DISPLAY_IDENTIFIER CalRegn01Inin00.CalibrationPorts.LimrCdngTqIncSlewY.Ary1D /end CHARACTERISTIC
/begin CHARACTERISTIC CalRegn01Inin00.McuDiagc2MilliSecCntrCompThd.Val "MICROSAR RTE" VALUE 0x0 RTE_RL_UWORD 0 NO_COMPU_METHOD 0 65535 SYMBOL_LINK "Rte_CalprmRom_CalRegn01Inin00_DEFAULT_RTE_CALPRM_GROUP.McuDiagc2MilliSecCntrCompThd_Val" 0 DISPLAY_IDENTIFIER CalRegn01Inin00.CalibrationPorts.McuDiagc2MilliSecCntrCompThd.Val /end CHARACTERISTIC
/begin CHARACTERISTIC CalRegn01Inin00.McuDiagcFltFailStep.Val "MICROSAR RTE" VALUE 0x0 RTE_RL_UWORD 0 NO_COMPU_METHOD 0 65535 SYMBOL_LINK "Rte_CalprmRom_CalRegn01Inin00_DEFAULT_RTE_CALPRM_GROUP.McuDiagcFltFailStep_Val" 0 DISPLAY_IDENTIFIER CalRegn01Inin00.CalibrationPorts.McuDiagcFltFailStep.Val /end CHARACTERISTIC
/begin CHARACTERISTIC CalRegn01Inin00.McuDiagcFltPassStep.Val "MICROSAR RTE" VALUE 0x0 RTE_RL_UWORD 0 NO_COMPU_METHOD 0 65535 SYMBOL_LINK "Rte_CalprmRom_CalRegn01Inin00_DEFAULT_RTE_CALPRM_GROUP.McuDiagcFltPassStep_Val" 0 DISPLAY_IDENTIFIER CalRegn01Inin00.CalibrationPorts.McuDiagcFltPassStep.Val /end CHARACTERISTIC
/begin CHARACTERISTIC CalRegn01Inin00.MotAg1MeasMotAgOffs.Val "MICROSAR RTE" VALUE 0x0 RTE_RL_UWORD 0 NO_COMPU_METHOD 0 65535 SYMBOL_LINK "Rte_CalprmRom_CalRegn01Inin00_DEFAULT_RTE_CALPRM_GROUP.MotAg1MeasMotAgOffs_Val" 0 DISPLAY_IDENTIFIER CalRegn01Inin00.CalibrationPorts.MotAg1MeasMotAgOffs.Val /end CHARACTERISTIC
/begin CHARACTERISTIC CalRegn01Inin00.MotTqTranlDampgCmdLim.Val "MICROSAR RTE" VALUE 0x0 RTE_RL_FLOAT32_IEEE 0 NO_COMPU_METHOD -3.402823466e+38 3.402823466e+38 SYMBOL_LINK "Rte_CalprmRom_CalRegn01Inin00_DEFAULT_RTE_CALPRM_GROUP.MotTqTranlDampgCmdLim_Val" 0 DISPLAY_IDENTIFIER CalRegn01Inin00.CalibrationPorts.MotTqTranlDampgCmdLim.Val /end CHARACTERISTIC
/begin CHARACTERISTIC CalRegn01Inin00.MotTqTranlDampgDampgCoeff.Val "MICROSAR RTE" VALUE 0x0 RTE_RL_FLOAT32_IEEE 0 NO_COMPU_METHOD -3.402823466e+38 3.402823466e+38 SYMBOL_LINK "Rte_CalprmRom_CalRegn01Inin00_DEFAULT_RTE_CALPRM_GROUP.MotTqTranlDampgDampgCoeff_Val" 0 DISPLAY_IDENTIFIER CalRegn01Inin00.CalibrationPorts.MotTqTranlDampgDampgCoeff.Val /end CHARACTERISTIC
/begin CHARACTERISTIC CalRegn01Inin00.MotTqTranlDampgRampEnd.Val "MICROSAR RTE" VALUE 0x0 RTE_RL_UWORD 0 NO_COMPU_METHOD 0 65535 SYMBOL_LINK "Rte_CalprmRom_CalRegn01Inin00_DEFAULT_RTE_CALPRM_GROUP.MotTqTranlDampgRampEnd_Val" 0 DISPLAY_IDENTIFIER CalRegn01Inin00.CalibrationPorts.MotTqTranlDampgRampEnd.Val /end CHARACTERISTIC
/begin CHARACTERISTIC CalRegn01Inin00.MotTqTranlDampgTmrPt1.Val "MICROSAR RTE" VALUE 0x0 RTE_RL_FLOAT32_IEEE 0 NO_COMPU_METHOD -3.402823466e+38 3.402823466e+38 SYMBOL_LINK "Rte_CalprmRom_CalRegn01Inin00_DEFAULT_RTE_CALPRM_GROUP.MotTqTranlDampgTmrPt1_Val" 0 DISPLAY_IDENTIFIER CalRegn01Inin00.CalibrationPorts.MotTqTranlDampgTmrPt1.Val /end CHARACTERISTIC
/begin CHARACTERISTIC CalRegn01Inin00.MotTqTranlDampgTmrPt2.Val "MICROSAR RTE" VALUE 0x0 RTE_RL_FLOAT32_IEEE 0 NO_COMPU_METHOD -3.402823466e+38 3.402823466e+38 SYMBOL_LINK "Rte_CalprmRom_CalRegn01Inin00_DEFAULT_RTE_CALPRM_GROUP.MotTqTranlDampgTmrPt2_Val" 0 DISPLAY_IDENTIFIER CalRegn01Inin00.CalibrationPorts.MotTqTranlDampgTmrPt2.Val /end CHARACTERISTIC
/begin CHARACTERISTIC CalRegn01Inin00.MotTqTranlDampgVehSpdBlndX.Ary1D "MICROSAR RTE" VAL_BLK 0x0 RTE_RL_UWORD 0 NO_COMPU_METHOD 0 65535 MATRIX_DIM 4 1 1 SYMBOL_LINK "Rte_CalprmRom_CalRegn01Inin00_DEFAULT_RTE_CALPRM_GROUP.MotTqTranlDampgVehSpdBlndX_Ary1D" 0 DISPLAY_IDENTIFIER CalRegn01Inin00.CalibrationPorts.MotTqTranlDampgVehSpdBlndX.Ary1D /end CHARACTERISTIC
/begin CHARACTERISTIC CalRegn01Inin00.MotTqTranlDampgVelThd.Val "MICROSAR RTE" VALUE 0x0 RTE_RL_FLOAT32_IEEE 0 NO_COMPU_METHOD -3.402823466e+38 3.402823466e+38 SYMBOL_LINK "Rte_CalprmRom_CalRegn01Inin00_DEFAULT_RTE_CALPRM_GROUP.MotTqTranlDampgVelThd_Val" 0 DISPLAY_IDENTIFIER CalRegn01Inin00.CalibrationPorts.MotTqTranlDampgVelThd.Val /end CHARACTERISTIC
/begin CHARACTERISTIC CalRegn01Inin00.PwrDiscnctNtc0x042FailStep.Val "MICROSAR RTE" VALUE 0x0 RTE_RL_UWORD 0 NO_COMPU_METHOD 0 65535 SYMBOL_LINK "Rte_CalprmRom_CalRegn01Inin00_DEFAULT_RTE_CALPRM_GROUP.PwrDiscnctNtc0x042FailStep_Val" 0 DISPLAY_IDENTIFIER CalRegn01Inin00.CalibrationPorts.PwrDiscnctNtc0x042FailStep.Val /end CHARACTERISTIC
/begin CHARACTERISTIC CalRegn01Inin00.PwrDiscnctNtc0x042PassStep.Val "MICROSAR RTE" VALUE 0x0 RTE_RL_UWORD 0 NO_COMPU_METHOD 0 65535 SYMBOL_LINK "Rte_CalprmRom_CalRegn01Inin00_DEFAULT_RTE_CALPRM_GROUP.PwrDiscnctNtc0x042PassStep_Val" 0 DISPLAY_IDENTIFIER CalRegn01Inin00.CalibrationPorts.PwrDiscnctNtc0x042PassStep.Val /end CHARACTERISTIC
/begin CHARACTERISTIC CalRegn01Inin00.PwrDiscnctNtc0x04AFailStep.Val "MICROSAR RTE" VALUE 0x0 RTE_RL_UWORD 0 NO_COMPU_METHOD 0 65535 SYMBOL_LINK "Rte_CalprmRom_CalRegn01Inin00_DEFAULT_RTE_CALPRM_GROUP.PwrDiscnctNtc0x04AFailStep_Val" 0 DISPLAY_IDENTIFIER CalRegn01Inin00.CalibrationPorts.PwrDiscnctNtc0x04AFailStep.Val /end CHARACTERISTIC
/begin CHARACTERISTIC CalRegn01Inin00.PwrDiscnctNtc0x04APassStep.Val "MICROSAR RTE" VALUE 0x0 RTE_RL_UWORD 0 NO_COMPU_METHOD 0 65535 SYMBOL_LINK "Rte_CalprmRom_CalRegn01Inin00_DEFAULT_RTE_CALPRM_GROUP.PwrDiscnctNtc0x04APassStep_Val" 0 DISPLAY_IDENTIFIER CalRegn01Inin00.CalibrationPorts.PwrDiscnctNtc0x04APassStep.Val /end CHARACTERISTIC
/begin CHARACTERISTIC CalRegn01Inin00.RtnPahFwlUpprBndTblX.Ary1D "MICROSAR RTE" VAL_BLK 0x0 RTE_RL_SWORD 0 NO_COMPU_METHOD -32768 32767 MATRIX_DIM 11 1 1 SYMBOL_LINK "Rte_CalprmRom_CalRegn01Inin00_DEFAULT_RTE_CALPRM_GROUP.RtnPahFwlUpprBndTblX_Ary1D" 0 DISPLAY_IDENTIFIER CalRegn01Inin00.CalibrationPorts.RtnPahFwlUpprBndTblX.Ary1D /end CHARACTERISTIC
/begin CHARACTERISTIC CalRegn01Inin00.RtnPahFwlUpprBndTblY.Ary2D "MICROSAR RTE" VAL_BLK 0x0 RTE_RL_SWORD 0 NO_COMPU_METHOD -32768 32767 MATRIX_DIM 11 8 1 SYMBOL_LINK "Rte_CalprmRom_CalRegn01Inin00_DEFAULT_RTE_CALPRM_GROUP.RtnPahFwlUpprBndTblY_Ary2D" 0 DISPLAY_IDENTIFIER CalRegn01Inin00.CalibrationPorts.RtnPahFwlUpprBndTblY.Ary2D /end CHARACTERISTIC
/begin CHARACTERISTIC CalRegn01Inin00.RtnPahFwlVehSpd.Ary1D "MICROSAR RTE" VAL_BLK 0x0 RTE_RL_UWORD 0 NO_COMPU_METHOD 0 65535 MATRIX_DIM 8 1 1 SYMBOL_LINK "Rte_CalprmRom_CalRegn01Inin00_DEFAULT_RTE_CALPRM_GROUP.RtnPahFwlVehSpd_Ary1D" 0 DISPLAY_IDENTIFIER CalRegn01Inin00.CalibrationPorts.RtnPahFwlVehSpd.Ary1D /end CHARACTERISTIC
/begin CHARACTERISTIC CalRegn01Inin00.SnsrMeasStrtTrigDly.Val "MICROSAR RTE" VALUE 0x0 RTE_RL_UWORD 0 NO_COMPU_METHOD 0 65535 SYMBOL_LINK "Rte_CalprmRom_CalRegn01Inin00_DEFAULT_RTE_CALPRM_GROUP.SnsrMeasStrtTrigDly_Val" 0 DISPLAY_IDENTIFIER CalRegn01Inin00.CalibrationPorts.SnsrMeasStrtTrigDly.Val /end CHARACTERISTIC
/begin CHARACTERISTIC CalRegn01Inin00.StHlthSigNormnHiCtrlrT.Val "MICROSAR RTE" VALUE 0x0 RTE_RL_FLOAT32_IEEE 0 NO_COMPU_METHOD -3.402823466e+38 3.402823466e+38 SYMBOL_LINK "Rte_CalprmRom_CalRegn01Inin00_DEFAULT_RTE_CALPRM_GROUP.StHlthSigNormnHiCtrlrT_Val" 0 DISPLAY_IDENTIFIER CalRegn01Inin00.CalibrationPorts.StHlthSigNormnHiCtrlrT.Val /end CHARACTERISTIC
/begin CHARACTERISTIC CalRegn01Inin00.StHlthSigNormnLoCtrlrT.Val "MICROSAR RTE" VALUE 0x0 RTE_RL_FLOAT32_IEEE 0 NO_COMPU_METHOD -3.402823466e+38 3.402823466e+38 SYMBOL_LINK "Rte_CalprmRom_CalRegn01Inin00_DEFAULT_RTE_CALPRM_GROUP.StHlthSigNormnLoCtrlrT_Val" 0 DISPLAY_IDENTIFIER CalRegn01Inin00.CalibrationPorts.StHlthSigNormnLoCtrlrT.Val /end CHARACTERISTIC
/begin CHARACTERISTIC CalRegn01Inin00.SysFricLrngAvrgFricFrq.Val "MICROSAR RTE" VALUE 0x0 RTE_RL_FLOAT32_IEEE 0 NO_COMPU_METHOD -3.402823466e+38 3.402823466e+38 SYMBOL_LINK "Rte_CalprmRom_CalRegn01Inin00_DEFAULT_RTE_CALPRM_GROUP.SysFricLrngAvrgFricFrq_Val" 0 DISPLAY_IDENTIFIER CalRegn01Inin00.CalibrationPorts.SysFricLrngAvrgFricFrq.Val /end CHARACTERISTIC
/begin CHARACTERISTIC CalRegn01Inin00.SysFricLrngBasLineEolFric.Val "MICROSAR RTE" VALUE 0x0 RTE_RL_FLOAT32_IEEE 0 NO_COMPU_METHOD -3.402823466e+38 3.402823466e+38 SYMBOL_LINK "Rte_CalprmRom_CalRegn01Inin00_DEFAULT_RTE_CALPRM_GROUP.SysFricLrngBasLineEolFric_Val" 0 DISPLAY_IDENTIFIER CalRegn01Inin00.CalibrationPorts.SysFricLrngBasLineEolFric.Val /end CHARACTERISTIC
/begin CHARACTERISTIC CalRegn01Inin00.SysFricLrngBasLineFric.Ary1D "MICROSAR RTE" VAL_BLK 0x0 RTE_RL_FLOAT32_IEEE 0 NO_COMPU_METHOD -3.402823466e+38 3.402823466e+38 MATRIX_DIM 4 1 1 SYMBOL_LINK "Rte_CalprmRom_CalRegn01Inin00_DEFAULT_RTE_CALPRM_GROUP.SysFricLrngBasLineFric_Ary1D" 0 DISPLAY_IDENTIFIER CalRegn01Inin00.CalibrationPorts.SysFricLrngBasLineFric.Ary1D /end CHARACTERISTIC
/begin CHARACTERISTIC CalRegn01Inin00.SysFricLrngBasLineHys.Ary2D "MICROSAR RTE" VAL_BLK 0x0 RTE_RL_FLOAT32_IEEE 0 NO_COMPU_METHOD -3.402823466e+38 3.402823466e+38 MATRIX_DIM 4 8 1 SYMBOL_LINK "Rte_CalprmRom_CalRegn01Inin00_DEFAULT_RTE_CALPRM_GROUP.SysFricLrngBasLineHys_Ary2D" 0 DISPLAY_IDENTIFIER CalRegn01Inin00.CalibrationPorts.SysFricLrngBasLineHys.Ary2D /end CHARACTERISTIC
/begin CHARACTERISTIC CalRegn01Inin00.SysFricLrngBasLineRngCntr.Ary2D "MICROSAR RTE" VAL_BLK 0x0 RTE_RL_UWORD 0 NO_COMPU_METHOD 0 65535 MATRIX_DIM 3 8 1 SYMBOL_LINK "Rte_CalprmRom_CalRegn01Inin00_DEFAULT_RTE_CALPRM_GROUP.SysFricLrngBasLineRngCntr_Ary2D" 0 DISPLAY_IDENTIFIER CalRegn01Inin00.CalibrationPorts.SysFricLrngBasLineRngCntr.Ary2D /end CHARACTERISTIC
/begin CHARACTERISTIC CalRegn01Inin00.SysFricLrngDataPrepLpFilFrq.Val "MICROSAR RTE" VALUE 0x0 RTE_RL_FLOAT32_IEEE 0 NO_COMPU_METHOD -3.402823466e+38 3.402823466e+38 SYMBOL_LINK "Rte_CalprmRom_CalRegn01Inin00_DEFAULT_RTE_CALPRM_GROUP.SysFricLrngDataPrepLpFilFrq_Val" 0 DISPLAY_IDENTIFIER CalRegn01Inin00.CalibrationPorts.SysFricLrngDataPrepLpFilFrq.Val /end CHARACTERISTIC
/begin CHARACTERISTIC CalRegn01Inin00.SysFricLrngEolFricDifHiLim.Val "MICROSAR RTE" VALUE 0x0 RTE_RL_FLOAT32_IEEE 0 NO_COMPU_METHOD -3.402823466e+38 3.402823466e+38 SYMBOL_LINK "Rte_CalprmRom_CalRegn01Inin00_DEFAULT_RTE_CALPRM_GROUP.SysFricLrngEolFricDifHiLim_Val" 0 DISPLAY_IDENTIFIER CalRegn01Inin00.CalibrationPorts.SysFricLrngEolFricDifHiLim.Val /end CHARACTERISTIC
/begin CHARACTERISTIC CalRegn01Inin00.SysFricLrngEolFricDifLoLim.Val "MICROSAR RTE" VALUE 0x0 RTE_RL_FLOAT32_IEEE 0 NO_COMPU_METHOD -3.402823466e+38 3.402823466e+38 SYMBOL_LINK "Rte_CalprmRom_CalRegn01Inin00_DEFAULT_RTE_CALPRM_GROUP.SysFricLrngEolFricDifLoLim_Val" 0 DISPLAY_IDENTIFIER CalRegn01Inin00.CalibrationPorts.SysFricLrngEolFricDifLoLim.Val /end CHARACTERISTIC
/begin CHARACTERISTIC CalRegn01Inin00.SysFricLrngEolFricDifScagFac.Val "MICROSAR RTE" VALUE 0x0 RTE_RL_FLOAT32_IEEE 0 NO_COMPU_METHOD -3.402823466e+38 3.402823466e+38 SYMBOL_LINK "Rte_CalprmRom_CalRegn01Inin00_DEFAULT_RTE_CALPRM_GROUP.SysFricLrngEolFricDifScagFac_Val" 0 DISPLAY_IDENTIFIER CalRegn01Inin00.CalibrationPorts.SysFricLrngEolFricDifScagFac.Val /end CHARACTERISTIC
/begin CHARACTERISTIC CalRegn01Inin00.SysFricLrngFricChgWght.Ary1D "MICROSAR RTE" VAL_BLK 0x0 RTE_RL_FLOAT32_IEEE 0 NO_COMPU_METHOD -3.402823466e+38 3.402823466e+38 MATRIX_DIM 4 1 1 SYMBOL_LINK "Rte_CalprmRom_CalRegn01Inin00_DEFAULT_RTE_CALPRM_GROUP.SysFricLrngFricChgWght_Ary1D" 0 DISPLAY_IDENTIFIER CalRegn01Inin00.CalibrationPorts.SysFricLrngFricChgWght.Ary1D /end CHARACTERISTIC
/begin CHARACTERISTIC CalRegn01Inin00.SysFricLrngFricDiagcThd.Val "MICROSAR RTE" VALUE 0x0 RTE_RL_FLOAT32_IEEE 0 NO_COMPU_METHOD -3.402823466e+38 3.402823466e+38 SYMBOL_LINK "Rte_CalprmRom_CalRegn01Inin00_DEFAULT_RTE_CALPRM_GROUP.SysFricLrngFricDiagcThd_Val" 0 DISPLAY_IDENTIFIER CalRegn01Inin00.CalibrationPorts.SysFricLrngFricDiagcThd.Val /end CHARACTERISTIC
/begin CHARACTERISTIC CalRegn01Inin00.SysFricLrngFricDiagcTiThd.Val "MICROSAR RTE" VALUE 0x0 RTE_RL_FLOAT32_IEEE 0 NO_COMPU_METHOD -3.402823466e+38 3.402823466e+38 SYMBOL_LINK "Rte_CalprmRom_CalRegn01Inin00_DEFAULT_RTE_CALPRM_GROUP.SysFricLrngFricDiagcTiThd_Val" 0 DISPLAY_IDENTIFIER CalRegn01Inin00.CalibrationPorts.SysFricLrngFricDiagcTiThd.Val /end CHARACTERISTIC
/begin CHARACTERISTIC CalRegn01Inin00.SysFricLrngFricHysHwAgPt.Ary1D "MICROSAR RTE" VAL_BLK 0x0 RTE_RL_FLOAT32_IEEE 0 NO_COMPU_METHOD -3.402823466e+38 3.402823466e+38 MATRIX_DIM 4 1 1 SYMBOL_LINK "Rte_CalprmRom_CalRegn01Inin00_DEFAULT_RTE_CALPRM_GROUP.SysFricLrngFricHysHwAgPt_Ary1D" 0 DISPLAY_IDENTIFIER CalRegn01Inin00.CalibrationPorts.SysFricLrngFricHysHwAgPt.Ary1D /end CHARACTERISTIC
/begin CHARACTERISTIC CalRegn01Inin00.SysFricLrngFricOffs.Val "MICROSAR RTE" VALUE 0x0 RTE_RL_FLOAT32_IEEE 0 NO_COMPU_METHOD -3.402823466e+38 3.402823466e+38 SYMBOL_LINK "Rte_CalprmRom_CalRegn01Inin00_DEFAULT_RTE_CALPRM_GROUP.SysFricLrngFricOffs_Val" 0 DISPLAY_IDENTIFIER CalRegn01Inin00.CalibrationPorts.SysFricLrngFricOffs.Val /end CHARACTERISTIC
/begin CHARACTERISTIC CalRegn01Inin00.SysFricLrngFricOffsHiLim.Val "MICROSAR RTE" VALUE 0x0 RTE_RL_FLOAT32_IEEE 0 NO_COMPU_METHOD -3.402823466e+38 3.402823466e+38 SYMBOL_LINK "Rte_CalprmRom_CalRegn01Inin00_DEFAULT_RTE_CALPRM_GROUP.SysFricLrngFricOffsHiLim_Val" 0 DISPLAY_IDENTIFIER CalRegn01Inin00.CalibrationPorts.SysFricLrngFricOffsHiLim.Val /end CHARACTERISTIC
/begin CHARACTERISTIC CalRegn01Inin00.SysFricLrngFricOffsLoLim.Val "MICROSAR RTE" VALUE 0x0 RTE_RL_FLOAT32_IEEE 0 NO_COMPU_METHOD -3.402823466e+38 3.402823466e+38 SYMBOL_LINK "Rte_CalprmRom_CalRegn01Inin00_DEFAULT_RTE_CALPRM_GROUP.SysFricLrngFricOffsLoLim_Val" 0 DISPLAY_IDENTIFIER CalRegn01Inin00.CalibrationPorts.SysFricLrngFricOffsLoLim.Val /end CHARACTERISTIC
/begin CHARACTERISTIC CalRegn01Inin00.SysFricLrngFricOffsLpFilFrq.Val "MICROSAR RTE" VALUE 0x0 RTE_RL_FLOAT32_IEEE 0 NO_COMPU_METHOD -3.402823466e+38 3.402823466e+38 SYMBOL_LINK "Rte_CalprmRom_CalRegn01Inin00_DEFAULT_RTE_CALPRM_GROUP.SysFricLrngFricOffsLpFilFrq_Val" 0 DISPLAY_IDENTIFIER CalRegn01Inin00.CalibrationPorts.SysFricLrngFricOffsLpFilFrq.Val /end CHARACTERISTIC
/begin CHARACTERISTIC CalRegn01Inin00.SysFricLrngGain.Val "MICROSAR RTE" VALUE 0x0 RTE_RL_FLOAT32_IEEE 0 NO_COMPU_METHOD -3.402823466e+38 3.402823466e+38 SYMBOL_LINK "Rte_CalprmRom_CalRegn01Inin00_DEFAULT_RTE_CALPRM_GROUP.SysFricLrngGain_Val" 0 DISPLAY_IDENTIFIER CalRegn01Inin00.CalibrationPorts.SysFricLrngGain.Val /end CHARACTERISTIC
/begin CHARACTERISTIC CalRegn01Inin00.SysFricLrngHwPosnAuthyThd.Val "MICROSAR RTE" VALUE 0x0 RTE_RL_FLOAT32_IEEE 0 NO_COMPU_METHOD -3.402823466e+38 3.402823466e+38 SYMBOL_LINK "Rte_CalprmRom_CalRegn01Inin00_DEFAULT_RTE_CALPRM_GROUP.SysFricLrngHwPosnAuthyThd_Val" 0 DISPLAY_IDENTIFIER CalRegn01Inin00.CalibrationPorts.SysFricLrngHwPosnAuthyThd.Val /end CHARACTERISTIC
/begin CHARACTERISTIC CalRegn01Inin00.SysFricLrngHwVelConstrLim.Val "MICROSAR RTE" VALUE 0x0 RTE_RL_FLOAT32_IEEE 0 NO_COMPU_METHOD -3.402823466e+38 3.402823466e+38 SYMBOL_LINK "Rte_CalprmRom_CalRegn01Inin00_DEFAULT_RTE_CALPRM_GROUP.SysFricLrngHwVelConstrLim_Val" 0 DISPLAY_IDENTIFIER CalRegn01Inin00.CalibrationPorts.SysFricLrngHwVelConstrLim.Val /end CHARACTERISTIC
/begin CHARACTERISTIC CalRegn01Inin00.SysFricLrngHwVelHiLim.Val "MICROSAR RTE" VALUE 0x0 RTE_RL_FLOAT32_IEEE 0 NO_COMPU_METHOD -3.402823466e+38 3.402823466e+38 SYMBOL_LINK "Rte_CalprmRom_CalRegn01Inin00_DEFAULT_RTE_CALPRM_GROUP.SysFricLrngHwVelHiLim_Val" 0 DISPLAY_IDENTIFIER CalRegn01Inin00.CalibrationPorts.SysFricLrngHwVelHiLim.Val /end CHARACTERISTIC
/begin CHARACTERISTIC CalRegn01Inin00.SysFricLrngHwVelLoLim.Val "MICROSAR RTE" VALUE 0x0 RTE_RL_FLOAT32_IEEE 0 NO_COMPU_METHOD -3.402823466e+38 3.402823466e+38 SYMBOL_LINK "Rte_CalprmRom_CalRegn01Inin00_DEFAULT_RTE_CALPRM_GROUP.SysFricLrngHwVelLoLim_Val" 0 DISPLAY_IDENTIFIER CalRegn01Inin00.CalibrationPorts.SysFricLrngHwVelLoLim.Val /end CHARACTERISTIC
/begin CHARACTERISTIC CalRegn01Inin00.SysFricLrngIgnCycFricChgLim.Val "MICROSAR RTE" VALUE 0x0 RTE_RL_FLOAT32_IEEE 0 NO_COMPU_METHOD -3.402823466e+38 3.402823466e+38 SYMBOL_LINK "Rte_CalprmRom_CalRegn01Inin00_DEFAULT_RTE_CALPRM_GROUP.SysFricLrngIgnCycFricChgLim_Val" 0 DISPLAY_IDENTIFIER CalRegn01Inin00.CalibrationPorts.SysFricLrngIgnCycFricChgLim.Val /end CHARACTERISTIC
/begin CHARACTERISTIC CalRegn01Inin00.SysFricLrngIvsTrsmRatX.Ary1D "MICROSAR RTE" VAL_BLK 0x0 RTE_RL_UWORD 0 NO_COMPU_METHOD 0 65535 MATRIX_DIM 10 1 1 SYMBOL_LINK "Rte_CalprmRom_CalRegn01Inin00_DEFAULT_RTE_CALPRM_GROUP.SysFricLrngIvsTrsmRatX_Ary1D" 0 DISPLAY_IDENTIFIER CalRegn01Inin00.CalibrationPorts.SysFricLrngIvsTrsmRatX.Ary1D /end CHARACTERISTIC
/begin CHARACTERISTIC CalRegn01Inin00.SysFricLrngIvsTrsmRatY.Ary1D "MICROSAR RTE" VAL_BLK 0x0 RTE_RL_UWORD 0 NO_COMPU_METHOD 0 65535 MATRIX_DIM 10 1 1 SYMBOL_LINK "Rte_CalprmRom_CalRegn01Inin00_DEFAULT_RTE_CALPRM_GROUP.SysFricLrngIvsTrsmRatY_Ary1D" 0 DISPLAY_IDENTIFIER CalRegn01Inin00.CalibrationPorts.SysFricLrngIvsTrsmRatY.Ary1D /end CHARACTERISTIC
/begin CHARACTERISTIC CalRegn01Inin00.SysFricLrngLatAHiLim.Val "MICROSAR RTE" VALUE 0x0 RTE_RL_FLOAT32_IEEE 0 NO_COMPU_METHOD -3.402823466e+38 3.402823466e+38 SYMBOL_LINK "Rte_CalprmRom_CalRegn01Inin00_DEFAULT_RTE_CALPRM_GROUP.SysFricLrngLatAHiLim_Val" 0 DISPLAY_IDENTIFIER CalRegn01Inin00.CalibrationPorts.SysFricLrngLatAHiLim.Val /end CHARACTERISTIC
/begin CHARACTERISTIC CalRegn01Inin00.SysFricLrngLatALoLim.Val "MICROSAR RTE" VALUE 0x0 RTE_RL_FLOAT32_IEEE 0 NO_COMPU_METHOD -3.402823466e+38 3.402823466e+38 SYMBOL_LINK "Rte_CalprmRom_CalRegn01Inin00_DEFAULT_RTE_CALPRM_GROUP.SysFricLrngLatALoLim_Val" 0 DISPLAY_IDENTIFIER CalRegn01Inin00.CalibrationPorts.SysFricLrngLatALoLim.Val /end CHARACTERISTIC
/begin CHARACTERISTIC CalRegn01Inin00.SysFricLrngMaskVehSpd.Ary1D "MICROSAR RTE" VAL_BLK 0x0 RTE_RL_BOOLEAN 0 RTE_CM_BOOLEAN 0 255 MATRIX_DIM 4 1 1 SYMBOL_LINK "Rte_CalprmRom_CalRegn01Inin00_DEFAULT_RTE_CALPRM_GROUP.SysFricLrngMaskVehSpd_Ary1D" 0 DISPLAY_IDENTIFIER CalRegn01Inin00.CalibrationPorts.SysFricLrngMaskVehSpd.Ary1D /end CHARACTERISTIC
/begin CHARACTERISTIC CalRegn01Inin00.SysFricLrngRngCntrThd.Val "MICROSAR RTE" VALUE 0x0 RTE_RL_UWORD 0 NO_COMPU_METHOD 0 65535 SYMBOL_LINK "Rte_CalprmRom_CalRegn01Inin00_DEFAULT_RTE_CALPRM_GROUP.SysFricLrngRngCntrThd_Val" 0 DISPLAY_IDENTIFIER CalRegn01Inin00.CalibrationPorts.SysFricLrngRngCntrThd.Val /end CHARACTERISTIC
/begin CHARACTERISTIC CalRegn01Inin00.SysFricLrngTHiLim.Val "MICROSAR RTE" VALUE 0x0 RTE_RL_FLOAT32_IEEE 0 NO_COMPU_METHOD -3.402823466e+38 3.402823466e+38 SYMBOL_LINK "Rte_CalprmRom_CalRegn01Inin00_DEFAULT_RTE_CALPRM_GROUP.SysFricLrngTHiLim_Val" 0 DISPLAY_IDENTIFIER CalRegn01Inin00.CalibrationPorts.SysFricLrngTHiLim.Val /end CHARACTERISTIC
/begin CHARACTERISTIC CalRegn01Inin00.SysFricLrngTLoLim.Val "MICROSAR RTE" VALUE 0x0 RTE_RL_FLOAT32_IEEE 0 NO_COMPU_METHOD -3.402823466e+38 3.402823466e+38 SYMBOL_LINK "Rte_CalprmRom_CalRegn01Inin00_DEFAULT_RTE_CALPRM_GROUP.SysFricLrngTLoLim_Val" 0 DISPLAY_IDENTIFIER CalRegn01Inin00.CalibrationPorts.SysFricLrngTLoLim.Val /end CHARACTERISTIC
/begin CHARACTERISTIC CalRegn01Inin00.SysFricLrngThd.Val "MICROSAR RTE" VALUE 0x0 RTE_RL_ULONG 0 NO_COMPU_METHOD 0 4294967295 SYMBOL_LINK "Rte_CalprmRom_CalRegn01Inin00_DEFAULT_RTE_CALPRM_GROUP.SysFricLrngThd_Val" 0 DISPLAY_IDENTIFIER CalRegn01Inin00.CalibrationPorts.SysFricLrngThd.Val /end CHARACTERISTIC
/begin CHARACTERISTIC CalRegn01Inin00.SysFricLrngVehSpd.Ary2D "MICROSAR RTE" VAL_BLK 0x0 RTE_RL_FLOAT32_IEEE 0 NO_COMPU_METHOD -3.402823466e+38 3.402823466e+38 MATRIX_DIM 2 4 1 SYMBOL_LINK "Rte_CalprmRom_CalRegn01Inin00_DEFAULT_RTE_CALPRM_GROUP.SysFricLrngVehSpd_Ary2D" 0 DISPLAY_IDENTIFIER CalRegn01Inin00.CalibrationPorts.SysFricLrngVehSpd.Ary2D /end CHARACTERISTIC
/begin CHARACTERISTIC CalRegn01Inin00.SysGlbPrmMotPoleCnt.Val "MICROSAR RTE" VALUE 0x0 RTE_RL_UBYTE 0 NO_COMPU_METHOD 0 255 SYMBOL_LINK "Rte_CalprmRom_CalRegn01Inin00_DEFAULT_RTE_CALPRM_GROUP.SysGlbPrmMotPoleCnt_Val" 0 DISPLAY_IDENTIFIER CalRegn01Inin00.CalibrationPorts.SysGlbPrmMotPoleCnt.Val /end CHARACTERISTIC
/begin CHARACTERISTIC CalRegn01Inin00.SysGlbPrmTorsBarStfn.Val "MICROSAR RTE" VALUE 0x0 RTE_RL_FLOAT32_IEEE 0 NO_COMPU_METHOD -3.402823466e+38 3.402823466e+38 SYMBOL_LINK "Rte_CalprmRom_CalRegn01Inin00_DEFAULT_RTE_CALPRM_GROUP.SysGlbPrmTorsBarStfn_Val" 0 DISPLAY_IDENTIFIER CalRegn01Inin00.CalibrationPorts.SysGlbPrmTorsBarStfn.Val /end CHARACTERISTIC
/begin CHARACTERISTIC CalRegn01Inin00.TEstimnAmbPwrMplr.Val "MICROSAR RTE" VALUE 0x0 RTE_RL_FLOAT32_IEEE 0 NO_COMPU_METHOD -3.402823466e+38 3.402823466e+38 SYMBOL_LINK "Rte_CalprmRom_CalRegn01Inin00_DEFAULT_RTE_CALPRM_GROUP.TEstimnAmbPwrMplr_Val" 0 DISPLAY_IDENTIFIER CalRegn01Inin00.CalibrationPorts.TEstimnAmbPwrMplr.Val /end CHARACTERISTIC
/begin CHARACTERISTIC CalRegn01Inin00.TEstimnAmbTSca.Val "MICROSAR RTE" VALUE 0x0 RTE_RL_FLOAT32_IEEE 0 NO_COMPU_METHOD -3.402823466e+38 3.402823466e+38 SYMBOL_LINK "Rte_CalprmRom_CalRegn01Inin00_DEFAULT_RTE_CALPRM_GROUP.TEstimnAmbTSca_Val" 0 DISPLAY_IDENTIFIER CalRegn01Inin00.CalibrationPorts.TEstimnAmbTSca.Val /end CHARACTERISTIC
/begin CHARACTERISTIC CalRegn01Inin00.TEstimnAssiMechAmbLpFilFrq.Val "MICROSAR RTE" VALUE 0x0 RTE_RL_FLOAT32_IEEE 0 NO_COMPU_METHOD -3.402823466e+38 3.402823466e+38 SYMBOL_LINK "Rte_CalprmRom_CalRegn01Inin00_DEFAULT_RTE_CALPRM_GROUP.TEstimnAssiMechAmbLpFilFrq_Val" 0 DISPLAY_IDENTIFIER CalRegn01Inin00.CalibrationPorts.TEstimnAssiMechAmbLpFilFrq.Val /end CHARACTERISTIC
/begin CHARACTERISTIC CalRegn01Inin00.TEstimnAssiMechAmbMplr.Val "MICROSAR RTE" VALUE 0x0 RTE_RL_FLOAT32_IEEE 0 NO_COMPU_METHOD -3.402823466e+38 3.402823466e+38 SYMBOL_LINK "Rte_CalprmRom_CalRegn01Inin00_DEFAULT_RTE_CALPRM_GROUP.TEstimnAssiMechAmbMplr_Val" 0 DISPLAY_IDENTIFIER CalRegn01Inin00.CalibrationPorts.TEstimnAssiMechAmbMplr.Val /end CHARACTERISTIC
/begin CHARACTERISTIC CalRegn01Inin00.TEstimnAssiMechCorrLim.Val "MICROSAR RTE" VALUE 0x0 RTE_RL_FLOAT32_IEEE 0 NO_COMPU_METHOD -3.402823466e+38 3.402823466e+38 SYMBOL_LINK "Rte_CalprmRom_CalRegn01Inin00_DEFAULT_RTE_CALPRM_GROUP.TEstimnAssiMechCorrLim_Val" 0 DISPLAY_IDENTIFIER CalRegn01Inin00.CalibrationPorts.TEstimnAssiMechCorrLim.Val /end CHARACTERISTIC
/begin CHARACTERISTIC CalRegn01Inin00.TEstimnAssiMechDampgSca.Val "MICROSAR RTE" VALUE 0x0 RTE_RL_FLOAT32_IEEE 0 NO_COMPU_METHOD -3.402823466e+38 3.402823466e+38 SYMBOL_LINK "Rte_CalprmRom_CalRegn01Inin00_DEFAULT_RTE_CALPRM_GROUP.TEstimnAssiMechDampgSca_Val" 0 DISPLAY_IDENTIFIER CalRegn01Inin00.CalibrationPorts.TEstimnAssiMechDampgSca.Val /end CHARACTERISTIC
/begin CHARACTERISTIC CalRegn01Inin00.TEstimnAssiMechDftT.Val "MICROSAR RTE" VALUE 0x0 RTE_RL_FLOAT32_IEEE 0 NO_COMPU_METHOD -3.402823466e+38 3.402823466e+38 SYMBOL_LINK "Rte_CalprmRom_CalRegn01Inin00_DEFAULT_RTE_CALPRM_GROUP.TEstimnAssiMechDftT_Val" 0 DISPLAY_IDENTIFIER CalRegn01Inin00.CalibrationPorts.TEstimnAssiMechDftT.Val /end CHARACTERISTIC
/begin CHARACTERISTIC CalRegn01Inin00.TEstimnAssiMechLLFilCoeffA1.Val "MICROSAR RTE" VALUE 0x0 RTE_RL_FLOAT32_IEEE 0 NO_COMPU_METHOD -3.402823466e+38 3.402823466e+38 SYMBOL_LINK "Rte_CalprmRom_CalRegn01Inin00_DEFAULT_RTE_CALPRM_GROUP.TEstimnAssiMechLLFilCoeffA1_Val" 0 DISPLAY_IDENTIFIER CalRegn01Inin00.CalibrationPorts.TEstimnAssiMechLLFilCoeffA1.Val /end CHARACTERISTIC
/begin CHARACTERISTIC CalRegn01Inin00.TEstimnAssiMechLLFilCoeffB0.Val "MICROSAR RTE" VALUE 0x0 RTE_RL_FLOAT32_IEEE 0 NO_COMPU_METHOD -3.402823466e+38 3.402823466e+38 SYMBOL_LINK "Rte_CalprmRom_CalRegn01Inin00_DEFAULT_RTE_CALPRM_GROUP.TEstimnAssiMechLLFilCoeffB0_Val" 0 DISPLAY_IDENTIFIER CalRegn01Inin00.CalibrationPorts.TEstimnAssiMechLLFilCoeffB0.Val /end CHARACTERISTIC
/begin CHARACTERISTIC CalRegn01Inin00.TEstimnAssiMechLLFilCoeffB1.Val "MICROSAR RTE" VALUE 0x0 RTE_RL_FLOAT32_IEEE 0 NO_COMPU_METHOD -3.402823466e+38 3.402823466e+38 SYMBOL_LINK "Rte_CalprmRom_CalRegn01Inin00_DEFAULT_RTE_CALPRM_GROUP.TEstimnAssiMechLLFilCoeffB1_Val" 0 DISPLAY_IDENTIFIER CalRegn01Inin00.CalibrationPorts.TEstimnAssiMechLLFilCoeffB1.Val /end CHARACTERISTIC
/begin CHARACTERISTIC CalRegn01Inin00.TEstimnAssiMechSlew.Val "MICROSAR RTE" VALUE 0x0 RTE_RL_FLOAT32_IEEE 0 NO_COMPU_METHOD -3.402823466e+38 3.402823466e+38 SYMBOL_LINK "Rte_CalprmRom_CalRegn01Inin00_DEFAULT_RTE_CALPRM_GROUP.TEstimnAssiMechSlew_Val" 0 DISPLAY_IDENTIFIER CalRegn01Inin00.CalibrationPorts.TEstimnAssiMechSlew.Val /end CHARACTERISTIC
/begin CHARACTERISTIC CalRegn01Inin00.TEstimnCorrnTAssiMech.Val "MICROSAR RTE" VALUE 0x0 RTE_RL_FLOAT32_IEEE 0 NO_COMPU_METHOD -3.402823466e+38 3.402823466e+38 SYMBOL_LINK "Rte_CalprmRom_CalRegn01Inin00_DEFAULT_RTE_CALPRM_GROUP.TEstimnCorrnTAssiMech_Val" 0 DISPLAY_IDENTIFIER CalRegn01Inin00.CalibrationPorts.TEstimnCorrnTAssiMech.Val /end CHARACTERISTIC
/begin CHARACTERISTIC CalRegn01Inin00.TEstimnCorrnTCu.Val "MICROSAR RTE" VALUE 0x0 RTE_RL_FLOAT32_IEEE 0 NO_COMPU_METHOD -3.402823466e+38 3.402823466e+38 SYMBOL_LINK "Rte_CalprmRom_CalRegn01Inin00_DEFAULT_RTE_CALPRM_GROUP.TEstimnCorrnTCu_Val" 0 DISPLAY_IDENTIFIER CalRegn01Inin00.CalibrationPorts.TEstimnCorrnTCu.Val /end CHARACTERISTIC
/begin CHARACTERISTIC CalRegn01Inin00.TEstimnCorrnTMag.Val "MICROSAR RTE" VALUE 0x0 RTE_RL_FLOAT32_IEEE 0 NO_COMPU_METHOD -3.402823466e+38 3.402823466e+38 SYMBOL_LINK "Rte_CalprmRom_CalRegn01Inin00_DEFAULT_RTE_CALPRM_GROUP.TEstimnCorrnTMag_Val" 0 DISPLAY_IDENTIFIER CalRegn01Inin00.CalibrationPorts.TEstimnCorrnTMag.Val /end CHARACTERISTIC
/begin CHARACTERISTIC CalRegn01Inin00.TEstimnCorrnTSi.Val "MICROSAR RTE" VALUE 0x0 RTE_RL_FLOAT32_IEEE 0 NO_COMPU_METHOD -3.402823466e+38 3.402823466e+38 SYMBOL_LINK "Rte_CalprmRom_CalRegn01Inin00_DEFAULT_RTE_CALPRM_GROUP.TEstimnCorrnTSi_Val" 0 DISPLAY_IDENTIFIER CalRegn01Inin00.CalibrationPorts.TEstimnCorrnTSi.Val /end CHARACTERISTIC
/begin CHARACTERISTIC CalRegn01Inin00.TEstimnCuAmbLpFilFrq.Val "MICROSAR RTE" VALUE 0x0 RTE_RL_FLOAT32_IEEE 0 NO_COMPU_METHOD -3.402823466e+38 3.402823466e+38 SYMBOL_LINK "Rte_CalprmRom_CalRegn01Inin00_DEFAULT_RTE_CALPRM_GROUP.TEstimnCuAmbLpFilFrq_Val" 0 DISPLAY_IDENTIFIER CalRegn01Inin00.CalibrationPorts.TEstimnCuAmbLpFilFrq.Val /end CHARACTERISTIC
/begin CHARACTERISTIC CalRegn01Inin00.TEstimnCuAmbMplr.Val "MICROSAR RTE" VALUE 0x0 RTE_RL_FLOAT32_IEEE 0 NO_COMPU_METHOD -3.402823466e+38 3.402823466e+38 SYMBOL_LINK "Rte_CalprmRom_CalRegn01Inin00_DEFAULT_RTE_CALPRM_GROUP.TEstimnCuAmbMplr_Val" 0 DISPLAY_IDENTIFIER CalRegn01Inin00.CalibrationPorts.TEstimnCuAmbMplr.Val /end CHARACTERISTIC
/begin CHARACTERISTIC CalRegn01Inin00.TEstimnCuCorrnLim.Val "MICROSAR RTE" VALUE 0x0 RTE_RL_FLOAT32_IEEE 0 NO_COMPU_METHOD -3.402823466e+38 3.402823466e+38 SYMBOL_LINK "Rte_CalprmRom_CalRegn01Inin00_DEFAULT_RTE_CALPRM_GROUP.TEstimnCuCorrnLim_Val" 0 DISPLAY_IDENTIFIER CalRegn01Inin00.CalibrationPorts.TEstimnCuCorrnLim.Val /end CHARACTERISTIC
/begin CHARACTERISTIC CalRegn01Inin00.TEstimnCuLLFilCoeffA1.Val "MICROSAR RTE" VALUE 0x0 RTE_RL_FLOAT32_IEEE 0 NO_COMPU_METHOD -3.402823466e+38 3.402823466e+38 SYMBOL_LINK "Rte_CalprmRom_CalRegn01Inin00_DEFAULT_RTE_CALPRM_GROUP.TEstimnCuLLFilCoeffA1_Val" 0 DISPLAY_IDENTIFIER CalRegn01Inin00.CalibrationPorts.TEstimnCuLLFilCoeffA1.Val /end CHARACTERISTIC
/begin CHARACTERISTIC CalRegn01Inin00.TEstimnCuLLFilCoeffB0.Val "MICROSAR RTE" VALUE 0x0 RTE_RL_FLOAT32_IEEE 0 NO_COMPU_METHOD -3.402823466e+38 3.402823466e+38 SYMBOL_LINK "Rte_CalprmRom_CalRegn01Inin00_DEFAULT_RTE_CALPRM_GROUP.TEstimnCuLLFilCoeffB0_Val" 0 DISPLAY_IDENTIFIER CalRegn01Inin00.CalibrationPorts.TEstimnCuLLFilCoeffB0.Val /end CHARACTERISTIC
/begin CHARACTERISTIC CalRegn01Inin00.TEstimnCuLLFilCoeffB1.Val "MICROSAR RTE" VALUE 0x0 RTE_RL_FLOAT32_IEEE 0 NO_COMPU_METHOD -3.402823466e+38 3.402823466e+38 SYMBOL_LINK "Rte_CalprmRom_CalRegn01Inin00_DEFAULT_RTE_CALPRM_GROUP.TEstimnCuLLFilCoeffB1_Val" 0 DISPLAY_IDENTIFIER CalRegn01Inin00.CalibrationPorts.TEstimnCuLLFilCoeffB1.Val /end CHARACTERISTIC
/begin CHARACTERISTIC CalRegn01Inin00.TEstimnEngTSca.Val "MICROSAR RTE" VALUE 0x0 RTE_RL_FLOAT32_IEEE 0 NO_COMPU_METHOD -3.402823466e+38 3.402823466e+38 SYMBOL_LINK "Rte_CalprmRom_CalRegn01Inin00_DEFAULT_RTE_CALPRM_GROUP.TEstimnEngTSca_Val" 0 DISPLAY_IDENTIFIER CalRegn01Inin00.CalibrationPorts.TEstimnEngTSca.Val /end CHARACTERISTIC
/begin CHARACTERISTIC CalRegn01Inin00.TEstimnMagAmbLpFilFrq.Val "MICROSAR RTE" VALUE 0x0 RTE_RL_FLOAT32_IEEE 0 NO_COMPU_METHOD -3.402823466e+38 3.402823466e+38 SYMBOL_LINK "Rte_CalprmRom_CalRegn01Inin00_DEFAULT_RTE_CALPRM_GROUP.TEstimnMagAmbLpFilFrq_Val" 0 DISPLAY_IDENTIFIER CalRegn01Inin00.CalibrationPorts.TEstimnMagAmbLpFilFrq.Val /end CHARACTERISTIC
/begin CHARACTERISTIC CalRegn01Inin00.TEstimnMagCorrnLim.Val "MICROSAR RTE" VALUE 0x0 RTE_RL_FLOAT32_IEEE 0 NO_COMPU_METHOD -3.402823466e+38 3.402823466e+38 SYMBOL_LINK "Rte_CalprmRom_CalRegn01Inin00_DEFAULT_RTE_CALPRM_GROUP.TEstimnMagCorrnLim_Val" 0 DISPLAY_IDENTIFIER CalRegn01Inin00.CalibrationPorts.TEstimnMagCorrnLim.Val /end CHARACTERISTIC
/begin CHARACTERISTIC CalRegn01Inin00.TEstimnMagLLFilCoeffA1.Val "MICROSAR RTE" VALUE 0x0 RTE_RL_FLOAT32_IEEE 0 NO_COMPU_METHOD -3.402823466e+38 3.402823466e+38 SYMBOL_LINK "Rte_CalprmRom_CalRegn01Inin00_DEFAULT_RTE_CALPRM_GROUP.TEstimnMagLLFilCoeffA1_Val" 0 DISPLAY_IDENTIFIER CalRegn01Inin00.CalibrationPorts.TEstimnMagLLFilCoeffA1.Val /end CHARACTERISTIC
/begin CHARACTERISTIC CalRegn01Inin00.TEstimnMagLLFilCoeffB0.Val "MICROSAR RTE" VALUE 0x0 RTE_RL_FLOAT32_IEEE 0 NO_COMPU_METHOD -3.402823466e+38 3.402823466e+38 SYMBOL_LINK "Rte_CalprmRom_CalRegn01Inin00_DEFAULT_RTE_CALPRM_GROUP.TEstimnMagLLFilCoeffB0_Val" 0 DISPLAY_IDENTIFIER CalRegn01Inin00.CalibrationPorts.TEstimnMagLLFilCoeffB0.Val /end CHARACTERISTIC
/begin CHARACTERISTIC CalRegn01Inin00.TEstimnMagLLFilCoeffB1.Val "MICROSAR RTE" VALUE 0x0 RTE_RL_FLOAT32_IEEE 0 NO_COMPU_METHOD -3.402823466e+38 3.402823466e+38 SYMBOL_LINK "Rte_CalprmRom_CalRegn01Inin00_DEFAULT_RTE_CALPRM_GROUP.TEstimnMagLLFilCoeffB1_Val" 0 DISPLAY_IDENTIFIER CalRegn01Inin00.CalibrationPorts.TEstimnMagLLFilCoeffB1.Val /end CHARACTERISTIC
/begin CHARACTERISTIC CalRegn01Inin00.TEstimnSiAmbLpFilFrq.Val "MICROSAR RTE" VALUE 0x0 RTE_RL_FLOAT32_IEEE 0 NO_COMPU_METHOD -3.402823466e+38 3.402823466e+38 SYMBOL_LINK "Rte_CalprmRom_CalRegn01Inin00_DEFAULT_RTE_CALPRM_GROUP.TEstimnSiAmbLpFilFrq_Val" 0 DISPLAY_IDENTIFIER CalRegn01Inin00.CalibrationPorts.TEstimnSiAmbLpFilFrq.Val /end CHARACTERISTIC
/begin CHARACTERISTIC CalRegn01Inin00.TEstimnSiAmbMplr.Val "MICROSAR RTE" VALUE 0x0 RTE_RL_FLOAT32_IEEE 0 NO_COMPU_METHOD -3.402823466e+38 3.402823466e+38 SYMBOL_LINK "Rte_CalprmRom_CalRegn01Inin00_DEFAULT_RTE_CALPRM_GROUP.TEstimnSiAmbMplr_Val" 0 DISPLAY_IDENTIFIER CalRegn01Inin00.CalibrationPorts.TEstimnSiAmbMplr.Val /end CHARACTERISTIC
/begin CHARACTERISTIC CalRegn01Inin00.TEstimnSiCorrnLim.Val "MICROSAR RTE" VALUE 0x0 RTE_RL_FLOAT32_IEEE 0 NO_COMPU_METHOD -3.402823466e+38 3.402823466e+38 SYMBOL_LINK "Rte_CalprmRom_CalRegn01Inin00_DEFAULT_RTE_CALPRM_GROUP.TEstimnSiCorrnLim_Val" 0 DISPLAY_IDENTIFIER CalRegn01Inin00.CalibrationPorts.TEstimnSiCorrnLim.Val /end CHARACTERISTIC
/begin CHARACTERISTIC CalRegn01Inin00.TEstimnSiLLFilCoeffA1.Val "MICROSAR RTE" VALUE 0x0 RTE_RL_FLOAT32_IEEE 0 NO_COMPU_METHOD -3.402823466e+38 3.402823466e+38 SYMBOL_LINK "Rte_CalprmRom_CalRegn01Inin00_DEFAULT_RTE_CALPRM_GROUP.TEstimnSiLLFilCoeffA1_Val" 0 DISPLAY_IDENTIFIER CalRegn01Inin00.CalibrationPorts.TEstimnSiLLFilCoeffA1.Val /end CHARACTERISTIC
/begin CHARACTERISTIC CalRegn01Inin00.TEstimnSiLLFilCoeffB0.Val "MICROSAR RTE" VALUE 0x0 RTE_RL_FLOAT32_IEEE 0 NO_COMPU_METHOD -3.402823466e+38 3.402823466e+38 SYMBOL_LINK "Rte_CalprmRom_CalRegn01Inin00_DEFAULT_RTE_CALPRM_GROUP.TEstimnSiLLFilCoeffB0_Val" 0 DISPLAY_IDENTIFIER CalRegn01Inin00.CalibrationPorts.TEstimnSiLLFilCoeffB0.Val /end CHARACTERISTIC
/begin CHARACTERISTIC CalRegn01Inin00.TEstimnSiLLFilCoeffB1.Val "MICROSAR RTE" VALUE 0x0 RTE_RL_FLOAT32_IEEE 0 NO_COMPU_METHOD -3.402823466e+38 3.402823466e+38 SYMBOL_LINK "Rte_CalprmRom_CalRegn01Inin00_DEFAULT_RTE_CALPRM_GROUP.TEstimnSiLLFilCoeffB1_Val" 0 DISPLAY_IDENTIFIER CalRegn01Inin00.CalibrationPorts.TEstimnSiLLFilCoeffB1.Val /end CHARACTERISTIC
/begin CHARACTERISTIC CalRegn01Inin00.TEstimnWghtAvrgTDi.Logl "MICROSAR RTE" VALUE 0x0 RTE_RL_BOOLEAN 0 RTE_CM_BOOLEAN 0 255 SYMBOL_LINK "Rte_CalprmRom_CalRegn01Inin00_DEFAULT_RTE_CALPRM_GROUP.TEstimnWghtAvrgTDi_Logl" 0 DISPLAY_IDENTIFIER CalRegn01Inin00.CalibrationPorts.TEstimnWghtAvrgTDi.Logl /end CHARACTERISTIC
/begin CHARACTERISTIC CalRegn01Inin00.TunSelnAuthyVehSpdX.Ary1D "MICROSAR RTE" VAL_BLK 0x0 RTE_RL_UWORD 0 NO_COMPU_METHOD 0 65535 MATRIX_DIM 6 1 1 SYMBOL_LINK "Rte_CalprmRom_CalRegn01Inin00_DEFAULT_RTE_CALPRM_GROUP.TunSelnAuthyVehSpdX_Ary1D" 0 DISPLAY_IDENTIFIER CalRegn01Inin00.CalibrationPorts.TunSelnAuthyVehSpdX.Ary1D /end CHARACTERISTIC
/begin CHARACTERISTIC CalRegn01Inin00.VehSigCdngLatASlewRate.Val "MICROSAR RTE" VALUE 0x0 RTE_RL_FLOAT32_IEEE 0 NO_COMPU_METHOD 0.1 400.0 SYMBOL_LINK "Rte_CalprmRom_CalRegn01Inin00_DEFAULT_RTE_CALPRM_GROUP.VehSigCdngLatASlewRate_Val" 0 DISPLAY_IDENTIFIER CalRegn01Inin00.CalibrationPorts.VehSigCdngLatASlewRate.Val /end CHARACTERISTIC
/begin CHARACTERISTIC CalRegn01Inin00.VehSigCdngLtgASlewRate.Val "MICROSAR RTE" VALUE 0x0 RTE_RL_FLOAT32_IEEE 0 NO_COMPU_METHOD 0.1 500.0 SYMBOL_LINK "Rte_CalprmRom_CalRegn01Inin00_DEFAULT_RTE_CALPRM_GROUP.VehSigCdngLtgASlewRate_Val" 0 DISPLAY_IDENTIFIER CalRegn01Inin00.CalibrationPorts.VehSigCdngLtgASlewRate.Val /end CHARACTERISTIC
/begin CHARACTERISTIC CalRegn01Inin00.VehSigCdngVehSpdSlewRate.Val "MICROSAR RTE" VALUE 0x0 RTE_RL_FLOAT32_IEEE 0 NO_COMPU_METHOD 1.0 50.0 SYMBOL_LINK "Rte_CalprmRom_CalRegn01Inin00_DEFAULT_RTE_CALPRM_GROUP.VehSigCdngVehSpdSlewRate_Val" 0 DISPLAY_IDENTIFIER CalRegn01Inin00.CalibrationPorts.VehSigCdngVehSpdSlewRate.Val /end CHARACTERISTIC
/begin CHARACTERISTIC CalRegn01Inin00.WhlImbRejctnDcTrendFltRcvryThd.Val "MICROSAR RTE" VALUE 0x0 RTE_RL_FLOAT32_IEEE 0 NO_COMPU_METHOD -3.402823466e+38 3.402823466e+38 SYMBOL_LINK "Rte_CalprmRom_CalRegn01Inin00_DEFAULT_RTE_CALPRM_GROUP.WhlImbRejctnDcTrendFltRcvryThd_Val" 0 DISPLAY_IDENTIFIER CalRegn01Inin00.CalibrationPorts.WhlImbRejctnDcTrendFltRcvryThd.Val /end CHARACTERISTIC
/begin CHARACTERISTIC CalRegn01Inin00GroupB.GmRoadWhlInQlfrMaxAllwblFrq.Val "MICROSAR RTE" VALUE 0x0 RTE_RL_FLOAT32_IEEE 0 NO_COMPU_METHOD -3.402823466e+38 3.402823466e+38 SYMBOL_LINK "Rte_CalprmRom_CalRegn01Inin00GroupB_DEFAULT_RTE_CALPRM_GROUP.GmRoadWhlInQlfrMaxAllwblFrq_Val" 0 DISPLAY_IDENTIFIER CalRegn01Inin00GroupB.CalibrationPorts.GmRoadWhlInQlfrMaxAllwblFrq.Val /end CHARACTERISTIC
/begin CHARACTERISTIC CalRegn01Inin00GroupB.GmRoadWhlInQlfrMaxFrqChg.Val "MICROSAR RTE" VALUE 0x0 RTE_RL_FLOAT32_IEEE 0 NO_COMPU_METHOD -3.402823466e+38 3.402823466e+38 SYMBOL_LINK "Rte_CalprmRom_CalRegn01Inin00GroupB_DEFAULT_RTE_CALPRM_GROUP.GmRoadWhlInQlfrMaxFrqChg_Val" 0 DISPLAY_IDENTIFIER CalRegn01Inin00GroupB.CalibrationPorts.GmRoadWhlInQlfrMaxFrqChg.Val /end CHARACTERISTIC
/begin CHARACTERISTIC CalRegn01Inin00GroupB.WhlImbRejctnDcTrendFltRcvryNegStep.Val "MICROSAR RTE" VALUE 0x0 RTE_RL_FLOAT32_IEEE 0 NO_COMPU_METHOD -3.402823466e+38 3.402823466e+38 SYMBOL_LINK "Rte_CalprmRom_CalRegn01Inin00GroupB_DEFAULT_RTE_CALPRM_GROUP.WhlImbRejctnDcTrendFltRcvryNegStep_Val" 0 DISPLAY_IDENTIFIER CalRegn01Inin00GroupB.CalibrationPorts.WhlImbRejctnDcTrendFltRcvryNegStep.Val /end CHARACTERISTIC
/begin CHARACTERISTIC CalRegn01Inin00GroupB.WhlImbRejctnDcTrendFltRcvryPosStep.Val "MICROSAR RTE" VALUE 0x0 RTE_RL_FLOAT32_IEEE 0 NO_COMPU_METHOD -3.402823466e+38 3.402823466e+38 SYMBOL_LINK "Rte_CalprmRom_CalRegn01Inin00GroupB_DEFAULT_RTE_CALPRM_GROUP.WhlImbRejctnDcTrendFltRcvryPosStep_Val" 0 DISPLAY_IDENTIFIER CalRegn01Inin00GroupB.CalibrationPorts.WhlImbRejctnDcTrendFltRcvryPosStep.Val /end CHARACTERISTIC
/begin CHARACTERISTIC CalRegn01Inin00GroupB.WhlImbRejctnFrqDiagcAmpThd.Val "MICROSAR RTE" VALUE 0x0 RTE_RL_FLOAT32_IEEE 0 NO_COMPU_METHOD -3.402823466e+38 3.402823466e+38 SYMBOL_LINK "Rte_CalprmRom_CalRegn01Inin00GroupB_DEFAULT_RTE_CALPRM_GROUP.WhlImbRejctnFrqDiagcAmpThd_Val" 0 DISPLAY_IDENTIFIER CalRegn01Inin00GroupB.CalibrationPorts.WhlImbRejctnFrqDiagcAmpThd.Val /end CHARACTERISTIC
/begin CHARACTERISTIC CalRegn01Inin00GroupB.WhlImbRejctnFrqDiagcFltRcvryNegStep.Val "MICROSAR RTE" VALUE 0x0 RTE_RL_FLOAT32_IEEE 0 NO_COMPU_METHOD -3.402823466e+38 3.402823466e+38 SYMBOL_LINK "Rte_CalprmRom_CalRegn01Inin00GroupB_DEFAULT_RTE_CALPRM_GROUP.WhlImbRejctnFrqDiagcFltRcvryNegStep_Val" 0 DISPLAY_IDENTIFIER CalRegn01Inin00GroupB.CalibrationPorts.WhlImbRejctnFrqDiagcFltRcvryNegStep.Val /end CHARACTERISTIC
/begin CHARACTERISTIC CalRegn01Inin00GroupB.WhlImbRejctnFrqDiagcFltRcvryPosStep.Val "MICROSAR RTE" VALUE 0x0 RTE_RL_FLOAT32_IEEE 0 NO_COMPU_METHOD -3.402823466e+38 3.402823466e+38 SYMBOL_LINK "Rte_CalprmRom_CalRegn01Inin00GroupB_DEFAULT_RTE_CALPRM_GROUP.WhlImbRejctnFrqDiagcFltRcvryPosStep_Val" 0 DISPLAY_IDENTIFIER CalRegn01Inin00GroupB.CalibrationPorts.WhlImbRejctnFrqDiagcFltRcvryPosStep.Val /end CHARACTERISTIC
/begin CHARACTERISTIC CalRegn01Inin00GroupB.WhlImbRejctnFrqDiagcFltRcvryThd.Val "MICROSAR RTE" VALUE 0x0 RTE_RL_FLOAT32_IEEE 0 NO_COMPU_METHOD -3.402823466e+38 3.402823466e+38 SYMBOL_LINK "Rte_CalprmRom_CalRegn01Inin00GroupB_DEFAULT_RTE_CALPRM_GROUP.WhlImbRejctnFrqDiagcFltRcvryThd_Val" 0 DISPLAY_IDENTIFIER CalRegn01Inin00GroupB.CalibrationPorts.WhlImbRejctnFrqDiagcFltRcvryThd.Val /end CHARACTERISTIC
/begin CHARACTERISTIC CalRegn01Inin00GroupB.WhlImbRejctnFrqDiagcThd.Val "MICROSAR RTE" VALUE 0x0 RTE_RL_FLOAT32_IEEE 0 NO_COMPU_METHOD -3.402823466e+38 3.402823466e+38 SYMBOL_LINK "Rte_CalprmRom_CalRegn01Inin00GroupB_DEFAULT_RTE_CALPRM_GROUP.WhlImbRejctnFrqDiagcThd_Val" 0 DISPLAY_IDENTIFIER CalRegn01Inin00GroupB.CalibrationPorts.WhlImbRejctnFrqDiagcThd.Val /end CHARACTERISTIC
/begin CHARACTERISTIC CalRegn01Inin00GroupB.WhlImbRejctnFrqDiagcTout.Val "MICROSAR RTE" VALUE 0x0 RTE_RL_UWORD 0 NO_COMPU_METHOD 0 65535 SYMBOL_LINK "Rte_CalprmRom_CalRegn01Inin00GroupB_DEFAULT_RTE_CALPRM_GROUP.WhlImbRejctnFrqDiagcTout_Val" 0 DISPLAY_IDENTIFIER CalRegn01Inin00GroupB.CalibrationPorts.WhlImbRejctnFrqDiagcTout.Val /end CHARACTERISTIC
/begin CHARACTERISTIC CalRegn01Inin00GroupB.WhlImbRejctnMaxMgnFltNegStep.Val "MICROSAR RTE" VALUE 0x0 RTE_RL_FLOAT32_IEEE 0 NO_COMPU_METHOD -3.402823466e+38 3.402823466e+38 SYMBOL_LINK "Rte_CalprmRom_CalRegn01Inin00GroupB_DEFAULT_RTE_CALPRM_GROUP.WhlImbRejctnMaxMgnFltNegStep_Val" 0 DISPLAY_IDENTIFIER CalRegn01Inin00GroupB.CalibrationPorts.WhlImbRejctnMaxMgnFltNegStep.Val /end CHARACTERISTIC
/begin CHARACTERISTIC CalRegn01Inin00GroupB.WhlImbRejctnMaxMgnFltPosStep.Val "MICROSAR RTE" VALUE 0x0 RTE_RL_FLOAT32_IEEE 0 NO_COMPU_METHOD -3.402823466e+38 3.402823466e+38 SYMBOL_LINK "Rte_CalprmRom_CalRegn01Inin00GroupB_DEFAULT_RTE_CALPRM_GROUP.WhlImbRejctnMaxMgnFltPosStep_Val" 0 DISPLAY_IDENTIFIER CalRegn01Inin00GroupB.CalibrationPorts.WhlImbRejctnMaxMgnFltPosStep.Val /end CHARACTERISTIC
/begin CHARACTERISTIC CalRegn01Inin00GroupB.WhlImbRejctnMaxMgnFltRcvryNegStep.Val "MICROSAR RTE" VALUE 0x0 RTE_RL_FLOAT32_IEEE 0 NO_COMPU_METHOD -3.402823466e+38 3.402823466e+38 SYMBOL_LINK "Rte_CalprmRom_CalRegn01Inin00GroupB_DEFAULT_RTE_CALPRM_GROUP.WhlImbRejctnMaxMgnFltRcvryNegStep_Val" 0 DISPLAY_IDENTIFIER CalRegn01Inin00GroupB.CalibrationPorts.WhlImbRejctnMaxMgnFltRcvryNegStep.Val /end CHARACTERISTIC
/begin CHARACTERISTIC CalRegn01Inin00GroupB.WhlImbRejctnMaxMgnFltRcvryPosStep.Val "MICROSAR RTE" VALUE 0x0 RTE_RL_FLOAT32_IEEE 0 NO_COMPU_METHOD -3.402823466e+38 3.402823466e+38 SYMBOL_LINK "Rte_CalprmRom_CalRegn01Inin00GroupB_DEFAULT_RTE_CALPRM_GROUP.WhlImbRejctnMaxMgnFltRcvryPosStep_Val" 0 DISPLAY_IDENTIFIER CalRegn01Inin00GroupB.CalibrationPorts.WhlImbRejctnMaxMgnFltRcvryPosStep.Val /end CHARACTERISTIC
/begin CHARACTERISTIC CalRegn01Inin00GroupB.WhlImbRejctnMaxMgnFltRcvryThd.Val "MICROSAR RTE" VALUE 0x0 RTE_RL_FLOAT32_IEEE 0 NO_COMPU_METHOD -3.402823466e+38 3.402823466e+38 SYMBOL_LINK "Rte_CalprmRom_CalRegn01Inin00GroupB_DEFAULT_RTE_CALPRM_GROUP.WhlImbRejctnMaxMgnFltRcvryThd_Val" 0 DISPLAY_IDENTIFIER CalRegn01Inin00GroupB.CalibrationPorts.WhlImbRejctnMaxMgnFltRcvryThd.Val /end CHARACTERISTIC
/begin CHARACTERISTIC CalRegn01Inin00GroupB.WhlImbRejctnMaxMgnFltThd.Val "MICROSAR RTE" VALUE 0x0 RTE_RL_FLOAT32_IEEE 0 NO_COMPU_METHOD -3.402823466e+38 3.402823466e+38 SYMBOL_LINK "Rte_CalprmRom_CalRegn01Inin00GroupB_DEFAULT_RTE_CALPRM_GROUP.WhlImbRejctnMaxMgnFltThd_Val" 0 DISPLAY_IDENTIFIER CalRegn01Inin00GroupB.CalibrationPorts.WhlImbRejctnMaxMgnFltThd.Val /end CHARACTERISTIC
/begin CHARACTERISTIC CalRegn01Inin00GroupB.WhlImbRejctnWhlSpdCorrlnFltRcvryNegStep.Val "MICROSAR RTE" VALUE 0x0 RTE_RL_FLOAT32_IEEE 0 NO_COMPU_METHOD -3.402823466e+38 3.402823466e+38 SYMBOL_LINK "Rte_CalprmRom_CalRegn01Inin00GroupB_DEFAULT_RTE_CALPRM_GROUP.WhlImbRejctnWhlSpdCorrlnFltRcvryNegStep_Val" 0 DISPLAY_IDENTIFIER CalRegn01Inin00GroupB.CalibrationPorts.WhlImbRejctnWhlSpdCorrlnFltRcvryNegStep.Val /end CHARACTERISTIC
/begin CHARACTERISTIC CalRegn01Inin00GroupB.WhlImbRejctnWhlSpdCorrlnFltRcvryPosStep.Val "MICROSAR RTE" VALUE 0x0 RTE_RL_FLOAT32_IEEE 0 NO_COMPU_METHOD -3.402823466e+38 3.402823466e+38 SYMBOL_LINK "Rte_CalprmRom_CalRegn01Inin00GroupB_DEFAULT_RTE_CALPRM_GROUP.WhlImbRejctnWhlSpdCorrlnFltRcvryPosStep_Val" 0 DISPLAY_IDENTIFIER CalRegn01Inin00GroupB.CalibrationPorts.WhlImbRejctnWhlSpdCorrlnFltRcvryPosStep.Val /end CHARACTERISTIC
/begin CHARACTERISTIC CalRegn01Inin00GroupB.WhlImbRejctnWhlSpdCorrlnFltRcvryThd.Val "MICROSAR RTE" VALUE 0x0 RTE_RL_FLOAT32_IEEE 0 NO_COMPU_METHOD -3.402823466e+38 3.402823466e+38 SYMBOL_LINK "Rte_CalprmRom_CalRegn01Inin00GroupB_DEFAULT_RTE_CALPRM_GROUP.WhlImbRejctnWhlSpdCorrlnFltRcvryThd_Val" 0 DISPLAY_IDENTIFIER CalRegn01Inin00GroupB.CalibrationPorts.WhlImbRejctnWhlSpdCorrlnFltRcvryThd.Val /end CHARACTERISTIC
/begin CHARACTERISTIC CalRegn01Inin00GroupC.EotProtnFwlEotDampgActvBndY.Ary2D "MICROSAR RTE" VAL_BLK 0x0 RTE_RL_SWORD 0 NO_COMPU_METHOD -32768 32767 MATRIX_DIM 5 4 1 SYMBOL_LINK "Rte_CalprmRom_CalRegn01Inin00GroupC_DEFAULT_RTE_CALPRM_GROUP.EotProtnFwlEotDampgActvBndY_Ary2D" 0 DISPLAY_IDENTIFIER CalRegn01Inin00GroupC.CalibrationPorts.EotProtnFwlEotDampgActvBndY.Ary2D /end CHARACTERISTIC
/begin CHARACTERISTIC CalRegn01Inin00GroupC.GmVehPwrModHwTqMinKeepAssi.Val "MICROSAR RTE" VALUE 0x0 RTE_RL_FLOAT32_IEEE 0 NO_COMPU_METHOD -3.402823466e+38 3.402823466e+38 SYMBOL_LINK "Rte_CalprmRom_CalRegn01Inin00GroupC_DEFAULT_RTE_CALPRM_GROUP.GmVehPwrModHwTqMinKeepAssi_Val" 0 DISPLAY_IDENTIFIER CalRegn01Inin00GroupC.CalibrationPorts.GmVehPwrModHwTqMinKeepAssi.Val /end CHARACTERISTIC
/begin CHARACTERISTIC CalRegn01Inin00GroupC.GmVehPwrModHwTqMinKeepTmr.Val "MICROSAR RTE" VALUE 0x0 RTE_RL_ULONG 0 NO_COMPU_METHOD 0 4294967295 SYMBOL_LINK "Rte_CalprmRom_CalRegn01Inin00GroupC_DEFAULT_RTE_CALPRM_GROUP.GmVehPwrModHwTqMinKeepTmr_Val" 0 DISPLAY_IDENTIFIER CalRegn01Inin00GroupC.CalibrationPorts.GmVehPwrModHwTqMinKeepTmr.Val /end CHARACTERISTIC
/begin CHARACTERISTIC CalRegn01Inin00GroupC.GmVehPwrModVehSpdAssiOnMin.Val "MICROSAR RTE" VALUE 0x0 RTE_RL_FLOAT32_IEEE 0 NO_COMPU_METHOD -3.402823466e+38 3.402823466e+38 SYMBOL_LINK "Rte_CalprmRom_CalRegn01Inin00GroupC_DEFAULT_RTE_CALPRM_GROUP.GmVehPwrModVehSpdAssiOnMin_Val" 0 DISPLAY_IDENTIFIER CalRegn01Inin00GroupC.CalibrationPorts.GmVehPwrModVehSpdAssiOnMin.Val /end CHARACTERISTIC
/begin CHARACTERISTIC CalRegn01Inin00GroupC.GmVehPwrModVehSpdMinKeepAssi.Val "MICROSAR RTE" VALUE 0x0 RTE_RL_FLOAT32_IEEE 0 NO_COMPU_METHOD -3.402823466e+38 3.402823466e+38 SYMBOL_LINK "Rte_CalprmRom_CalRegn01Inin00GroupC_DEFAULT_RTE_CALPRM_GROUP.GmVehPwrModVehSpdMinKeepAssi_Val" 0 DISPLAY_IDENTIFIER CalRegn01Inin00GroupC.CalibrationPorts.GmVehPwrModVehSpdMinKeepAssi.Val /end CHARACTERISTIC
/begin CHARACTERISTIC CalRegn01Rt00.TEstimnMagAmbMplr.Val "MICROSAR RTE" VALUE 0x0 RTE_RL_FLOAT32_IEEE 0 NO_COMPU_METHOD -3.402823466e+38 3.402823466e+38 SYMBOL_LINK "Rte_CalprmRom_CalRegn01Rt00_DEFAULT_RTE_CALPRM_GROUP.TEstimnMagAmbMplr_Val" 0 DISPLAY_IDENTIFIER CalRegn01Rt00.CalibrationPorts.TEstimnMagAmbMplr.Val /end CHARACTERISTIC
/begin CHARACTERISTIC CalRegn01Rt00.TunSelnAuthyHwTqY.Ary1D "MICROSAR RTE" VAL_BLK 0x0 RTE_RL_UWORD 0 NO_COMPU_METHOD 0 65535 MATRIX_DIM 6 1 1 SYMBOL_LINK "Rte_CalprmRom_CalRegn01Rt00_DEFAULT_RTE_CALPRM_GROUP.TunSelnAuthyHwTqY_Ary1D" 0 DISPLAY_IDENTIFIER CalRegn01Rt00.CalibrationPorts.TunSelnAuthyHwTqY.Ary1D /end CHARACTERISTIC
/begin CHARACTERISTIC CalRegn01Rt00.TunSelnAuthyHwVelY.Ary1D "MICROSAR RTE" VAL_BLK 0x0 RTE_RL_UWORD 0 NO_COMPU_METHOD 0 65535 MATRIX_DIM 6 1 1 SYMBOL_LINK "Rte_CalprmRom_CalRegn01Rt00_DEFAULT_RTE_CALPRM_GROUP.TunSelnAuthyHwVelY_Ary1D" 0 DISPLAY_IDENTIFIER CalRegn01Rt00.CalibrationPorts.TunSelnAuthyHwVelY.Ary1D /end CHARACTERISTIC
/begin CHARACTERISTIC CalRegn01Rt01.TEstimnMagAmbMplr.Val "MICROSAR RTE" VALUE 0x0 RTE_RL_FLOAT32_IEEE 0 NO_COMPU_METHOD -3.402823466e+38 3.402823466e+38 SYMBOL_LINK "Rte_CalprmRom_CalRegn01Rt01_DEFAULT_RTE_CALPRM_GROUP.TEstimnMagAmbMplr_Val" 0 DISPLAY_IDENTIFIER CalRegn01Rt01.CalibrationPorts.TEstimnMagAmbMplr.Val /end CHARACTERISTIC
/begin CHARACTERISTIC CalRegn01Rt01.TunSelnAuthyHwTqY.Ary1D "MICROSAR RTE" VAL_BLK 0x0 RTE_RL_UWORD 0 NO_COMPU_METHOD 0 65535 MATRIX_DIM 6 1 1 SYMBOL_LINK "Rte_CalprmRom_CalRegn01Rt01_DEFAULT_RTE_CALPRM_GROUP.TunSelnAuthyHwTqY_Ary1D" 0 DISPLAY_IDENTIFIER CalRegn01Rt01.CalibrationPorts.TunSelnAuthyHwTqY.Ary1D /end CHARACTERISTIC
/begin CHARACTERISTIC CalRegn01Rt01.TunSelnAuthyHwVelY.Ary1D "MICROSAR RTE" VAL_BLK 0x0 RTE_RL_UWORD 0 NO_COMPU_METHOD 0 65535 MATRIX_DIM 6 1 1 SYMBOL_LINK "Rte_CalprmRom_CalRegn01Rt01_DEFAULT_RTE_CALPRM_GROUP.TunSelnAuthyHwVelY_Ary1D" 0 DISPLAY_IDENTIFIER CalRegn01Rt01.CalibrationPorts.TunSelnAuthyHwVelY.Ary1D /end CHARACTERISTIC
/begin CHARACTERISTIC CalRegn01Rt01_Dummy.TEstimnMagAmbMplr.Val "MICROSAR RTE" VALUE 0x0 RTE_RL_FLOAT32_IEEE 0 NO_COMPU_METHOD -3.402823466e+38 3.402823466e+38 SYMBOL_LINK "Rte_CalprmRom_CalRegn01Rt01_DEFAULT_RTE_CALPRM_GROUP.TEstimnMagAmbMplr_Val" 0 DISPLAY_IDENTIFIER CalRegn01Rt01_Dummy.CalibrationPorts.TEstimnMagAmbMplr.Val /end CHARACTERISTIC
/begin CHARACTERISTIC CalRegn01Rt01_Dummy.TunSelnAuthyHwTqY.Ary1D "MICROSAR RTE" VAL_BLK 0x0 RTE_RL_UWORD 0 NO_COMPU_METHOD 0 65535 MATRIX_DIM 6 1 1 SYMBOL_LINK "Rte_CalprmRom_CalRegn01Rt01_DEFAULT_RTE_CALPRM_GROUP.TunSelnAuthyHwTqY_Ary1D" 0 DISPLAY_IDENTIFIER CalRegn01Rt01_Dummy.CalibrationPorts.TunSelnAuthyHwTqY.Ary1D /end CHARACTERISTIC
/begin CHARACTERISTIC CalRegn01Rt01_Dummy.TunSelnAuthyHwVelY.Ary1D "MICROSAR RTE" VAL_BLK 0x0 RTE_RL_UWORD 0 NO_COMPU_METHOD 0 65535 MATRIX_DIM 6 1 1 SYMBOL_LINK "Rte_CalprmRom_CalRegn01Rt01_DEFAULT_RTE_CALPRM_GROUP.TunSelnAuthyHwVelY_Ary1D" 0 DISPLAY_IDENTIFIER CalRegn01Rt01_Dummy.CalibrationPorts.TunSelnAuthyHwVelY.Ary1D /end CHARACTERISTIC
/begin CHARACTERISTIC CalRegn01Rt01_Dummy_1.TEstimnMagAmbMplr.Val "MICROSAR RTE" VALUE 0x0 RTE_RL_FLOAT32_IEEE 0 NO_COMPU_METHOD -3.402823466e+38 3.402823466e+38 SYMBOL_LINK "Rte_CalprmRom_CalRegn01Rt02_DEFAULT_RTE_CALPRM_GROUP.TEstimnMagAmbMplr_Val" 0 DISPLAY_IDENTIFIER CalRegn01Rt01_Dummy_1.CalibrationPorts.TEstimnMagAmbMplr.Val /end CHARACTERISTIC
/begin CHARACTERISTIC CalRegn01Rt01_Dummy_1.TunSelnAuthyHwTqY.Ary1D "MICROSAR RTE" VAL_BLK 0x0 RTE_RL_UWORD 0 NO_COMPU_METHOD 0 65535 MATRIX_DIM 6 1 1 SYMBOL_LINK "Rte_CalprmRom_CalRegn01Rt02_DEFAULT_RTE_CALPRM_GROUP.TunSelnAuthyHwTqY_Ary1D" 0 DISPLAY_IDENTIFIER CalRegn01Rt01_Dummy_1.CalibrationPorts.TunSelnAuthyHwTqY.Ary1D /end CHARACTERISTIC
/begin CHARACTERISTIC CalRegn01Rt01_Dummy_1.TunSelnAuthyHwVelY.Ary1D "MICROSAR RTE" VAL_BLK 0x0 RTE_RL_UWORD 0 NO_COMPU_METHOD 0 65535 MATRIX_DIM 6 1 1 SYMBOL_LINK "Rte_CalprmRom_CalRegn01Rt02_DEFAULT_RTE_CALPRM_GROUP.TunSelnAuthyHwVelY_Ary1D" 0 DISPLAY_IDENTIFIER CalRegn01Rt01_Dummy_1.CalibrationPorts.TunSelnAuthyHwVelY.Ary1D /end CHARACTERISTIC
/begin CHARACTERISTIC CalRegn01Rt01_Dummy_2.TEstimnMagAmbMplr.Val "MICROSAR RTE" VALUE 0x0 RTE_RL_FLOAT32_IEEE 0 NO_COMPU_METHOD -3.402823466e+38 3.402823466e+38 SYMBOL_LINK "Rte_CalprmRom_CalRegn01Rt03_DEFAULT_RTE_CALPRM_GROUP.TEstimnMagAmbMplr_Val" 0 DISPLAY_IDENTIFIER CalRegn01Rt01_Dummy_2.CalibrationPorts.TEstimnMagAmbMplr.Val /end CHARACTERISTIC
/begin CHARACTERISTIC CalRegn01Rt01_Dummy_2.TunSelnAuthyHwTqY.Ary1D "MICROSAR RTE" VAL_BLK 0x0 RTE_RL_UWORD 0 NO_COMPU_METHOD 0 65535 MATRIX_DIM 6 1 1 SYMBOL_LINK "Rte_CalprmRom_CalRegn01Rt03_DEFAULT_RTE_CALPRM_GROUP.TunSelnAuthyHwTqY_Ary1D" 0 DISPLAY_IDENTIFIER CalRegn01Rt01_Dummy_2.CalibrationPorts.TunSelnAuthyHwTqY.Ary1D /end CHARACTERISTIC
/begin CHARACTERISTIC CalRegn01Rt01_Dummy_2.TunSelnAuthyHwVelY.Ary1D "MICROSAR RTE" VAL_BLK 0x0 RTE_RL_UWORD 0 NO_COMPU_METHOD 0 65535 MATRIX_DIM 6 1 1 SYMBOL_LINK "Rte_CalprmRom_CalRegn01Rt03_DEFAULT_RTE_CALPRM_GROUP.TunSelnAuthyHwVelY_Ary1D" 0 DISPLAY_IDENTIFIER CalRegn01Rt01_Dummy_2.CalibrationPorts.TunSelnAuthyHwVelY.Ary1D /end CHARACTERISTIC
/begin CHARACTERISTIC CalRegn01Rt01_Dummy_3.TEstimnMagAmbMplr.Val "MICROSAR RTE" VALUE 0x0 RTE_RL_FLOAT32_IEEE 0 NO_COMPU_METHOD -3.402823466e+38 3.402823466e+38 SYMBOL_LINK "Rte_CalprmRom_CalRegn01Rt04_DEFAULT_RTE_CALPRM_GROUP.TEstimnMagAmbMplr_Val" 0 DISPLAY_IDENTIFIER CalRegn01Rt01_Dummy_3.CalibrationPorts.TEstimnMagAmbMplr.Val /end CHARACTERISTIC
/begin CHARACTERISTIC CalRegn01Rt01_Dummy_3.TunSelnAuthyHwTqY.Ary1D "MICROSAR RTE" VAL_BLK 0x0 RTE_RL_UWORD 0 NO_COMPU_METHOD 0 65535 MATRIX_DIM 6 1 1 SYMBOL_LINK "Rte_CalprmRom_CalRegn01Rt04_DEFAULT_RTE_CALPRM_GROUP.TunSelnAuthyHwTqY_Ary1D" 0 DISPLAY_IDENTIFIER CalRegn01Rt01_Dummy_3.CalibrationPorts.TunSelnAuthyHwTqY.Ary1D /end CHARACTERISTIC
/begin CHARACTERISTIC CalRegn01Rt01_Dummy_3.TunSelnAuthyHwVelY.Ary1D "MICROSAR RTE" VAL_BLK 0x0 RTE_RL_UWORD 0 NO_COMPU_METHOD 0 65535 MATRIX_DIM 6 1 1 SYMBOL_LINK "Rte_CalprmRom_CalRegn01Rt04_DEFAULT_RTE_CALPRM_GROUP.TunSelnAuthyHwVelY_Ary1D" 0 DISPLAY_IDENTIFIER CalRegn01Rt01_Dummy_3.CalibrationPorts.TunSelnAuthyHwVelY.Ary1D /end CHARACTERISTIC
/begin CHARACTERISTIC CalRegn01Rt01_Dummy_4.TEstimnMagAmbMplr.Val "MICROSAR RTE" VALUE 0x0 RTE_RL_FLOAT32_IEEE 0 NO_COMPU_METHOD -3.402823466e+38 3.402823466e+38 SYMBOL_LINK "Rte_CalprmRom_CalRegn01Rt00_DEFAULT_RTE_CALPRM_GROUP.TEstimnMagAmbMplr_Val" 0 DISPLAY_IDENTIFIER CalRegn01Rt01_Dummy_4.CalibrationPorts.TEstimnMagAmbMplr.Val /end CHARACTERISTIC
/begin CHARACTERISTIC CalRegn01Rt01_Dummy_4.TunSelnAuthyHwTqY.Ary1D "MICROSAR RTE" VAL_BLK 0x0 RTE_RL_UWORD 0 NO_COMPU_METHOD 0 65535 MATRIX_DIM 6 1 1 SYMBOL_LINK "Rte_CalprmRom_CalRegn01Rt00_DEFAULT_RTE_CALPRM_GROUP.TunSelnAuthyHwTqY_Ary1D" 0 DISPLAY_IDENTIFIER CalRegn01Rt01_Dummy_4.CalibrationPorts.TunSelnAuthyHwTqY.Ary1D /end CHARACTERISTIC
/begin CHARACTERISTIC CalRegn01Rt01_Dummy_4.TunSelnAuthyHwVelY.Ary1D "MICROSAR RTE" VAL_BLK 0x0 RTE_RL_UWORD 0 NO_COMPU_METHOD 0 65535 MATRIX_DIM 6 1 1 SYMBOL_LINK "Rte_CalprmRom_CalRegn01Rt00_DEFAULT_RTE_CALPRM_GROUP.TunSelnAuthyHwVelY_Ary1D" 0 DISPLAY_IDENTIFIER CalRegn01Rt01_Dummy_4.CalibrationPorts.TunSelnAuthyHwVelY.Ary1D /end CHARACTERISTIC
/begin CHARACTERISTIC CalRegn01Rt02.TEstimnMagAmbMplr.Val "MICROSAR RTE" VALUE 0x0 RTE_RL_FLOAT32_IEEE 0 NO_COMPU_METHOD -3.402823466e+38 3.402823466e+38 SYMBOL_LINK "Rte_CalprmRom_CalRegn01Rt02_DEFAULT_RTE_CALPRM_GROUP.TEstimnMagAmbMplr_Val" 0 DISPLAY_IDENTIFIER CalRegn01Rt02.CalibrationPorts.TEstimnMagAmbMplr.Val /end CHARACTERISTIC
/begin CHARACTERISTIC CalRegn01Rt02.TunSelnAuthyHwTqY.Ary1D "MICROSAR RTE" VAL_BLK 0x0 RTE_RL_UWORD 0 NO_COMPU_METHOD 0 65535 MATRIX_DIM 6 1 1 SYMBOL_LINK "Rte_CalprmRom_CalRegn01Rt02_DEFAULT_RTE_CALPRM_GROUP.TunSelnAuthyHwTqY_Ary1D" 0 DISPLAY_IDENTIFIER CalRegn01Rt02.CalibrationPorts.TunSelnAuthyHwTqY.Ary1D /end CHARACTERISTIC
/begin CHARACTERISTIC CalRegn01Rt02.TunSelnAuthyHwVelY.Ary1D "MICROSAR RTE" VAL_BLK 0x0 RTE_RL_UWORD 0 NO_COMPU_METHOD 0 65535 MATRIX_DIM 6 1 1 SYMBOL_LINK "Rte_CalprmRom_CalRegn01Rt02_DEFAULT_RTE_CALPRM_GROUP.TunSelnAuthyHwVelY_Ary1D" 0 DISPLAY_IDENTIFIER CalRegn01Rt02.CalibrationPorts.TunSelnAuthyHwVelY.Ary1D /end CHARACTERISTIC
/begin CHARACTERISTIC CalRegn01Rt03.TEstimnMagAmbMplr.Val "MICROSAR RTE" VALUE 0x0 RTE_RL_FLOAT32_IEEE 0 NO_COMPU_METHOD -3.402823466e+38 3.402823466e+38 SYMBOL_LINK "Rte_CalprmRom_CalRegn01Rt03_DEFAULT_RTE_CALPRM_GROUP.TEstimnMagAmbMplr_Val" 0 DISPLAY_IDENTIFIER CalRegn01Rt03.CalibrationPorts.TEstimnMagAmbMplr.Val /end CHARACTERISTIC
/begin CHARACTERISTIC CalRegn01Rt03.TunSelnAuthyHwTqY.Ary1D "MICROSAR RTE" VAL_BLK 0x0 RTE_RL_UWORD 0 NO_COMPU_METHOD 0 65535 MATRIX_DIM 6 1 1 SYMBOL_LINK "Rte_CalprmRom_CalRegn01Rt03_DEFAULT_RTE_CALPRM_GROUP.TunSelnAuthyHwTqY_Ary1D" 0 DISPLAY_IDENTIFIER CalRegn01Rt03.CalibrationPorts.TunSelnAuthyHwTqY.Ary1D /end CHARACTERISTIC
/begin CHARACTERISTIC CalRegn01Rt03.TunSelnAuthyHwVelY.Ary1D "MICROSAR RTE" VAL_BLK 0x0 RTE_RL_UWORD 0 NO_COMPU_METHOD 0 65535 MATRIX_DIM 6 1 1 SYMBOL_LINK "Rte_CalprmRom_CalRegn01Rt03_DEFAULT_RTE_CALPRM_GROUP.TunSelnAuthyHwVelY_Ary1D" 0 DISPLAY_IDENTIFIER CalRegn01Rt03.CalibrationPorts.TunSelnAuthyHwVelY.Ary1D /end CHARACTERISTIC
/begin CHARACTERISTIC CalRegn01Rt04.TEstimnMagAmbMplr.Val "MICROSAR RTE" VALUE 0x0 RTE_RL_FLOAT32_IEEE 0 NO_COMPU_METHOD -3.402823466e+38 3.402823466e+38 SYMBOL_LINK "Rte_CalprmRom_CalRegn01Rt04_DEFAULT_RTE_CALPRM_GROUP.TEstimnMagAmbMplr_Val" 0 DISPLAY_IDENTIFIER CalRegn01Rt04.CalibrationPorts.TEstimnMagAmbMplr.Val /end CHARACTERISTIC
/begin CHARACTERISTIC CalRegn01Rt04.TunSelnAuthyHwTqY.Ary1D "MICROSAR RTE" VAL_BLK 0x0 RTE_RL_UWORD 0 NO_COMPU_METHOD 0 65535 MATRIX_DIM 6 1 1 SYMBOL_LINK "Rte_CalprmRom_CalRegn01Rt04_DEFAULT_RTE_CALPRM_GROUP.TunSelnAuthyHwTqY_Ary1D" 0 DISPLAY_IDENTIFIER CalRegn01Rt04.CalibrationPorts.TunSelnAuthyHwTqY.Ary1D /end CHARACTERISTIC
/begin CHARACTERISTIC CalRegn01Rt04.TunSelnAuthyHwVelY.Ary1D "MICROSAR RTE" VAL_BLK 0x0 RTE_RL_UWORD 0 NO_COMPU_METHOD 0 65535 MATRIX_DIM 6 1 1 SYMBOL_LINK "Rte_CalprmRom_CalRegn01Rt04_DEFAULT_RTE_CALPRM_GROUP.TunSelnAuthyHwVelY_Ary1D" 0 DISPLAY_IDENTIFIER CalRegn01Rt04.CalibrationPorts.TunSelnAuthyHwVelY.Ary1D /end CHARACTERISTIC
/begin CHARACTERISTIC CalRegn02Cmn.DiagcMgrFltResp.Ary1D "MICROSAR RTE" VAL_BLK 0x0 RTE_RL_ULONG 0 NO_COMPU_METHOD 0 4294967295 MATRIX_DIM 512 1 1 SYMBOL_LINK "Rte_CalprmRom_CalRegn02Cmn_DEFAULT_RTE_CALPRM_GROUP.DiagcMgrFltResp_Ary1D" 0 DISPLAY_IDENTIFIER CalRegn02Cmn.CalibrationPorts.DiagcMgrFltResp.Ary1D /end CHARACTERISTIC
/begin CHARACTERISTIC CalRegn02Cmn.InertiaCmpVelDecelGainEnaCal.Logl "MICROSAR RTE" VALUE 0x0 RTE_RL_BOOLEAN 0 RTE_CM_BOOLEAN 0 255 SYMBOL_LINK "Rte_CalprmRom_CalRegn02Cmn_DEFAULT_RTE_CALPRM_GROUP.InertiaCmpVelDecelGainEnaCal_Logl" 0 DISPLAY_IDENTIFIER CalRegn02Cmn.CalibrationPorts.InertiaCmpVelDecelGainEnaCal.Logl /end CHARACTERISTIC
/begin CHARACTERISTIC CalRegn02Cmn.NxtrCalIdsCal1DevlpAuthor.Ary1D "MICROSAR RTE" VAL_BLK 0x0 RTE_RL_UBYTE 0 NO_COMPU_METHOD 0 255 MATRIX_DIM 6 1 1 SYMBOL_LINK "Rte_CalprmRom_CalRegn02Cmn_DEFAULT_RTE_CALPRM_GROUP.NxtrCalIdsCal1DevlpAuthor_Ary1D" 0 DISPLAY_IDENTIFIER CalRegn02Cmn.CalibrationPorts.NxtrCalIdsCal1DevlpAuthor.Ary1D /end CHARACTERISTIC
/begin CHARACTERISTIC CalRegn02Cmn.NxtrCalIdsCal1DevlpDesc.Ary1D "MICROSAR RTE" VAL_BLK 0x0 RTE_RL_UBYTE 0 NO_COMPU_METHOD 0 255 MATRIX_DIM 48 1 1 SYMBOL_LINK "Rte_CalprmRom_CalRegn02Cmn_DEFAULT_RTE_CALPRM_GROUP.NxtrCalIdsCal1DevlpDesc_Ary1D" 0 DISPLAY_IDENTIFIER CalRegn02Cmn.CalibrationPorts.NxtrCalIdsCal1DevlpDesc.Ary1D /end CHARACTERISTIC
/begin CHARACTERISTIC CalRegn02Cmn.NxtrCalIdsCal1DevlpRelNr.Val "MICROSAR RTE" VALUE 0x0 RTE_RL_ULONG 0 NO_COMPU_METHOD 0 4294967295 SYMBOL_LINK "Rte_CalprmRom_CalRegn02Cmn_DEFAULT_RTE_CALPRM_GROUP.NxtrCalIdsCal1DevlpRelNr_Val" 0 DISPLAY_IDENTIFIER CalRegn02Cmn.CalibrationPorts.NxtrCalIdsCal1DevlpRelNr.Val /end CHARACTERISTIC
/begin CHARACTERISTIC CalRegn02Cmn.NxtrCalIdsCal1DevlpRelSt.Val "MICROSAR RTE" VALUE 0x0 RTE_RL_UBYTE 0 NO_COMPU_METHOD 0 255 SYMBOL_LINK "Rte_CalprmRom_CalRegn02Cmn_DEFAULT_RTE_CALPRM_GROUP.NxtrCalIdsCal1DevlpRelSt_Val" 0 DISPLAY_IDENTIFIER CalRegn02Cmn.CalibrationPorts.NxtrCalIdsCal1DevlpRelSt.Val /end CHARACTERISTIC
/begin CHARACTERISTIC CalRegn02Cmn.NxtrCalIdsCal1DevlpTiStamp.Val "MICROSAR RTE" VALUE 0x0 RTE_RL_ULONG 0 NO_COMPU_METHOD 0 4294967295 SYMBOL_LINK "Rte_CalprmRom_CalRegn02Cmn_DEFAULT_RTE_CALPRM_GROUP.NxtrCalIdsCal1DevlpTiStamp_Val" 0 DISPLAY_IDENTIFIER CalRegn02Cmn.CalibrationPorts.NxtrCalIdsCal1DevlpTiStamp.Val /end CHARACTERISTIC
/begin CHARACTERISTIC CalRegn02Cmn.NxtrCalIdsCal1DevlpVers.Val "MICROSAR RTE" VALUE 0x0 RTE_RL_UBYTE 0 NO_COMPU_METHOD 0 255 SYMBOL_LINK "Rte_CalprmRom_CalRegn02Cmn_DEFAULT_RTE_CALPRM_GROUP.NxtrCalIdsCal1DevlpVers_Val" 0 DISPLAY_IDENTIFIER CalRegn02Cmn.CalibrationPorts.NxtrCalIdsCal1DevlpVers.Val /end CHARACTERISTIC
/begin CHARACTERISTIC CalRegn02Cmn.SnsrOffsCorrnHwAgLrndOffsLim.Val "MICROSAR RTE" VALUE 0x0 RTE_RL_FLOAT32_IEEE 0 NO_COMPU_METHOD -3.402823466e+38 3.402823466e+38 SYMBOL_LINK "Rte_CalprmRom_CalRegn02Cmn_DEFAULT_RTE_CALPRM_GROUP.SnsrOffsCorrnHwAgLrndOffsLim_Val" 0 DISPLAY_IDENTIFIER CalRegn02Cmn.CalibrationPorts.SnsrOffsCorrnHwAgLrndOffsLim.Val /end CHARACTERISTIC
/begin CHARACTERISTIC CalRegn02Cmn.SnsrOffsCorrnHwTqLrndOffsLim.Val "MICROSAR RTE" VALUE 0x0 RTE_RL_FLOAT32_IEEE 0 NO_COMPU_METHOD -3.402823466e+38 3.402823466e+38 SYMBOL_LINK "Rte_CalprmRom_CalRegn02Cmn_DEFAULT_RTE_CALPRM_GROUP.SnsrOffsCorrnHwTqLrndOffsLim_Val" 0 DISPLAY_IDENTIFIER CalRegn02Cmn.CalibrationPorts.SnsrOffsCorrnHwTqLrndOffsLim.Val /end CHARACTERISTIC
/begin CHARACTERISTIC CalRegn02Cmn.SnsrOffsCorrnOffsEna.Logl "MICROSAR RTE" VALUE 0x0 RTE_RL_BOOLEAN 0 RTE_CM_BOOLEAN 0 255 SYMBOL_LINK "Rte_CalprmRom_CalRegn02Cmn_DEFAULT_RTE_CALPRM_GROUP.SnsrOffsCorrnOffsEna_Logl" 0 DISPLAY_IDENTIFIER CalRegn02Cmn.CalibrationPorts.SnsrOffsCorrnOffsEna.Logl /end CHARACTERISTIC
/begin CHARACTERISTIC CalRegn02Cmn.SnsrOffsCorrnVehYawRateLrndOffsLim.Val "MICROSAR RTE" VALUE 0x0 RTE_RL_FLOAT32_IEEE 0 NO_COMPU_METHOD -3.402823466e+38 3.402823466e+38 SYMBOL_LINK "Rte_CalprmRom_CalRegn02Cmn_DEFAULT_RTE_CALPRM_GROUP.SnsrOffsCorrnVehYawRateLrndOffsLim_Val" 0 DISPLAY_IDENTIFIER CalRegn02Cmn.CalibrationPorts.SnsrOffsCorrnVehYawRateLrndOffsLim.Val /end CHARACTERISTIC
/begin CHARACTERISTIC CalRegn02Cmn.SnsrOffsLrngHwAgLrngTi.Val "MICROSAR RTE" VALUE 0x0 RTE_RL_FLOAT32_IEEE 0 NO_COMPU_METHOD -3.402823466e+38 3.402823466e+38 SYMBOL_LINK "Rte_CalprmRom_CalRegn02Cmn_DEFAULT_RTE_CALPRM_GROUP.SnsrOffsLrngHwAgLrngTi_Val" 0 DISPLAY_IDENTIFIER CalRegn02Cmn.CalibrationPorts.SnsrOffsLrngHwAgLrngTi.Val /end CHARACTERISTIC
/begin CHARACTERISTIC CalRegn02Cmn.SnsrOffsLrngHwTqLrngHwTqZeroOffsThd.Val "MICROSAR RTE" VALUE 0x0 RTE_RL_FLOAT32_IEEE 0 NO_COMPU_METHOD -3.402823466e+38 3.402823466e+38 SYMBOL_LINK "Rte_CalprmRom_CalRegn02Cmn_DEFAULT_RTE_CALPRM_GROUP.SnsrOffsLrngHwTqLrngHwTqZeroOffsThd_Val" 0 DISPLAY_IDENTIFIER CalRegn02Cmn.CalibrationPorts.SnsrOffsLrngHwTqLrngHwTqZeroOffsThd.Val /end CHARACTERISTIC
/begin CHARACTERISTIC CalRegn02Cmn.SnsrOffsLrngHwTqLrngMeasTi.Val "MICROSAR RTE" VALUE 0x0 RTE_RL_FLOAT32_IEEE 0 NO_COMPU_METHOD -3.402823466e+38 3.402823466e+38 SYMBOL_LINK "Rte_CalprmRom_CalRegn02Cmn_DEFAULT_RTE_CALPRM_GROUP.SnsrOffsLrngHwTqLrngMeasTi_Val" 0 DISPLAY_IDENTIFIER CalRegn02Cmn.CalibrationPorts.SnsrOffsLrngHwTqLrngMeasTi.Val /end CHARACTERISTIC
/begin CHARACTERISTIC CalRegn02Cmn.SnsrOffsLrngHwTqLrngSampleImbThd1.Val "MICROSAR RTE" VALUE 0x0 RTE_RL_FLOAT32_IEEE 0 NO_COMPU_METHOD -3.402823466e+38 3.402823466e+38 SYMBOL_LINK "Rte_CalprmRom_CalRegn02Cmn_DEFAULT_RTE_CALPRM_GROUP.SnsrOffsLrngHwTqLrngSampleImbThd1_Val" 0 DISPLAY_IDENTIFIER CalRegn02Cmn.CalibrationPorts.SnsrOffsLrngHwTqLrngSampleImbThd1.Val /end CHARACTERISTIC
/begin CHARACTERISTIC CalRegn02Cmn.SnsrOffsLrngHwTqLrngSampleImbThd2.Val "MICROSAR RTE" VALUE 0x0 RTE_RL_FLOAT32_IEEE 0 NO_COMPU_METHOD -3.402823466e+38 3.402823466e+38 SYMBOL_LINK "Rte_CalprmRom_CalRegn02Cmn_DEFAULT_RTE_CALPRM_GROUP.SnsrOffsLrngHwTqLrngSampleImbThd2_Val" 0 DISPLAY_IDENTIFIER CalRegn02Cmn.CalibrationPorts.SnsrOffsLrngHwTqLrngSampleImbThd2.Val /end CHARACTERISTIC
/begin CHARACTERISTIC CalRegn02Cmn.SnsrOffsLrngHwTqLrngSampleThd1.Val "MICROSAR RTE" VALUE 0x0 RTE_RL_UWORD 0 NO_COMPU_METHOD 0 65535 SYMBOL_LINK "Rte_CalprmRom_CalRegn02Cmn_DEFAULT_RTE_CALPRM_GROUP.SnsrOffsLrngHwTqLrngSampleThd1_Val" 0 DISPLAY_IDENTIFIER CalRegn02Cmn.CalibrationPorts.SnsrOffsLrngHwTqLrngSampleThd1.Val /end CHARACTERISTIC
/begin CHARACTERISTIC CalRegn02Cmn.SnsrOffsLrngHwTqLrngSampleThd2.Val "MICROSAR RTE" VALUE 0x0 RTE_RL_UWORD 0 NO_COMPU_METHOD 0 65535 SYMBOL_LINK "Rte_CalprmRom_CalRegn02Cmn_DEFAULT_RTE_CALPRM_GROUP.SnsrOffsLrngHwTqLrngSampleThd2_Val" 0 DISPLAY_IDENTIFIER CalRegn02Cmn.CalibrationPorts.SnsrOffsLrngHwTqLrngSampleThd2.Val /end CHARACTERISTIC
/begin CHARACTERISTIC CalRegn02Cmn.SnsrOffsLrngHwTqLrngTiWghtCoeff.Val "MICROSAR RTE" VALUE 0x0 RTE_RL_FLOAT32_IEEE 0 NO_COMPU_METHOD -3.402823466e+38 3.402823466e+38 SYMBOL_LINK "Rte_CalprmRom_CalRegn02Cmn_DEFAULT_RTE_CALPRM_GROUP.SnsrOffsLrngHwTqLrngTiWghtCoeff_Val" 0 DISPLAY_IDENTIFIER CalRegn02Cmn.CalibrationPorts.SnsrOffsLrngHwTqLrngTiWghtCoeff.Val /end CHARACTERISTIC
/begin CHARACTERISTIC CalRegn02Cmn.SnsrOffsLrngYawLrngTi.Val "MICROSAR RTE" VALUE 0x0 RTE_RL_FLOAT32_IEEE 0 NO_COMPU_METHOD -3.402823466e+38 3.402823466e+38 SYMBOL_LINK "Rte_CalprmRom_CalRegn02Cmn_DEFAULT_RTE_CALPRM_GROUP.SnsrOffsLrngYawLrngTi_Val" 0 DISPLAY_IDENTIFIER CalRegn02Cmn.CalibrationPorts.SnsrOffsLrngYawLrngTi.Val /end CHARACTERISTIC
/begin CHARACTERISTIC CalRegn02CmnGroupA.GmOvrlStMgrApaMfgEna.Logl "MICROSAR RTE" VALUE 0x0 RTE_RL_BOOLEAN 0 RTE_CM_BOOLEAN 0 255 SYMBOL_LINK "Rte_CalprmRom_CalRegn02CmnGroupA_DEFAULT_RTE_CALPRM_GROUP.GmOvrlStMgrApaMfgEna_Logl" 0 DISPLAY_IDENTIFIER CalRegn02CmnGroupA.CalibrationPorts.GmOvrlStMgrApaMfgEna.Logl /end CHARACTERISTIC
/begin CHARACTERISTIC CalRegn02CmnGroupA.GmOvrlStMgrEscMfgEna.Logl "MICROSAR RTE" VALUE 0x0 RTE_RL_BOOLEAN 0 RTE_CM_BOOLEAN 0 255 SYMBOL_LINK "Rte_CalprmRom_CalRegn02CmnGroupA_DEFAULT_RTE_CALPRM_GROUP.GmOvrlStMgrEscMfgEna_Logl" 0 DISPLAY_IDENTIFIER CalRegn02CmnGroupA.CalibrationPorts.GmOvrlStMgrEscMfgEna.Logl /end CHARACTERISTIC
/begin CHARACTERISTIC CalRegn02CmnGroupA.GmOvrlStMgrLkaHwTqThd1.Val "MICROSAR RTE" VALUE 0x0 RTE_RL_FLOAT32_IEEE 0 NO_COMPU_METHOD -3.402823466e+38 3.402823466e+38 SYMBOL_LINK "Rte_CalprmRom_CalRegn02CmnGroupA_DEFAULT_RTE_CALPRM_GROUP.GmOvrlStMgrLkaHwTqThd1_Val" 0 DISPLAY_IDENTIFIER CalRegn02CmnGroupA.CalibrationPorts.GmOvrlStMgrLkaHwTqThd1.Val /end CHARACTERISTIC
/begin CHARACTERISTIC CalRegn02CmnGroupA.GmOvrlStMgrLkaHwTqThd2.Val "MICROSAR RTE" VALUE 0x0 RTE_RL_FLOAT32_IEEE 0 NO_COMPU_METHOD -3.402823466e+38 3.402823466e+38 SYMBOL_LINK "Rte_CalprmRom_CalRegn02CmnGroupA_DEFAULT_RTE_CALPRM_GROUP.GmOvrlStMgrLkaHwTqThd2_Val" 0 DISPLAY_IDENTIFIER CalRegn02CmnGroupA.CalibrationPorts.GmOvrlStMgrLkaHwTqThd2.Val /end CHARACTERISTIC
/begin CHARACTERISTIC CalRegn02CmnGroupA.GmOvrlStMgrLkaMfgEna.Logl "MICROSAR RTE" VALUE 0x0 RTE_RL_BOOLEAN 0 RTE_CM_BOOLEAN 0 255 SYMBOL_LINK "Rte_CalprmRom_CalRegn02CmnGroupA_DEFAULT_RTE_CALPRM_GROUP.GmOvrlStMgrLkaMfgEna_Logl" 0 DISPLAY_IDENTIFIER CalRegn02CmnGroupA.CalibrationPorts.GmOvrlStMgrLkaMfgEna.Logl /end CHARACTERISTIC
/begin CHARACTERISTIC CalRegn02CmnGroupA.PullCmpActvEna.Logl "MICROSAR RTE" VALUE 0x0 RTE_RL_BOOLEAN 0 RTE_CM_BOOLEAN 0 255 SYMBOL_LINK "Rte_CalprmRom_CalRegn02CmnGroupA_DEFAULT_RTE_CALPRM_GROUP.PullCmpActvEna_Logl" 0 DISPLAY_IDENTIFIER CalRegn02CmnGroupA.CalibrationPorts.PullCmpActvEna.Logl /end CHARACTERISTIC
/begin CHARACTERISTIC CalRegn02CmnGroupB.WhlImbRejctnFctEna.Logl "MICROSAR RTE" VALUE 0x0 RTE_RL_BOOLEAN 0 RTE_CM_BOOLEAN 0 255 SYMBOL_LINK "Rte_CalprmRom_CalRegn02CmnGroupB_DEFAULT_RTE_CALPRM_GROUP.WhlImbRejctnFctEna_Logl" 0 DISPLAY_IDENTIFIER CalRegn02CmnGroupB.CalibrationPorts.WhlImbRejctnFctEna.Logl /end CHARACTERISTIC
/begin CHARACTERISTIC CalRegn02CmnGroupC.GmOvrlStMgrApaHaptcEna.Logl "MICROSAR RTE" VALUE 0x0 RTE_RL_BOOLEAN 0 RTE_CM_BOOLEAN 0 255 SYMBOL_LINK "Rte_CalprmRom_CalRegn02CmnGroupC_DEFAULT_RTE_CALPRM_GROUP.GmOvrlStMgrApaHaptcEna_Logl" 0 DISPLAY_IDENTIFIER CalRegn02CmnGroupC.CalibrationPorts.GmOvrlStMgrApaHaptcEna.Logl /end CHARACTERISTIC
/begin CHARACTERISTIC CalRegn02CmnGroupC.GmOvrlStMgrApaHwTqThd.Val "MICROSAR RTE" VALUE 0x0 RTE_RL_FLOAT32_IEEE 0 NO_COMPU_METHOD -3.402823466e+38 3.402823466e+38 SYMBOL_LINK "Rte_CalprmRom_CalRegn02CmnGroupC_DEFAULT_RTE_CALPRM_GROUP.GmOvrlStMgrApaHwTqThd_Val" 0 DISPLAY_IDENTIFIER CalRegn02CmnGroupC.CalibrationPorts.GmOvrlStMgrApaHwTqThd.Val /end CHARACTERISTIC
/begin CHARACTERISTIC CalRegn02CmnGroupC.GmOvrlStMgrApaVehSpdHiLim.Val "MICROSAR RTE" VALUE 0x0 RTE_RL_FLOAT32_IEEE 0 NO_COMPU_METHOD -3.402823466e+38 3.402823466e+38 SYMBOL_LINK "Rte_CalprmRom_CalRegn02CmnGroupC_DEFAULT_RTE_CALPRM_GROUP.GmOvrlStMgrApaVehSpdHiLim_Val" 0 DISPLAY_IDENTIFIER CalRegn02CmnGroupC.CalibrationPorts.GmOvrlStMgrApaVehSpdHiLim.Val /end CHARACTERISTIC
/begin CHARACTERISTIC CalRegn02CmnGroupC.GmOvrlStMgrEscVehSpdHiLim.Val "MICROSAR RTE" VALUE 0x0 RTE_RL_FLOAT32_IEEE 0 NO_COMPU_METHOD -3.402823466e+38 3.402823466e+38 SYMBOL_LINK "Rte_CalprmRom_CalRegn02CmnGroupC_DEFAULT_RTE_CALPRM_GROUP.GmOvrlStMgrEscVehSpdHiLim_Val" 0 DISPLAY_IDENTIFIER CalRegn02CmnGroupC.CalibrationPorts.GmOvrlStMgrEscVehSpdHiLim.Val /end CHARACTERISTIC
/begin CHARACTERISTIC CalRegn02CmnGroupC.GmOvrlStMgrHaptcAmp.Val "MICROSAR RTE" VALUE 0x0 RTE_RL_FLOAT32_IEEE 0 NO_COMPU_METHOD -3.402823466e+38 3.402823466e+38 SYMBOL_LINK "Rte_CalprmRom_CalRegn02CmnGroupC_DEFAULT_RTE_CALPRM_GROUP.GmOvrlStMgrHaptcAmp_Val" 0 DISPLAY_IDENTIFIER CalRegn02CmnGroupC.CalibrationPorts.GmOvrlStMgrHaptcAmp.Val /end CHARACTERISTIC
/begin CHARACTERISTIC CalRegn02CmnGroupC.GmOvrlStMgrHaptcDurn.Val "MICROSAR RTE" VALUE 0x0 RTE_RL_ULONG 0 NO_COMPU_METHOD 0 4294967295 SYMBOL_LINK "Rte_CalprmRom_CalRegn02CmnGroupC_DEFAULT_RTE_CALPRM_GROUP.GmOvrlStMgrHaptcDurn_Val" 0 DISPLAY_IDENTIFIER CalRegn02CmnGroupC.CalibrationPorts.GmOvrlStMgrHaptcDurn.Val /end CHARACTERISTIC
/begin CHARACTERISTIC CalRegn02CmnGroupC.GmOvrlStMgrLkaVehSpdHiLim.Val "MICROSAR RTE" VALUE 0x0 RTE_RL_FLOAT32_IEEE 0 NO_COMPU_METHOD -3.402823466e+38 3.402823466e+38 SYMBOL_LINK "Rte_CalprmRom_CalRegn02CmnGroupC_DEFAULT_RTE_CALPRM_GROUP.GmOvrlStMgrLkaVehSpdHiLim_Val" 0 DISPLAY_IDENTIFIER CalRegn02CmnGroupC.CalibrationPorts.GmOvrlStMgrLkaVehSpdHiLim.Val /end CHARACTERISTIC
/begin CHARACTERISTIC CalRegn02CmnGroupC.GmOvrlStMgrLkaVehSpdLoLim.Val "MICROSAR RTE" VALUE 0x0 RTE_RL_FLOAT32_IEEE 0 NO_COMPU_METHOD -3.402823466e+38 3.402823466e+38 SYMBOL_LINK "Rte_CalprmRom_CalRegn02CmnGroupC_DEFAULT_RTE_CALPRM_GROUP.GmOvrlStMgrLkaVehSpdLoLim_Val" 0 DISPLAY_IDENTIFIER CalRegn02CmnGroupC.CalibrationPorts.GmOvrlStMgrLkaVehSpdLoLim.Val /end CHARACTERISTIC
/begin CHARACTERISTIC CalRegn02CmnGroupC.HowDetnHiFrqGainY.Ary1D "MICROSAR RTE" VAL_BLK 0x0 RTE_RL_UWORD 0 NO_COMPU_METHOD 0 65535 MATRIX_DIM 9 1 1 SYMBOL_LINK "Rte_CalprmRom_CalRegn02CmnGroupC_DEFAULT_RTE_CALPRM_GROUP.HowDetnHiFrqGainY_Ary1D" 0 DISPLAY_IDENTIFIER CalRegn02CmnGroupC.CalibrationPorts.HowDetnHiFrqGainY.Ary1D /end CHARACTERISTIC
/begin CHARACTERISTIC CalRegn02CmnGroupC.HowDetnHiFrqRateX.Ary2D "MICROSAR RTE" VAL_BLK 0x0 RTE_RL_UWORD 0 NO_COMPU_METHOD 0 65535 MATRIX_DIM 6 3 1 SYMBOL_LINK "Rte_CalprmRom_CalRegn02CmnGroupC_DEFAULT_RTE_CALPRM_GROUP.HowDetnHiFrqRateX_Ary2D" 0 DISPLAY_IDENTIFIER CalRegn02CmnGroupC.CalibrationPorts.HowDetnHiFrqRateX.Ary2D /end CHARACTERISTIC
/begin CHARACTERISTIC CalRegn02CmnGroupC.HowDetnHiFrqRateY.Ary2D "MICROSAR RTE" VAL_BLK 0x0 RTE_RL_SWORD 0 NO_COMPU_METHOD -32768 32767 MATRIX_DIM 6 3 1 SYMBOL_LINK "Rte_CalprmRom_CalRegn02CmnGroupC_DEFAULT_RTE_CALPRM_GROUP.HowDetnHiFrqRateY_Ary2D" 0 DISPLAY_IDENTIFIER CalRegn02CmnGroupC.CalibrationPorts.HowDetnHiFrqRateY.Ary2D /end CHARACTERISTIC
/begin CHARACTERISTIC CalRegn02CmnGroupC.HowDetnLoFrqRateX.Ary2D "MICROSAR RTE" VAL_BLK 0x0 RTE_RL_UWORD 0 NO_COMPU_METHOD 0 65535 MATRIX_DIM 5 3 1 SYMBOL_LINK "Rte_CalprmRom_CalRegn02CmnGroupC_DEFAULT_RTE_CALPRM_GROUP.HowDetnLoFrqRateX_Ary2D" 0 DISPLAY_IDENTIFIER CalRegn02CmnGroupC.CalibrationPorts.HowDetnLoFrqRateX.Ary2D /end CHARACTERISTIC
/begin CHARACTERISTIC CalRegn02CmnGroupC.HowDetnLoFrqRateY.Ary2D "MICROSAR RTE" VAL_BLK 0x0 RTE_RL_SWORD 0 NO_COMPU_METHOD -32768 32767 MATRIX_DIM 5 3 1 SYMBOL_LINK "Rte_CalprmRom_CalRegn02CmnGroupC_DEFAULT_RTE_CALPRM_GROUP.HowDetnLoFrqRateY_Ary2D" 0 DISPLAY_IDENTIFIER CalRegn02CmnGroupC.CalibrationPorts.HowDetnLoFrqRateY.Ary2D /end CHARACTERISTIC
/begin CHARACTERISTIC CalRegn02CmnGroupC.HowDetnMinVehSpd.Val "MICROSAR RTE" VALUE 0x0 RTE_RL_FLOAT32_IEEE 0 NO_COMPU_METHOD -3.402823466e+38 3.402823466e+38 SYMBOL_LINK "Rte_CalprmRom_CalRegn02CmnGroupC_DEFAULT_RTE_CALPRM_GROUP.HowDetnMinVehSpd_Val" 0 DISPLAY_IDENTIFIER CalRegn02CmnGroupC.CalibrationPorts.HowDetnMinVehSpd.Val /end CHARACTERISTIC
/begin CHARACTERISTIC CalRegn02CmnGroupC.HowDetnPercOfPrevHowEstim.Val "MICROSAR RTE" VALUE 0x0 RTE_RL_FLOAT32_IEEE 0 NO_COMPU_METHOD -3.402823466e+38 3.402823466e+38 SYMBOL_LINK "Rte_CalprmRom_CalRegn02CmnGroupC_DEFAULT_RTE_CALPRM_GROUP.HowDetnPercOfPrevHowEstim_Val" 0 DISPLAY_IDENTIFIER CalRegn02CmnGroupC.CalibrationPorts.HowDetnPercOfPrevHowEstim.Val /end CHARACTERISTIC
/begin CHARACTERISTIC CalRegn02CmnGroupC.HowDetnSlewRate.Val "MICROSAR RTE" VALUE 0x0 RTE_RL_FLOAT32_IEEE 0 NO_COMPU_METHOD -3.402823466e+38 3.402823466e+38 SYMBOL_LINK "Rte_CalprmRom_CalRegn02CmnGroupC_DEFAULT_RTE_CALPRM_GROUP.HowDetnSlewRate_Val" 0 DISPLAY_IDENTIFIER CalRegn02CmnGroupC.CalibrationPorts.HowDetnSlewRate.Val /end CHARACTERISTIC
/begin CHARACTERISTIC CalRegn02CmnGroupC.HowDetnStThdX.Ary1D "MICROSAR RTE" VAL_BLK 0x0 RTE_RL_UWORD 0 NO_COMPU_METHOD 0 65535 MATRIX_DIM 7 1 1 SYMBOL_LINK "Rte_CalprmRom_CalRegn02CmnGroupC_DEFAULT_RTE_CALPRM_GROUP.HowDetnStThdX_Ary1D" 0 DISPLAY_IDENTIFIER CalRegn02CmnGroupC.CalibrationPorts.HowDetnStThdX.Ary1D /end CHARACTERISTIC
/begin CHARACTERISTIC CalRegn02CmnGroupC.HowDetnTqHpFilFrq.Val "MICROSAR RTE" VALUE 0x0 RTE_RL_FLOAT32_IEEE 0 NO_COMPU_METHOD -3.402823466e+38 3.402823466e+38 SYMBOL_LINK "Rte_CalprmRom_CalRegn02CmnGroupC_DEFAULT_RTE_CALPRM_GROUP.HowDetnTqHpFilFrq_Val" 0 DISPLAY_IDENTIFIER CalRegn02CmnGroupC.CalibrationPorts.HowDetnTqHpFilFrq.Val /end CHARACTERISTIC
/begin CHARACTERISTIC CalRegn02CmnGroupC.HowDetnVehSpd.Ary1D "MICROSAR RTE" VAL_BLK 0x0 RTE_RL_UWORD 0 NO_COMPU_METHOD 0 65535 MATRIX_DIM 9 1 1 SYMBOL_LINK "Rte_CalprmRom_CalRegn02CmnGroupC_DEFAULT_RTE_CALPRM_GROUP.HowDetnVehSpd_Ary1D" 0 DISPLAY_IDENTIFIER CalRegn02CmnGroupC.CalibrationPorts.HowDetnVehSpd.Ary1D /end CHARACTERISTIC
/begin CHARACTERISTIC CalRegn02CmnGroupC.SnsrOffsLrngFctEna.Logl "MICROSAR RTE" VALUE 0x0 RTE_RL_BOOLEAN 0 RTE_CM_BOOLEAN 0 255 SYMBOL_LINK "Rte_CalprmRom_CalRegn02CmnGroupC_DEFAULT_RTE_CALPRM_GROUP.SnsrOffsLrngFctEna_Logl" 0 DISPLAY_IDENTIFIER CalRegn02CmnGroupC.CalibrationPorts.SnsrOffsLrngFctEna.Logl /end CHARACTERISTIC
/begin CHARACTERISTIC CalRegn02CmnGroupC.SnsrOffsLrngHwAgLrngDrvgDstThd.Val "MICROSAR RTE" VALUE 0x0 RTE_RL_FLOAT32_IEEE 0 NO_COMPU_METHOD -3.402823466e+38 3.402823466e+38 SYMBOL_LINK "Rte_CalprmRom_CalRegn02CmnGroupC_DEFAULT_RTE_CALPRM_GROUP.SnsrOffsLrngHwAgLrngDrvgDstThd_Val" 0 DISPLAY_IDENTIFIER CalRegn02CmnGroupC.CalibrationPorts.SnsrOffsLrngHwAgLrngDrvgDstThd.Val /end CHARACTERISTIC
/begin CHARACTERISTIC CalRegn02CmnGroupC.SnsrOffsLrngHwAgLrngEna.Logl "MICROSAR RTE" VALUE 0x0 RTE_RL_BOOLEAN 0 RTE_CM_BOOLEAN 0 255 SYMBOL_LINK "Rte_CalprmRom_CalRegn02CmnGroupC_DEFAULT_RTE_CALPRM_GROUP.SnsrOffsLrngHwAgLrngEna_Logl" 0 DISPLAY_IDENTIFIER CalRegn02CmnGroupC.CalibrationPorts.SnsrOffsLrngHwAgLrngEna.Logl /end CHARACTERISTIC
/begin CHARACTERISTIC CalRegn02CmnGroupC.SnsrOffsLrngHwAgLrngHwVelThd.Val "MICROSAR RTE" VALUE 0x0 RTE_RL_FLOAT32_IEEE 0 NO_COMPU_METHOD -3.402823466e+38 3.402823466e+38 SYMBOL_LINK "Rte_CalprmRom_CalRegn02CmnGroupC_DEFAULT_RTE_CALPRM_GROUP.SnsrOffsLrngHwAgLrngHwVelThd_Val" 0 DISPLAY_IDENTIFIER CalRegn02CmnGroupC.CalibrationPorts.SnsrOffsLrngHwAgLrngHwVelThd.Val /end CHARACTERISTIC
/begin CHARACTERISTIC CalRegn02CmnGroupC.SnsrOffsLrngHwAgLrngSysTqThd.Val "MICROSAR RTE" VALUE 0x0 RTE_RL_FLOAT32_IEEE 0 NO_COMPU_METHOD -3.402823466e+38 3.402823466e+38 SYMBOL_LINK "Rte_CalprmRom_CalRegn02CmnGroupC_DEFAULT_RTE_CALPRM_GROUP.SnsrOffsLrngHwAgLrngSysTqThd_Val" 0 DISPLAY_IDENTIFIER CalRegn02CmnGroupC.CalibrationPorts.SnsrOffsLrngHwAgLrngSysTqThd.Val /end CHARACTERISTIC
/begin CHARACTERISTIC CalRegn02CmnGroupC.SnsrOffsLrngHwAgLrngSysTqThdMed.Val "MICROSAR RTE" VALUE 0x0 RTE_RL_FLOAT32_IEEE 0 NO_COMPU_METHOD -3.402823466e+38 3.402823466e+38 SYMBOL_LINK "Rte_CalprmRom_CalRegn02CmnGroupC_DEFAULT_RTE_CALPRM_GROUP.SnsrOffsLrngHwAgLrngSysTqThdMed_Val" 0 DISPLAY_IDENTIFIER CalRegn02CmnGroupC.CalibrationPorts.SnsrOffsLrngHwAgLrngSysTqThdMed.Val /end CHARACTERISTIC
/begin CHARACTERISTIC CalRegn02CmnGroupC.SnsrOffsLrngHwAgLrngSysTqThdTrustd.Val "MICROSAR RTE" VALUE 0x0 RTE_RL_FLOAT32_IEEE 0 NO_COMPU_METHOD -3.402823466e+38 3.402823466e+38 SYMBOL_LINK "Rte_CalprmRom_CalRegn02CmnGroupC_DEFAULT_RTE_CALPRM_GROUP.SnsrOffsLrngHwAgLrngSysTqThdTrustd_Val" 0 DISPLAY_IDENTIFIER CalRegn02CmnGroupC.CalibrationPorts.SnsrOffsLrngHwAgLrngSysTqThdTrustd.Val /end CHARACTERISTIC
/begin CHARACTERISTIC CalRegn02CmnGroupC.SnsrOffsLrngHwAgLrngSysTqThdWide.Val "MICROSAR RTE" VALUE 0x0 RTE_RL_FLOAT32_IEEE 0 NO_COMPU_METHOD -3.402823466e+38 3.402823466e+38 SYMBOL_LINK "Rte_CalprmRom_CalRegn02CmnGroupC_DEFAULT_RTE_CALPRM_GROUP.SnsrOffsLrngHwAgLrngSysTqThdWide_Val" 0 DISPLAY_IDENTIFIER CalRegn02CmnGroupC.CalibrationPorts.SnsrOffsLrngHwAgLrngSysTqThdWide.Val /end CHARACTERISTIC
/begin CHARACTERISTIC CalRegn02CmnGroupC.SnsrOffsLrngHwAgLrngVehSpdThd.Val "MICROSAR RTE" VALUE 0x0 RTE_RL_FLOAT32_IEEE 0 NO_COMPU_METHOD -3.402823466e+38 3.402823466e+38 SYMBOL_LINK "Rte_CalprmRom_CalRegn02CmnGroupC_DEFAULT_RTE_CALPRM_GROUP.SnsrOffsLrngHwAgLrngVehSpdThd_Val" 0 DISPLAY_IDENTIFIER CalRegn02CmnGroupC.CalibrationPorts.SnsrOffsLrngHwAgLrngVehSpdThd.Val /end CHARACTERISTIC
/begin CHARACTERISTIC CalRegn02CmnGroupC.SnsrOffsLrngHwAgLrngYawOffsDbnd.Val "MICROSAR RTE" VALUE 0x0 RTE_RL_FLOAT32_IEEE 0 NO_COMPU_METHOD -3.402823466e+38 3.402823466e+38 SYMBOL_LINK "Rte_CalprmRom_CalRegn02CmnGroupC_DEFAULT_RTE_CALPRM_GROUP.SnsrOffsLrngHwAgLrngYawOffsDbnd_Val" 0 DISPLAY_IDENTIFIER CalRegn02CmnGroupC.CalibrationPorts.SnsrOffsLrngHwAgLrngYawOffsDbnd.Val /end CHARACTERISTIC
/begin CHARACTERISTIC CalRegn02CmnGroupC.SnsrOffsLrngHwAgLrngYawRateThd.Val "MICROSAR RTE" VALUE 0x0 RTE_RL_FLOAT32_IEEE 0 NO_COMPU_METHOD -3.402823466e+38 3.402823466e+38 SYMBOL_LINK "Rte_CalprmRom_CalRegn02CmnGroupC_DEFAULT_RTE_CALPRM_GROUP.SnsrOffsLrngHwAgLrngYawRateThd_Val" 0 DISPLAY_IDENTIFIER CalRegn02CmnGroupC.CalibrationPorts.SnsrOffsLrngHwAgLrngYawRateThd.Val /end CHARACTERISTIC
/begin CHARACTERISTIC CalRegn02CmnGroupC.SnsrOffsLrngHwAgOffsLim.Val "MICROSAR RTE" VALUE 0x0 RTE_RL_FLOAT32_IEEE 0 NO_COMPU_METHOD -3.402823466e+38 3.402823466e+38 SYMBOL_LINK "Rte_CalprmRom_CalRegn02CmnGroupC_DEFAULT_RTE_CALPRM_GROUP.SnsrOffsLrngHwAgOffsLim_Val" 0 DISPLAY_IDENTIFIER CalRegn02CmnGroupC.CalibrationPorts.SnsrOffsLrngHwAgOffsLim.Val /end CHARACTERISTIC
/begin CHARACTERISTIC CalRegn02CmnGroupC.SnsrOffsLrngHwTqLrngEna.Logl "MICROSAR RTE" VALUE 0x0 RTE_RL_BOOLEAN 0 RTE_CM_BOOLEAN 0 255 SYMBOL_LINK "Rte_CalprmRom_CalRegn02CmnGroupC_DEFAULT_RTE_CALPRM_GROUP.SnsrOffsLrngHwTqLrngEna_Logl" 0 DISPLAY_IDENTIFIER CalRegn02CmnGroupC.CalibrationPorts.SnsrOffsLrngHwTqLrngEna.Logl /end CHARACTERISTIC
/begin CHARACTERISTIC CalRegn02CmnGroupC.SnsrOffsLrngHwTqLrngEnaTiThd.Val "MICROSAR RTE" VALUE 0x0 RTE_RL_FLOAT32_IEEE 0 NO_COMPU_METHOD -3.402823466e+38 3.402823466e+38 SYMBOL_LINK "Rte_CalprmRom_CalRegn02CmnGroupC_DEFAULT_RTE_CALPRM_GROUP.SnsrOffsLrngHwTqLrngEnaTiThd_Val" 0 DISPLAY_IDENTIFIER CalRegn02CmnGroupC.CalibrationPorts.SnsrOffsLrngHwTqLrngEnaTiThd.Val /end CHARACTERISTIC
/begin CHARACTERISTIC CalRegn02CmnGroupC.SnsrOffsLrngHwTqLrngHwAgDbnd.Val "MICROSAR RTE" VALUE 0x0 RTE_RL_FLOAT32_IEEE 0 NO_COMPU_METHOD -3.402823466e+38 3.402823466e+38 SYMBOL_LINK "Rte_CalprmRom_CalRegn02CmnGroupC_DEFAULT_RTE_CALPRM_GROUP.SnsrOffsLrngHwTqLrngHwAgDbnd_Val" 0 DISPLAY_IDENTIFIER CalRegn02CmnGroupC.CalibrationPorts.SnsrOffsLrngHwTqLrngHwAgDbnd.Val /end CHARACTERISTIC
/begin CHARACTERISTIC CalRegn02CmnGroupC.SnsrOffsLrngHwTqLrngHwAgThd.Val "MICROSAR RTE" VALUE 0x0 RTE_RL_FLOAT32_IEEE 0 NO_COMPU_METHOD -3.402823466e+38 3.402823466e+38 SYMBOL_LINK "Rte_CalprmRom_CalRegn02CmnGroupC_DEFAULT_RTE_CALPRM_GROUP.SnsrOffsLrngHwTqLrngHwAgThd_Val" 0 DISPLAY_IDENTIFIER CalRegn02CmnGroupC.CalibrationPorts.SnsrOffsLrngHwTqLrngHwAgThd.Val /end CHARACTERISTIC
/begin CHARACTERISTIC CalRegn02CmnGroupC.SnsrOffsLrngHwTqLrngHwTqThd.Val "MICROSAR RTE" VALUE 0x0 RTE_RL_FLOAT32_IEEE 0 NO_COMPU_METHOD -3.402823466e+38 3.402823466e+38 SYMBOL_LINK "Rte_CalprmRom_CalRegn02CmnGroupC_DEFAULT_RTE_CALPRM_GROUP.SnsrOffsLrngHwTqLrngHwTqThd_Val" 0 DISPLAY_IDENTIFIER CalRegn02CmnGroupC.CalibrationPorts.SnsrOffsLrngHwTqLrngHwTqThd.Val /end CHARACTERISTIC
/begin CHARACTERISTIC CalRegn02CmnGroupC.SnsrOffsLrngHwTqLrngHwVelThd.Val "MICROSAR RTE" VALUE 0x0 RTE_RL_FLOAT32_IEEE 0 NO_COMPU_METHOD -3.402823466e+38 3.402823466e+38 SYMBOL_LINK "Rte_CalprmRom_CalRegn02CmnGroupC_DEFAULT_RTE_CALPRM_GROUP.SnsrOffsLrngHwTqLrngHwVelThd_Val" 0 DISPLAY_IDENTIFIER CalRegn02CmnGroupC.CalibrationPorts.SnsrOffsLrngHwTqLrngHwVelThd.Val /end CHARACTERISTIC
/begin CHARACTERISTIC CalRegn02CmnGroupC.SnsrOffsLrngHwTqLrngMeasTiScar.Val "MICROSAR RTE" VALUE 0x0 RTE_RL_FLOAT32_IEEE 0 NO_COMPU_METHOD -3.402823466e+38 3.402823466e+38 SYMBOL_LINK "Rte_CalprmRom_CalRegn02CmnGroupC_DEFAULT_RTE_CALPRM_GROUP.SnsrOffsLrngHwTqLrngMeasTiScar_Val" 0 DISPLAY_IDENTIFIER CalRegn02CmnGroupC.CalibrationPorts.SnsrOffsLrngHwTqLrngMeasTiScar.Val /end CHARACTERISTIC
/begin CHARACTERISTIC CalRegn02CmnGroupC.SnsrOffsLrngHwTqLrngVehSpdThd.Val "MICROSAR RTE" VALUE 0x0 RTE_RL_FLOAT32_IEEE 0 NO_COMPU_METHOD -3.402823466e+38 3.402823466e+38 SYMBOL_LINK "Rte_CalprmRom_CalRegn02CmnGroupC_DEFAULT_RTE_CALPRM_GROUP.SnsrOffsLrngHwTqLrngVehSpdThd_Val" 0 DISPLAY_IDENTIFIER CalRegn02CmnGroupC.CalibrationPorts.SnsrOffsLrngHwTqLrngVehSpdThd.Val /end CHARACTERISTIC
/begin CHARACTERISTIC CalRegn02CmnGroupC.SnsrOffsLrngHwTqOffsLim.Val "MICROSAR RTE" VALUE 0x0 RTE_RL_FLOAT32_IEEE 0 NO_COMPU_METHOD -3.402823466e+38 3.402823466e+38 SYMBOL_LINK "Rte_CalprmRom_CalRegn02CmnGroupC_DEFAULT_RTE_CALPRM_GROUP.SnsrOffsLrngHwTqOffsLim_Val" 0 DISPLAY_IDENTIFIER CalRegn02CmnGroupC.CalibrationPorts.SnsrOffsLrngHwTqOffsLim.Val /end CHARACTERISTIC
/begin CHARACTERISTIC CalRegn02CmnGroupC.SnsrOffsLrngTqInpDetnPwrEstimnThd.Val "MICROSAR RTE" VALUE 0x0 RTE_RL_FLOAT32_IEEE 0 NO_COMPU_METHOD -3.402823466e+38 3.402823466e+38 SYMBOL_LINK "Rte_CalprmRom_CalRegn02CmnGroupC_DEFAULT_RTE_CALPRM_GROUP.SnsrOffsLrngTqInpDetnPwrEstimnThd_Val" 0 DISPLAY_IDENTIFIER CalRegn02CmnGroupC.CalibrationPorts.SnsrOffsLrngTqInpDetnPwrEstimnThd.Val /end CHARACTERISTIC
/begin CHARACTERISTIC CalRegn02CmnGroupC.SnsrOffsLrngTqInpDetnSinGenrAmp.Val "MICROSAR RTE" VALUE 0x0 RTE_RL_FLOAT32_IEEE 0 NO_COMPU_METHOD -3.402823466e+38 3.402823466e+38 SYMBOL_LINK "Rte_CalprmRom_CalRegn02CmnGroupC_DEFAULT_RTE_CALPRM_GROUP.SnsrOffsLrngTqInpDetnSinGenrAmp_Val" 0 DISPLAY_IDENTIFIER CalRegn02CmnGroupC.CalibrationPorts.SnsrOffsLrngTqInpDetnSinGenrAmp.Val /end CHARACTERISTIC
/begin CHARACTERISTIC CalRegn02CmnGroupC.SnsrOffsLrngTqInpDetnSinGenrFrq.Val "MICROSAR RTE" VALUE 0x0 RTE_RL_FLOAT32_IEEE 0 NO_COMPU_METHOD -3.402823466e+38 3.402823466e+38 SYMBOL_LINK "Rte_CalprmRom_CalRegn02CmnGroupC_DEFAULT_RTE_CALPRM_GROUP.SnsrOffsLrngTqInpDetnSinGenrFrq_Val" 0 DISPLAY_IDENTIFIER CalRegn02CmnGroupC.CalibrationPorts.SnsrOffsLrngTqInpDetnSinGenrFrq.Val /end CHARACTERISTIC
/begin GROUP CalRegn01Inin00.GmVehPwrModOperRampRate.Val "MICROSAR RTE" /begin SUB_GROUP /end SUB_GROUP /begin FUNCTION_LIST /end FUNCTION_LIST /begin REF_CHARACTERISTIC CalRegn01Inin00.GmVehPwrModOperRampRate.Val /end REF_CHARACTERISTIC /begin REF_MEASUREMENT /end REF_MEASUREMENT /end GROUP
/begin GROUP CalRegn01Inin00.HiLoadStallLimrMotTqCmdFilFrq.Val "MICROSAR RTE" /begin SUB_GROUP /end SUB_GROUP /begin FUNCTION_LIST /end FUNCTION_LIST /begin REF_CHARACTERISTIC CalRegn01Inin00.HiLoadStallLimrMotTqCmdFilFrq.Val /end REF_CHARACTERISTIC /begin REF_MEASUREMENT /end REF_MEASUREMENT /end GROUP
/begin GROUP CalRegn01Inin00.HiLoadStallLimrMotVelMgnThd.Val "MICROSAR RTE" /begin SUB_GROUP /end SUB_GROUP /begin FUNCTION_LIST /end FUNCTION_LIST /begin REF_CHARACTERISTIC CalRegn01Inin00.HiLoadStallLimrMotVelMgnThd.Val /end REF_CHARACTERISTIC /begin REF_MEASUREMENT /end REF_MEASUREMENT /end GROUP
/begin GROUP CalRegn01Inin00.HiLoadStallLimrStallMotTqCmdLimX.Ary1D "MICROSAR RTE" /begin SUB_GROUP /end SUB_GROUP /begin FUNCTION_LIST /end FUNCTION_LIST /begin REF_CHARACTERISTIC CalRegn01Inin00.HiLoadStallLimrStallMotTqCmdLimX.Ary1D /end REF_CHARACTERISTIC /begin REF_MEASUREMENT /end REF_MEASUREMENT /end GROUP
/begin GROUP CalRegn01Inin00.HiLoadStallLimrStallMotTqCmdLimY.Ary1D "MICROSAR RTE" /begin SUB_GROUP /end SUB_GROUP /begin FUNCTION_LIST /end FUNCTION_LIST /begin REF_CHARACTERISTIC CalRegn01Inin00.HiLoadStallLimrStallMotTqCmdLimY.Ary1D /end REF_CHARACTERISTIC /begin REF_MEASUREMENT /end REF_MEASUREMENT /end GROUP
/begin GROUP CalRegn01Inin00.HiLoadStallLimrStallMotTqLimSlewRate.Val "MICROSAR RTE" /begin SUB_GROUP /end SUB_GROUP /begin FUNCTION_LIST /end FUNCTION_LIST /begin REF_CHARACTERISTIC CalRegn01Inin00.HiLoadStallLimrStallMotTqLimSlewRate.Val /end REF_CHARACTERISTIC /begin REF_MEASUREMENT /end REF_MEASUREMENT /end GROUP
/begin GROUP CalRegn01Inin00.HwAg0MeasHwAg0IfFltFailStep.Val "MICROSAR RTE" /begin SUB_GROUP /end SUB_GROUP /begin FUNCTION_LIST /end FUNCTION_LIST /begin REF_CHARACTERISTIC CalRegn01Inin00.HwAg0MeasHwAg0IfFltFailStep.Val /end REF_CHARACTERISTIC /begin REF_MEASUREMENT /end REF_MEASUREMENT /end GROUP
/begin GROUP CalRegn01Inin00.HwAg0MeasHwAg0IfFltPassStep.Val "MICROSAR RTE" /begin SUB_GROUP /end SUB_GROUP /begin FUNCTION_LIST /end FUNCTION_LIST /begin REF_CHARACTERISTIC CalRegn01Inin00.HwAg0MeasHwAg0IfFltPassStep.Val /end REF_CHARACTERISTIC /begin REF_MEASUREMENT /end REF_MEASUREMENT /end GROUP
/begin GROUP CalRegn01Inin00.HwAg0MeasHwAg0Snsr0PrtclFltFailStep.Val "MICROSAR RTE" /begin SUB_GROUP /end SUB_GROUP /begin FUNCTION_LIST /end FUNCTION_LIST /begin REF_CHARACTERISTIC CalRegn01Inin00.HwAg0MeasHwAg0Snsr0PrtclFltFailStep.Val /end REF_CHARACTERISTIC /begin REF_MEASUREMENT /end REF_MEASUREMENT /end GROUP
/begin GROUP CalRegn01Inin00.HwAg0MeasHwAg0Snsr0PrtclFltPassStep.Val "MICROSAR RTE" /begin SUB_GROUP /end SUB_GROUP /begin FUNCTION_LIST /end FUNCTION_LIST /begin REF_CHARACTERISTIC CalRegn01Inin00.HwAg0MeasHwAg0Snsr0PrtclFltPassStep.Val /end REF_CHARACTERISTIC /begin REF_MEASUREMENT /end REF_MEASUREMENT /end GROUP
/begin GROUP CalRegn01Inin00.HwAg0MeasHwAg0Snsr1PrtclFltFailStep.Val "MICROSAR RTE" /begin SUB_GROUP /end SUB_GROUP /begin FUNCTION_LIST /end FUNCTION_LIST /begin REF_CHARACTERISTIC CalRegn01Inin00.HwAg0MeasHwAg0Snsr1PrtclFltFailStep.Val /end REF_CHARACTERISTIC /begin REF_MEASUREMENT /end REF_MEASUREMENT /end GROUP
/begin GROUP CalRegn01Inin00.HwAg0MeasHwAg0Snsr1PrtclFltPassStep.Val "MICROSAR RTE" /begin SUB_GROUP /end SUB_GROUP /begin FUNCTION_LIST /end FUNCTION_LIST /begin REF_CHARACTERISTIC CalRegn01Inin00.HwAg0MeasHwAg0Snsr1PrtclFltPassStep.Val /end REF_CHARACTERISTIC /begin REF_MEASUREMENT /end REF_MEASUREMENT /end GROUP
/begin GROUP CalRegn01Inin00.HwAg0MeasSnsr0Rev.Ary1D "MICROSAR RTE" /begin SUB_GROUP /end SUB_GROUP /begin FUNCTION_LIST /end FUNCTION_LIST /begin REF_CHARACTERISTIC CalRegn01Inin00.HwAg0MeasSnsr0Rev.Ary1D /end REF_CHARACTERISTIC /begin REF_MEASUREMENT /end REF_MEASUREMENT /end GROUP
/begin GROUP CalRegn01Inin00.HwAg0MeasSnsr1Rev.Ary1D "MICROSAR RTE" /begin SUB_GROUP /end SUB_GROUP /begin FUNCTION_LIST /end FUNCTION_LIST /begin REF_CHARACTERISTIC CalRegn01Inin00.HwAg0MeasSnsr1Rev.Ary1D /end REF_CHARACTERISTIC /begin REF_MEASUREMENT /end REF_MEASUREMENT /end GROUP
/begin GROUP CalRegn01Inin00.HwAg0MeasStep.Ary1D "MICROSAR RTE" /begin SUB_GROUP /end SUB_GROUP /begin FUNCTION_LIST /end FUNCTION_LIST /begin REF_CHARACTERISTIC CalRegn01Inin00.HwAg0MeasStep.Ary1D /end REF_CHARACTERISTIC /begin REF_MEASUREMENT /end REF_MEASUREMENT /end GROUP
/begin GROUP CalRegn01Inin00.HwAg0MeasVrnrErrThd.Val "MICROSAR RTE" /begin SUB_GROUP /end SUB_GROUP /begin FUNCTION_LIST /end FUNCTION_LIST /begin REF_CHARACTERISTIC CalRegn01Inin00.HwAg0MeasVrnrErrThd.Val /end REF_CHARACTERISTIC /begin REF_MEASUREMENT /end REF_MEASUREMENT /end GROUP
/begin GROUP CalRegn01Inin00.HwAg1MeasHwAg1IfFltFailStep.Val "MICROSAR RTE" /begin SUB_GROUP /end SUB_GROUP /begin FUNCTION_LIST /end FUNCTION_LIST /begin REF_CHARACTERISTIC CalRegn01Inin00.HwAg1MeasHwAg1IfFltFailStep.Val /end REF_CHARACTERISTIC /begin REF_MEASUREMENT /end REF_MEASUREMENT /end GROUP
/begin GROUP CalRegn01Inin00.HwAg1MeasHwAg1IfFltPassStep.Val "MICROSAR RTE" /begin SUB_GROUP /end SUB_GROUP /begin FUNCTION_LIST /end FUNCTION_LIST /begin REF_CHARACTERISTIC CalRegn01Inin00.HwAg1MeasHwAg1IfFltPassStep.Val /end REF_CHARACTERISTIC /begin REF_MEASUREMENT /end REF_MEASUREMENT /end GROUP
/begin GROUP CalRegn01Inin00.HwAg1MeasHwAg1Snsr0PrtclFltFailStep.Val "MICROSAR RTE" /begin SUB_GROUP /end SUB_GROUP /begin FUNCTION_LIST /end FUNCTION_LIST /begin REF_CHARACTERISTIC CalRegn01Inin00.HwAg1MeasHwAg1Snsr0PrtclFltFailStep.Val /end REF_CHARACTERISTIC /begin REF_MEASUREMENT /end REF_MEASUREMENT /end GROUP
/begin GROUP CalRegn01Inin00.HwAg1MeasHwAg1Snsr0PrtclFltPassStep.Val "MICROSAR RTE" /begin SUB_GROUP /end SUB_GROUP /begin FUNCTION_LIST /end FUNCTION_LIST /begin REF_CHARACTERISTIC CalRegn01Inin00.HwAg1MeasHwAg1Snsr0PrtclFltPassStep.Val /end REF_CHARACTERISTIC /begin REF_MEASUREMENT /end REF_MEASUREMENT /end GROUP
/begin GROUP CalRegn01Inin00.HwAg1MeasHwAg1Snsr1PrtclFltFailStep.Val "MICROSAR RTE" /begin SUB_GROUP /end SUB_GROUP /begin FUNCTION_LIST /end FUNCTION_LIST /begin REF_CHARACTERISTIC CalRegn01Inin00.HwAg1MeasHwAg1Snsr1PrtclFltFailStep.Val /end REF_CHARACTERISTIC /begin REF_MEASUREMENT /end REF_MEASUREMENT /end GROUP
/begin GROUP CalRegn01Inin00.HwAg1MeasHwAg1Snsr1PrtclFltPassStep.Val "MICROSAR RTE" /begin SUB_GROUP /end SUB_GROUP /begin FUNCTION_LIST /end FUNCTION_LIST /begin REF_CHARACTERISTIC CalRegn01Inin00.HwAg1MeasHwAg1Snsr1PrtclFltPassStep.Val /end REF_CHARACTERISTIC /begin REF_MEASUREMENT /end REF_MEASUREMENT /end GROUP
/begin GROUP CalRegn01Inin00.HwAg1MeasSnsr0Rev.Ary1D "MICROSAR RTE" /begin SUB_GROUP /end SUB_GROUP /begin FUNCTION_LIST /end FUNCTION_LIST /begin REF_CHARACTERISTIC CalRegn01Inin00.HwAg1MeasSnsr0Rev.Ary1D /end REF_CHARACTERISTIC /begin REF_MEASUREMENT /end REF_MEASUREMENT /end GROUP
/begin GROUP CalRegn01Inin00.HwAg1MeasSnsr1Rev.Ary1D "MICROSAR RTE" /begin SUB_GROUP /end SUB_GROUP /begin FUNCTION_LIST /end FUNCTION_LIST /begin REF_CHARACTERISTIC CalRegn01Inin00.HwAg1MeasSnsr1Rev.Ary1D /end REF_CHARACTERISTIC /begin REF_MEASUREMENT /end REF_MEASUREMENT /end GROUP
/begin GROUP CalRegn01Inin00.HwAg1MeasStep.Ary1D "MICROSAR RTE" /begin SUB_GROUP /end SUB_GROUP /begin FUNCTION_LIST /end FUNCTION_LIST /begin REF_CHARACTERISTIC CalRegn01Inin00.HwAg1MeasStep.Ary1D /end REF_CHARACTERISTIC /begin REF_MEASUREMENT /end REF_MEASUREMENT /end GROUP
/begin GROUP CalRegn01Inin00.HwAg1MeasVrnrErrThd.Val "MICROSAR RTE" /begin SUB_GROUP /end SUB_GROUP /begin FUNCTION_LIST /end FUNCTION_LIST /begin REF_CHARACTERISTIC CalRegn01Inin00.HwAg1MeasVrnrErrThd.Val /end REF_CHARACTERISTIC /begin REF_MEASUREMENT /end REF_MEASUREMENT /end GROUP
/begin GROUP CalRegn01Inin00.HwAgSnsrlsVehDynVehSpdThd.Val "MICROSAR RTE" /begin SUB_GROUP /end SUB_GROUP /begin FUNCTION_LIST /end FUNCTION_LIST /begin REF_CHARACTERISTIC CalRegn01Inin00.HwAgSnsrlsVehDynVehSpdThd.Val /end REF_CHARACTERISTIC /begin REF_MEASUREMENT /end REF_MEASUREMENT /end GROUP
/begin GROUP CalRegn01Inin00.HwAgSnsrlsVehDynYawRateThd.Val "MICROSAR RTE" /begin SUB_GROUP /end SUB_GROUP /begin FUNCTION_LIST /end FUNCTION_LIST /begin REF_CHARACTERISTIC CalRegn01Inin00.HwAgSnsrlsVehDynYawRateThd.Val /end REF_CHARACTERISTIC /begin REF_MEASUREMENT /end REF_MEASUREMENT /end GROUP
/begin GROUP CalRegn01Inin00.HwAgSnsrlsYawRateFilFrq.Val "MICROSAR RTE" /begin SUB_GROUP /end SUB_GROUP /begin FUNCTION_LIST /end FUNCTION_LIST /begin REF_CHARACTERISTIC CalRegn01Inin00.HwAgSnsrlsYawRateFilFrq.Val /end REF_CHARACTERISTIC /begin REF_MEASUREMENT /end REF_MEASUREMENT /end GROUP
/begin GROUP CalRegn01Inin00.HwTq0MeasHwTq0PrtclFltFailStep.Val "MICROSAR RTE" /begin SUB_GROUP /end SUB_GROUP /begin FUNCTION_LIST /end FUNCTION_LIST /begin REF_CHARACTERISTIC CalRegn01Inin00.HwTq0MeasHwTq0PrtclFltFailStep.Val /end REF_CHARACTERISTIC /begin REF_MEASUREMENT /end REF_MEASUREMENT /end GROUP
/begin GROUP CalRegn01Inin00.HwTq0MeasHwTq0PrtclFltPassStep.Val "MICROSAR RTE" /begin SUB_GROUP /end SUB_GROUP /begin FUNCTION_LIST /end FUNCTION_LIST /begin REF_CHARACTERISTIC CalRegn01Inin00.HwTq0MeasHwTq0PrtclFltPassStep.Val /end REF_CHARACTERISTIC /begin REF_MEASUREMENT /end REF_MEASUREMENT /end GROUP
/begin GROUP CalRegn01Inin00.HwTq1MeasHwTq1PrtclFltFailStep.Val "MICROSAR RTE" /begin SUB_GROUP /end SUB_GROUP /begin FUNCTION_LIST /end FUNCTION_LIST /begin REF_CHARACTERISTIC CalRegn01Inin00.HwTq1MeasHwTq1PrtclFltFailStep.Val /end REF_CHARACTERISTIC /begin REF_MEASUREMENT /end REF_MEASUREMENT /end GROUP
/begin GROUP CalRegn01Inin00.HwTq1MeasHwTq1PrtclFltPassStep.Val "MICROSAR RTE" /begin SUB_GROUP /end SUB_GROUP /begin FUNCTION_LIST /end FUNCTION_LIST /begin REF_CHARACTERISTIC CalRegn01Inin00.HwTq1MeasHwTq1PrtclFltPassStep.Val /end REF_CHARACTERISTIC /begin REF_MEASUREMENT /end REF_MEASUREMENT /end GROUP
/begin GROUP CalRegn01Inin00.LimrCdngGainDecSlew.Val "MICROSAR RTE" /begin SUB_GROUP /end SUB_GROUP /begin FUNCTION_LIST /end FUNCTION_LIST /begin REF_CHARACTERISTIC CalRegn01Inin00.LimrCdngGainDecSlew.Val /end REF_CHARACTERISTIC /begin REF_MEASUREMENT /end REF_MEASUREMENT /end GROUP
/begin GROUP CalRegn01Inin00.LimrCdngGainIncSlewX.Ary1D "MICROSAR RTE" /begin SUB_GROUP /end SUB_GROUP /begin FUNCTION_LIST /end FUNCTION_LIST /begin REF_CHARACTERISTIC CalRegn01Inin00.LimrCdngGainIncSlewX.Ary1D /end REF_CHARACTERISTIC /begin REF_MEASUREMENT /end REF_MEASUREMENT /end GROUP
/begin GROUP CalRegn01Inin00.LimrCdngGainIncSlewY.Ary1D "MICROSAR RTE" /begin SUB_GROUP /end SUB_GROUP /begin FUNCTION_LIST /end FUNCTION_LIST /begin REF_CHARACTERISTIC CalRegn01Inin00.LimrCdngGainIncSlewY.Ary1D /end REF_CHARACTERISTIC /begin REF_MEASUREMENT /end REF_MEASUREMENT /end GROUP
/begin GROUP CalRegn01Inin00.LimrCdngTqDecSlew.Val "MICROSAR RTE" /begin SUB_GROUP /end SUB_GROUP /begin FUNCTION_LIST /end FUNCTION_LIST /begin REF_CHARACTERISTIC CalRegn01Inin00.LimrCdngTqDecSlew.Val /end REF_CHARACTERISTIC /begin REF_MEASUREMENT /end REF_MEASUREMENT /end GROUP
/begin GROUP CalRegn01Inin00.LimrCdngTqIncSlewX.Ary1D "MICROSAR RTE" /begin SUB_GROUP /end SUB_GROUP /begin FUNCTION_LIST /end FUNCTION_LIST /begin REF_CHARACTERISTIC CalRegn01Inin00.LimrCdngTqIncSlewX.Ary1D /end REF_CHARACTERISTIC /begin REF_MEASUREMENT /end REF_MEASUREMENT /end GROUP
/begin GROUP CalRegn01Inin00.LimrCdngTqIncSlewY.Ary1D "MICROSAR RTE" /begin SUB_GROUP /end SUB_GROUP /begin FUNCTION_LIST /end FUNCTION_LIST /begin REF_CHARACTERISTIC CalRegn01Inin00.LimrCdngTqIncSlewY.Ary1D /end REF_CHARACTERISTIC /begin REF_MEASUREMENT /end REF_MEASUREMENT /end GROUP
/begin GROUP CalRegn01Inin00.McuDiagc2MilliSecCntrCompThd.Val "MICROSAR RTE" /begin SUB_GROUP /end SUB_GROUP /begin FUNCTION_LIST /end FUNCTION_LIST /begin REF_CHARACTERISTIC CalRegn01Inin00.McuDiagc2MilliSecCntrCompThd.Val /end REF_CHARACTERISTIC /begin REF_MEASUREMENT /end REF_MEASUREMENT /end GROUP
/begin GROUP CalRegn01Inin00.McuDiagcFltFailStep.Val "MICROSAR RTE" /begin SUB_GROUP /end SUB_GROUP /begin FUNCTION_LIST /end FUNCTION_LIST /begin REF_CHARACTERISTIC CalRegn01Inin00.McuDiagcFltFailStep.Val /end REF_CHARACTERISTIC /begin REF_MEASUREMENT /end REF_MEASUREMENT /end GROUP
/begin GROUP CalRegn01Inin00.McuDiagcFltPassStep.Val "MICROSAR RTE" /begin SUB_GROUP /end SUB_GROUP /begin FUNCTION_LIST /end FUNCTION_LIST /begin REF_CHARACTERISTIC CalRegn01Inin00.McuDiagcFltPassStep.Val /end REF_CHARACTERISTIC /begin REF_MEASUREMENT /end REF_MEASUREMENT /end GROUP
/begin GROUP CalRegn01Inin00.MotAg1MeasMotAgOffs.Val "MICROSAR RTE" /begin SUB_GROUP /end SUB_GROUP /begin FUNCTION_LIST /end FUNCTION_LIST /begin REF_CHARACTERISTIC CalRegn01Inin00.MotAg1MeasMotAgOffs.Val /end REF_CHARACTERISTIC /begin REF_MEASUREMENT /end REF_MEASUREMENT /end GROUP
/begin GROUP CalRegn01Inin00.MotTqTranlDampgCmdLim.Val "MICROSAR RTE" /begin SUB_GROUP /end SUB_GROUP /begin FUNCTION_LIST /end FUNCTION_LIST /begin REF_CHARACTERISTIC CalRegn01Inin00.MotTqTranlDampgCmdLim.Val /end REF_CHARACTERISTIC /begin REF_MEASUREMENT /end REF_MEASUREMENT /end GROUP
/begin GROUP CalRegn01Inin00.MotTqTranlDampgDampgCoeff.Val "MICROSAR RTE" /begin SUB_GROUP /end SUB_GROUP /begin FUNCTION_LIST /end FUNCTION_LIST /begin REF_CHARACTERISTIC CalRegn01Inin00.MotTqTranlDampgDampgCoeff.Val /end REF_CHARACTERISTIC /begin REF_MEASUREMENT /end REF_MEASUREMENT /end GROUP
/begin GROUP CalRegn01Inin00.MotTqTranlDampgRampEnd.Val "MICROSAR RTE" /begin SUB_GROUP /end SUB_GROUP /begin FUNCTION_LIST /end FUNCTION_LIST /begin REF_CHARACTERISTIC CalRegn01Inin00.MotTqTranlDampgRampEnd.Val /end REF_CHARACTERISTIC /begin REF_MEASUREMENT /end REF_MEASUREMENT /end GROUP
/begin GROUP CalRegn01Inin00.MotTqTranlDampgTmrPt1.Val "MICROSAR RTE" /begin SUB_GROUP /end SUB_GROUP /begin FUNCTION_LIST /end FUNCTION_LIST /begin REF_CHARACTERISTIC CalRegn01Inin00.MotTqTranlDampgTmrPt1.Val /end REF_CHARACTERISTIC /begin REF_MEASUREMENT /end REF_MEASUREMENT /end GROUP
/begin GROUP CalRegn01Inin00.MotTqTranlDampgTmrPt2.Val "MICROSAR RTE" /begin SUB_GROUP /end SUB_GROUP /begin FUNCTION_LIST /end FUNCTION_LIST /begin REF_CHARACTERISTIC CalRegn01Inin00.MotTqTranlDampgTmrPt2.Val /end REF_CHARACTERISTIC /begin REF_MEASUREMENT /end REF_MEASUREMENT /end GROUP
/begin GROUP CalRegn01Inin00.MotTqTranlDampgVehSpdBlndX.Ary1D "MICROSAR RTE" /begin SUB_GROUP /end SUB_GROUP /begin FUNCTION_LIST /end FUNCTION_LIST /begin REF_CHARACTERISTIC CalRegn01Inin00.MotTqTranlDampgVehSpdBlndX.Ary1D /end REF_CHARACTERISTIC /begin REF_MEASUREMENT /end REF_MEASUREMENT /end GROUP
/begin GROUP CalRegn01Inin00.MotTqTranlDampgVelThd.Val "MICROSAR RTE" /begin SUB_GROUP /end SUB_GROUP /begin FUNCTION_LIST /end FUNCTION_LIST /begin REF_CHARACTERISTIC CalRegn01Inin00.MotTqTranlDampgVelThd.Val /end REF_CHARACTERISTIC /begin REF_MEASUREMENT /end REF_MEASUREMENT /end GROUP
/begin GROUP CalRegn01Inin00.PwrDiscnctNtc0x042FailStep.Val "MICROSAR RTE" /begin SUB_GROUP /end SUB_GROUP /begin FUNCTION_LIST /end FUNCTION_LIST /begin REF_CHARACTERISTIC CalRegn01Inin00.PwrDiscnctNtc0x042FailStep.Val /end REF_CHARACTERISTIC /begin REF_MEASUREMENT /end REF_MEASUREMENT /end GROUP
/begin GROUP CalRegn01Inin00.PwrDiscnctNtc0x042PassStep.Val "MICROSAR RTE" /begin SUB_GROUP /end SUB_GROUP /begin FUNCTION_LIST /end FUNCTION_LIST /begin REF_CHARACTERISTIC CalRegn01Inin00.PwrDiscnctNtc0x042PassStep.Val /end REF_CHARACTERISTIC /begin REF_MEASUREMENT /end REF_MEASUREMENT /end GROUP
/begin GROUP CalRegn01Inin00.PwrDiscnctNtc0x04AFailStep.Val "MICROSAR RTE" /begin SUB_GROUP /end SUB_GROUP /begin FUNCTION_LIST /end FUNCTION_LIST /begin REF_CHARACTERISTIC CalRegn01Inin00.PwrDiscnctNtc0x04AFailStep.Val /end REF_CHARACTERISTIC /begin REF_MEASUREMENT /end REF_MEASUREMENT /end GROUP
/begin GROUP CalRegn01Inin00.PwrDiscnctNtc0x04APassStep.Val "MICROSAR RTE" /begin SUB_GROUP /end SUB_GROUP /begin FUNCTION_LIST /end FUNCTION_LIST /begin REF_CHARACTERISTIC CalRegn01Inin00.PwrDiscnctNtc0x04APassStep.Val /end REF_CHARACTERISTIC /begin REF_MEASUREMENT /end REF_MEASUREMENT /end GROUP
/begin GROUP CalRegn01Inin00.RtnPahFwlUpprBndTblX.Ary1D "MICROSAR RTE" /begin SUB_GROUP /end SUB_GROUP /begin FUNCTION_LIST /end FUNCTION_LIST /begin REF_CHARACTERISTIC CalRegn01Inin00.RtnPahFwlUpprBndTblX.Ary1D /end REF_CHARACTERISTIC /begin REF_MEASUREMENT /end REF_MEASUREMENT /end GROUP
/begin GROUP CalRegn01Inin00.RtnPahFwlUpprBndTblY.Ary2D "MICROSAR RTE" /begin SUB_GROUP /end SUB_GROUP /begin FUNCTION_LIST /end FUNCTION_LIST /begin REF_CHARACTERISTIC CalRegn01Inin00.RtnPahFwlUpprBndTblY.Ary2D /end REF_CHARACTERISTIC /begin REF_MEASUREMENT /end REF_MEASUREMENT /end GROUP
/begin GROUP CalRegn01Inin00.RtnPahFwlVehSpd.Ary1D "MICROSAR RTE" /begin SUB_GROUP /end SUB_GROUP /begin FUNCTION_LIST /end FUNCTION_LIST /begin REF_CHARACTERISTIC CalRegn01Inin00.RtnPahFwlVehSpd.Ary1D /end REF_CHARACTERISTIC /begin REF_MEASUREMENT /end REF_MEASUREMENT /end GROUP
/begin GROUP CalRegn01Inin00.SnsrMeasStrtTrigDly.Val "MICROSAR RTE" /begin SUB_GROUP /end SUB_GROUP /begin FUNCTION_LIST /end FUNCTION_LIST /begin REF_CHARACTERISTIC CalRegn01Inin00.SnsrMeasStrtTrigDly.Val /end REF_CHARACTERISTIC /begin REF_MEASUREMENT /end REF_MEASUREMENT /end GROUP
/begin GROUP CalRegn01Inin00.StHlthSigNormnHiCtrlrT.Val "MICROSAR RTE" /begin SUB_GROUP /end SUB_GROUP /begin FUNCTION_LIST /end FUNCTION_LIST /begin REF_CHARACTERISTIC CalRegn01Inin00.StHlthSigNormnHiCtrlrT.Val /end REF_CHARACTERISTIC /begin REF_MEASUREMENT /end REF_MEASUREMENT /end GROUP
/begin GROUP CalRegn01Inin00.StHlthSigNormnLoCtrlrT.Val "MICROSAR RTE" /begin SUB_GROUP /end SUB_GROUP /begin FUNCTION_LIST /end FUNCTION_LIST /begin REF_CHARACTERISTIC CalRegn01Inin00.StHlthSigNormnLoCtrlrT.Val /end REF_CHARACTERISTIC /begin REF_MEASUREMENT /end REF_MEASUREMENT /end GROUP
/begin GROUP CalRegn01Inin00.SysFricLrngAvrgFricFrq.Val "MICROSAR RTE" /begin SUB_GROUP /end SUB_GROUP /begin FUNCTION_LIST /end FUNCTION_LIST /begin REF_CHARACTERISTIC CalRegn01Inin00.SysFricLrngAvrgFricFrq.Val /end REF_CHARACTERISTIC /begin REF_MEASUREMENT /end REF_MEASUREMENT /end GROUP
/begin GROUP CalRegn01Inin00.SysFricLrngBasLineEolFric.Val "MICROSAR RTE" /begin SUB_GROUP /end SUB_GROUP /begin FUNCTION_LIST /end FUNCTION_LIST /begin REF_CHARACTERISTIC CalRegn01Inin00.SysFricLrngBasLineEolFric.Val /end REF_CHARACTERISTIC /begin REF_MEASUREMENT /end REF_MEASUREMENT /end GROUP
/begin GROUP CalRegn01Inin00.SysFricLrngBasLineFric.Ary1D "MICROSAR RTE" /begin SUB_GROUP /end SUB_GROUP /begin FUNCTION_LIST /end FUNCTION_LIST /begin REF_CHARACTERISTIC CalRegn01Inin00.SysFricLrngBasLineFric.Ary1D /end REF_CHARACTERISTIC /begin REF_MEASUREMENT /end REF_MEASUREMENT /end GROUP
/begin GROUP CalRegn01Inin00.SysFricLrngBasLineHys.Ary2D "MICROSAR RTE" /begin SUB_GROUP /end SUB_GROUP /begin FUNCTION_LIST /end FUNCTION_LIST /begin REF_CHARACTERISTIC CalRegn01Inin00.SysFricLrngBasLineHys.Ary2D /end REF_CHARACTERISTIC /begin REF_MEASUREMENT /end REF_MEASUREMENT /end GROUP
/begin GROUP CalRegn01Inin00.SysFricLrngBasLineRngCntr.Ary2D "MICROSAR RTE" /begin SUB_GROUP /end SUB_GROUP /begin FUNCTION_LIST /end FUNCTION_LIST /begin REF_CHARACTERISTIC CalRegn01Inin00.SysFricLrngBasLineRngCntr.Ary2D /end REF_CHARACTERISTIC /begin REF_MEASUREMENT /end REF_MEASUREMENT /end GROUP
/begin GROUP CalRegn01Inin00.SysFricLrngDataPrepLpFilFrq.Val "MICROSAR RTE" /begin SUB_GROUP /end SUB_GROUP /begin FUNCTION_LIST /end FUNCTION_LIST /begin REF_CHARACTERISTIC CalRegn01Inin00.SysFricLrngDataPrepLpFilFrq.Val /end REF_CHARACTERISTIC /begin REF_MEASUREMENT /end REF_MEASUREMENT /end GROUP
/begin GROUP CalRegn01Inin00.SysFricLrngEolFricDifHiLim.Val "MICROSAR RTE" /begin SUB_GROUP /end SUB_GROUP /begin FUNCTION_LIST /end FUNCTION_LIST /begin REF_CHARACTERISTIC CalRegn01Inin00.SysFricLrngEolFricDifHiLim.Val /end REF_CHARACTERISTIC /begin REF_MEASUREMENT /end REF_MEASUREMENT /end GROUP
/begin GROUP CalRegn01Inin00.SysFricLrngEolFricDifLoLim.Val "MICROSAR RTE" /begin SUB_GROUP /end SUB_GROUP /begin FUNCTION_LIST /end FUNCTION_LIST /begin REF_CHARACTERISTIC CalRegn01Inin00.SysFricLrngEolFricDifLoLim.Val /end REF_CHARACTERISTIC /begin REF_MEASUREMENT /end REF_MEASUREMENT /end GROUP
/begin GROUP CalRegn01Inin00.SysFricLrngEolFricDifScagFac.Val "MICROSAR RTE" /begin SUB_GROUP /end SUB_GROUP /begin FUNCTION_LIST /end FUNCTION_LIST /begin REF_CHARACTERISTIC CalRegn01Inin00.SysFricLrngEolFricDifScagFac.Val /end REF_CHARACTERISTIC /begin REF_MEASUREMENT /end REF_MEASUREMENT /end GROUP
/begin GROUP CalRegn01Inin00.SysFricLrngFricChgWght.Ary1D "MICROSAR RTE" /begin SUB_GROUP /end SUB_GROUP /begin FUNCTION_LIST /end FUNCTION_LIST /begin REF_CHARACTERISTIC CalRegn01Inin00.SysFricLrngFricChgWght.Ary1D /end REF_CHARACTERISTIC /begin REF_MEASUREMENT /end REF_MEASUREMENT /end GROUP
/begin GROUP CalRegn01Inin00.SysFricLrngFricDiagcThd.Val "MICROSAR RTE" /begin SUB_GROUP /end SUB_GROUP /begin FUNCTION_LIST /end FUNCTION_LIST /begin REF_CHARACTERISTIC CalRegn01Inin00.SysFricLrngFricDiagcThd.Val /end REF_CHARACTERISTIC /begin REF_MEASUREMENT /end REF_MEASUREMENT /end GROUP
/begin GROUP CalRegn01Inin00.SysFricLrngFricDiagcTiThd.Val "MICROSAR RTE" /begin SUB_GROUP /end SUB_GROUP /begin FUNCTION_LIST /end FUNCTION_LIST /begin REF_CHARACTERISTIC CalRegn01Inin00.SysFricLrngFricDiagcTiThd.Val /end REF_CHARACTERISTIC /begin REF_MEASUREMENT /end REF_MEASUREMENT /end GROUP
/begin GROUP CalRegn01Inin00.SysFricLrngFricHysHwAgPt.Ary1D "MICROSAR RTE" /begin SUB_GROUP /end SUB_GROUP /begin FUNCTION_LIST /end FUNCTION_LIST /begin REF_CHARACTERISTIC CalRegn01Inin00.SysFricLrngFricHysHwAgPt.Ary1D /end REF_CHARACTERISTIC /begin REF_MEASUREMENT /end REF_MEASUREMENT /end GROUP
/begin GROUP CalRegn01Inin00.SysFricLrngFricOffs.Val "MICROSAR RTE" /begin SUB_GROUP /end SUB_GROUP /begin FUNCTION_LIST /end FUNCTION_LIST /begin REF_CHARACTERISTIC CalRegn01Inin00.SysFricLrngFricOffs.Val /end REF_CHARACTERISTIC /begin REF_MEASUREMENT /end REF_MEASUREMENT /end GROUP
/begin GROUP CalRegn01Inin00.SysFricLrngFricOffsHiLim.Val "MICROSAR RTE" /begin SUB_GROUP /end SUB_GROUP /begin FUNCTION_LIST /end FUNCTION_LIST /begin REF_CHARACTERISTIC CalRegn01Inin00.SysFricLrngFricOffsHiLim.Val /end REF_CHARACTERISTIC /begin REF_MEASUREMENT /end REF_MEASUREMENT /end GROUP
/begin GROUP CalRegn01Inin00.SysFricLrngFricOffsLoLim.Val "MICROSAR RTE" /begin SUB_GROUP /end SUB_GROUP /begin FUNCTION_LIST /end FUNCTION_LIST /begin REF_CHARACTERISTIC CalRegn01Inin00.SysFricLrngFricOffsLoLim.Val /end REF_CHARACTERISTIC /begin REF_MEASUREMENT /end REF_MEASUREMENT /end GROUP
/begin GROUP CalRegn01Inin00.SysFricLrngFricOffsLpFilFrq.Val "MICROSAR RTE" /begin SUB_GROUP /end SUB_GROUP /begin FUNCTION_LIST /end FUNCTION_LIST /begin REF_CHARACTERISTIC CalRegn01Inin00.SysFricLrngFricOffsLpFilFrq.Val /end REF_CHARACTERISTIC /begin REF_MEASUREMENT /end REF_MEASUREMENT /end GROUP
/begin GROUP CalRegn01Inin00.SysFricLrngGain.Val "MICROSAR RTE" /begin SUB_GROUP /end SUB_GROUP /begin FUNCTION_LIST /end FUNCTION_LIST /begin REF_CHARACTERISTIC CalRegn01Inin00.SysFricLrngGain.Val /end REF_CHARACTERISTIC /begin REF_MEASUREMENT /end REF_MEASUREMENT /end GROUP
/begin GROUP CalRegn01Inin00.SysFricLrngHwPosnAuthyThd.Val "MICROSAR RTE" /begin SUB_GROUP /end SUB_GROUP /begin FUNCTION_LIST /end FUNCTION_LIST /begin REF_CHARACTERISTIC CalRegn01Inin00.SysFricLrngHwPosnAuthyThd.Val /end REF_CHARACTERISTIC /begin REF_MEASUREMENT /end REF_MEASUREMENT /end GROUP
/begin GROUP CalRegn01Inin00.SysFricLrngHwVelConstrLim.Val "MICROSAR RTE" /begin SUB_GROUP /end SUB_GROUP /begin FUNCTION_LIST /end FUNCTION_LIST /begin REF_CHARACTERISTIC CalRegn01Inin00.SysFricLrngHwVelConstrLim.Val /end REF_CHARACTERISTIC /begin REF_MEASUREMENT /end REF_MEASUREMENT /end GROUP
/begin GROUP CalRegn01Inin00.SysFricLrngHwVelHiLim.Val "MICROSAR RTE" /begin SUB_GROUP /end SUB_GROUP /begin FUNCTION_LIST /end FUNCTION_LIST /begin REF_CHARACTERISTIC CalRegn01Inin00.SysFricLrngHwVelHiLim.Val /end REF_CHARACTERISTIC /begin REF_MEASUREMENT /end REF_MEASUREMENT /end GROUP
/begin GROUP CalRegn01Inin00.SysFricLrngHwVelLoLim.Val "MICROSAR RTE" /begin SUB_GROUP /end SUB_GROUP /begin FUNCTION_LIST /end FUNCTION_LIST /begin REF_CHARACTERISTIC CalRegn01Inin00.SysFricLrngHwVelLoLim.Val /end REF_CHARACTERISTIC /begin REF_MEASUREMENT /end REF_MEASUREMENT /end GROUP
/begin GROUP CalRegn01Inin00.SysFricLrngIgnCycFricChgLim.Val "MICROSAR RTE" /begin SUB_GROUP /end SUB_GROUP /begin FUNCTION_LIST /end FUNCTION_LIST /begin REF_CHARACTERISTIC CalRegn01Inin00.SysFricLrngIgnCycFricChgLim.Val /end REF_CHARACTERISTIC /begin REF_MEASUREMENT /end REF_MEASUREMENT /end GROUP
/begin GROUP CalRegn01Inin00.SysFricLrngIvsTrsmRatX.Ary1D "MICROSAR RTE" /begin SUB_GROUP /end SUB_GROUP /begin FUNCTION_LIST /end FUNCTION_LIST /begin REF_CHARACTERISTIC CalRegn01Inin00.SysFricLrngIvsTrsmRatX.Ary1D /end REF_CHARACTERISTIC /begin REF_MEASUREMENT /end REF_MEASUREMENT /end GROUP
/begin GROUP CalRegn01Inin00.SysFricLrngIvsTrsmRatY.Ary1D "MICROSAR RTE" /begin SUB_GROUP /end SUB_GROUP /begin FUNCTION_LIST /end FUNCTION_LIST /begin REF_CHARACTERISTIC CalRegn01Inin00.SysFricLrngIvsTrsmRatY.Ary1D /end REF_CHARACTERISTIC /begin REF_MEASUREMENT /end REF_MEASUREMENT /end GROUP
/begin GROUP CalRegn01Inin00.SysFricLrngLatAHiLim.Val "MICROSAR RTE" /begin SUB_GROUP /end SUB_GROUP /begin FUNCTION_LIST /end FUNCTION_LIST /begin REF_CHARACTERISTIC CalRegn01Inin00.SysFricLrngLatAHiLim.Val /end REF_CHARACTERISTIC /begin REF_MEASUREMENT /end REF_MEASUREMENT /end GROUP
/begin GROUP CalRegn01Inin00.SysFricLrngLatALoLim.Val "MICROSAR RTE" /begin SUB_GROUP /end SUB_GROUP /begin FUNCTION_LIST /end FUNCTION_LIST /begin REF_CHARACTERISTIC CalRegn01Inin00.SysFricLrngLatALoLim.Val /end REF_CHARACTERISTIC /begin REF_MEASUREMENT /end REF_MEASUREMENT /end GROUP
/begin GROUP CalRegn01Inin00.SysFricLrngMaskVehSpd.Ary1D "MICROSAR RTE" /begin SUB_GROUP /end SUB_GROUP /begin FUNCTION_LIST /end FUNCTION_LIST /begin REF_CHARACTERISTIC CalRegn01Inin00.SysFricLrngMaskVehSpd.Ary1D /end REF_CHARACTERISTIC /begin REF_MEASUREMENT /end REF_MEASUREMENT /end GROUP
/begin GROUP CalRegn01Inin00.SysFricLrngRngCntrThd.Val "MICROSAR RTE" /begin SUB_GROUP /end SUB_GROUP /begin FUNCTION_LIST /end FUNCTION_LIST /begin REF_CHARACTERISTIC CalRegn01Inin00.SysFricLrngRngCntrThd.Val /end REF_CHARACTERISTIC /begin REF_MEASUREMENT /end REF_MEASUREMENT /end GROUP
/begin GROUP CalRegn01Inin00.SysFricLrngTHiLim.Val "MICROSAR RTE" /begin SUB_GROUP /end SUB_GROUP /begin FUNCTION_LIST /end FUNCTION_LIST /begin REF_CHARACTERISTIC CalRegn01Inin00.SysFricLrngTHiLim.Val /end REF_CHARACTERISTIC /begin REF_MEASUREMENT /end REF_MEASUREMENT /end GROUP
/begin GROUP CalRegn01Inin00.SysFricLrngTLoLim.Val "MICROSAR RTE" /begin SUB_GROUP /end SUB_GROUP /begin FUNCTION_LIST /end FUNCTION_LIST /begin REF_CHARACTERISTIC CalRegn01Inin00.SysFricLrngTLoLim.Val /end REF_CHARACTERISTIC /begin REF_MEASUREMENT /end REF_MEASUREMENT /end GROUP
/begin GROUP CalRegn01Inin00.SysFricLrngThd.Val "MICROSAR RTE" /begin SUB_GROUP /end SUB_GROUP /begin FUNCTION_LIST /end FUNCTION_LIST /begin REF_CHARACTERISTIC CalRegn01Inin00.SysFricLrngThd.Val /end REF_CHARACTERISTIC /begin REF_MEASUREMENT /end REF_MEASUREMENT /end GROUP
/begin GROUP CalRegn01Inin00.SysFricLrngVehSpd.Ary2D "MICROSAR RTE" /begin SUB_GROUP /end SUB_GROUP /begin FUNCTION_LIST /end FUNCTION_LIST /begin REF_CHARACTERISTIC CalRegn01Inin00.SysFricLrngVehSpd.Ary2D /end REF_CHARACTERISTIC /begin REF_MEASUREMENT /end REF_MEASUREMENT /end GROUP
/begin GROUP CalRegn01Inin00.SysGlbPrmMotPoleCnt.Val "MICROSAR RTE" /begin SUB_GROUP /end SUB_GROUP /begin FUNCTION_LIST /end FUNCTION_LIST /begin REF_CHARACTERISTIC CalRegn01Inin00.SysGlbPrmMotPoleCnt.Val /end REF_CHARACTERISTIC /begin REF_MEASUREMENT /end REF_MEASUREMENT /end GROUP
/begin GROUP CalRegn01Inin00.SysGlbPrmTorsBarStfn.Val "MICROSAR RTE" /begin SUB_GROUP /end SUB_GROUP /begin FUNCTION_LIST /end FUNCTION_LIST /begin REF_CHARACTERISTIC CalRegn01Inin00.SysGlbPrmTorsBarStfn.Val /end REF_CHARACTERISTIC /begin REF_MEASUREMENT /end REF_MEASUREMENT /end GROUP
/begin GROUP CalRegn01Inin00.TEstimnAmbPwrMplr.Val "MICROSAR RTE" /begin SUB_GROUP /end SUB_GROUP /begin FUNCTION_LIST /end FUNCTION_LIST /begin REF_CHARACTERISTIC CalRegn01Inin00.TEstimnAmbPwrMplr.Val /end REF_CHARACTERISTIC /begin REF_MEASUREMENT /end REF_MEASUREMENT /end GROUP
/begin GROUP CalRegn01Inin00.TEstimnAmbTSca.Val "MICROSAR RTE" /begin SUB_GROUP /end SUB_GROUP /begin FUNCTION_LIST /end FUNCTION_LIST /begin REF_CHARACTERISTIC CalRegn01Inin00.TEstimnAmbTSca.Val /end REF_CHARACTERISTIC /begin REF_MEASUREMENT /end REF_MEASUREMENT /end GROUP
/begin GROUP CalRegn01Inin00.TEstimnAssiMechAmbLpFilFrq.Val "MICROSAR RTE" /begin SUB_GROUP /end SUB_GROUP /begin FUNCTION_LIST /end FUNCTION_LIST /begin REF_CHARACTERISTIC CalRegn01Inin00.TEstimnAssiMechAmbLpFilFrq.Val /end REF_CHARACTERISTIC /begin REF_MEASUREMENT /end REF_MEASUREMENT /end GROUP
/begin GROUP CalRegn01Inin00.TEstimnAssiMechAmbMplr.Val "MICROSAR RTE" /begin SUB_GROUP /end SUB_GROUP /begin FUNCTION_LIST /end FUNCTION_LIST /begin REF_CHARACTERISTIC CalRegn01Inin00.TEstimnAssiMechAmbMplr.Val /end REF_CHARACTERISTIC /begin REF_MEASUREMENT /end REF_MEASUREMENT /end GROUP
/begin GROUP CalRegn01Inin00.TEstimnAssiMechCorrLim.Val "MICROSAR RTE" /begin SUB_GROUP /end SUB_GROUP /begin FUNCTION_LIST /end FUNCTION_LIST /begin REF_CHARACTERISTIC CalRegn01Inin00.TEstimnAssiMechCorrLim.Val /end REF_CHARACTERISTIC /begin REF_MEASUREMENT /end REF_MEASUREMENT /end GROUP
/begin GROUP CalRegn01Inin00.TEstimnAssiMechDampgSca.Val "MICROSAR RTE" /begin SUB_GROUP /end SUB_GROUP /begin FUNCTION_LIST /end FUNCTION_LIST /begin REF_CHARACTERISTIC CalRegn01Inin00.TEstimnAssiMechDampgSca.Val /end REF_CHARACTERISTIC /begin REF_MEASUREMENT /end REF_MEASUREMENT /end GROUP
/begin GROUP CalRegn01Inin00.TEstimnAssiMechDftT.Val "MICROSAR RTE" /begin SUB_GROUP /end SUB_GROUP /begin FUNCTION_LIST /end FUNCTION_LIST /begin REF_CHARACTERISTIC CalRegn01Inin00.TEstimnAssiMechDftT.Val /end REF_CHARACTERISTIC /begin REF_MEASUREMENT /end REF_MEASUREMENT /end GROUP
/begin GROUP CalRegn01Inin00.TEstimnAssiMechLLFilCoeffA1.Val "MICROSAR RTE" /begin SUB_GROUP /end SUB_GROUP /begin FUNCTION_LIST /end FUNCTION_LIST /begin REF_CHARACTERISTIC CalRegn01Inin00.TEstimnAssiMechLLFilCoeffA1.Val /end REF_CHARACTERISTIC /begin REF_MEASUREMENT /end REF_MEASUREMENT /end GROUP
/begin GROUP CalRegn01Inin00.TEstimnAssiMechLLFilCoeffB0.Val "MICROSAR RTE" /begin SUB_GROUP /end SUB_GROUP /begin FUNCTION_LIST /end FUNCTION_LIST /begin REF_CHARACTERISTIC CalRegn01Inin00.TEstimnAssiMechLLFilCoeffB0.Val /end REF_CHARACTERISTIC /begin REF_MEASUREMENT /end REF_MEASUREMENT /end GROUP
/begin GROUP CalRegn01Inin00.TEstimnAssiMechLLFilCoeffB1.Val "MICROSAR RTE" /begin SUB_GROUP /end SUB_GROUP /begin FUNCTION_LIST /end FUNCTION_LIST /begin REF_CHARACTERISTIC CalRegn01Inin00.TEstimnAssiMechLLFilCoeffB1.Val /end REF_CHARACTERISTIC /begin REF_MEASUREMENT /end REF_MEASUREMENT /end GROUP
/begin GROUP CalRegn01Inin00.TEstimnAssiMechSlew.Val "MICROSAR RTE" /begin SUB_GROUP /end SUB_GROUP /begin FUNCTION_LIST /end FUNCTION_LIST /begin REF_CHARACTERISTIC CalRegn01Inin00.TEstimnAssiMechSlew.Val /end REF_CHARACTERISTIC /begin REF_MEASUREMENT /end REF_MEASUREMENT /end GROUP
/begin GROUP CalRegn01Inin00.TEstimnCorrnTAssiMech.Val "MICROSAR RTE" /begin SUB_GROUP /end SUB_GROUP /begin FUNCTION_LIST /end FUNCTION_LIST /begin REF_CHARACTERISTIC CalRegn01Inin00.TEstimnCorrnTAssiMech.Val /end REF_CHARACTERISTIC /begin REF_MEASUREMENT /end REF_MEASUREMENT /end GROUP
/begin GROUP CalRegn01Inin00.TEstimnCorrnTCu.Val "MICROSAR RTE" /begin SUB_GROUP /end SUB_GROUP /begin FUNCTION_LIST /end FUNCTION_LIST /begin REF_CHARACTERISTIC CalRegn01Inin00.TEstimnCorrnTCu.Val /end REF_CHARACTERISTIC /begin REF_MEASUREMENT /end REF_MEASUREMENT /end GROUP
/begin GROUP CalRegn01Inin00.TEstimnCorrnTMag.Val "MICROSAR RTE" /begin SUB_GROUP /end SUB_GROUP /begin FUNCTION_LIST /end FUNCTION_LIST /begin REF_CHARACTERISTIC CalRegn01Inin00.TEstimnCorrnTMag.Val /end REF_CHARACTERISTIC /begin REF_MEASUREMENT /end REF_MEASUREMENT /end GROUP
/begin GROUP CalRegn01Inin00.TEstimnCorrnTSi.Val "MICROSAR RTE" /begin SUB_GROUP /end SUB_GROUP /begin FUNCTION_LIST /end FUNCTION_LIST /begin REF_CHARACTERISTIC CalRegn01Inin00.TEstimnCorrnTSi.Val /end REF_CHARACTERISTIC /begin REF_MEASUREMENT /end REF_MEASUREMENT /end GROUP
/begin GROUP CalRegn01Inin00.TEstimnCuAmbLpFilFrq.Val "MICROSAR RTE" /begin SUB_GROUP /end SUB_GROUP /begin FUNCTION_LIST /end FUNCTION_LIST /begin REF_CHARACTERISTIC CalRegn01Inin00.TEstimnCuAmbLpFilFrq.Val /end REF_CHARACTERISTIC /begin REF_MEASUREMENT /end REF_MEASUREMENT /end GROUP
/begin GROUP CalRegn01Inin00.TEstimnCuAmbMplr.Val "MICROSAR RTE" /begin SUB_GROUP /end SUB_GROUP /begin FUNCTION_LIST /end FUNCTION_LIST /begin REF_CHARACTERISTIC CalRegn01Inin00.TEstimnCuAmbMplr.Val /end REF_CHARACTERISTIC /begin REF_MEASUREMENT /end REF_MEASUREMENT /end GROUP
/begin GROUP CalRegn01Inin00.TEstimnCuCorrnLim.Val "MICROSAR RTE" /begin SUB_GROUP /end SUB_GROUP /begin FUNCTION_LIST /end FUNCTION_LIST /begin REF_CHARACTERISTIC CalRegn01Inin00.TEstimnCuCorrnLim.Val /end REF_CHARACTERISTIC /begin REF_MEASUREMENT /end REF_MEASUREMENT /end GROUP
/begin GROUP CalRegn01Inin00.TEstimnCuLLFilCoeffA1.Val "MICROSAR RTE" /begin SUB_GROUP /end SUB_GROUP /begin FUNCTION_LIST /end FUNCTION_LIST /begin REF_CHARACTERISTIC CalRegn01Inin00.TEstimnCuLLFilCoeffA1.Val /end REF_CHARACTERISTIC /begin REF_MEASUREMENT /end REF_MEASUREMENT /end GROUP
/begin GROUP CalRegn01Inin00.TEstimnCuLLFilCoeffB0.Val "MICROSAR RTE" /begin SUB_GROUP /end SUB_GROUP /begin FUNCTION_LIST /end FUNCTION_LIST /begin REF_CHARACTERISTIC CalRegn01Inin00.TEstimnCuLLFilCoeffB0.Val /end REF_CHARACTERISTIC /begin REF_MEASUREMENT /end REF_MEASUREMENT /end GROUP
/begin GROUP CalRegn01Inin00.TEstimnCuLLFilCoeffB1.Val "MICROSAR RTE" /begin SUB_GROUP /end SUB_GROUP /begin FUNCTION_LIST /end FUNCTION_LIST /begin REF_CHARACTERISTIC CalRegn01Inin00.TEstimnCuLLFilCoeffB1.Val /end REF_CHARACTERISTIC /begin REF_MEASUREMENT /end REF_MEASUREMENT /end GROUP
/begin GROUP CalRegn01Inin00.TEstimnEngTSca.Val "MICROSAR RTE" /begin SUB_GROUP /end SUB_GROUP /begin FUNCTION_LIST /end FUNCTION_LIST /begin REF_CHARACTERISTIC CalRegn01Inin00.TEstimnEngTSca.Val /end REF_CHARACTERISTIC /begin REF_MEASUREMENT /end REF_MEASUREMENT /end GROUP
/begin GROUP CalRegn01Inin00.TEstimnMagAmbLpFilFrq.Val "MICROSAR RTE" /begin SUB_GROUP /end SUB_GROUP /begin FUNCTION_LIST /end FUNCTION_LIST /begin REF_CHARACTERISTIC CalRegn01Inin00.TEstimnMagAmbLpFilFrq.Val /end REF_CHARACTERISTIC /begin REF_MEASUREMENT /end REF_MEASUREMENT /end GROUP
/begin GROUP CalRegn01Inin00.TEstimnMagCorrnLim.Val "MICROSAR RTE" /begin SUB_GROUP /end SUB_GROUP /begin FUNCTION_LIST /end FUNCTION_LIST /begin REF_CHARACTERISTIC CalRegn01Inin00.TEstimnMagCorrnLim.Val /end REF_CHARACTERISTIC /begin REF_MEASUREMENT /end REF_MEASUREMENT /end GROUP
/begin GROUP CalRegn01Inin00.TEstimnMagLLFilCoeffA1.Val "MICROSAR RTE" /begin SUB_GROUP /end SUB_GROUP /begin FUNCTION_LIST /end FUNCTION_LIST /begin REF_CHARACTERISTIC CalRegn01Inin00.TEstimnMagLLFilCoeffA1.Val /end REF_CHARACTERISTIC /begin REF_MEASUREMENT /end REF_MEASUREMENT /end GROUP
/begin GROUP CalRegn01Inin00.TEstimnMagLLFilCoeffB0.Val "MICROSAR RTE" /begin SUB_GROUP /end SUB_GROUP /begin FUNCTION_LIST /end FUNCTION_LIST /begin REF_CHARACTERISTIC CalRegn01Inin00.TEstimnMagLLFilCoeffB0.Val /end REF_CHARACTERISTIC /begin REF_MEASUREMENT /end REF_MEASUREMENT /end GROUP
/begin GROUP CalRegn01Inin00.TEstimnMagLLFilCoeffB1.Val "MICROSAR RTE" /begin SUB_GROUP /end SUB_GROUP /begin FUNCTION_LIST /end FUNCTION_LIST /begin REF_CHARACTERISTIC CalRegn01Inin00.TEstimnMagLLFilCoeffB1.Val /end REF_CHARACTERISTIC /begin REF_MEASUREMENT /end REF_MEASUREMENT /end GROUP
/begin GROUP CalRegn01Inin00.TEstimnSiAmbLpFilFrq.Val "MICROSAR RTE" /begin SUB_GROUP /end SUB_GROUP /begin FUNCTION_LIST /end FUNCTION_LIST /begin REF_CHARACTERISTIC CalRegn01Inin00.TEstimnSiAmbLpFilFrq.Val /end REF_CHARACTERISTIC /begin REF_MEASUREMENT /end REF_MEASUREMENT /end GROUP
/begin GROUP CalRegn01Inin00.TEstimnSiAmbMplr.Val "MICROSAR RTE" /begin SUB_GROUP /end SUB_GROUP /begin FUNCTION_LIST /end FUNCTION_LIST /begin REF_CHARACTERISTIC CalRegn01Inin00.TEstimnSiAmbMplr.Val /end REF_CHARACTERISTIC /begin REF_MEASUREMENT /end REF_MEASUREMENT /end GROUP
/begin GROUP CalRegn01Inin00.TEstimnSiCorrnLim.Val "MICROSAR RTE" /begin SUB_GROUP /end SUB_GROUP /begin FUNCTION_LIST /end FUNCTION_LIST /begin REF_CHARACTERISTIC CalRegn01Inin00.TEstimnSiCorrnLim.Val /end REF_CHARACTERISTIC /begin REF_MEASUREMENT /end REF_MEASUREMENT /end GROUP
/begin GROUP CalRegn01Inin00.TEstimnSiLLFilCoeffA1.Val "MICROSAR RTE" /begin SUB_GROUP /end SUB_GROUP /begin FUNCTION_LIST /end FUNCTION_LIST /begin REF_CHARACTERISTIC CalRegn01Inin00.TEstimnSiLLFilCoeffA1.Val /end REF_CHARACTERISTIC /begin REF_MEASUREMENT /end REF_MEASUREMENT /end GROUP
/begin GROUP CalRegn01Inin00.TEstimnSiLLFilCoeffB0.Val "MICROSAR RTE" /begin SUB_GROUP /end SUB_GROUP /begin FUNCTION_LIST /end FUNCTION_LIST /begin REF_CHARACTERISTIC CalRegn01Inin00.TEstimnSiLLFilCoeffB0.Val /end REF_CHARACTERISTIC /begin REF_MEASUREMENT /end REF_MEASUREMENT /end GROUP
/begin GROUP CalRegn01Inin00.TEstimnSiLLFilCoeffB1.Val "MICROSAR RTE" /begin SUB_GROUP /end SUB_GROUP /begin FUNCTION_LIST /end FUNCTION_LIST /begin REF_CHARACTERISTIC CalRegn01Inin00.TEstimnSiLLFilCoeffB1.Val /end REF_CHARACTERISTIC /begin REF_MEASUREMENT /end REF_MEASUREMENT /end GROUP
/begin GROUP CalRegn01Inin00.TEstimnWghtAvrgTDi.Logl "MICROSAR RTE" /begin SUB_GROUP /end SUB_GROUP /begin FUNCTION_LIST /end FUNCTION_LIST /begin REF_CHARACTERISTIC CalRegn01Inin00.TEstimnWghtAvrgTDi.Logl /end REF_CHARACTERISTIC /begin REF_MEASUREMENT /end REF_MEASUREMENT /end GROUP
/begin GROUP CalRegn01Inin00.TunSelnAuthyVehSpdX.Ary1D "MICROSAR RTE" /begin SUB_GROUP /end SUB_GROUP /begin FUNCTION_LIST /end FUNCTION_LIST /begin REF_CHARACTERISTIC CalRegn01Inin00.TunSelnAuthyVehSpdX.Ary1D /end REF_CHARACTERISTIC /begin REF_MEASUREMENT /end REF_MEASUREMENT /end GROUP
/begin GROUP CalRegn01Inin00.VehSigCdngLatASlewRate.Val "MICROSAR RTE" /begin SUB_GROUP /end SUB_GROUP /begin FUNCTION_LIST /end FUNCTION_LIST /begin REF_CHARACTERISTIC CalRegn01Inin00.VehSigCdngLatASlewRate.Val /end REF_CHARACTERISTIC /begin REF_MEASUREMENT /end REF_MEASUREMENT /end GROUP
/begin GROUP CalRegn01Inin00.VehSigCdngLtgASlewRate.Val "MICROSAR RTE" /begin SUB_GROUP /end SUB_GROUP /begin FUNCTION_LIST /end FUNCTION_LIST /begin REF_CHARACTERISTIC CalRegn01Inin00.VehSigCdngLtgASlewRate.Val /end REF_CHARACTERISTIC /begin REF_MEASUREMENT /end REF_MEASUREMENT /end GROUP
/begin GROUP CalRegn01Inin00.VehSigCdngVehSpdSlewRate.Val "MICROSAR RTE" /begin SUB_GROUP /end SUB_GROUP /begin FUNCTION_LIST /end FUNCTION_LIST /begin REF_CHARACTERISTIC CalRegn01Inin00.VehSigCdngVehSpdSlewRate.Val /end REF_CHARACTERISTIC /begin REF_MEASUREMENT /end REF_MEASUREMENT /end GROUP
/begin GROUP CalRegn01Inin00.WhlImbRejctnDcTrendFltRcvryThd.Val "MICROSAR RTE" /begin SUB_GROUP /end SUB_GROUP /begin FUNCTION_LIST /end FUNCTION_LIST /begin REF_CHARACTERISTIC CalRegn01Inin00.WhlImbRejctnDcTrendFltRcvryThd.Val /end REF_CHARACTERISTIC /begin REF_MEASUREMENT /end REF_MEASUREMENT /end GROUP
/begin GROUP CalRegn01Inin00GroupB "MICROSAR RTE" /begin SUB_GROUP CalRegn01Inin00GroupB.CalibrationPorts /end SUB_GROUP /begin FUNCTION_LIST /end FUNCTION_LIST /begin REF_CHARACTERISTIC /end REF_CHARACTERISTIC /begin REF_MEASUREMENT /end REF_MEASUREMENT /end GROUP
/begin GROUP CalRegn01Inin00GroupB.CalibrationPorts "MICROSAR RTE"
 /begin SUB_GROUP CalRegn01Inin00GroupB.GmRoadWhlInQlfrMaxAllwblFrq.Val CalRegn01Inin00GroupB.GmRoadWhlInQlfrMaxFrqChg.Val CalRegn01Inin00GroupB.WhlImbRejctnDcTrendFltRcvryNegStep.Val CalRegn01Inin00GroupB.WhlImbRejctnDcTrendFltRcvryPosStep.Val CalRegn01Inin00GroupB.WhlImbRejctnFrqDiagcAmpThd.Val CalRegn01Inin00GroupB.WhlImbRejctnFrqDiagcFltRcvryNegStep.Val CalRegn01Inin00GroupB.WhlImbRejctnFrqDiagcFltRcvryPosStep.Val CalRegn01Inin00GroupB.WhlImbRejctnFrqDiagcFltRcvryThd.Val CalRegn01Inin00GroupB.WhlImbRejctnFrqDiagcThd.Val CalRegn01Inin00GroupB.WhlImbRejctnFrqDiagcTout.Val CalRegn01Inin00GroupB.WhlImbRejctnMaxMgnFltNegStep.Val CalRegn01Inin00GroupB.WhlImbRejctnMaxMgnFltPosStep.Val CalRegn01Inin00GroupB.WhlImbRejctnMaxMgnFltRcvryNegStep.Val CalRegn01Inin00GroupB.WhlImbRejctnMaxMgnFltRcvryPosStep.Val CalRegn01Inin00GroupB.WhlImbRejctnMaxMgnFltRcvryThd.Val CalRegn01Inin00GroupB.WhlImbRejctnMaxMgnFltThd.Val CalRegn01Inin00GroupB.WhlImbRejctnWhlSpdCorrlnFltRcvryNegStep.Val CalRegn01Inin00GroupB.WhlImbRejctnWhlSpdCorrlnFltRcvryPosStep.Val CalRegn01Inin00GroupB.WhlImbRejctnWhlSpdCorrlnFltRcvryThd.Val /end SUB_GROUP
 /begin FUNCTION_LIST /end FUNCTION_LIST
 /begin REF_CHARACTERISTIC /end REF_CHARACTERISTIC
 /begin REF_MEASUREMENT /end REF_MEASUREMENT
/end GROUP
/begin GROUP CalRegn01Inin00GroupB.GmRoadWhlInQlfrMaxAllwblFrq.Val "MICROSAR RTE" /begin SUB_GROUP /end SUB_GROUP /begin FUNCTION_LIST /end FUNCTION_LIST /begin REF_CHARACTERISTIC CalRegn01Inin00GroupB.GmRoadWhlInQlfrMaxAllwblFrq.Val /end REF_CHARACTERISTIC /begin REF_MEASUREMENT /end REF_MEASUREMENT /end GROUP
/begin GROUP CalRegn01Inin00GroupB.GmRoadWhlInQlfrMaxFrqChg.Val "MICROSAR RTE" /begin SUB_GROUP /end SUB_GROUP /begin FUNCTION_LIST /end FUNCTION_LIST /begin REF_CHARACTERISTIC CalRegn01Inin00GroupB.GmRoadWhlInQlfrMaxFrqChg.Val /end REF_CHARACTERISTIC /begin REF_MEASUREMENT /end REF_MEASUREMENT /end GROUP
/begin GROUP CalRegn01Inin00GroupB.WhlImbRejctnDcTrendFltRcvryNegStep.Val "MICROSAR RTE" /begin SUB_GROUP /end SUB_GROUP /begin FUNCTION_LIST /end FUNCTION_LIST
 /begin REF_CHARACTERISTIC CalRegn01Inin00GroupB.WhlImbRejctnDcTrendFltRcvryNegStep.Val /end REF_CHARACTERISTIC
 /begin REF_MEASUREMENT /end REF_MEASUREMENT
/end GROUP
/begin GROUP CalRegn01Inin00GroupB.WhlImbRejctnDcTrendFltRcvryPosStep.Val "MICROSAR RTE" /begin SUB_GROUP /end SUB_GROUP /begin FUNCTION_LIST /end FUNCTION_LIST
 /begin REF_CHARACTERISTIC CalRegn01Inin00GroupB.WhlImbRejctnDcTrendFltRcvryPosStep.Val /end REF_CHARACTERISTIC
 /begin REF_MEASUREMENT /end REF_MEASUREMENT
/end GROUP
/begin GROUP CalRegn01Inin00GroupB.WhlImbRejctnFrqDiagcAmpThd.Val "MICROSAR RTE" /begin SUB_GROUP /end SUB_GROUP /begin FUNCTION_LIST /end FUNCTION_LIST /begin REF_CHARACTERISTIC CalRegn01Inin00GroupB.WhlImbRejctnFrqDiagcAmpThd.Val /end REF_CHARACTERISTIC /begin REF_MEASUREMENT /end REF_MEASUREMENT /end GROUP
/begin GROUP CalRegn01Inin00GroupB.WhlImbRejctnFrqDiagcFltRcvryNegStep.Val "MICROSAR RTE" /begin SUB_GROUP /end SUB_GROUP /begin FUNCTION_LIST /end FUNCTION_LIST
 /begin REF_CHARACTERISTIC CalRegn01Inin00GroupB.WhlImbRejctnFrqDiagcFltRcvryNegStep.Val /end REF_CHARACTERISTIC
 /begin REF_MEASUREMENT /end REF_MEASUREMENT
/end GROUP
/begin GROUP CalRegn01Inin00GroupB.WhlImbRejctnFrqDiagcFltRcvryPosStep.Val "MICROSAR RTE" /begin SUB_GROUP /end SUB_GROUP /begin FUNCTION_LIST /end FUNCTION_LIST
 /begin REF_CHARACTERISTIC CalRegn01Inin00GroupB.WhlImbRejctnFrqDiagcFltRcvryPosStep.Val /end REF_CHARACTERISTIC
 /begin REF_MEASUREMENT /end REF_MEASUREMENT
/end GROUP
/begin GROUP CalRegn01Inin00GroupB.WhlImbRejctnFrqDiagcFltRcvryThd.Val "MICROSAR RTE" /begin SUB_GROUP /end SUB_GROUP /begin FUNCTION_LIST /end FUNCTION_LIST /begin REF_CHARACTERISTIC CalRegn01Inin00GroupB.WhlImbRejctnFrqDiagcFltRcvryThd.Val /end REF_CHARACTERISTIC /begin REF_MEASUREMENT /end REF_MEASUREMENT /end GROUP
/begin GROUP CalRegn01Inin00GroupB.WhlImbRejctnFrqDiagcThd.Val "MICROSAR RTE" /begin SUB_GROUP /end SUB_GROUP /begin FUNCTION_LIST /end FUNCTION_LIST /begin REF_CHARACTERISTIC CalRegn01Inin00GroupB.WhlImbRejctnFrqDiagcThd.Val /end REF_CHARACTERISTIC /begin REF_MEASUREMENT /end REF_MEASUREMENT /end GROUP
/begin GROUP CalRegn01Inin00GroupB.WhlImbRejctnFrqDiagcTout.Val "MICROSAR RTE" /begin SUB_GROUP /end SUB_GROUP /begin FUNCTION_LIST /end FUNCTION_LIST /begin REF_CHARACTERISTIC CalRegn01Inin00GroupB.WhlImbRejctnFrqDiagcTout.Val /end REF_CHARACTERISTIC /begin REF_MEASUREMENT /end REF_MEASUREMENT /end GROUP
/begin GROUP CalRegn01Inin00GroupB.WhlImbRejctnMaxMgnFltNegStep.Val "MICROSAR RTE" /begin SUB_GROUP /end SUB_GROUP /begin FUNCTION_LIST /end FUNCTION_LIST /begin REF_CHARACTERISTIC CalRegn01Inin00GroupB.WhlImbRejctnMaxMgnFltNegStep.Val /end REF_CHARACTERISTIC /begin REF_MEASUREMENT /end REF_MEASUREMENT /end GROUP
/begin GROUP CalRegn01Inin00GroupB.WhlImbRejctnMaxMgnFltPosStep.Val "MICROSAR RTE" /begin SUB_GROUP /end SUB_GROUP /begin FUNCTION_LIST /end FUNCTION_LIST /begin REF_CHARACTERISTIC CalRegn01Inin00GroupB.WhlImbRejctnMaxMgnFltPosStep.Val /end REF_CHARACTERISTIC /begin REF_MEASUREMENT /end REF_MEASUREMENT /end GROUP
/begin GROUP CalRegn01Inin00GroupB.WhlImbRejctnMaxMgnFltRcvryNegStep.Val "MICROSAR RTE" /begin SUB_GROUP /end SUB_GROUP /begin FUNCTION_LIST /end FUNCTION_LIST
 /begin REF_CHARACTERISTIC CalRegn01Inin00GroupB.WhlImbRejctnMaxMgnFltRcvryNegStep.Val /end REF_CHARACTERISTIC
 /begin REF_MEASUREMENT /end REF_MEASUREMENT
/end GROUP
/begin GROUP CalRegn01Inin00GroupB.WhlImbRejctnMaxMgnFltRcvryPosStep.Val "MICROSAR RTE" /begin SUB_GROUP /end SUB_GROUP /begin FUNCTION_LIST /end FUNCTION_LIST
 /begin REF_CHARACTERISTIC CalRegn01Inin00GroupB.WhlImbRejctnMaxMgnFltRcvryPosStep.Val /end REF_CHARACTERISTIC
 /begin REF_MEASUREMENT /end REF_MEASUREMENT
/end GROUP
/begin GROUP CalRegn01Inin00GroupB.WhlImbRejctnMaxMgnFltRcvryThd.Val "MICROSAR RTE" /begin SUB_GROUP /end SUB_GROUP /begin FUNCTION_LIST /end FUNCTION_LIST /begin REF_CHARACTERISTIC CalRegn01Inin00GroupB.WhlImbRejctnMaxMgnFltRcvryThd.Val /end REF_CHARACTERISTIC /begin REF_MEASUREMENT /end REF_MEASUREMENT /end GROUP
/begin GROUP CalRegn01Inin00GroupB.WhlImbRejctnMaxMgnFltThd.Val "MICROSAR RTE" /begin SUB_GROUP /end SUB_GROUP /begin FUNCTION_LIST /end FUNCTION_LIST /begin REF_CHARACTERISTIC CalRegn01Inin00GroupB.WhlImbRejctnMaxMgnFltThd.Val /end REF_CHARACTERISTIC /begin REF_MEASUREMENT /end REF_MEASUREMENT /end GROUP
/begin GROUP CalRegn01Inin00GroupB.WhlImbRejctnWhlSpdCorrlnFltRcvryNegStep.Val "MICROSAR RTE" /begin SUB_GROUP /end SUB_GROUP /begin FUNCTION_LIST /end FUNCTION_LIST
 /begin REF_CHARACTERISTIC CalRegn01Inin00GroupB.WhlImbRejctnWhlSpdCorrlnFltRcvryNegStep.Val /end REF_CHARACTERISTIC
 /begin REF_MEASUREMENT /end REF_MEASUREMENT
/end GROUP
/begin GROUP CalRegn01Inin00GroupB.WhlImbRejctnWhlSpdCorrlnFltRcvryPosStep.Val "MICROSAR RTE" /begin SUB_GROUP /end SUB_GROUP /begin FUNCTION_LIST /end FUNCTION_LIST
 /begin REF_CHARACTERISTIC CalRegn01Inin00GroupB.WhlImbRejctnWhlSpdCorrlnFltRcvryPosStep.Val /end REF_CHARACTERISTIC
 /begin REF_MEASUREMENT /end REF_MEASUREMENT
/end GROUP
/begin GROUP CalRegn01Inin00GroupB.WhlImbRejctnWhlSpdCorrlnFltRcvryThd.Val "MICROSAR RTE" /begin SUB_GROUP /end SUB_GROUP /begin FUNCTION_LIST /end FUNCTION_LIST
 /begin REF_CHARACTERISTIC CalRegn01Inin00GroupB.WhlImbRejctnWhlSpdCorrlnFltRcvryThd.Val /end REF_CHARACTERISTIC
 /begin REF_MEASUREMENT /end REF_MEASUREMENT
/end GROUP
/begin GROUP CalRegn01Inin00GroupC "MICROSAR RTE" /begin SUB_GROUP CalRegn01Inin00GroupC.CalibrationPorts /end SUB_GROUP /begin FUNCTION_LIST /end FUNCTION_LIST /begin REF_CHARACTERISTIC /end REF_CHARACTERISTIC /begin REF_MEASUREMENT /end REF_MEASUREMENT /end GROUP
/begin GROUP CalRegn01Inin00GroupC.CalibrationPorts "MICROSAR RTE"
 /begin SUB_GROUP CalRegn01Inin00GroupC.EotProtnFwlEotDampgActvBndY.Ary2D CalRegn01Inin00GroupC.GmVehPwrModHwTqMinKeepAssi.Val CalRegn01Inin00GroupC.GmVehPwrModHwTqMinKeepTmr.Val CalRegn01Inin00GroupC.GmVehPwrModVehSpdAssiOnMin.Val CalRegn01Inin00GroupC.GmVehPwrModVehSpdMinKeepAssi.Val /end SUB_GROUP
 /begin FUNCTION_LIST /end FUNCTION_LIST
 /begin REF_CHARACTERISTIC /end REF_CHARACTERISTIC
 /begin REF_MEASUREMENT /end REF_MEASUREMENT
/end GROUP
/begin GROUP CalRegn01Inin00GroupC.EotProtnFwlEotDampgActvBndY.Ary2D "MICROSAR RTE" /begin SUB_GROUP /end SUB_GROUP /begin FUNCTION_LIST /end FUNCTION_LIST /begin REF_CHARACTERISTIC CalRegn01Inin00GroupC.EotProtnFwlEotDampgActvBndY.Ary2D /end REF_CHARACTERISTIC /begin REF_MEASUREMENT /end REF_MEASUREMENT /end GROUP
/begin GROUP CalRegn01Inin00GroupC.GmVehPwrModHwTqMinKeepAssi.Val "MICROSAR RTE" /begin SUB_GROUP /end SUB_GROUP /begin FUNCTION_LIST /end FUNCTION_LIST /begin REF_CHARACTERISTIC CalRegn01Inin00GroupC.GmVehPwrModHwTqMinKeepAssi.Val /end REF_CHARACTERISTIC /begin REF_MEASUREMENT /end REF_MEASUREMENT /end GROUP
/begin GROUP CalRegn01Inin00GroupC.GmVehPwrModHwTqMinKeepTmr.Val "MICROSAR RTE" /begin SUB_GROUP /end SUB_GROUP /begin FUNCTION_LIST /end FUNCTION_LIST /begin REF_CHARACTERISTIC CalRegn01Inin00GroupC.GmVehPwrModHwTqMinKeepTmr.Val /end REF_CHARACTERISTIC /begin REF_MEASUREMENT /end REF_MEASUREMENT /end GROUP
/begin GROUP CalRegn01Inin00GroupC.GmVehPwrModVehSpdAssiOnMin.Val "MICROSAR RTE" /begin SUB_GROUP /end SUB_GROUP /begin FUNCTION_LIST /end FUNCTION_LIST /begin REF_CHARACTERISTIC CalRegn01Inin00GroupC.GmVehPwrModVehSpdAssiOnMin.Val /end REF_CHARACTERISTIC /begin REF_MEASUREMENT /end REF_MEASUREMENT /end GROUP
/begin GROUP CalRegn01Inin00GroupC.GmVehPwrModVehSpdMinKeepAssi.Val "MICROSAR RTE" /begin SUB_GROUP /end SUB_GROUP /begin FUNCTION_LIST /end FUNCTION_LIST /begin REF_CHARACTERISTIC CalRegn01Inin00GroupC.GmVehPwrModVehSpdMinKeepAssi.Val /end REF_CHARACTERISTIC /begin REF_MEASUREMENT /end REF_MEASUREMENT /end GROUP
/begin GROUP CalRegn01Rt00 "MICROSAR RTE" /begin SUB_GROUP CalRegn01Rt00.CalibrationPorts /end SUB_GROUP /begin FUNCTION_LIST /end FUNCTION_LIST /begin REF_CHARACTERISTIC /end REF_CHARACTERISTIC /begin REF_MEASUREMENT /end REF_MEASUREMENT /end GROUP
/begin GROUP CalRegn01Rt00.CalibrationPorts "MICROSAR RTE"
 /begin SUB_GROUP CalRegn01Rt00.TEstimnMagAmbMplr.Val CalRegn01Rt00.TunSelnAuthyHwTqY.Ary1D CalRegn01Rt00.TunSelnAuthyHwVelY.Ary1D /end SUB_GROUP
 /begin FUNCTION_LIST /end FUNCTION_LIST
 /begin REF_CHARACTERISTIC /end REF_CHARACTERISTIC
 /begin REF_MEASUREMENT /end REF_MEASUREMENT
/end GROUP
/begin GROUP CalRegn01Rt00.TEstimnMagAmbMplr.Val "MICROSAR RTE" /begin SUB_GROUP /end SUB_GROUP /begin FUNCTION_LIST /end FUNCTION_LIST /begin REF_CHARACTERISTIC CalRegn01Rt00.TEstimnMagAmbMplr.Val /end REF_CHARACTERISTIC /begin REF_MEASUREMENT /end REF_MEASUREMENT /end GROUP
/begin GROUP CalRegn01Rt00.TunSelnAuthyHwTqY.Ary1D "MICROSAR RTE" /begin SUB_GROUP /end SUB_GROUP /begin FUNCTION_LIST /end FUNCTION_LIST /begin REF_CHARACTERISTIC CalRegn01Rt00.TunSelnAuthyHwTqY.Ary1D /end REF_CHARACTERISTIC /begin REF_MEASUREMENT /end REF_MEASUREMENT /end GROUP
/begin GROUP CalRegn01Rt00.TunSelnAuthyHwVelY.Ary1D "MICROSAR RTE" /begin SUB_GROUP /end SUB_GROUP /begin FUNCTION_LIST /end FUNCTION_LIST /begin REF_CHARACTERISTIC CalRegn01Rt00.TunSelnAuthyHwVelY.Ary1D /end REF_CHARACTERISTIC /begin REF_MEASUREMENT /end REF_MEASUREMENT /end GROUP
/begin GROUP CalRegn01Rt01 "MICROSAR RTE" /begin SUB_GROUP CalRegn01Rt01.CalibrationPorts /end SUB_GROUP /begin FUNCTION_LIST /end FUNCTION_LIST /begin REF_CHARACTERISTIC /end REF_CHARACTERISTIC /begin REF_MEASUREMENT /end REF_MEASUREMENT /end GROUP
/begin GROUP CalRegn01Rt01.CalibrationPorts "MICROSAR RTE"
 /begin SUB_GROUP CalRegn01Rt01.TEstimnMagAmbMplr.Val CalRegn01Rt01.TunSelnAuthyHwTqY.Ary1D CalRegn01Rt01.TunSelnAuthyHwVelY.Ary1D /end SUB_GROUP
 /begin FUNCTION_LIST /end FUNCTION_LIST
 /begin REF_CHARACTERISTIC /end REF_CHARACTERISTIC
 /begin REF_MEASUREMENT /end REF_MEASUREMENT
/end GROUP
/begin GROUP CalRegn01Rt01.TEstimnMagAmbMplr.Val "MICROSAR RTE" /begin SUB_GROUP /end SUB_GROUP /begin FUNCTION_LIST /end FUNCTION_LIST /begin REF_CHARACTERISTIC CalRegn01Rt01.TEstimnMagAmbMplr.Val /end REF_CHARACTERISTIC /begin REF_MEASUREMENT /end REF_MEASUREMENT /end GROUP
/begin GROUP CalRegn01Rt01.TunSelnAuthyHwTqY.Ary1D "MICROSAR RTE" /begin SUB_GROUP /end SUB_GROUP /begin FUNCTION_LIST /end FUNCTION_LIST /begin REF_CHARACTERISTIC CalRegn01Rt01.TunSelnAuthyHwTqY.Ary1D /end REF_CHARACTERISTIC /begin REF_MEASUREMENT /end REF_MEASUREMENT /end GROUP
/begin GROUP CalRegn01Rt01.TunSelnAuthyHwVelY.Ary1D "MICROSAR RTE" /begin SUB_GROUP /end SUB_GROUP /begin FUNCTION_LIST /end FUNCTION_LIST /begin REF_CHARACTERISTIC CalRegn01Rt01.TunSelnAuthyHwVelY.Ary1D /end REF_CHARACTERISTIC /begin REF_MEASUREMENT /end REF_MEASUREMENT /end GROUP
/begin GROUP CalRegn01Rt01_Dummy "MICROSAR RTE" /begin SUB_GROUP CalRegn01Rt01_Dummy.CalibrationPorts /end SUB_GROUP /begin FUNCTION_LIST /end FUNCTION_LIST /begin REF_CHARACTERISTIC /end REF_CHARACTERISTIC /begin REF_MEASUREMENT /end REF_MEASUREMENT /end GROUP
/begin GROUP CalRegn01Rt01_Dummy.CalibrationPorts "MICROSAR RTE"
 /begin SUB_GROUP CalRegn01Rt01_Dummy.TEstimnMagAmbMplr.Val CalRegn01Rt01_Dummy.TunSelnAuthyHwTqY.Ary1D CalRegn01Rt01_Dummy.TunSelnAuthyHwVelY.Ary1D /end SUB_GROUP
 /begin FUNCTION_LIST /end FUNCTION_LIST
 /begin REF_CHARACTERISTIC /end REF_CHARACTERISTIC
 /begin REF_MEASUREMENT /end REF_MEASUREMENT
/end GROUP
/begin GROUP CalRegn01Rt01_Dummy.TEstimnMagAmbMplr.Val "MICROSAR RTE" /begin SUB_GROUP /end SUB_GROUP /begin FUNCTION_LIST /end FUNCTION_LIST /begin REF_CHARACTERISTIC CalRegn01Rt01_Dummy.TEstimnMagAmbMplr.Val /end REF_CHARACTERISTIC /begin REF_MEASUREMENT /end REF_MEASUREMENT /end GROUP
/begin GROUP CalRegn01Rt01_Dummy.TunSelnAuthyHwTqY.Ary1D "MICROSAR RTE" /begin SUB_GROUP /end SUB_GROUP /begin FUNCTION_LIST /end FUNCTION_LIST /begin REF_CHARACTERISTIC CalRegn01Rt01_Dummy.TunSelnAuthyHwTqY.Ary1D /end REF_CHARACTERISTIC /begin REF_MEASUREMENT /end REF_MEASUREMENT /end GROUP
/begin GROUP CalRegn01Rt01_Dummy.TunSelnAuthyHwVelY.Ary1D "MICROSAR RTE" /begin SUB_GROUP /end SUB_GROUP /begin FUNCTION_LIST /end FUNCTION_LIST /begin REF_CHARACTERISTIC CalRegn01Rt01_Dummy.TunSelnAuthyHwVelY.Ary1D /end REF_CHARACTERISTIC /begin REF_MEASUREMENT /end REF_MEASUREMENT /end GROUP
/begin GROUP CalRegn01Rt01_Dummy_1 "MICROSAR RTE" /begin SUB_GROUP CalRegn01Rt01_Dummy_1.CalibrationPorts /end SUB_GROUP /begin FUNCTION_LIST /end FUNCTION_LIST /begin REF_CHARACTERISTIC /end REF_CHARACTERISTIC /begin REF_MEASUREMENT /end REF_MEASUREMENT /end GROUP
/begin GROUP CalRegn01Rt01_Dummy_1.CalibrationPorts "MICROSAR RTE"
 /begin SUB_GROUP CalRegn01Rt01_Dummy_1.TEstimnMagAmbMplr.Val CalRegn01Rt01_Dummy_1.TunSelnAuthyHwTqY.Ary1D CalRegn01Rt01_Dummy_1.TunSelnAuthyHwVelY.Ary1D /end SUB_GROUP
 /begin FUNCTION_LIST /end FUNCTION_LIST
 /begin REF_CHARACTERISTIC /end REF_CHARACTERISTIC
 /begin REF_MEASUREMENT /end REF_MEASUREMENT
/end GROUP
/begin GROUP CalRegn01Rt01_Dummy_1.TEstimnMagAmbMplr.Val "MICROSAR RTE" /begin SUB_GROUP /end SUB_GROUP /begin FUNCTION_LIST /end FUNCTION_LIST /begin REF_CHARACTERISTIC CalRegn01Rt01_Dummy_1.TEstimnMagAmbMplr.Val /end REF_CHARACTERISTIC /begin REF_MEASUREMENT /end REF_MEASUREMENT /end GROUP
/begin GROUP CalRegn01Rt01_Dummy_1.TunSelnAuthyHwTqY.Ary1D "MICROSAR RTE" /begin SUB_GROUP /end SUB_GROUP /begin FUNCTION_LIST /end FUNCTION_LIST /begin REF_CHARACTERISTIC CalRegn01Rt01_Dummy_1.TunSelnAuthyHwTqY.Ary1D /end REF_CHARACTERISTIC /begin REF_MEASUREMENT /end REF_MEASUREMENT /end GROUP
/begin GROUP CalRegn01Rt01_Dummy_1.TunSelnAuthyHwVelY.Ary1D "MICROSAR RTE" /begin SUB_GROUP /end SUB_GROUP /begin FUNCTION_LIST /end FUNCTION_LIST /begin REF_CHARACTERISTIC CalRegn01Rt01_Dummy_1.TunSelnAuthyHwVelY.Ary1D /end REF_CHARACTERISTIC /begin REF_MEASUREMENT /end REF_MEASUREMENT /end GROUP
/begin GROUP CalRegn01Rt01_Dummy_2 "MICROSAR RTE" /begin SUB_GROUP CalRegn01Rt01_Dummy_2.CalibrationPorts /end SUB_GROUP /begin FUNCTION_LIST /end FUNCTION_LIST /begin REF_CHARACTERISTIC /end REF_CHARACTERISTIC /begin REF_MEASUREMENT /end REF_MEASUREMENT /end GROUP
/begin GROUP CalRegn01Rt01_Dummy_2.CalibrationPorts "MICROSAR RTE"
 /begin SUB_GROUP CalRegn01Rt01_Dummy_2.TEstimnMagAmbMplr.Val CalRegn01Rt01_Dummy_2.TunSelnAuthyHwTqY.Ary1D CalRegn01Rt01_Dummy_2.TunSelnAuthyHwVelY.Ary1D /end SUB_GROUP
 /begin FUNCTION_LIST /end FUNCTION_LIST
 /begin REF_CHARACTERISTIC /end REF_CHARACTERISTIC
 /begin REF_MEASUREMENT /end REF_MEASUREMENT
/end GROUP
/begin GROUP CalRegn01Rt01_Dummy_2.TEstimnMagAmbMplr.Val "MICROSAR RTE" /begin SUB_GROUP /end SUB_GROUP /begin FUNCTION_LIST /end FUNCTION_LIST /begin REF_CHARACTERISTIC CalRegn01Rt01_Dummy_2.TEstimnMagAmbMplr.Val /end REF_CHARACTERISTIC /begin REF_MEASUREMENT /end REF_MEASUREMENT /end GROUP
/begin GROUP CalRegn01Rt01_Dummy_2.TunSelnAuthyHwTqY.Ary1D "MICROSAR RTE" /begin SUB_GROUP /end SUB_GROUP /begin FUNCTION_LIST /end FUNCTION_LIST /begin REF_CHARACTERISTIC CalRegn01Rt01_Dummy_2.TunSelnAuthyHwTqY.Ary1D /end REF_CHARACTERISTIC /begin REF_MEASUREMENT /end REF_MEASUREMENT /end GROUP
/begin GROUP CalRegn01Rt01_Dummy_2.TunSelnAuthyHwVelY.Ary1D "MICROSAR RTE" /begin SUB_GROUP /end SUB_GROUP /begin FUNCTION_LIST /end FUNCTION_LIST /begin REF_CHARACTERISTIC CalRegn01Rt01_Dummy_2.TunSelnAuthyHwVelY.Ary1D /end REF_CHARACTERISTIC /begin REF_MEASUREMENT /end REF_MEASUREMENT /end GROUP
/begin GROUP CalRegn01Rt01_Dummy_3 "MICROSAR RTE" /begin SUB_GROUP CalRegn01Rt01_Dummy_3.CalibrationPorts /end SUB_GROUP /begin FUNCTION_LIST /end FUNCTION_LIST /begin REF_CHARACTERISTIC /end REF_CHARACTERISTIC /begin REF_MEASUREMENT /end REF_MEASUREMENT /end GROUP
/begin GROUP CalRegn01Rt01_Dummy_3.CalibrationPorts "MICROSAR RTE"
 /begin SUB_GROUP CalRegn01Rt01_Dummy_3.TEstimnMagAmbMplr.Val CalRegn01Rt01_Dummy_3.TunSelnAuthyHwTqY.Ary1D CalRegn01Rt01_Dummy_3.TunSelnAuthyHwVelY.Ary1D /end SUB_GROUP
 /begin FUNCTION_LIST /end FUNCTION_LIST
 /begin REF_CHARACTERISTIC /end REF_CHARACTERISTIC
 /begin REF_MEASUREMENT /end REF_MEASUREMENT
/end GROUP
/begin GROUP CalRegn01Rt01_Dummy_3.TEstimnMagAmbMplr.Val "MICROSAR RTE" /begin SUB_GROUP /end SUB_GROUP /begin FUNCTION_LIST /end FUNCTION_LIST /begin REF_CHARACTERISTIC CalRegn01Rt01_Dummy_3.TEstimnMagAmbMplr.Val /end REF_CHARACTERISTIC /begin REF_MEASUREMENT /end REF_MEASUREMENT /end GROUP
/begin GROUP CalRegn01Rt01_Dummy_3.TunSelnAuthyHwTqY.Ary1D "MICROSAR RTE" /begin SUB_GROUP /end SUB_GROUP /begin FUNCTION_LIST /end FUNCTION_LIST /begin REF_CHARACTERISTIC CalRegn01Rt01_Dummy_3.TunSelnAuthyHwTqY.Ary1D /end REF_CHARACTERISTIC /begin REF_MEASUREMENT /end REF_MEASUREMENT /end GROUP
/begin GROUP CalRegn01Rt01_Dummy_3.TunSelnAuthyHwVelY.Ary1D "MICROSAR RTE" /begin SUB_GROUP /end SUB_GROUP /begin FUNCTION_LIST /end FUNCTION_LIST /begin REF_CHARACTERISTIC CalRegn01Rt01_Dummy_3.TunSelnAuthyHwVelY.Ary1D /end REF_CHARACTERISTIC /begin REF_MEASUREMENT /end REF_MEASUREMENT /end GROUP
/begin GROUP CalRegn01Rt01_Dummy_4 "MICROSAR RTE" /begin SUB_GROUP CalRegn01Rt01_Dummy_4.CalibrationPorts /end SUB_GROUP /begin FUNCTION_LIST /end FUNCTION_LIST /begin REF_CHARACTERISTIC /end REF_CHARACTERISTIC /begin REF_MEASUREMENT /end REF_MEASUREMENT /end GROUP
/begin GROUP CalRegn01Rt01_Dummy_4.CalibrationPorts "MICROSAR RTE"
 /begin SUB_GROUP CalRegn01Rt01_Dummy_4.TEstimnMagAmbMplr.Val CalRegn01Rt01_Dummy_4.TunSelnAuthyHwTqY.Ary1D CalRegn01Rt01_Dummy_4.TunSelnAuthyHwVelY.Ary1D /end SUB_GROUP
 /begin FUNCTION_LIST /end FUNCTION_LIST
 /begin REF_CHARACTERISTIC /end REF_CHARACTERISTIC
 /begin REF_MEASUREMENT /end REF_MEASUREMENT
/end GROUP
/begin GROUP CalRegn01Rt01_Dummy_4.TEstimnMagAmbMplr.Val "MICROSAR RTE" /begin SUB_GROUP /end SUB_GROUP /begin FUNCTION_LIST /end FUNCTION_LIST /begin REF_CHARACTERISTIC CalRegn01Rt01_Dummy_4.TEstimnMagAmbMplr.Val /end REF_CHARACTERISTIC /begin REF_MEASUREMENT /end REF_MEASUREMENT /end GROUP
/begin GROUP CalRegn01Rt01_Dummy_4.TunSelnAuthyHwTqY.Ary1D "MICROSAR RTE" /begin SUB_GROUP /end SUB_GROUP /begin FUNCTION_LIST /end FUNCTION_LIST /begin REF_CHARACTERISTIC CalRegn01Rt01_Dummy_4.TunSelnAuthyHwTqY.Ary1D /end REF_CHARACTERISTIC /begin REF_MEASUREMENT /end REF_MEASUREMENT /end GROUP
/begin GROUP CalRegn01Rt01_Dummy_4.TunSelnAuthyHwVelY.Ary1D "MICROSAR RTE" /begin SUB_GROUP /end SUB_GROUP /begin FUNCTION_LIST /end FUNCTION_LIST /begin REF_CHARACTERISTIC CalRegn01Rt01_Dummy_4.TunSelnAuthyHwVelY.Ary1D /end REF_CHARACTERISTIC /begin REF_MEASUREMENT /end REF_MEASUREMENT /end GROUP
/begin GROUP CalRegn01Rt02 "MICROSAR RTE" /begin SUB_GROUP CalRegn01Rt02.CalibrationPorts /end SUB_GROUP /begin FUNCTION_LIST /end FUNCTION_LIST /begin REF_CHARACTERISTIC /end REF_CHARACTERISTIC /begin REF_MEASUREMENT /end REF_MEASUREMENT /end GROUP
/begin GROUP CalRegn01Rt02.CalibrationPorts "MICROSAR RTE"
 /begin SUB_GROUP CalRegn01Rt02.TEstimnMagAmbMplr.Val CalRegn01Rt02.TunSelnAuthyHwTqY.Ary1D CalRegn01Rt02.TunSelnAuthyHwVelY.Ary1D /end SUB_GROUP
 /begin FUNCTION_LIST /end FUNCTION_LIST
 /begin REF_CHARACTERISTIC /end REF_CHARACTERISTIC
 /begin REF_MEASUREMENT /end REF_MEASUREMENT
/end GROUP
/begin GROUP CalRegn01Rt02.TEstimnMagAmbMplr.Val "MICROSAR RTE" /begin SUB_GROUP /end SUB_GROUP /begin FUNCTION_LIST /end FUNCTION_LIST /begin REF_CHARACTERISTIC CalRegn01Rt02.TEstimnMagAmbMplr.Val /end REF_CHARACTERISTIC /begin REF_MEASUREMENT /end REF_MEASUREMENT /end GROUP
/begin GROUP CalRegn01Rt02.TunSelnAuthyHwTqY.Ary1D "MICROSAR RTE" /begin SUB_GROUP /end SUB_GROUP /begin FUNCTION_LIST /end FUNCTION_LIST /begin REF_CHARACTERISTIC CalRegn01Rt02.TunSelnAuthyHwTqY.Ary1D /end REF_CHARACTERISTIC /begin REF_MEASUREMENT /end REF_MEASUREMENT /end GROUP
/begin GROUP CalRegn01Rt02.TunSelnAuthyHwVelY.Ary1D "MICROSAR RTE" /begin SUB_GROUP /end SUB_GROUP /begin FUNCTION_LIST /end FUNCTION_LIST /begin REF_CHARACTERISTIC CalRegn01Rt02.TunSelnAuthyHwVelY.Ary1D /end REF_CHARACTERISTIC /begin REF_MEASUREMENT /end REF_MEASUREMENT /end GROUP
/begin GROUP CalRegn01Rt03 "MICROSAR RTE" /begin SUB_GROUP CalRegn01Rt03.CalibrationPorts /end SUB_GROUP /begin FUNCTION_LIST /end FUNCTION_LIST /begin REF_CHARACTERISTIC /end REF_CHARACTERISTIC /begin REF_MEASUREMENT /end REF_MEASUREMENT /end GROUP
/begin GROUP CalRegn01Rt03.CalibrationPorts "MICROSAR RTE"
 /begin SUB_GROUP CalRegn01Rt03.TEstimnMagAmbMplr.Val CalRegn01Rt03.TunSelnAuthyHwTqY.Ary1D CalRegn01Rt03.TunSelnAuthyHwVelY.Ary1D /end SUB_GROUP
 /begin FUNCTION_LIST /end FUNCTION_LIST
 /begin REF_CHARACTERISTIC /end REF_CHARACTERISTIC
 /begin REF_MEASUREMENT /end REF_MEASUREMENT
/end GROUP
/begin GROUP CalRegn01Rt03.TEstimnMagAmbMplr.Val "MICROSAR RTE" /begin SUB_GROUP /end SUB_GROUP /begin FUNCTION_LIST /end FUNCTION_LIST /begin REF_CHARACTERISTIC CalRegn01Rt03.TEstimnMagAmbMplr.Val /end REF_CHARACTERISTIC /begin REF_MEASUREMENT /end REF_MEASUREMENT /end GROUP
/begin GROUP CalRegn01Rt03.TunSelnAuthyHwTqY.Ary1D "MICROSAR RTE" /begin SUB_GROUP /end SUB_GROUP /begin FUNCTION_LIST /end FUNCTION_LIST /begin REF_CHARACTERISTIC CalRegn01Rt03.TunSelnAuthyHwTqY.Ary1D /end REF_CHARACTERISTIC /begin REF_MEASUREMENT /end REF_MEASUREMENT /end GROUP
/begin GROUP CalRegn01Rt03.TunSelnAuthyHwVelY.Ary1D "MICROSAR RTE" /begin SUB_GROUP /end SUB_GROUP /begin FUNCTION_LIST /end FUNCTION_LIST /begin REF_CHARACTERISTIC CalRegn01Rt03.TunSelnAuthyHwVelY.Ary1D /end REF_CHARACTERISTIC /begin REF_MEASUREMENT /end REF_MEASUREMENT /end GROUP
/begin GROUP CalRegn01Rt04 "MICROSAR RTE" /begin SUB_GROUP CalRegn01Rt04.CalibrationPorts /end SUB_GROUP /begin FUNCTION_LIST /end FUNCTION_LIST /begin REF_CHARACTERISTIC /end REF_CHARACTERISTIC /begin REF_MEASUREMENT /end REF_MEASUREMENT /end GROUP
/begin GROUP CalRegn01Rt04.CalibrationPorts "MICROSAR RTE"
 /begin SUB_GROUP CalRegn01Rt04.TEstimnMagAmbMplr.Val CalRegn01Rt04.TunSelnAuthyHwTqY.Ary1D CalRegn01Rt04.TunSelnAuthyHwVelY.Ary1D /end SUB_GROUP
 /begin FUNCTION_LIST /end FUNCTION_LIST
 /begin REF_CHARACTERISTIC /end REF_CHARACTERISTIC
 /begin REF_MEASUREMENT /end REF_MEASUREMENT
/end GROUP
/begin GROUP CalRegn01Rt04.TEstimnMagAmbMplr.Val "MICROSAR RTE" /begin SUB_GROUP /end SUB_GROUP /begin FUNCTION_LIST /end FUNCTION_LIST /begin REF_CHARACTERISTIC CalRegn01Rt04.TEstimnMagAmbMplr.Val /end REF_CHARACTERISTIC /begin REF_MEASUREMENT /end REF_MEASUREMENT /end GROUP
/begin GROUP CalRegn01Rt04.TunSelnAuthyHwTqY.Ary1D "MICROSAR RTE" /begin SUB_GROUP /end SUB_GROUP /begin FUNCTION_LIST /end FUNCTION_LIST /begin REF_CHARACTERISTIC CalRegn01Rt04.TunSelnAuthyHwTqY.Ary1D /end REF_CHARACTERISTIC /begin REF_MEASUREMENT /end REF_MEASUREMENT /end GROUP
/begin GROUP CalRegn01Rt04.TunSelnAuthyHwVelY.Ary1D "MICROSAR RTE" /begin SUB_GROUP /end SUB_GROUP /begin FUNCTION_LIST /end FUNCTION_LIST /begin REF_CHARACTERISTIC CalRegn01Rt04.TunSelnAuthyHwVelY.Ary1D /end REF_CHARACTERISTIC /begin REF_MEASUREMENT /end REF_MEASUREMENT /end GROUP
/begin GROUP CalRegn02Cmn "MICROSAR RTE" /begin SUB_GROUP CalRegn02Cmn.CalibrationPorts /end SUB_GROUP /begin FUNCTION_LIST /end FUNCTION_LIST /begin REF_CHARACTERISTIC /end REF_CHARACTERISTIC /begin REF_MEASUREMENT /end REF_MEASUREMENT /end GROUP
/begin GROUP CalRegn02Cmn.CalibrationPorts "MICROSAR RTE"
 /begin SUB_GROUP CalRegn02Cmn.DiagcMgrFltResp.Ary1D CalRegn02Cmn.InertiaCmpVelDecelGainEnaCal.Logl CalRegn02Cmn.NxtrCalIdsCal1DevlpAuthor.Ary1D CalRegn02Cmn.NxtrCalIdsCal1DevlpDesc.Ary1D CalRegn02Cmn.NxtrCalIdsCal1DevlpRelNr.Val CalRegn02Cmn.NxtrCalIdsCal1DevlpRelSt.Val CalRegn02Cmn.NxtrCalIdsCal1DevlpTiStamp.Val CalRegn02Cmn.NxtrCalIdsCal1DevlpVers.Val CalRegn02Cmn.SnsrOffsCorrnHwAgLrndOffsLim.Val CalRegn02Cmn.SnsrOffsCorrnHwTqLrndOffsLim.Val CalRegn02Cmn.SnsrOffsCorrnOffsEna.Logl CalRegn02Cmn.SnsrOffsCorrnVehYawRateLrndOffsLim.Val CalRegn02Cmn.SnsrOffsLrngHwAgLrngTi.Val CalRegn02Cmn.SnsrOffsLrngHwTqLrngHwTqZeroOffsThd.Val CalRegn02Cmn.SnsrOffsLrngHwTqLrngMeasTi.Val CalRegn02Cmn.SnsrOffsLrngHwTqLrngSampleImbThd1.Val CalRegn02Cmn.SnsrOffsLrngHwTqLrngSampleImbThd2.Val CalRegn02Cmn.SnsrOffsLrngHwTqLrngSampleThd1.Val CalRegn02Cmn.SnsrOffsLrngHwTqLrngSampleThd2.Val CalRegn02Cmn.SnsrOffsLrngHwTqLrngTiWghtCoeff.Val CalRegn02Cmn.SnsrOffsLrngYawLrngTi.Val /end SUB_GROUP
 /begin FUNCTION_LIST /end FUNCTION_LIST
 /begin REF_CHARACTERISTIC /end REF_CHARACTERISTIC
 /begin REF_MEASUREMENT /end REF_MEASUREMENT
/end GROUP
/begin GROUP CalRegn02Cmn.DiagcMgrFltResp.Ary1D "MICROSAR RTE" /begin SUB_GROUP /end SUB_GROUP /begin FUNCTION_LIST /end FUNCTION_LIST /begin REF_CHARACTERISTIC CalRegn02Cmn.DiagcMgrFltResp.Ary1D /end REF_CHARACTERISTIC /begin REF_MEASUREMENT /end REF_MEASUREMENT /end GROUP
/begin GROUP CalRegn02Cmn.InertiaCmpVelDecelGainEnaCal.Logl "MICROSAR RTE" /begin SUB_GROUP /end SUB_GROUP /begin FUNCTION_LIST /end FUNCTION_LIST /begin REF_CHARACTERISTIC CalRegn02Cmn.InertiaCmpVelDecelGainEnaCal.Logl /end REF_CHARACTERISTIC /begin REF_MEASUREMENT /end REF_MEASUREMENT /end GROUP
/begin GROUP CalRegn02Cmn.NxtrCalIdsCal1DevlpAuthor.Ary1D "MICROSAR RTE" /begin SUB_GROUP /end SUB_GROUP /begin FUNCTION_LIST /end FUNCTION_LIST /begin REF_CHARACTERISTIC CalRegn02Cmn.NxtrCalIdsCal1DevlpAuthor.Ary1D /end REF_CHARACTERISTIC /begin REF_MEASUREMENT /end REF_MEASUREMENT /end GROUP
/begin GROUP CalRegn02Cmn.NxtrCalIdsCal1DevlpDesc.Ary1D "MICROSAR RTE" /begin SUB_GROUP /end SUB_GROUP /begin FUNCTION_LIST /end FUNCTION_LIST /begin REF_CHARACTERISTIC CalRegn02Cmn.NxtrCalIdsCal1DevlpDesc.Ary1D /end REF_CHARACTERISTIC /begin REF_MEASUREMENT /end REF_MEASUREMENT /end GROUP
/begin GROUP CalRegn02Cmn.NxtrCalIdsCal1DevlpRelNr.Val "MICROSAR RTE" /begin SUB_GROUP /end SUB_GROUP /begin FUNCTION_LIST /end FUNCTION_LIST /begin REF_CHARACTERISTIC CalRegn02Cmn.NxtrCalIdsCal1DevlpRelNr.Val /end REF_CHARACTERISTIC /begin REF_MEASUREMENT /end REF_MEASUREMENT /end GROUP
/begin GROUP CalRegn02Cmn.NxtrCalIdsCal1DevlpRelSt.Val "MICROSAR RTE" /begin SUB_GROUP /end SUB_GROUP /begin FUNCTION_LIST /end FUNCTION_LIST /begin REF_CHARACTERISTIC CalRegn02Cmn.NxtrCalIdsCal1DevlpRelSt.Val /end REF_CHARACTERISTIC /begin REF_MEASUREMENT /end REF_MEASUREMENT /end GROUP
/begin GROUP CalRegn02Cmn.NxtrCalIdsCal1DevlpTiStamp.Val "MICROSAR RTE" /begin SUB_GROUP /end SUB_GROUP /begin FUNCTION_LIST /end FUNCTION_LIST /begin REF_CHARACTERISTIC CalRegn02Cmn.NxtrCalIdsCal1DevlpTiStamp.Val /end REF_CHARACTERISTIC /begin REF_MEASUREMENT /end REF_MEASUREMENT /end GROUP
/begin GROUP CalRegn02Cmn.NxtrCalIdsCal1DevlpVers.Val "MICROSAR RTE" /begin SUB_GROUP /end SUB_GROUP /begin FUNCTION_LIST /end FUNCTION_LIST /begin REF_CHARACTERISTIC CalRegn02Cmn.NxtrCalIdsCal1DevlpVers.Val /end REF_CHARACTERISTIC /begin REF_MEASUREMENT /end REF_MEASUREMENT /end GROUP
/begin GROUP CalRegn02Cmn.SnsrOffsCorrnHwAgLrndOffsLim.Val "MICROSAR RTE" /begin SUB_GROUP /end SUB_GROUP /begin FUNCTION_LIST /end FUNCTION_LIST /begin REF_CHARACTERISTIC CalRegn02Cmn.SnsrOffsCorrnHwAgLrndOffsLim.Val /end REF_CHARACTERISTIC /begin REF_MEASUREMENT /end REF_MEASUREMENT /end GROUP
/begin GROUP CalRegn02Cmn.SnsrOffsCorrnHwTqLrndOffsLim.Val "MICROSAR RTE" /begin SUB_GROUP /end SUB_GROUP /begin FUNCTION_LIST /end FUNCTION_LIST /begin REF_CHARACTERISTIC CalRegn02Cmn.SnsrOffsCorrnHwTqLrndOffsLim.Val /end REF_CHARACTERISTIC /begin REF_MEASUREMENT /end REF_MEASUREMENT /end GROUP
/begin GROUP CalRegn02Cmn.SnsrOffsCorrnOffsEna.Logl "MICROSAR RTE" /begin SUB_GROUP /end SUB_GROUP /begin FUNCTION_LIST /end FUNCTION_LIST /begin REF_CHARACTERISTIC CalRegn02Cmn.SnsrOffsCorrnOffsEna.Logl /end REF_CHARACTERISTIC /begin REF_MEASUREMENT /end REF_MEASUREMENT /end GROUP
/begin GROUP CalRegn02Cmn.SnsrOffsCorrnVehYawRateLrndOffsLim.Val "MICROSAR RTE" /begin SUB_GROUP /end SUB_GROUP /begin FUNCTION_LIST /end FUNCTION_LIST /begin REF_CHARACTERISTIC CalRegn02Cmn.SnsrOffsCorrnVehYawRateLrndOffsLim.Val /end REF_CHARACTERISTIC /begin REF_MEASUREMENT /end REF_MEASUREMENT /end GROUP
/begin GROUP CalRegn02Cmn.SnsrOffsLrngHwAgLrngTi.Val "MICROSAR RTE" /begin SUB_GROUP /end SUB_GROUP /begin FUNCTION_LIST /end FUNCTION_LIST /begin REF_CHARACTERISTIC CalRegn02Cmn.SnsrOffsLrngHwAgLrngTi.Val /end REF_CHARACTERISTIC /begin REF_MEASUREMENT /end REF_MEASUREMENT /end GROUP
/begin GROUP CalRegn02Cmn.SnsrOffsLrngHwTqLrngHwTqZeroOffsThd.Val "MICROSAR RTE" /begin SUB_GROUP /end SUB_GROUP /begin FUNCTION_LIST /end FUNCTION_LIST /begin REF_CHARACTERISTIC CalRegn02Cmn.SnsrOffsLrngHwTqLrngHwTqZeroOffsThd.Val /end REF_CHARACTERISTIC /begin REF_MEASUREMENT /end REF_MEASUREMENT /end GROUP
/begin GROUP CalRegn02Cmn.SnsrOffsLrngHwTqLrngMeasTi.Val "MICROSAR RTE" /begin SUB_GROUP /end SUB_GROUP /begin FUNCTION_LIST /end FUNCTION_LIST /begin REF_CHARACTERISTIC CalRegn02Cmn.SnsrOffsLrngHwTqLrngMeasTi.Val /end REF_CHARACTERISTIC /begin REF_MEASUREMENT /end REF_MEASUREMENT /end GROUP
/begin GROUP CalRegn02Cmn.SnsrOffsLrngHwTqLrngSampleImbThd1.Val "MICROSAR RTE" /begin SUB_GROUP /end SUB_GROUP /begin FUNCTION_LIST /end FUNCTION_LIST /begin REF_CHARACTERISTIC CalRegn02Cmn.SnsrOffsLrngHwTqLrngSampleImbThd1.Val /end REF_CHARACTERISTIC /begin REF_MEASUREMENT /end REF_MEASUREMENT /end GROUP
/begin GROUP CalRegn02Cmn.SnsrOffsLrngHwTqLrngSampleImbThd2.Val "MICROSAR RTE" /begin SUB_GROUP /end SUB_GROUP /begin FUNCTION_LIST /end FUNCTION_LIST /begin REF_CHARACTERISTIC CalRegn02Cmn.SnsrOffsLrngHwTqLrngSampleImbThd2.Val /end REF_CHARACTERISTIC /begin REF_MEASUREMENT /end REF_MEASUREMENT /end GROUP
/begin GROUP CalRegn02Cmn.SnsrOffsLrngHwTqLrngSampleThd1.Val "MICROSAR RTE" /begin SUB_GROUP /end SUB_GROUP /begin FUNCTION_LIST /end FUNCTION_LIST /begin REF_CHARACTERISTIC CalRegn02Cmn.SnsrOffsLrngHwTqLrngSampleThd1.Val /end REF_CHARACTERISTIC /begin REF_MEASUREMENT /end REF_MEASUREMENT /end GROUP
/begin GROUP CalRegn02Cmn.SnsrOffsLrngHwTqLrngSampleThd2.Val "MICROSAR RTE" /begin SUB_GROUP /end SUB_GROUP /begin FUNCTION_LIST /end FUNCTION_LIST /begin REF_CHARACTERISTIC CalRegn02Cmn.SnsrOffsLrngHwTqLrngSampleThd2.Val /end REF_CHARACTERISTIC /begin REF_MEASUREMENT /end REF_MEASUREMENT /end GROUP
/begin GROUP CalRegn02Cmn.SnsrOffsLrngHwTqLrngTiWghtCoeff.Val "MICROSAR RTE" /begin SUB_GROUP /end SUB_GROUP /begin FUNCTION_LIST /end FUNCTION_LIST /begin REF_CHARACTERISTIC CalRegn02Cmn.SnsrOffsLrngHwTqLrngTiWghtCoeff.Val /end REF_CHARACTERISTIC /begin REF_MEASUREMENT /end REF_MEASUREMENT /end GROUP
/begin GROUP CalRegn02Cmn.SnsrOffsLrngYawLrngTi.Val "MICROSAR RTE" /begin SUB_GROUP /end SUB_GROUP /begin FUNCTION_LIST /end FUNCTION_LIST /begin REF_CHARACTERISTIC CalRegn02Cmn.SnsrOffsLrngYawLrngTi.Val /end REF_CHARACTERISTIC /begin REF_MEASUREMENT /end REF_MEASUREMENT /end GROUP
/begin GROUP CalRegn02CmnGroupA "MICROSAR RTE" /begin SUB_GROUP CalRegn02CmnGroupA.CalibrationPorts /end SUB_GROUP /begin FUNCTION_LIST /end FUNCTION_LIST /begin REF_CHARACTERISTIC /end REF_CHARACTERISTIC /begin REF_MEASUREMENT /end REF_MEASUREMENT /end GROUP
/begin GROUP CalRegn02CmnGroupA.CalibrationPorts "MICROSAR RTE"
 /begin SUB_GROUP CalRegn02CmnGroupA.GmOvrlStMgrApaMfgEna.Logl CalRegn02CmnGroupA.GmOvrlStMgrEscMfgEna.Logl CalRegn02CmnGroupA.GmOvrlStMgrLkaHwTqThd1.Val CalRegn02CmnGroupA.GmOvrlStMgrLkaHwTqThd2.Val CalRegn02CmnGroupA.GmOvrlStMgrLkaMfgEna.Logl CalRegn02CmnGroupA.PullCmpActvEna.Logl /end SUB_GROUP
 /begin FUNCTION_LIST /end FUNCTION_LIST
 /begin REF_CHARACTERISTIC /end REF_CHARACTERISTIC
 /begin REF_MEASUREMENT /end REF_MEASUREMENT
/end GROUP
/begin GROUP CalRegn02CmnGroupA.GmOvrlStMgrApaMfgEna.Logl "MICROSAR RTE" /begin SUB_GROUP /end SUB_GROUP /begin FUNCTION_LIST /end FUNCTION_LIST /begin REF_CHARACTERISTIC CalRegn02CmnGroupA.GmOvrlStMgrApaMfgEna.Logl /end REF_CHARACTERISTIC /begin REF_MEASUREMENT /end REF_MEASUREMENT /end GROUP
/begin GROUP CalRegn02CmnGroupA.GmOvrlStMgrEscMfgEna.Logl "MICROSAR RTE" /begin SUB_GROUP /end SUB_GROUP /begin FUNCTION_LIST /end FUNCTION_LIST /begin REF_CHARACTERISTIC CalRegn02CmnGroupA.GmOvrlStMgrEscMfgEna.Logl /end REF_CHARACTERISTIC /begin REF_MEASUREMENT /end REF_MEASUREMENT /end GROUP
/begin GROUP CalRegn02CmnGroupA.GmOvrlStMgrLkaHwTqThd1.Val "MICROSAR RTE" /begin SUB_GROUP /end SUB_GROUP /begin FUNCTION_LIST /end FUNCTION_LIST /begin REF_CHARACTERISTIC CalRegn02CmnGroupA.GmOvrlStMgrLkaHwTqThd1.Val /end REF_CHARACTERISTIC /begin REF_MEASUREMENT /end REF_MEASUREMENT /end GROUP
/begin GROUP CalRegn02CmnGroupA.GmOvrlStMgrLkaHwTqThd2.Val "MICROSAR RTE" /begin SUB_GROUP /end SUB_GROUP /begin FUNCTION_LIST /end FUNCTION_LIST /begin REF_CHARACTERISTIC CalRegn02CmnGroupA.GmOvrlStMgrLkaHwTqThd2.Val /end REF_CHARACTERISTIC /begin REF_MEASUREMENT /end REF_MEASUREMENT /end GROUP
/begin GROUP CalRegn02CmnGroupA.GmOvrlStMgrLkaMfgEna.Logl "MICROSAR RTE" /begin SUB_GROUP /end SUB_GROUP /begin FUNCTION_LIST /end FUNCTION_LIST /begin REF_CHARACTERISTIC CalRegn02CmnGroupA.GmOvrlStMgrLkaMfgEna.Logl /end REF_CHARACTERISTIC /begin REF_MEASUREMENT /end REF_MEASUREMENT /end GROUP
/begin GROUP CalRegn02CmnGroupA.PullCmpActvEna.Logl "MICROSAR RTE" /begin SUB_GROUP /end SUB_GROUP /begin FUNCTION_LIST /end FUNCTION_LIST /begin REF_CHARACTERISTIC CalRegn02CmnGroupA.PullCmpActvEna.Logl /end REF_CHARACTERISTIC /begin REF_MEASUREMENT /end REF_MEASUREMENT /end GROUP
/begin GROUP CalRegn02CmnGroupB "MICROSAR RTE" /begin SUB_GROUP CalRegn02CmnGroupB.CalibrationPorts /end SUB_GROUP /begin FUNCTION_LIST /end FUNCTION_LIST /begin REF_CHARACTERISTIC /end REF_CHARACTERISTIC /begin REF_MEASUREMENT /end REF_MEASUREMENT /end GROUP
/begin GROUP CalRegn02CmnGroupB.CalibrationPorts "MICROSAR RTE" /begin SUB_GROUP CalRegn02CmnGroupB.WhlImbRejctnFctEna.Logl /end SUB_GROUP /begin FUNCTION_LIST /end FUNCTION_LIST /begin REF_CHARACTERISTIC /end REF_CHARACTERISTIC /begin REF_MEASUREMENT /end REF_MEASUREMENT /end GROUP
/begin GROUP CalRegn02CmnGroupB.WhlImbRejctnFctEna.Logl "MICROSAR RTE" /begin SUB_GROUP /end SUB_GROUP /begin FUNCTION_LIST /end FUNCTION_LIST /begin REF_CHARACTERISTIC CalRegn02CmnGroupB.WhlImbRejctnFctEna.Logl /end REF_CHARACTERISTIC /begin REF_MEASUREMENT /end REF_MEASUREMENT /end GROUP
/begin GROUP CalRegn02CmnGroupC "MICROSAR RTE" /begin SUB_GROUP CalRegn02CmnGroupC.CalibrationPorts /end SUB_GROUP /begin FUNCTION_LIST /end FUNCTION_LIST /begin REF_CHARACTERISTIC /end REF_CHARACTERISTIC /begin REF_MEASUREMENT /end REF_MEASUREMENT /end GROUP
/begin GROUP CalRegn02CmnGroupC.CalibrationPorts "MICROSAR RTE"
 /begin SUB_GROUP CalRegn02CmnGroupC.GmOvrlStMgrApaHaptcEna.Logl CalRegn02CmnGroupC.GmOvrlStMgrApaHwTqThd.Val CalRegn02CmnGroupC.GmOvrlStMgrApaVehSpdHiLim.Val CalRegn02CmnGroupC.GmOvrlStMgrEscVehSpdHiLim.Val CalRegn02CmnGroupC.GmOvrlStMgrHaptcAmp.Val CalRegn02CmnGroupC.GmOvrlStMgrHaptcDurn.Val CalRegn02CmnGroupC.GmOvrlStMgrLkaVehSpdHiLim.Val CalRegn02CmnGroupC.GmOvrlStMgrLkaVehSpdLoLim.Val CalRegn02CmnGroupC.HowDetnHiFrqGainY.Ary1D CalRegn02CmnGroupC.HowDetnHiFrqRateX.Ary2D CalRegn02CmnGroupC.HowDetnHiFrqRateY.Ary2D CalRegn02CmnGroupC.HowDetnLoFrqRateX.Ary2D CalRegn02CmnGroupC.HowDetnLoFrqRateY.Ary2D CalRegn02CmnGroupC.HowDetnMinVehSpd.Val CalRegn02CmnGroupC.HowDetnPercOfPrevHowEstim.Val CalRegn02CmnGroupC.HowDetnSlewRate.Val CalRegn02CmnGroupC.HowDetnStThdX.Ary1D CalRegn02CmnGroupC.HowDetnTqHpFilFrq.Val CalRegn02CmnGroupC.HowDetnVehSpd.Ary1D CalRegn02CmnGroupC.SnsrOffsLrngFctEna.Logl CalRegn02CmnGroupC.SnsrOffsLrngHwAgLrngDrvgDstThd.Val CalRegn02CmnGroupC.SnsrOffsLrngHwAgLrngEna.Logl CalRegn02CmnGroupC.SnsrOffsLrngHwAgLrngHwVelThd.Val CalRegn02CmnGroupC.SnsrOffsLrngHwAgLrngSysTqThd.Val CalRegn02CmnGroupC.SnsrOffsLrngHwAgLrngSysTqThdMed.Val CalRegn02CmnGroupC.SnsrOffsLrngHwAgLrngSysTqThdTrustd.Val CalRegn02CmnGroupC.SnsrOffsLrngHwAgLrngSysTqThdWide.Val CalRegn02CmnGroupC.SnsrOffsLrngHwAgLrngVehSpdThd.Val CalRegn02CmnGroupC.SnsrOffsLrngHwAgLrngYawOffsDbnd.Val CalRegn02CmnGroupC.SnsrOffsLrngHwAgLrngYawRateThd.Val CalRegn02CmnGroupC.SnsrOffsLrngHwAgOffsLim.Val CalRegn02CmnGroupC.SnsrOffsLrngHwTqLrngEna.Logl CalRegn02CmnGroupC.SnsrOffsLrngHwTqLrngEnaTiThd.Val CalRegn02CmnGroupC.SnsrOffsLrngHwTqLrngHwAgDbnd.Val CalRegn02CmnGroupC.SnsrOffsLrngHwTqLrngHwAgThd.Val CalRegn02CmnGroupC.SnsrOffsLrngHwTqLrngHwTqThd.Val CalRegn02CmnGroupC.SnsrOffsLrngHwTqLrngHwVelThd.Val CalRegn02CmnGroupC.SnsrOffsLrngHwTqLrngMeasTiScar.Val CalRegn02CmnGroupC.SnsrOffsLrngHwTqLrngVehSpdThd.Val CalRegn02CmnGroupC.SnsrOffsLrngHwTqOffsLim.Val CalRegn02CmnGroupC.SnsrOffsLrngTqInpDetnPwrEstimnThd.Val CalRegn02CmnGroupC.SnsrOffsLrngTqInpDetnSinGenrAmp.Val CalRegn02CmnGroupC.SnsrOffsLrngTqInpDetnSinGenrFrq.Val CalRegn02CmnGroupC.SnsrOffsLrngTqInpDetnStg1FilGain.Val CalRegn02CmnGroupC.SnsrOffsLrngTqInpDetnStg1WinSize.Val CalRegn02CmnGroupC.SnsrOffsLrngTqInpDetnStg2FilGainCen.Val CalRegn02CmnGroupC.SnsrOffsLrngTqInpDetnStg2FilGainDwn.Val CalRegn02CmnGroupC.SnsrOffsLrngTqInpDetnStg2FilGainUp.Val CalRegn02CmnGroupC.SnsrOffsLrngTqInpDetnStg2WinSize.Val CalRegn02CmnGroupC.SnsrOffsLrngYawLrngEna.Logl CalRegn02CmnGroupC.SnsrOffsLrngYawLrngHwAgThd.Val CalRegn02CmnGroupC.SnsrOffsLrngYawLrngYawAThd.Val CalRegn02CmnGroupC.SnsrOffsLrngYawOffsFrshTiThd.Val CalRegn02CmnGroupC.SnsrOffsLrngYawRateOffsLim.Val /end SUB_GROUP
 /begin FUNCTION_LIST /end FUNCTION_LIST
 /begin REF_CHARACTERISTIC /end REF_CHARACTERISTIC
 /begin REF_MEASUREMENT /end REF_MEASUREMENT
/end GROUP
/begin GROUP CalRegn02CmnGroupC.GmOvrlStMgrApaHaptcEna.Logl "MICROSAR RTE" /begin SUB_GROUP /end SUB_GROUP /begin FUNCTION_LIST /end FUNCTION_LIST /begin REF_CHARACTERISTIC CalRegn02CmnGroupC.GmOvrlStMgrApaHaptcEna.Logl /end REF_CHARACTERISTIC /begin REF_MEASUREMENT /end REF_MEASUREMENT /end GROUP
/begin GROUP CalRegn02CmnGroupC.GmOvrlStMgrApaHwTqThd.Val "MICROSAR RTE" /begin SUB_GROUP /end SUB_GROUP /begin FUNCTION_LIST /end FUNCTION_LIST /begin REF_CHARACTERISTIC CalRegn02CmnGroupC.GmOvrlStMgrApaHwTqThd.Val /end REF_CHARACTERISTIC /begin REF_MEASUREMENT /end REF_MEASUREMENT /end GROUP
/begin GROUP CalRegn02CmnGroupC.GmOvrlStMgrApaVehSpdHiLim.Val "MICROSAR RTE" /begin SUB_GROUP /end SUB_GROUP /begin FUNCTION_LIST /end FUNCTION_LIST /begin REF_CHARACTERISTIC CalRegn02CmnGroupC.GmOvrlStMgrApaVehSpdHiLim.Val /end REF_CHARACTERISTIC /begin REF_MEASUREMENT /end REF_MEASUREMENT /end GROUP
/begin GROUP CalRegn02CmnGroupC.GmOvrlStMgrEscVehSpdHiLim.Val "MICROSAR RTE" /begin SUB_GROUP /end SUB_GROUP /begin FUNCTION_LIST /end FUNCTION_LIST /begin REF_CHARACTERISTIC CalRegn02CmnGroupC.GmOvrlStMgrEscVehSpdHiLim.Val /end REF_CHARACTERISTIC /begin REF_MEASUREMENT /end REF_MEASUREMENT /end GROUP
/begin GROUP CalRegn02CmnGroupC.GmOvrlStMgrHaptcAmp.Val "MICROSAR RTE" /begin SUB_GROUP /end SUB_GROUP /begin FUNCTION_LIST /end FUNCTION_LIST /begin REF_CHARACTERISTIC CalRegn02CmnGroupC.GmOvrlStMgrHaptcAmp.Val /end REF_CHARACTERISTIC /begin REF_MEASUREMENT /end REF_MEASUREMENT /end GROUP
/begin GROUP CalRegn02CmnGroupC.GmOvrlStMgrHaptcDurn.Val "MICROSAR RTE" /begin SUB_GROUP /end SUB_GROUP /begin FUNCTION_LIST /end FUNCTION_LIST /begin REF_CHARACTERISTIC CalRegn02CmnGroupC.GmOvrlStMgrHaptcDurn.Val /end REF_CHARACTERISTIC /begin REF_MEASUREMENT /end REF_MEASUREMENT /end GROUP
/begin GROUP CalRegn02CmnGroupC.GmOvrlStMgrLkaVehSpdHiLim.Val "MICROSAR RTE" /begin SUB_GROUP /end SUB_GROUP /begin FUNCTION_LIST /end FUNCTION_LIST /begin REF_CHARACTERISTIC CalRegn02CmnGroupC.GmOvrlStMgrLkaVehSpdHiLim.Val /end REF_CHARACTERISTIC /begin REF_MEASUREMENT /end REF_MEASUREMENT /end GROUP
/begin GROUP CalRegn02CmnGroupC.GmOvrlStMgrLkaVehSpdLoLim.Val "MICROSAR RTE" /begin SUB_GROUP /end SUB_GROUP /begin FUNCTION_LIST /end FUNCTION_LIST /begin REF_CHARACTERISTIC CalRegn02CmnGroupC.GmOvrlStMgrLkaVehSpdLoLim.Val /end REF_CHARACTERISTIC /begin REF_MEASUREMENT /end REF_MEASUREMENT /end GROUP
/begin GROUP CalRegn02CmnGroupC.HowDetnHiFrqGainY.Ary1D "MICROSAR RTE" /begin SUB_GROUP /end SUB_GROUP /begin FUNCTION_LIST /end FUNCTION_LIST /begin REF_CHARACTERISTIC CalRegn02CmnGroupC.HowDetnHiFrqGainY.Ary1D /end REF_CHARACTERISTIC /begin REF_MEASUREMENT /end REF_MEASUREMENT /end GROUP
/begin GROUP CalRegn02CmnGroupC.HowDetnHiFrqRateX.Ary2D "MICROSAR RTE" /begin SUB_GROUP /end SUB_GROUP /begin FUNCTION_LIST /end FUNCTION_LIST /begin REF_CHARACTERISTIC CalRegn02CmnGroupC.HowDetnHiFrqRateX.Ary2D /end REF_CHARACTERISTIC /begin REF_MEASUREMENT /end REF_MEASUREMENT /end GROUP
/begin GROUP CalRegn02CmnGroupC.HowDetnHiFrqRateY.Ary2D "MICROSAR RTE" /begin SUB_GROUP /end SUB_GROUP /begin FUNCTION_LIST /end FUNCTION_LIST /begin REF_CHARACTERISTIC CalRegn02CmnGroupC.HowDetnHiFrqRateY.Ary2D /end REF_CHARACTERISTIC /begin REF_MEASUREMENT /end REF_MEASUREMENT /end GROUP
/begin GROUP CalRegn02CmnGroupC.HowDetnLoFrqRateX.Ary2D "MICROSAR RTE" /begin SUB_GROUP /end SUB_GROUP /begin FUNCTION_LIST /end FUNCTION_LIST /begin REF_CHARACTERISTIC CalRegn02CmnGroupC.HowDetnLoFrqRateX.Ary2D /end REF_CHARACTERISTIC /begin REF_MEASUREMENT /end REF_MEASUREMENT /end GROUP
/begin GROUP CalRegn02CmnGroupC.HowDetnLoFrqRateY.Ary2D "MICROSAR RTE" /begin SUB_GROUP /end SUB_GROUP /begin FUNCTION_LIST /end FUNCTION_LIST /begin REF_CHARACTERISTIC CalRegn02CmnGroupC.HowDetnLoFrqRateY.Ary2D /end REF_CHARACTERISTIC /begin REF_MEASUREMENT /end REF_MEASUREMENT /end GROUP
/begin GROUP CalRegn02CmnGroupC.HowDetnMinVehSpd.Val "MICROSAR RTE" /begin SUB_GROUP /end SUB_GROUP /begin FUNCTION_LIST /end FUNCTION_LIST /begin REF_CHARACTERISTIC CalRegn02CmnGroupC.HowDetnMinVehSpd.Val /end REF_CHARACTERISTIC /begin REF_MEASUREMENT /end REF_MEASUREMENT /end GROUP
/begin GROUP CalRegn02CmnGroupC.HowDetnPercOfPrevHowEstim.Val "MICROSAR RTE" /begin SUB_GROUP /end SUB_GROUP /begin FUNCTION_LIST /end FUNCTION_LIST /begin REF_CHARACTERISTIC CalRegn02CmnGroupC.HowDetnPercOfPrevHowEstim.Val /end REF_CHARACTERISTIC /begin REF_MEASUREMENT /end REF_MEASUREMENT /end GROUP
/begin GROUP CalRegn02CmnGroupC.HowDetnSlewRate.Val "MICROSAR RTE" /begin SUB_GROUP /end SUB_GROUP /begin FUNCTION_LIST /end FUNCTION_LIST /begin REF_CHARACTERISTIC CalRegn02CmnGroupC.HowDetnSlewRate.Val /end REF_CHARACTERISTIC /begin REF_MEASUREMENT /end REF_MEASUREMENT /end GROUP
/begin GROUP CalRegn02CmnGroupC.HowDetnStThdX.Ary1D "MICROSAR RTE" /begin SUB_GROUP /end SUB_GROUP /begin FUNCTION_LIST /end FUNCTION_LIST /begin REF_CHARACTERISTIC CalRegn02CmnGroupC.HowDetnStThdX.Ary1D /end REF_CHARACTERISTIC /begin REF_MEASUREMENT /end REF_MEASUREMENT /end GROUP
/begin GROUP CalRegn02CmnGroupC.HowDetnTqHpFilFrq.Val "MICROSAR RTE" /begin SUB_GROUP /end SUB_GROUP /begin FUNCTION_LIST /end FUNCTION_LIST /begin REF_CHARACTERISTIC CalRegn02CmnGroupC.HowDetnTqHpFilFrq.Val /end REF_CHARACTERISTIC /begin REF_MEASUREMENT /end REF_MEASUREMENT /end GROUP
/begin GROUP CalRegn02CmnGroupC.HowDetnVehSpd.Ary1D "MICROSAR RTE" /begin SUB_GROUP /end SUB_GROUP /begin FUNCTION_LIST /end FUNCTION_LIST /begin REF_CHARACTERISTIC CalRegn02CmnGroupC.HowDetnVehSpd.Ary1D /end REF_CHARACTERISTIC /begin REF_MEASUREMENT /end REF_MEASUREMENT /end GROUP
/begin GROUP CalRegn02CmnGroupC.SnsrOffsLrngFctEna.Logl "MICROSAR RTE" /begin SUB_GROUP /end SUB_GROUP /begin FUNCTION_LIST /end FUNCTION_LIST /begin REF_CHARACTERISTIC CalRegn02CmnGroupC.SnsrOffsLrngFctEna.Logl /end REF_CHARACTERISTIC /begin REF_MEASUREMENT /end REF_MEASUREMENT /end GROUP
/begin GROUP CalRegn02CmnGroupC.SnsrOffsLrngHwAgLrngDrvgDstThd.Val "MICROSAR RTE" /begin SUB_GROUP /end SUB_GROUP /begin FUNCTION_LIST /end FUNCTION_LIST /begin REF_CHARACTERISTIC CalRegn02CmnGroupC.SnsrOffsLrngHwAgLrngDrvgDstThd.Val /end REF_CHARACTERISTIC /begin REF_MEASUREMENT /end REF_MEASUREMENT /end GROUP
/begin GROUP CalRegn02CmnGroupC.SnsrOffsLrngHwAgLrngEna.Logl "MICROSAR RTE" /begin SUB_GROUP /end SUB_GROUP /begin FUNCTION_LIST /end FUNCTION_LIST /begin REF_CHARACTERISTIC CalRegn02CmnGroupC.SnsrOffsLrngHwAgLrngEna.Logl /end REF_CHARACTERISTIC /begin REF_MEASUREMENT /end REF_MEASUREMENT /end GROUP
/begin GROUP CalRegn02CmnGroupC.SnsrOffsLrngHwAgLrngHwVelThd.Val "MICROSAR RTE" /begin SUB_GROUP /end SUB_GROUP /begin FUNCTION_LIST /end FUNCTION_LIST /begin REF_CHARACTERISTIC CalRegn02CmnGroupC.SnsrOffsLrngHwAgLrngHwVelThd.Val /end REF_CHARACTERISTIC /begin REF_MEASUREMENT /end REF_MEASUREMENT /end GROUP
/begin GROUP CalRegn02CmnGroupC.SnsrOffsLrngHwAgLrngSysTqThd.Val "MICROSAR RTE" /begin SUB_GROUP /end SUB_GROUP /begin FUNCTION_LIST /end FUNCTION_LIST /begin REF_CHARACTERISTIC CalRegn02CmnGroupC.SnsrOffsLrngHwAgLrngSysTqThd.Val /end REF_CHARACTERISTIC /begin REF_MEASUREMENT /end REF_MEASUREMENT /end GROUP
/begin GROUP CalRegn02CmnGroupC.SnsrOffsLrngHwAgLrngSysTqThdMed.Val "MICROSAR RTE" /begin SUB_GROUP /end SUB_GROUP /begin FUNCTION_LIST /end FUNCTION_LIST /begin REF_CHARACTERISTIC CalRegn02CmnGroupC.SnsrOffsLrngHwAgLrngSysTqThdMed.Val /end REF_CHARACTERISTIC /begin REF_MEASUREMENT /end REF_MEASUREMENT /end GROUP
/begin GROUP CalRegn02CmnGroupC.SnsrOffsLrngHwAgLrngSysTqThdTrustd.Val "MICROSAR RTE" /begin SUB_GROUP /end SUB_GROUP /begin FUNCTION_LIST /end FUNCTION_LIST /begin REF_CHARACTERISTIC CalRegn02CmnGroupC.SnsrOffsLrngHwAgLrngSysTqThdTrustd.Val /end REF_CHARACTERISTIC /begin REF_MEASUREMENT /end REF_MEASUREMENT /end GROUP
/begin GROUP CalRegn02CmnGroupC.SnsrOffsLrngHwAgLrngSysTqThdWide.Val "MICROSAR RTE" /begin SUB_GROUP /end SUB_GROUP /begin FUNCTION_LIST /end FUNCTION_LIST /begin REF_CHARACTERISTIC CalRegn02CmnGroupC.SnsrOffsLrngHwAgLrngSysTqThdWide.Val /end REF_CHARACTERISTIC /begin REF_MEASUREMENT /end REF_MEASUREMENT /end GROUP
/begin GROUP CalRegn02CmnGroupC.SnsrOffsLrngHwAgLrngVehSpdThd.Val "MICROSAR RTE" /begin SUB_GROUP /end SUB_GROUP /begin FUNCTION_LIST /end FUNCTION_LIST /begin REF_CHARACTERISTIC CalRegn02CmnGroupC.SnsrOffsLrngHwAgLrngVehSpdThd.Val /end REF_CHARACTERISTIC /begin REF_MEASUREMENT /end REF_MEASUREMENT /end GROUP
/begin GROUP CalRegn02CmnGroupC.SnsrOffsLrngHwAgLrngYawOffsDbnd.Val "MICROSAR RTE" /begin SUB_GROUP /end SUB_GROUP /begin FUNCTION_LIST /end FUNCTION_LIST /begin REF_CHARACTERISTIC CalRegn02CmnGroupC.SnsrOffsLrngHwAgLrngYawOffsDbnd.Val /end REF_CHARACTERISTIC /begin REF_MEASUREMENT /end REF_MEASUREMENT /end GROUP
/begin GROUP CalRegn02CmnGroupC.SnsrOffsLrngHwAgLrngYawRateThd.Val "MICROSAR RTE" /begin SUB_GROUP /end SUB_GROUP /begin FUNCTION_LIST /end FUNCTION_LIST /begin REF_CHARACTERISTIC CalRegn02CmnGroupC.SnsrOffsLrngHwAgLrngYawRateThd.Val /end REF_CHARACTERISTIC /begin REF_MEASUREMENT /end REF_MEASUREMENT /end GROUP
/begin GROUP CalRegn02CmnGroupC.SnsrOffsLrngHwAgOffsLim.Val "MICROSAR RTE" /begin SUB_GROUP /end SUB_GROUP /begin FUNCTION_LIST /end FUNCTION_LIST /begin REF_CHARACTERISTIC CalRegn02CmnGroupC.SnsrOffsLrngHwAgOffsLim.Val /end REF_CHARACTERISTIC /begin REF_MEASUREMENT /end REF_MEASUREMENT /end GROUP
/begin GROUP CalRegn02CmnGroupC.SnsrOffsLrngHwTqLrngEna.Logl "MICROSAR RTE" /begin SUB_GROUP /end SUB_GROUP /begin FUNCTION_LIST /end FUNCTION_LIST /begin REF_CHARACTERISTIC CalRegn02CmnGroupC.SnsrOffsLrngHwTqLrngEna.Logl /end REF_CHARACTERISTIC /begin REF_MEASUREMENT /end REF_MEASUREMENT /end GROUP
/begin GROUP CalRegn02CmnGroupC.SnsrOffsLrngHwTqLrngEnaTiThd.Val "MICROSAR RTE" /begin SUB_GROUP /end SUB_GROUP /begin FUNCTION_LIST /end FUNCTION_LIST /begin REF_CHARACTERISTIC CalRegn02CmnGroupC.SnsrOffsLrngHwTqLrngEnaTiThd.Val /end REF_CHARACTERISTIC /begin REF_MEASUREMENT /end REF_MEASUREMENT /end GROUP
/begin GROUP CalRegn02CmnGroupC.SnsrOffsLrngHwTqLrngHwAgDbnd.Val "MICROSAR RTE" /begin SUB_GROUP /end SUB_GROUP /begin FUNCTION_LIST /end FUNCTION_LIST /begin REF_CHARACTERISTIC CalRegn02CmnGroupC.SnsrOffsLrngHwTqLrngHwAgDbnd.Val /end REF_CHARACTERISTIC /begin REF_MEASUREMENT /end REF_MEASUREMENT /end GROUP
/begin GROUP CalRegn02CmnGroupC.SnsrOffsLrngHwTqLrngHwAgThd.Val "MICROSAR RTE" /begin SUB_GROUP /end SUB_GROUP /begin FUNCTION_LIST /end FUNCTION_LIST /begin REF_CHARACTERISTIC CalRegn02CmnGroupC.SnsrOffsLrngHwTqLrngHwAgThd.Val /end REF_CHARACTERISTIC /begin REF_MEASUREMENT /end REF_MEASUREMENT /end GROUP
/begin GROUP CalRegn02CmnGroupC.SnsrOffsLrngHwTqLrngHwTqThd.Val "MICROSAR RTE" /begin SUB_GROUP /end SUB_GROUP /begin FUNCTION_LIST /end FUNCTION_LIST /begin REF_CHARACTERISTIC CalRegn02CmnGroupC.SnsrOffsLrngHwTqLrngHwTqThd.Val /end REF_CHARACTERISTIC /begin REF_MEASUREMENT /end REF_MEASUREMENT /end GROUP
/begin GROUP CalRegn02CmnGroupC.SnsrOffsLrngHwTqLrngHwVelThd.Val "MICROSAR RTE" /begin SUB_GROUP /end SUB_GROUP /begin FUNCTION_LIST /end FUNCTION_LIST /begin REF_CHARACTERISTIC CalRegn02CmnGroupC.SnsrOffsLrngHwTqLrngHwVelThd.Val /end REF_CHARACTERISTIC /begin REF_MEASUREMENT /end REF_MEASUREMENT /end GROUP
/begin GROUP CalRegn02CmnGroupC.SnsrOffsLrngHwTqLrngMeasTiScar.Val "MICROSAR RTE" /begin SUB_GROUP /end SUB_GROUP /begin FUNCTION_LIST /end FUNCTION_LIST /begin REF_CHARACTERISTIC CalRegn02CmnGroupC.SnsrOffsLrngHwTqLrngMeasTiScar.Val /end REF_CHARACTERISTIC /begin REF_MEASUREMENT /end REF_MEASUREMENT /end GROUP
/begin GROUP CalRegn02CmnGroupC.SnsrOffsLrngHwTqLrngVehSpdThd.Val "MICROSAR RTE" /begin SUB_GROUP /end SUB_GROUP /begin FUNCTION_LIST /end FUNCTION_LIST /begin REF_CHARACTERISTIC CalRegn02CmnGroupC.SnsrOffsLrngHwTqLrngVehSpdThd.Val /end REF_CHARACTERISTIC /begin REF_MEASUREMENT /end REF_MEASUREMENT /end GROUP
/begin GROUP CalRegn02CmnGroupC.SnsrOffsLrngHwTqOffsLim.Val "MICROSAR RTE" /begin SUB_GROUP /end SUB_GROUP /begin FUNCTION_LIST /end FUNCTION_LIST /begin REF_CHARACTERISTIC CalRegn02CmnGroupC.SnsrOffsLrngHwTqOffsLim.Val /end REF_CHARACTERISTIC /begin REF_MEASUREMENT /end REF_MEASUREMENT /end GROUP
/begin GROUP CalRegn02CmnGroupC.SnsrOffsLrngTqInpDetnPwrEstimnThd.Val "MICROSAR RTE" /begin SUB_GROUP /end SUB_GROUP /begin FUNCTION_LIST /end FUNCTION_LIST /begin REF_CHARACTERISTIC CalRegn02CmnGroupC.SnsrOffsLrngTqInpDetnPwrEstimnThd.Val /end REF_CHARACTERISTIC /begin REF_MEASUREMENT /end REF_MEASUREMENT /end GROUP
/begin GROUP CalRegn02CmnGroupC.SnsrOffsLrngTqInpDetnSinGenrAmp.Val "MICROSAR RTE" /begin SUB_GROUP /end SUB_GROUP /begin FUNCTION_LIST /end FUNCTION_LIST /begin REF_CHARACTERISTIC CalRegn02CmnGroupC.SnsrOffsLrngTqInpDetnSinGenrAmp.Val /end REF_CHARACTERISTIC /begin REF_MEASUREMENT /end REF_MEASUREMENT /end GROUP
/begin GROUP CalRegn02CmnGroupC.SnsrOffsLrngTqInpDetnSinGenrFrq.Val "MICROSAR RTE" /begin SUB_GROUP /end SUB_GROUP /begin FUNCTION_LIST /end FUNCTION_LIST /begin REF_CHARACTERISTIC CalRegn02CmnGroupC.SnsrOffsLrngTqInpDetnSinGenrFrq.Val /end REF_CHARACTERISTIC /begin REF_MEASUREMENT /end REF_MEASUREMENT /end GROUP
/**********************************************************************************************************************
* RECORD_LAYOUT
*********************************************************************************************************************/
/begin RECORD_LAYOUT RTE_RL_UBYTE FNC_VALUES 1 UBYTE ROW_DIR DIRECT /end RECORD_LAYOUT
/begin RECORD_LAYOUT RTE_RL_UWORD FNC_VALUES 1 UWORD ROW_DIR DIRECT /end RECORD_LAYOUT
/begin RECORD_LAYOUT RTE_RL_ULONG FNC_VALUES 1 ULONG ROW_DIR DIRECT /end RECORD_LAYOUT
/begin RECORD_LAYOUT RTE_RL_SWORD FNC_VALUES 1 SWORD ROW_DIR DIRECT /end RECORD_LAYOUT
/begin RECORD_LAYOUT RTE_RL_FLOAT32_IEEE FNC_VALUES 1 FLOAT32_IEEE ROW_DIR DIRECT /end RECORD_LAYOUT
/begin RECORD_LAYOUT RTE_RL_BOOLEAN FNC_VALUES 1 UBYTE ROW_DIR DIRECT /end RECORD_LAYOUT
/**********************************************************************************************************************
* COMPU_METHOD / COMPU_VTAB_RANGE
*********************************************************************************************************************/
/begin COMPU_METHOD RTE_CM_BOOLEAN "" TAB_VERB "%3.1" "" COMPU_TAB_REF RTE_CM_BOOLEAN /end COMPU_METHOD
/begin COMPU_VTAB_RANGE RTE_CM_BOOLEAN "" 2 0 0 "false" 1 255 "true" /end COMPU_VTAB_RANGE
