/begin CHARACTERISTIC GmMsg0C5BusHiSpd.GmMsg0C5BusHiSpdInvldTiOut.Val "MICROSAR RTE" VALUE 0x0 RTE_RL_UWORD 0 NO_COMPU_METHOD 0 65535 SYMBOL_LINK "Rte_CalprmRom_CalRegn01Cmn_DEFAULT_RTE_CALPRM_GROUP.GmMsg0C5BusHiSpdInvldTiOut_Val" 0 DISPLAY_IDENTIFIER GmMsg0C5BusHiSpd.CalibrationPorts.GmMsg0C5BusHiSpdInvldTiOut.Val /end CHARACTERISTIC
/begin CHARACTERISTIC GmMsg0C5BusHiSpd.GmMsg0C5BusHiSpdMissTiOut.Val "MICROSAR RTE" VALUE 0x0 RTE_RL_UWORD 0 NO_COMPU_METHOD 0 65535 SYMBOL_LINK "Rte_CalprmRom_CalRegn01Cmn_DEFAULT_RTE_CALPRM_GROUP.GmMsg0C5BusHiSpdMissTiOut_Val" 0 DISPLAY_IDENTIFIER GmMsg0C5BusHiSpd.CalibrationPorts.GmMsg0C5BusHiSpdMissTiOut.Val /end CHARACTERISTIC
/begin CHARACTERISTIC GmMsg0C5BusHiSpd.GmMsg0C5BusHiSpdRstTiOut.Val "MICROSAR RTE" VALUE 0x0 RTE_RL_UWORD 0 NO_COMPU_METHOD 0 65535 SYMBOL_LINK "Rte_CalprmRom_CalRegn01Cmn_DEFAULT_RTE_CALPRM_GROUP.GmMsg0C5BusHiSpdRstTiOut_Val" 0 DISPLAY_IDENTIFIER GmMsg0C5BusHiSpd.CalibrationPorts.GmMsg0C5BusHiSpdRstTiOut.Val /end CHARACTERISTIC
/begin CHARACTERISTIC GmMsg0C5BusHiSpd.GmMsg0C5BusHiSpdSeqNrTiOut.Val "MICROSAR RTE" VALUE 0x0 RTE_RL_UWORD 0 NO_COMPU_METHOD 0 65535 SYMBOL_LINK "Rte_CalprmRom_CalRegn01Cmn_DEFAULT_RTE_CALPRM_GROUP.GmMsg0C5BusHiSpdSeqNrTiOut_Val" 0 DISPLAY_IDENTIFIER GmMsg0C5BusHiSpd.CalibrationPorts.GmMsg0C5BusHiSpdSeqNrTiOut.Val /end CHARACTERISTIC
/begin CHARACTERISTIC GmMsg0C9BusHiSpd.GmMsg0C9BusHiSpdInvldTiOut.Val "MICROSAR RTE" VALUE 0x0 RTE_RL_UWORD 0 NO_COMPU_METHOD 0 65535 SYMBOL_LINK "Rte_CalprmRom_CalRegn01Cmn_DEFAULT_RTE_CALPRM_GROUP.GmMsg0C9BusHiSpdInvldTiOut_Val" 0 DISPLAY_IDENTIFIER GmMsg0C9BusHiSpd.CalibrationPorts.GmMsg0C9BusHiSpdInvldTiOut.Val /end CHARACTERISTIC
/begin CHARACTERISTIC GmMsg0C9BusHiSpd.GmMsg0C9BusHiSpdMissTiOut.Val "MICROSAR RTE" VALUE 0x0 RTE_RL_UWORD 0 NO_COMPU_METHOD 0 65535 SYMBOL_LINK "Rte_CalprmRom_CalRegn01Cmn_DEFAULT_RTE_CALPRM_GROUP.GmMsg0C9BusHiSpdMissTiOut_Val" 0 DISPLAY_IDENTIFIER GmMsg0C9BusHiSpd.CalibrationPorts.GmMsg0C9BusHiSpdMissTiOut.Val /end CHARACTERISTIC
/begin CHARACTERISTIC GmMsg0C9BusHiSpd.GmMsg0C9BusHiSpdVehSpdThd.Val "MICROSAR RTE" VALUE 0x0 RTE_RL_FLOAT32_IEEE 0 NO_COMPU_METHOD -3.402823466e+38 3.402823466e+38 SYMBOL_LINK "Rte_CalprmRom_CalRegn01Cmn_DEFAULT_RTE_CALPRM_GROUP.GmMsg0C9BusHiSpdVehSpdThd_Val" 0 DISPLAY_IDENTIFIER GmMsg0C9BusHiSpd.CalibrationPorts.GmMsg0C9BusHiSpdVehSpdThd.Val /end CHARACTERISTIC
/begin CHARACTERISTIC GmMsg17DBusHiSpd.GmMsg17DBusHiSpdInvldTiOut.Val "MICROSAR RTE" VALUE 0x0 RTE_RL_UWORD 0 NO_COMPU_METHOD 0 65535 SYMBOL_LINK "Rte_CalprmRom_CalRegn01Cmn_DEFAULT_RTE_CALPRM_GROUP.GmMsg17DBusHiSpdInvldTiOut_Val" 0 DISPLAY_IDENTIFIER GmMsg17DBusHiSpd.CalibrationPorts.GmMsg17DBusHiSpdInvldTiOut.Val /end CHARACTERISTIC
/begin CHARACTERISTIC GmMsg17DBusHiSpd.GmMsg17DBusHiSpdMissTiOut.Val "MICROSAR RTE" VALUE 0x0 RTE_RL_UWORD 0 NO_COMPU_METHOD 0 65535 SYMBOL_LINK "Rte_CalprmRom_CalRegn01Cmn_DEFAULT_RTE_CALPRM_GROUP.GmMsg17DBusHiSpdMissTiOut_Val" 0 DISPLAY_IDENTIFIER GmMsg17DBusHiSpd.CalibrationPorts.GmMsg17DBusHiSpdMissTiOut.Val /end CHARACTERISTIC
/begin CHARACTERISTIC GmMsg180BusChassisExp.GmMsg180BusChassisExpInvldProtnValTiOut.Val "MICROSAR RTE" VALUE 0x0 RTE_RL_UWORD 0 NO_COMPU_METHOD 0 65535 SYMBOL_LINK "Rte_CalprmRom_CalRegn01Cmn_DEFAULT_RTE_CALPRM_GROUP.GmMsg180BusChassisExpInvldProtnValTiOut_Val" 0 DISPLAY_IDENTIFIER GmMsg180BusChassisExp.CalibrationPorts.GmMsg180BusChassisExpInvldProtnValTiOut.Val /end CHARACTERISTIC
/begin CHARACTERISTIC GmMsg180BusChassisExp.GmMsg180BusChassisExpMissTiOut.Val "MICROSAR RTE" VALUE 0x0 RTE_RL_UWORD 0 NO_COMPU_METHOD 0 65535 SYMBOL_LINK "Rte_CalprmRom_CalRegn01Cmn_DEFAULT_RTE_CALPRM_GROUP.GmMsg180BusChassisExpMissTiOut_Val" 0 DISPLAY_IDENTIFIER GmMsg180BusChassisExp.CalibrationPorts.GmMsg180BusChassisExpMissTiOut.Val /end CHARACTERISTIC
/begin CHARACTERISTIC GmMsg180BusChassisExp.GmMsg180BusChassisExpRollgCntrInvldTiOut.Val "MICROSAR RTE" VALUE 0x0 RTE_RL_UWORD 0 NO_COMPU_METHOD 0 65535 SYMBOL_LINK "Rte_CalprmRom_CalRegn01Cmn_DEFAULT_RTE_CALPRM_GROUP.GmMsg180BusChassisExpRollgCntrInvldTiOut_Val" 0 DISPLAY_IDENTIFIER GmMsg180BusChassisExp.CalibrationPorts.GmMsg180BusChassisExpRollgCntrInvldTiOut.Val /end CHARACTERISTIC
/begin CHARACTERISTIC GmMsg180BusChassisExp.GmMsg180BusChassisExpTqPolarity.Val "MICROSAR RTE" VALUE 0x0 RTE_RL_SBYTE 0 NO_COMPU_METHOD -128 127 SYMBOL_LINK "Rte_CalprmRom_CalRegn01Cmn_DEFAULT_RTE_CALPRM_GROUP.GmMsg180BusChassisExpTqPolarity_Val" 0 DISPLAY_IDENTIFIER GmMsg180BusChassisExp.CalibrationPorts.GmMsg180BusChassisExpTqPolarity.Val /end CHARACTERISTIC
/begin CHARACTERISTIC GmMsg180BusHiSpd.GmMsg180BusHiSpdCrcInvldTiOut.Val "MICROSAR RTE" VALUE 0x0 RTE_RL_UWORD 0 NO_COMPU_METHOD 0 65535 SYMBOL_LINK "Rte_CalprmRom_CalRegn01Cmn_DEFAULT_RTE_CALPRM_GROUP.GmMsg180BusHiSpdCrcInvldTiOut_Val" 0 DISPLAY_IDENTIFIER GmMsg180BusHiSpd.CalibrationPorts.GmMsg180BusHiSpdCrcInvldTiOut.Val /end CHARACTERISTIC
/begin CHARACTERISTIC GmMsg180BusHiSpd.GmMsg180BusHiSpdMissTiOut.Val "MICROSAR RTE" VALUE 0x0 RTE_RL_UWORD 0 NO_COMPU_METHOD 0 65535 SYMBOL_LINK "Rte_CalprmRom_CalRegn01Cmn_DEFAULT_RTE_CALPRM_GROUP.GmMsg180BusHiSpdMissTiOut_Val" 0 DISPLAY_IDENTIFIER GmMsg180BusHiSpd.CalibrationPorts.GmMsg180BusHiSpdMissTiOut.Val /end CHARACTERISTIC
/begin CHARACTERISTIC GmMsg180BusHiSpd.GmMsg180BusHiSpdRollgCntrInvldTiOut.Val "MICROSAR RTE" VALUE 0x0 RTE_RL_UWORD 0 NO_COMPU_METHOD 0 65535 SYMBOL_LINK "Rte_CalprmRom_CalRegn01Cmn_DEFAULT_RTE_CALPRM_GROUP.GmMsg180BusHiSpdRollgCntrInvldTiOut_Val" 0 DISPLAY_IDENTIFIER GmMsg180BusHiSpd.CalibrationPorts.GmMsg180BusHiSpdRollgCntrInvldTiOut.Val /end CHARACTERISTIC
/begin CHARACTERISTIC GmMsg180BusHiSpd.GmMsg180BusHiSpdTqPolarity.Val "MICROSAR RTE" VALUE 0x0 RTE_RL_SBYTE 0 NO_COMPU_METHOD -128 127 SYMBOL_LINK "Rte_CalprmRom_CalRegn01Cmn_DEFAULT_RTE_CALPRM_GROUP.GmMsg180BusHiSpdTqPolarity_Val" 0 DISPLAY_IDENTIFIER GmMsg180BusHiSpd.CalibrationPorts.GmMsg180BusHiSpdTqPolarity.Val /end CHARACTERISTIC
/begin CHARACTERISTIC GmMsg182BusChassisExp.GmMsg182BusChassisExpInvldTiOut.Val "MICROSAR RTE" VALUE 0x0 RTE_RL_UWORD 0 NO_COMPU_METHOD 0 65535 SYMBOL_LINK "Rte_CalprmRom_CalRegn01Cmn_DEFAULT_RTE_CALPRM_GROUP.GmMsg182BusChassisExpInvldTiOut_Val" 0 DISPLAY_IDENTIFIER GmMsg182BusChassisExp.CalibrationPorts.GmMsg182BusChassisExpInvldTiOut.Val /end CHARACTERISTIC
/begin CHARACTERISTIC GmMsg182BusChassisExp.GmMsg182BusChassisExpMissTiOut.Val "MICROSAR RTE" VALUE 0x0 RTE_RL_UWORD 0 NO_COMPU_METHOD 0 65535 SYMBOL_LINK "Rte_CalprmRom_CalRegn01Cmn_DEFAULT_RTE_CALPRM_GROUP.GmMsg182BusChassisExpMissTiOut_Val" 0 DISPLAY_IDENTIFIER GmMsg182BusChassisExp.CalibrationPorts.GmMsg182BusChassisExpMissTiOut.Val /end CHARACTERISTIC
/begin CHARACTERISTIC GmMsg184BusHiSpd.GmMsg184BusHiSpdHandsOnThd.Val "MICROSAR RTE" VALUE 0x0 RTE_RL_FLOAT32_IEEE 0 NO_COMPU_METHOD -3.402823466e+38 3.402823466e+38 SYMBOL_LINK "Rte_CalprmRom_CalRegn01Cmn_DEFAULT_RTE_CALPRM_GROUP.GmMsg184BusHiSpdHandsOnThd_Val" 0 DISPLAY_IDENTIFIER GmMsg184BusHiSpd.CalibrationPorts.GmMsg184BusHiSpdHandsOnThd.Val /end CHARACTERISTIC
/begin CHARACTERISTIC GmMsg184BusHiSpd.GmMsg184BusHiSpdTqPolarity.Val "MICROSAR RTE" VALUE 0x0 RTE_RL_SBYTE 0 NO_COMPU_METHOD -128 127 SYMBOL_LINK "Rte_CalprmRom_CalRegn01Cmn_DEFAULT_RTE_CALPRM_GROUP.GmMsg184BusHiSpdTqPolarity_Val" 0 DISPLAY_IDENTIFIER GmMsg184BusHiSpd.CalibrationPorts.GmMsg184BusHiSpdTqPolarity.Val /end CHARACTERISTIC
/begin CHARACTERISTIC GmMsg184BusHiSpd.GmOvrlStMgrLkaMfgEna.Logl "MICROSAR RTE" VALUE 0x0 RTE_RL_BOOLEAN 0 RTE_CM_BOOLEAN 0 255 SYMBOL_LINK "Rte_CalprmRom_CalRegn02CmnGroupA_DEFAULT_RTE_CALPRM_GROUP.GmOvrlStMgrLkaMfgEna_Logl" 0 DISPLAY_IDENTIFIER GmMsg184BusHiSpd.CalibrationPorts.GmOvrlStMgrLkaMfgEna.Logl /end CHARACTERISTIC
/begin CHARACTERISTIC GmMsg184BusHiSpd.LoaMgrHwTqIdptSigFltThd.Val "MICROSAR RTE" VALUE 0x0 RTE_RL_UBYTE 0 NO_COMPU_METHOD 0 255 SYMBOL_LINK "Rte_CalprmRom_CalRegn01Cmn_DEFAULT_RTE_CALPRM_GROUP.LoaMgrHwTqIdptSigFltThd_Val" 0 DISPLAY_IDENTIFIER GmMsg184BusHiSpd.CalibrationPorts.LoaMgrHwTqIdptSigFltThd.Val /end CHARACTERISTIC
/begin CHARACTERISTIC GmMsg1CABusChassisExp.GmMsg1CaBusChassisExpTqPolarity.Val "MICROSAR RTE" VALUE 0x0 RTE_RL_SBYTE 0 NO_COMPU_METHOD -128 127 SYMBOL_LINK "Rte_CalprmRom_CalRegn01Cmn_DEFAULT_RTE_CALPRM_GROUP.GmMsg1CaBusChassisExpTqPolarity_Val" 0 DISPLAY_IDENTIFIER GmMsg1CABusChassisExp.CalibrationPorts.GmMsg1CaBusChassisExpTqPolarity.Val /end CHARACTERISTIC
/begin CHARACTERISTIC GmMsg1E9BusHiSpd.GmMsg1E9BusHiSpdAbsFaildTiOut.Val "MICROSAR RTE" VALUE 0x0 RTE_RL_UWORD 0 NO_COMPU_METHOD 0 65535 SYMBOL_LINK "Rte_CalprmRom_CalRegn01Cmn_DEFAULT_RTE_CALPRM_GROUP.GmMsg1E9BusHiSpdAbsFaildTiOut_Val" 0 DISPLAY_IDENTIFIER GmMsg1E9BusHiSpd.CalibrationPorts.GmMsg1E9BusHiSpdAbsFaildTiOut.Val /end CHARACTERISTIC
/begin CHARACTERISTIC GmMsg1E9BusHiSpd.GmMsg1E9BusHiSpdLatADft.Val "MICROSAR RTE" VALUE 0x0 RTE_RL_FLOAT32_IEEE 0 NO_COMPU_METHOD -3.402823466e+38 3.402823466e+38 SYMBOL_LINK "Rte_CalprmRom_CalRegn01Cmn_DEFAULT_RTE_CALPRM_GROUP.GmMsg1E9BusHiSpdLatADft_Val" 0 DISPLAY_IDENTIFIER GmMsg1E9BusHiSpd.CalibrationPorts.GmMsg1E9BusHiSpdLatADft.Val /end CHARACTERISTIC
/begin CHARACTERISTIC GmMsg1E9BusHiSpd.GmMsg1E9BusHiSpdLatAInvldTiOut.Val "MICROSAR RTE" VALUE 0x0 RTE_RL_UWORD 0 NO_COMPU_METHOD 0 65535 SYMBOL_LINK "Rte_CalprmRom_CalRegn01Cmn_DEFAULT_RTE_CALPRM_GROUP.GmMsg1E9BusHiSpdLatAInvldTiOut_Val" 0 DISPLAY_IDENTIFIER GmMsg1E9BusHiSpd.CalibrationPorts.GmMsg1E9BusHiSpdLatAInvldTiOut.Val /end CHARACTERISTIC
/begin CHARACTERISTIC GmMsg1E9BusHiSpd.GmMsg1E9BusHiSpdMissTiOut.Val "MICROSAR RTE" VALUE 0x0 RTE_RL_UWORD 0 NO_COMPU_METHOD 0 65535 SYMBOL_LINK "Rte_CalprmRom_CalRegn01Cmn_DEFAULT_RTE_CALPRM_GROUP.GmMsg1E9BusHiSpdMissTiOut_Val" 0 DISPLAY_IDENTIFIER GmMsg1E9BusHiSpd.CalibrationPorts.GmMsg1E9BusHiSpdMissTiOut.Val /end CHARACTERISTIC
/begin CHARACTERISTIC GmMsg1E9BusHiSpd.GmMsg1E9BusHiSpdTcsDisadTiOut.Val "MICROSAR RTE" VALUE 0x0 RTE_RL_UWORD 0 NO_COMPU_METHOD 0 65535 SYMBOL_LINK "Rte_CalprmRom_CalRegn01Cmn_DEFAULT_RTE_CALPRM_GROUP.GmMsg1E9BusHiSpdTcsDisadTiOut_Val" 0 DISPLAY_IDENTIFIER GmMsg1E9BusHiSpd.CalibrationPorts.GmMsg1E9BusHiSpdTcsDisadTiOut.Val /end CHARACTERISTIC
/begin CHARACTERISTIC GmMsg1E9BusHiSpd.GmMsg1E9BusHiSpdVehDynCtrlStTiOut.Val "MICROSAR RTE" VALUE 0x0 RTE_RL_UWORD 0 NO_COMPU_METHOD 0 65535 SYMBOL_LINK "Rte_CalprmRom_CalRegn01Cmn_DEFAULT_RTE_CALPRM_GROUP.GmMsg1E9BusHiSpdVehDynCtrlStTiOut_Val" 0 DISPLAY_IDENTIFIER GmMsg1E9BusHiSpd.CalibrationPorts.GmMsg1E9BusHiSpdVehDynCtrlStTiOut.Val /end CHARACTERISTIC
/begin CHARACTERISTIC GmMsg1E9BusHiSpd.GmMsg1E9BusHiSpdVehStabyEnhmtActvVldTiOut.Val "MICROSAR RTE" VALUE 0x0 RTE_RL_UWORD 0 NO_COMPU_METHOD 0 65535 SYMBOL_LINK "Rte_CalprmRom_CalRegn01Cmn_DEFAULT_RTE_CALPRM_GROUP.GmMsg1E9BusHiSpdVehStabyEnhmtActvVldTiOut_Val" 0 DISPLAY_IDENTIFIER GmMsg1E9BusHiSpd.CalibrationPorts.GmMsg1E9BusHiSpdVehStabyEnhmtActvVldTiOut.Val /end CHARACTERISTIC
/begin CHARACTERISTIC GmMsg1E9BusHiSpd.GmMsg1E9BusHiSpdYawRateDft.Val "MICROSAR RTE" VALUE 0x0 RTE_RL_FLOAT32_IEEE 0 NO_COMPU_METHOD -3.402823466e+38 3.402823466e+38 SYMBOL_LINK "Rte_CalprmRom_CalRegn01Cmn_DEFAULT_RTE_CALPRM_GROUP.GmMsg1E9BusHiSpdYawRateDft_Val" 0 DISPLAY_IDENTIFIER GmMsg1E9BusHiSpd.CalibrationPorts.GmMsg1E9BusHiSpdYawRateDft.Val /end CHARACTERISTIC
/begin CHARACTERISTIC GmMsg1E9BusHiSpd.GmMsg1E9BusHiSpdYawRateInvldTiOut.Val "MICROSAR RTE" VALUE 0x0 RTE_RL_UWORD 0 NO_COMPU_METHOD 0 65535 SYMBOL_LINK "Rte_CalprmRom_CalRegn01Cmn_DEFAULT_RTE_CALPRM_GROUP.GmMsg1E9BusHiSpdYawRateInvldTiOut_Val" 0 DISPLAY_IDENTIFIER GmMsg1E9BusHiSpd.CalibrationPorts.GmMsg1E9BusHiSpdYawRateInvldTiOut.Val /end CHARACTERISTIC
/begin CHARACTERISTIC GmMsg1F1BusHiSpd.GmMsg1F1BusHiSpdMissTiOut.Val "MICROSAR RTE" VALUE 0x0 RTE_RL_UWORD 0 NO_COMPU_METHOD 0 65535 SYMBOL_LINK "Rte_CalprmRom_CalRegn01Cmn_DEFAULT_RTE_CALPRM_GROUP.GmMsg1F1BusHiSpdMissTiOut_Val" 0 DISPLAY_IDENTIFIER GmMsg1F1BusHiSpd.CalibrationPorts.GmMsg1F1BusHiSpdMissTiOut.Val /end CHARACTERISTIC
/begin CHARACTERISTIC GmMsg1F5BusHiSpd.GmMsg1F5BusHiSpdInvldTiOut.Val "MICROSAR RTE" VALUE 0x0 RTE_RL_UWORD 0 NO_COMPU_METHOD 0 65535 SYMBOL_LINK "Rte_CalprmRom_CalRegn01Cmn_DEFAULT_RTE_CALPRM_GROUP.GmMsg1F5BusHiSpdInvldTiOut_Val" 0 DISPLAY_IDENTIFIER GmMsg1F5BusHiSpd.CalibrationPorts.GmMsg1F5BusHiSpdInvldTiOut.Val /end CHARACTERISTIC
/begin CHARACTERISTIC GmMsg1F5BusHiSpd.GmMsg1F5BusHiSpdMissTiOut.Val "MICROSAR RTE" VALUE 0x0 RTE_RL_UWORD 0 NO_COMPU_METHOD 0 65535 SYMBOL_LINK "Rte_CalprmRom_CalRegn01Cmn_DEFAULT_RTE_CALPRM_GROUP.GmMsg1F5BusHiSpdMissTiOut_Val" 0 DISPLAY_IDENTIFIER GmMsg1F5BusHiSpd.CalibrationPorts.GmMsg1F5BusHiSpdMissTiOut.Val /end CHARACTERISTIC
/begin CHARACTERISTIC GmMsg214BusHiSpd.GmMsg214BusHiSpdAbsActvProtdInvldTiOut.Val "MICROSAR RTE" VALUE 0x0 RTE_RL_UWORD 0 NO_COMPU_METHOD 0 65535 SYMBOL_LINK "Rte_CalprmRom_CalRegn01Cmn_DEFAULT_RTE_CALPRM_GROUP.GmMsg214BusHiSpdAbsActvProtdInvldTiOut_Val" 0 DISPLAY_IDENTIFIER GmMsg214BusHiSpd.CalibrationPorts.GmMsg214BusHiSpdAbsActvProtdInvldTiOut.Val /end CHARACTERISTIC
/begin MEASUREMENT GmFctDiArbn.HwAgEotCcw.Val "MICROSAR RTE" FLOAT32_IEEE NO_COMPU_METHOD 0 0 -3.402823466e+38 3.402823466e+38 ECU_ADDRESS 0 SYMBOL_LINK "Rte_EotLrng_HwAgEotCcw_Val" 0 DISPLAY_IDENTIFIER GmFctDiArbn.ReceiverPorts.HwAgEotCcw.Val /end MEASUREMENT
/begin MEASUREMENT GmFctDiArbn.HwAgEotCw.Val "MICROSAR RTE" FLOAT32_IEEE NO_COMPU_METHOD 0 0 -3.402823466e+38 3.402823466e+38 ECU_ADDRESS 0 SYMBOL_LINK "Rte_EotLrng_HwAgEotCw_Val" 0 DISPLAY_IDENTIFIER GmFctDiArbn.ReceiverPorts.HwAgEotCw.Val /end MEASUREMENT
/begin MEASUREMENT GmFctDiArbn.HwTq.Val "MICROSAR RTE" FLOAT32_IEEE NO_COMPU_METHOD 0 0 -3.402823466e+38 3.402823466e+38 ECU_ADDRESS 0 SYMBOL_LINK "Rte_Swp_HwTqSwp_Val" 0 DISPLAY_IDENTIFIER GmFctDiArbn.ReceiverPorts.HwTq.Val /end MEASUREMENT
/begin MEASUREMENT GmFctDiArbn.InCcwEotRng "MICROSAR RTE" UBYTE RTE_CM_BOOLEAN 0 0 0 255 ECU_ADDRESS 0 SYMBOL_LINK "Rte_GmFctDiArbn_InCcwEotRng" 0 DISPLAY_IDENTIFIER GmFctDiArbn.PerInstanceMemories.InCcwEotRng /end MEASUREMENT
/begin MEASUREMENT GmFctDiArbn.InCcwEotRngElpdTi "MICROSAR RTE" ULONG NO_COMPU_METHOD 0 0 0 4294967295 ECU_ADDRESS 0 SYMBOL_LINK "Rte_GmFctDiArbn_InCcwEotRngElpdTi" 0 DISPLAY_IDENTIFIER GmFctDiArbn.PerInstanceMemories.InCcwEotRngElpdTi /end MEASUREMENT
/begin MEASUREMENT GmFctDiArbn.InCwEotRng "MICROSAR RTE" UBYTE RTE_CM_BOOLEAN 0 0 0 255 ECU_ADDRESS 0 SYMBOL_LINK "Rte_GmFctDiArbn_InCwEotRng" 0 DISPLAY_IDENTIFIER GmFctDiArbn.PerInstanceMemories.InCwEotRng /end MEASUREMENT
/begin MEASUREMENT GmFctDiArbn.InCwEotRngElpdTi "MICROSAR RTE" ULONG NO_COMPU_METHOD 0 0 0 4294967295 ECU_ADDRESS 0 SYMBOL_LINK "Rte_GmFctDiArbn_InCwEotRngElpdTi" 0 DISPLAY_IDENTIFIER GmFctDiArbn.PerInstanceMemories.InCwEotRngElpdTi /end MEASUREMENT
/begin MEASUREMENT GmFctDiArbn.InOnCentrRng "MICROSAR RTE" UBYTE RTE_CM_BOOLEAN 0 0 0 255 ECU_ADDRESS 0 SYMBOL_LINK "Rte_GmFctDiArbn_InOnCentrRng" 0 DISPLAY_IDENTIFIER GmFctDiArbn.PerInstanceMemories.InOnCentrRng /end MEASUREMENT
/begin MEASUREMENT GmFctDiArbn.InertiaCmpDecelGainDi.Logl "MICROSAR RTE" UBYTE RTE_CM_BOOLEAN 0 0 0 255 ECU_ADDRESS 0 SYMBOL_LINK "Rte_GmFctDiArbn_InertiaCmpDecelGainDi_Logl" 0 DISPLAY_IDENTIFIER GmFctDiArbn.SenderPorts.InertiaCmpDecelGainDi.Logl /end MEASUREMENT
/begin MEASUREMENT GmFctDiArbn.LkaEna.Logl "MICROSAR RTE" UBYTE RTE_CM_BOOLEAN 0 0 0 255 ECU_ADDRESS 0 SYMBOL_LINK "Rte_GmMsg180BusHiSpd_LkaReqActv_Logl" 0 DISPLAY_IDENTIFIER GmFctDiArbn.ReceiverPorts.LkaEna.Logl /end MEASUREMENT
/begin MEASUREMENT GmFctDiArbn.LkaEnaArbn.Logl "MICROSAR RTE" UBYTE RTE_CM_BOOLEAN 0 0 0 255 ECU_ADDRESS 0 SYMBOL_LINK "Rte_GmFctDiArbn_LkaEnaArbn_Logl" 0 DISPLAY_IDENTIFIER GmFctDiArbn.SenderPorts.LkaEnaArbn.Logl /end MEASUREMENT
/begin MEASUREMENT GmFctDiArbn.LoaSt.Val "MICROSAR RTE" UBYTE RTE_CM_ENUM_LoaSt1 0 0 0 255 ECU_ADDRESS 0 SYMBOL_LINK "Rte_LoaMgr_LoaSt_Val" 0 DISPLAY_IDENTIFIER GmFctDiArbn.ReceiverPorts.LoaSt.Val /end MEASUREMENT
/begin MEASUREMENT GmFctDiArbn.OnCentrElpdTi "MICROSAR RTE" ULONG NO_COMPU_METHOD 0 0 0 4294967295 ECU_ADDRESS 0 SYMBOL_LINK "Rte_GmFctDiArbn_OnCentrElpdTi" 0 DISPLAY_IDENTIFIER GmFctDiArbn.PerInstanceMemories.OnCentrElpdTi /end MEASUREMENT
/begin MEASUREMENT GmFctDiArbn.PullCmpActvDi.Logl "MICROSAR RTE" UBYTE RTE_CM_BOOLEAN 0 0 0 255 ECU_ADDRESS 0 SYMBOL_LINK "Rte_GmFctDiArbn_PullCmpActvDi_Logl" 0 DISPLAY_IDENTIFIER GmFctDiArbn.SenderPorts.PullCmpActvDi.Logl /end MEASUREMENT
/begin MEASUREMENT GmFctDiArbn.TunSetRtDi.Logl "MICROSAR RTE" UBYTE RTE_CM_BOOLEAN 0 0 0 255 ECU_ADDRESS 0 SYMBOL_LINK "Rte_GmFctDiArbn_TunSetRtDi_Logl" 0 DISPLAY_IDENTIFIER GmFctDiArbn.SenderPorts.TunSetRtDi.Logl /end MEASUREMENT
/begin MEASUREMENT GmFctDiArbn.WhlImbRejctnDi.Logl "MICROSAR RTE" UBYTE RTE_CM_BOOLEAN 0 0 0 255 ECU_ADDRESS 0 SYMBOL_LINK "Rte_GmFctDiArbn_WhlImbRejctnDi_Logl" 0 DISPLAY_IDENTIFIER GmFctDiArbn.SenderPorts.WhlImbRejctnDi.Logl /end MEASUREMENT
/begin MEASUREMENT GmMsg0C5BusHiSpd.GmMsg0C5BusHiSpdLeInvldTmr "MICROSAR RTE" ULONG NO_COMPU_METHOD 0 0 0 4294967295 ECU_ADDRESS 0 SYMBOL_LINK "Rte_GmMsg0C5BusHiSpd_GmMsg0C5BusHiSpdLeInvldTmr" 0 DISPLAY_IDENTIFIER GmMsg0C5BusHiSpd.PerInstanceMemories.GmMsg0C5BusHiSpdLeInvldTmr /end MEASUREMENT
/begin MEASUREMENT GmMsg0C5BusHiSpd.GmMsg0C5BusHiSpdLeRstTmr "MICROSAR RTE" ULONG NO_COMPU_METHOD 0 0 0 4294967295 ECU_ADDRESS 0 SYMBOL_LINK "Rte_GmMsg0C5BusHiSpd_GmMsg0C5BusHiSpdLeRstTmr" 0 DISPLAY_IDENTIFIER GmMsg0C5BusHiSpd.PerInstanceMemories.GmMsg0C5BusHiSpdLeRstTmr /end MEASUREMENT
/begin MEASUREMENT GmMsg0C5BusHiSpd.GmMsg0C5BusHiSpdLeSeqNrTmr "MICROSAR RTE" ULONG NO_COMPU_METHOD 0 0 0 4294967295 ECU_ADDRESS 0 SYMBOL_LINK "Rte_GmMsg0C5BusHiSpd_GmMsg0C5BusHiSpdLeSeqNrTmr" 0 DISPLAY_IDENTIFIER GmMsg0C5BusHiSpd.PerInstanceMemories.GmMsg0C5BusHiSpdLeSeqNrTmr /end MEASUREMENT
/begin MEASUREMENT GmMsg0C5BusHiSpd.GmMsg0C5BusHiSpdPrevLeDstPlsCnt "MICROSAR RTE" UWORD NO_COMPU_METHOD 0 0 0 65535 ECU_ADDRESS 0 SYMBOL_LINK "Rte_GmMsg0C5BusHiSpd_GmMsg0C5BusHiSpdPrevLeDstPlsCnt" 0 DISPLAY_IDENTIFIER GmMsg0C5BusHiSpd.PerInstanceMemories.GmMsg0C5BusHiSpdPrevLeDstPlsCnt /end MEASUREMENT
/begin MEASUREMENT GmMsg0C5BusHiSpd.GmMsg0C5BusHiSpdPrevLeDstTiStamp "MICROSAR RTE" UWORD NO_COMPU_METHOD 0 0 0 65535 ECU_ADDRESS 0 SYMBOL_LINK "Rte_GmMsg0C5BusHiSpd_GmMsg0C5BusHiSpdPrevLeDstTiStamp" 0 DISPLAY_IDENTIFIER GmMsg0C5BusHiSpd.PerInstanceMemories.GmMsg0C5BusHiSpdPrevLeDstTiStamp /end MEASUREMENT
/begin MEASUREMENT GmMsg0C5BusHiSpd.GmMsg0C5BusHiSpdPrevLeSeqNr "MICROSAR RTE" UBYTE NO_COMPU_METHOD 0 0 0 255 ECU_ADDRESS 0 SYMBOL_LINK "Rte_GmMsg0C5BusHiSpd_GmMsg0C5BusHiSpdPrevLeSeqNr" 0 DISPLAY_IDENTIFIER GmMsg0C5BusHiSpd.PerInstanceMemories.GmMsg0C5BusHiSpdPrevLeSeqNr /end MEASUREMENT
/begin MEASUREMENT GmMsg0C5BusHiSpd.GmMsg0C5BusHiSpdPrevLeVld "MICROSAR RTE" UBYTE RTE_CM_BOOLEAN 0 0 0 255 ECU_ADDRESS 0 SYMBOL_LINK "Rte_GmMsg0C5BusHiSpd_GmMsg0C5BusHiSpdPrevLeVld" 0 DISPLAY_IDENTIFIER GmMsg0C5BusHiSpd.PerInstanceMemories.GmMsg0C5BusHiSpdPrevLeVld /end MEASUREMENT
/begin MEASUREMENT GmMsg0C5BusHiSpd.GmMsg0C5BusHiSpdPrevRiDstPlsCnt "MICROSAR RTE" UWORD NO_COMPU_METHOD 0 0 0 65535 ECU_ADDRESS 0 SYMBOL_LINK "Rte_GmMsg0C5BusHiSpd_GmMsg0C5BusHiSpdPrevRiDstPlsCnt" 0 DISPLAY_IDENTIFIER GmMsg0C5BusHiSpd.PerInstanceMemories.GmMsg0C5BusHiSpdPrevRiDstPlsCnt /end MEASUREMENT
/begin MEASUREMENT GmMsg0C5BusHiSpd.GmMsg0C5BusHiSpdPrevRiDstTiStamp "MICROSAR RTE" UWORD NO_COMPU_METHOD 0 0 0 65535 ECU_ADDRESS 0 SYMBOL_LINK "Rte_GmMsg0C5BusHiSpd_GmMsg0C5BusHiSpdPrevRiDstTiStamp" 0 DISPLAY_IDENTIFIER GmMsg0C5BusHiSpd.PerInstanceMemories.GmMsg0C5BusHiSpdPrevRiDstTiStamp /end MEASUREMENT
/begin MEASUREMENT GmMsg0C5BusHiSpd.GmMsg0C5BusHiSpdPrevRiSeqNr "MICROSAR RTE" UBYTE NO_COMPU_METHOD 0 0 0 255 ECU_ADDRESS 0 SYMBOL_LINK "Rte_GmMsg0C5BusHiSpd_GmMsg0C5BusHiSpdPrevRiSeqNr" 0 DISPLAY_IDENTIFIER GmMsg0C5BusHiSpd.PerInstanceMemories.GmMsg0C5BusHiSpdPrevRiSeqNr /end MEASUREMENT
/begin MEASUREMENT GmMsg0C5BusHiSpd.GmMsg0C5BusHiSpdPrevRiVld "MICROSAR RTE" UBYTE RTE_CM_BOOLEAN 0 0 0 255 ECU_ADDRESS 0 SYMBOL_LINK "Rte_GmMsg0C5BusHiSpd_GmMsg0C5BusHiSpdPrevRiVld" 0 DISPLAY_IDENTIFIER GmMsg0C5BusHiSpd.PerInstanceMemories.GmMsg0C5BusHiSpdPrevRiVld /end MEASUREMENT
/begin MEASUREMENT GmMsg0C5BusHiSpd.GmMsg0C5BusHiSpdPrevRxnTi "MICROSAR RTE" ULONG NO_COMPU_METHOD 0 0 0 4294967295 ECU_ADDRESS 0 SYMBOL_LINK "Rte_GmMsg0C5BusHiSpd_GmMsg0C5BusHiSpdPrevRxnTi" 0 DISPLAY_IDENTIFIER GmMsg0C5BusHiSpd.PerInstanceMemories.GmMsg0C5BusHiSpdPrevRxnTi /end MEASUREMENT
/begin MEASUREMENT GmMsg0C5BusHiSpd.GmMsg0C5BusHiSpdRiInvldTmr "MICROSAR RTE" ULONG NO_COMPU_METHOD 0 0 0 4294967295 ECU_ADDRESS 0 SYMBOL_LINK "Rte_GmMsg0C5BusHiSpd_GmMsg0C5BusHiSpdRiInvldTmr" 0 DISPLAY_IDENTIFIER GmMsg0C5BusHiSpd.PerInstanceMemories.GmMsg0C5BusHiSpdRiInvldTmr /end MEASUREMENT
/begin MEASUREMENT GmMsg0C5BusHiSpd.GmMsg0C5BusHiSpdRiRstTmr "MICROSAR RTE" ULONG NO_COMPU_METHOD 0 0 0 4294967295 ECU_ADDRESS 0 SYMBOL_LINK "Rte_GmMsg0C5BusHiSpd_GmMsg0C5BusHiSpdRiRstTmr" 0 DISPLAY_IDENTIFIER GmMsg0C5BusHiSpd.PerInstanceMemories.GmMsg0C5BusHiSpdRiRstTmr /end MEASUREMENT
/begin MEASUREMENT GmMsg0C5BusHiSpd.GmMsg0C5BusHiSpdRiSeqNrTmr "MICROSAR RTE" ULONG NO_COMPU_METHOD 0 0 0 4294967295 ECU_ADDRESS 0 SYMBOL_LINK "Rte_GmMsg0C5BusHiSpd_GmMsg0C5BusHiSpdRiSeqNrTmr" 0 DISPLAY_IDENTIFIER GmMsg0C5BusHiSpd.PerInstanceMemories.GmMsg0C5BusHiSpdRiSeqNrTmr /end MEASUREMENT
/begin MEASUREMENT GmMsg0C5BusHiSpd.GmMsg0C5BusHiSpdRollgCntrRst "MICROSAR RTE" UBYTE RTE_CM_BOOLEAN 0 0 0 255 ECU_ADDRESS 0 SYMBOL_LINK "Rte_GmMsg0C5BusHiSpd_GmMsg0C5BusHiSpdRollgCntrRst" 0 DISPLAY_IDENTIFIER GmMsg0C5BusHiSpd.PerInstanceMemories.GmMsg0C5BusHiSpdRollgCntrRst /end MEASUREMENT
/begin MEASUREMENT GmMsg0C5BusHiSpd.LeWhlDstPlsCntr.Val "MICROSAR RTE" UWORD NO_COMPU_METHOD 0 0 0 65535 ECU_ADDRESS 0 SYMBOL_LINK "Rte_GmMsg0C5BusHiSpd_LeWhlDstPlsCntr_Val" 0 DISPLAY_IDENTIFIER GmMsg0C5BusHiSpd.SenderPorts.LeWhlDstPlsCntr.Val /end MEASUREMENT
/begin MEASUREMENT GmMsg0C5BusHiSpd.LeWhlDstPlsCntrRaw.Val "MICROSAR RTE" UWORD NO_COMPU_METHOD 0 0 0 65535 ECU_ADDRESS 0 SYMBOL_LINK "Rte_SerlComInpProxy_LeWhlDstPlsCntrRaw_Val" 0 DISPLAY_IDENTIFIER GmMsg0C5BusHiSpd.ReceiverPorts.LeWhlDstPlsCntrRaw.Val /end MEASUREMENT
/begin MEASUREMENT GmMsg0C5BusHiSpd.LeWhlDstTiStamp.Val "MICROSAR RTE" UWORD NO_COMPU_METHOD 0 0 0 65535 ECU_ADDRESS 0 SYMBOL_LINK "Rte_GmMsg0C5BusHiSpd_LeWhlDstTiStamp_Val" 0 DISPLAY_IDENTIFIER GmMsg0C5BusHiSpd.SenderPorts.LeWhlDstTiStamp.Val /end MEASUREMENT
/begin MEASUREMENT GmMsg0C5BusHiSpd.LeWhlDstTiStampRaw.Val "MICROSAR RTE" UWORD NO_COMPU_METHOD 0 0 0 65535 ECU_ADDRESS 0 SYMBOL_LINK "Rte_SerlComInpProxy_LeWhlDstTiStampRaw_Val" 0 DISPLAY_IDENTIFIER GmMsg0C5BusHiSpd.ReceiverPorts.LeWhlDstTiStampRaw.Val /end MEASUREMENT
/begin MEASUREMENT GmMsg0C5BusHiSpd.LeWhlDstVld.Logl "MICROSAR RTE" UBYTE RTE_CM_BOOLEAN 0 0 0 255 ECU_ADDRESS 0 SYMBOL_LINK "Rte_GmMsg0C5BusHiSpd_LeWhlDstVld_Logl" 0 DISPLAY_IDENTIFIER GmMsg0C5BusHiSpd.SenderPorts.LeWhlDstVld.Logl /end MEASUREMENT
/begin MEASUREMENT GmMsg0C5BusHiSpd.LeWhlDstVldRaw.Val "MICROSAR RTE" UBYTE NO_COMPU_METHOD 0 0 0 255 ECU_ADDRESS 0 SYMBOL_LINK "Rte_SerlComInpProxy_LeWhlDstVldRaw_Val" 0 DISPLAY_IDENTIFIER GmMsg0C5BusHiSpd.ReceiverPorts.LeWhlDstVldRaw.Val /end MEASUREMENT
/begin MEASUREMENT GmMsg0C5BusHiSpd.LeWhlRotlStsRstRaw.Val "MICROSAR RTE" UBYTE NO_COMPU_METHOD 0 0 0 255 ECU_ADDRESS 0 SYMBOL_LINK "Rte_SerlComInpProxy_LeWhlRotlStsRstRaw_Val" 0 DISPLAY_IDENTIFIER GmMsg0C5BusHiSpd.ReceiverPorts.LeWhlRotlStsRstRaw.Val /end MEASUREMENT
/begin MEASUREMENT GmMsg0C5BusHiSpd.LeWhlSeqNrRaw.Val "MICROSAR RTE" UBYTE NO_COMPU_METHOD 0 0 0 255 ECU_ADDRESS 0 SYMBOL_LINK "Rte_SerlComInpProxy_LeWhlSeqNrRaw_Val" 0 DISPLAY_IDENTIFIER GmMsg0C5BusHiSpd.ReceiverPorts.LeWhlSeqNrRaw.Val /end MEASUREMENT
/begin MEASUREMENT GmMsg0C5BusHiSpd.LstRxnTiMsg0C5BusHiSpd.Val "MICROSAR RTE" ULONG NO_COMPU_METHOD 0 0 0 4294967295 ECU_ADDRESS 0 SYMBOL_LINK "Rte_SerlComInpProxy_LstRxnTiMsg0C5_Val" 0 DISPLAY_IDENTIFIER GmMsg0C5BusHiSpd.ReceiverPorts.LstRxnTiMsg0C5BusHiSpd.Val /end MEASUREMENT
/begin MEASUREMENT GmMsg0C5BusHiSpd.RiWhlDstPlsCntr.Val "MICROSAR RTE" UWORD NO_COMPU_METHOD 0 0 0 65535 ECU_ADDRESS 0 SYMBOL_LINK "Rte_GmMsg0C5BusHiSpd_RiWhlDstPlsCntr_Val" 0 DISPLAY_IDENTIFIER GmMsg0C5BusHiSpd.SenderPorts.RiWhlDstPlsCntr.Val /end MEASUREMENT
/begin MEASUREMENT GmMsg0C5BusHiSpd.RiWhlDstPlsCntrRaw.Val "MICROSAR RTE" UWORD NO_COMPU_METHOD 0 0 0 65535 ECU_ADDRESS 0 SYMBOL_LINK "Rte_SerlComInpProxy_RiWhlDstPlsCntrRaw_Val" 0 DISPLAY_IDENTIFIER GmMsg0C5BusHiSpd.ReceiverPorts.RiWhlDstPlsCntrRaw.Val /end MEASUREMENT
/begin MEASUREMENT GmMsg0C5BusHiSpd.RiWhlDstTiStamp.Val "MICROSAR RTE" UWORD NO_COMPU_METHOD 0 0 0 65535 ECU_ADDRESS 0 SYMBOL_LINK "Rte_GmMsg0C5BusHiSpd_RiWhlDstTiStamp_Val" 0 DISPLAY_IDENTIFIER GmMsg0C5BusHiSpd.SenderPorts.RiWhlDstTiStamp.Val /end MEASUREMENT
/begin MEASUREMENT GmMsg0C5BusHiSpd.RiWhlDstTiStampRaw.Val "MICROSAR RTE" UWORD NO_COMPU_METHOD 0 0 0 65535 ECU_ADDRESS 0 SYMBOL_LINK "Rte_SerlComInpProxy_RiWhlDstTiStampRaw_Val" 0 DISPLAY_IDENTIFIER GmMsg0C5BusHiSpd.ReceiverPorts.RiWhlDstTiStampRaw.Val /end MEASUREMENT
/begin MEASUREMENT GmMsg0C5BusHiSpd.RiWhlDstVld.Logl "MICROSAR RTE" UBYTE RTE_CM_BOOLEAN 0 0 0 255 ECU_ADDRESS 0 SYMBOL_LINK "Rte_GmMsg0C5BusHiSpd_RiWhlDstVld_Logl" 0 DISPLAY_IDENTIFIER GmMsg0C5BusHiSpd.SenderPorts.RiWhlDstVld.Logl /end MEASUREMENT
/begin MEASUREMENT GmMsg0C5BusHiSpd.RiWhlDstVldRaw.Val "MICROSAR RTE" UBYTE NO_COMPU_METHOD 0 0 0 255 ECU_ADDRESS 0 SYMBOL_LINK "Rte_SerlComInpProxy_RiWhlDstVldRaw_Val" 0 DISPLAY_IDENTIFIER GmMsg0C5BusHiSpd.ReceiverPorts.RiWhlDstVldRaw.Val /end MEASUREMENT
/begin MEASUREMENT GmMsg0C5BusHiSpd.RiWhlRotlStsRstRaw.Val "MICROSAR RTE" UBYTE NO_COMPU_METHOD 0 0 0 255 ECU_ADDRESS 0 SYMBOL_LINK "Rte_SerlComInpProxy_RiWhlRotlStsRstRaw_Val" 0 DISPLAY_IDENTIFIER GmMsg0C5BusHiSpd.ReceiverPorts.RiWhlRotlStsRstRaw.Val /end MEASUREMENT
/begin MEASUREMENT GmMsg0C5BusHiSpd.RiWhlSeqNrRaw.Val "MICROSAR RTE" UBYTE NO_COMPU_METHOD 0 0 0 255 ECU_ADDRESS 0 SYMBOL_LINK "Rte_SerlComInpProxy_RiWhlSeqNrRaw_Val" 0 DISPLAY_IDENTIFIER GmMsg0C5BusHiSpd.ReceiverPorts.RiWhlSeqNrRaw.Val /end MEASUREMENT
/begin MEASUREMENT GmMsg0C9BusHiSpd.EngRunActv.Logl "MICROSAR RTE" UBYTE RTE_CM_BOOLEAN 0 0 0 255 ECU_ADDRESS 0 SYMBOL_LINK "Rte_GmMsg0C9BusHiSpd_EngRunActv_Logl" 0 DISPLAY_IDENTIFIER GmMsg0C9BusHiSpd.SenderPorts.EngRunActv.Logl /end MEASUREMENT
/begin MEASUREMENT GmMsg0C9BusHiSpd.EngRunActvRaw.Val "MICROSAR RTE" UBYTE NO_COMPU_METHOD 0 0 0 255 ECU_ADDRESS 0 SYMBOL_LINK "Rte_SerlComInpProxy_EngRunActvRaw_Val" 0 DISPLAY_IDENTIFIER GmMsg0C9BusHiSpd.ReceiverPorts.EngRunActvRaw.Val /end MEASUREMENT
/begin MEASUREMENT GmMsg0C9BusHiSpd.EngSpd.Val "MICROSAR RTE" FLOAT32_IEEE NO_COMPU_METHOD 0 0 -3.402823466e+38 3.402823466e+38 ECU_ADDRESS 0 SYMBOL_LINK "Rte_GmMsg0C9BusHiSpd_EngSpd_Val" 0 DISPLAY_IDENTIFIER GmMsg0C9BusHiSpd.SenderPorts.EngSpd.Val /end MEASUREMENT
/begin MEASUREMENT GmMsg0C9BusHiSpd.EngSpdRaw.Val "MICROSAR RTE" UWORD NO_COMPU_METHOD 0 0 0 65535 ECU_ADDRESS 0 SYMBOL_LINK "Rte_SerlComInpProxy_EngSpdRaw_Val" 0 DISPLAY_IDENTIFIER GmMsg0C9BusHiSpd.ReceiverPorts.EngSpdRaw.Val /end MEASUREMENT
/begin MEASUREMENT GmMsg0C9BusHiSpd.EngSpdStsNorm.Logl "MICROSAR RTE" UBYTE RTE_CM_BOOLEAN 0 0 0 255 ECU_ADDRESS 0 SYMBOL_LINK "Rte_GmMsg0C9BusHiSpd_EngSpdStsNorm_Logl" 0 DISPLAY_IDENTIFIER GmMsg0C9BusHiSpd.SenderPorts.EngSpdStsNorm.Logl /end MEASUREMENT
/begin MEASUREMENT GmMsg0C9BusHiSpd.EngSpdStsRaw.Val "MICROSAR RTE" UBYTE NO_COMPU_METHOD 0 0 0 255 ECU_ADDRESS 0 SYMBOL_LINK "Rte_SerlComInpProxy_EngSpdStsRaw_Val" 0 DISPLAY_IDENTIFIER GmMsg0C9BusHiSpd.ReceiverPorts.EngSpdStsRaw.Val /end MEASUREMENT
/begin MEASUREMENT GmMsg0C9BusHiSpd.GmMsg0C9BusHiSpdInvldMsgTmr "MICROSAR RTE" ULONG NO_COMPU_METHOD 0 0 0 4294967295 ECU_ADDRESS 0 SYMBOL_LINK "Rte_GmMsg0C9BusHiSpd_GmMsg0C9BusHiSpdInvldMsgTmr" 0 DISPLAY_IDENTIFIER GmMsg0C9BusHiSpd.PerInstanceMemories.GmMsg0C9BusHiSpdInvldMsgTmr /end MEASUREMENT
/begin MEASUREMENT GmMsg0C9BusHiSpd.GmMsg0C9BusHiSpdPrevEndSpd "MICROSAR RTE" FLOAT32_IEEE NO_COMPU_METHOD 0 0 -3.402823466e+38 3.402823466e+38 ECU_ADDRESS 0 SYMBOL_LINK "Rte_GmMsg0C9BusHiSpd_GmMsg0C9BusHiSpdPrevEndSpd" 0 DISPLAY_IDENTIFIER GmMsg0C9BusHiSpd.PerInstanceMemories.GmMsg0C9BusHiSpdPrevEndSpd /end MEASUREMENT
/begin MEASUREMENT GmMsg0C9BusHiSpd.GmMsg0C9BusHiSpdPrevEngRunActv "MICROSAR RTE" UBYTE RTE_CM_BOOLEAN 0 0 0 255 ECU_ADDRESS 0 SYMBOL_LINK "Rte_GmMsg0C9BusHiSpd_GmMsg0C9BusHiSpdPrevEngRunActv" 0 DISPLAY_IDENTIFIER GmMsg0C9BusHiSpd.PerInstanceMemories.GmMsg0C9BusHiSpdPrevEngRunActv /end MEASUREMENT
/begin MEASUREMENT GmMsg0C9BusHiSpd.InvldMsg0C9.Logl "MICROSAR RTE" UBYTE RTE_CM_BOOLEAN 0 0 0 255 ECU_ADDRESS 0 SYMBOL_LINK "Rte_GmMsg0C9BusHiSpd_InvldMsg0C9_Logl" 0 DISPLAY_IDENTIFIER GmMsg0C9BusHiSpd.SenderPorts.InvldMsg0C9.Logl /end MEASUREMENT
/begin MEASUREMENT GmMsg0C9BusHiSpd.LstRxnTiMsg0C9.Val "MICROSAR RTE" ULONG NO_COMPU_METHOD 0 0 0 4294967295 ECU_ADDRESS 0 SYMBOL_LINK "Rte_SerlComInpProxy_LstRxnTiMsg0C9_Val" 0 DISPLAY_IDENTIFIER GmMsg0C9BusHiSpd.ReceiverPorts.LstRxnTiMsg0C9.Val /end MEASUREMENT
/begin MEASUREMENT GmMsg0C9BusHiSpd.MissMsg0C9.Logl "MICROSAR RTE" UBYTE RTE_CM_BOOLEAN 0 0 0 255 ECU_ADDRESS 0 SYMBOL_LINK "Rte_GmMsg0C9BusHiSpd_MissMsg0C9_Logl" 0 DISPLAY_IDENTIFIER GmMsg0C9BusHiSpd.SenderPorts.MissMsg0C9.Logl /end MEASUREMENT
/begin MEASUREMENT GmMsg0C9BusHiSpd.PtCrkActv.Logl "MICROSAR RTE" UBYTE RTE_CM_BOOLEAN 0 0 0 255 ECU_ADDRESS 0 SYMBOL_LINK "Rte_GmMsg0C9BusHiSpd_PtCrkActv_Logl" 0 DISPLAY_IDENTIFIER GmMsg0C9BusHiSpd.SenderPorts.PtCrkActv.Logl /end MEASUREMENT
/begin MEASUREMENT GmMsg0C9BusHiSpd.PtCrkActvRaw.Val "MICROSAR RTE" UBYTE NO_COMPU_METHOD 0 0 0 255 ECU_ADDRESS 0 SYMBOL_LINK "Rte_SerlComInpProxy_PtCrkActvRaw_Val" 0 DISPLAY_IDENTIFIER GmMsg0C9BusHiSpd.ReceiverPorts.PtCrkActvRaw.Val /end MEASUREMENT
/begin MEASUREMENT GmMsg0C9BusHiSpd.VehSpd.Val "MICROSAR RTE" FLOAT32_IEEE NO_COMPU_METHOD 0 0 -3.402823466e+38 3.402823466e+38 ECU_ADDRESS 0 SYMBOL_LINK "Rte_VehSigCdng_VehSpd_Val" 0 DISPLAY_IDENTIFIER GmMsg0C9BusHiSpd.ReceiverPorts.VehSpd.Val /end MEASUREMENT
/begin MEASUREMENT GmMsg0C9BusHiSpd.VehSpdVld.Logl "MICROSAR RTE" UBYTE RTE_CM_BOOLEAN 0 0 0 255 ECU_ADDRESS 0 SYMBOL_LINK "Rte_VehSigCdng_VehSpdVld_Logl" 0 DISPLAY_IDENTIFIER GmMsg0C9BusHiSpd.ReceiverPorts.VehSpdVld.Logl /end MEASUREMENT
/begin MEASUREMENT GmMsg148BusHiSpd.PwrSteerIndcr.Val "MICROSAR RTE" UBYTE NO_COMPU_METHOD 0 0 0 255 ECU_ADDRESS 0 SYMBOL_LINK "Rte_GmMsg148BusHiSpd_PwrSteerIndcr_Val" 0 DISPLAY_IDENTIFIER GmMsg148BusHiSpd.SenderPorts.PwrSteerIndcr.Val /end MEASUREMENT
/begin MEASUREMENT GmMsg148BusHiSpd.SteerAssiLimd.Val "MICROSAR RTE" UBYTE NO_COMPU_METHOD 0 0 0 255 ECU_ADDRESS 0 SYMBOL_LINK "Rte_GmMsg148BusHiSpd_SteerAssiLimd_Val" 0 DISPLAY_IDENTIFIER GmMsg148BusHiSpd.SenderPorts.SteerAssiLimd.Val /end MEASUREMENT
/begin MEASUREMENT GmMsg148BusHiSpd.SteerAssiLimdLvl2.Val "MICROSAR RTE" UBYTE NO_COMPU_METHOD 0 0 0 255 ECU_ADDRESS 0 SYMBOL_LINK "Rte_GmMsg148BusHiSpd_SteerAssiLimdLvl2_Val" 0 DISPLAY_IDENTIFIER GmMsg148BusHiSpd.SenderPorts.SteerAssiLimdLvl2.Val /end MEASUREMENT
/begin MEASUREMENT GmMsg148BusHiSpd.SteerAssiLimdLvl3.Val "MICROSAR RTE" UBYTE NO_COMPU_METHOD 0 0 0 255 ECU_ADDRESS 0 SYMBOL_LINK "Rte_GmMsg148BusHiSpd_SteerAssiLimdLvl3_Val" 0 DISPLAY_IDENTIFIER GmMsg148BusHiSpd.SenderPorts.SteerAssiLimdLvl3.Val /end MEASUREMENT
/begin MEASUREMENT GmMsg148BusHiSpd.SysSt.Val "MICROSAR RTE" UBYTE RTE_CM_ENUM_SysSt1 0 0 0 255 ECU_ADDRESS 0 SYMBOL_LINK "Rte_SysStMod_SysSt_Val" 0 DISPLAY_IDENTIFIER GmMsg148BusHiSpd.ReceiverPorts.SysSt.Val /end MEASUREMENT
/begin MEASUREMENT GmMsg17DBusHiSpd.GmMsg17DBusHiSpdInvldMsgTmr "MICROSAR RTE" ULONG NO_COMPU_METHOD 0 0 0 4294967295 ECU_ADDRESS 0 SYMBOL_LINK "Rte_GmMsg17DBusHiSpd_GmMsg17DBusHiSpdInvldMsgTmr" 0 DISPLAY_IDENTIFIER GmMsg17DBusHiSpd.PerInstanceMemories.GmMsg17DBusHiSpdInvldMsgTmr /end MEASUREMENT
/begin MEASUREMENT GmMsg17DBusHiSpd.InvldMsg17D.Logl "MICROSAR RTE" UBYTE RTE_CM_BOOLEAN 0 0 0 255 ECU_ADDRESS 0 SYMBOL_LINK "Rte_GmMsg17DBusHiSpd_InvldMsg17D_Logl" 0 DISPLAY_IDENTIFIER GmMsg17DBusHiSpd.SenderPorts.InvldMsg17D.Logl /end MEASUREMENT
/begin MEASUREMENT GmMsg17DBusHiSpd.LstRxnTiMsg17D.Val "MICROSAR RTE" ULONG NO_COMPU_METHOD 0 0 0 4294967295 ECU_ADDRESS 0 SYMBOL_LINK "Rte_SerlComInpProxy_LstRxnTiMsg17D_Val" 0 DISPLAY_IDENTIFIER GmMsg17DBusHiSpd.ReceiverPorts.LstRxnTiMsg17D.Val /end MEASUREMENT
/begin MEASUREMENT GmMsg17DBusHiSpd.MissMsg17D.Logl "MICROSAR RTE" UBYTE RTE_CM_BOOLEAN 0 0 0 255 ECU_ADDRESS 0 SYMBOL_LINK "Rte_GmMsg17DBusHiSpd_MissMsg17D_Logl" 0 DISPLAY_IDENTIFIER GmMsg17DBusHiSpd.SenderPorts.MissMsg17D.Logl /end MEASUREMENT
/begin MEASUREMENT GmMsg17DBusHiSpd.VehStabyEnhmtStsRaw.Val "MICROSAR RTE" UBYTE NO_COMPU_METHOD 0 0 0 255 ECU_ADDRESS 0 SYMBOL_LINK "Rte_SerlComInpProxy_VehStabyEnhmtStsRaw_Val" 0 DISPLAY_IDENTIFIER GmMsg17DBusHiSpd.ReceiverPorts.VehStabyEnhmtStsRaw.Val /end MEASUREMENT
/begin MEASUREMENT GmMsg180BusChassisExp.EscCmd.Val "MICROSAR RTE" FLOAT32_IEEE NO_COMPU_METHOD 0 0 -3.402823466e+38 3.402823466e+38 ECU_ADDRESS 0 SYMBOL_LINK "Rte_GmMsg180BusChassisExp_EscCmd_Val" 0 DISPLAY_IDENTIFIER GmMsg180BusChassisExp.SenderPorts.EscCmd.Val /end MEASUREMENT
/begin MEASUREMENT GmMsg180BusChassisExp.EscReqActv.Logl "MICROSAR RTE" UBYTE RTE_CM_BOOLEAN 0 0 0 255 ECU_ADDRESS 0 SYMBOL_LINK "Rte_GmMsg180BusChassisExp_EscReqActv_Logl" 0 DISPLAY_IDENTIFIER GmMsg180BusChassisExp.SenderPorts.EscReqActv.Logl /end MEASUREMENT
/begin MEASUREMENT GmMsg180BusChassisExp.GmMsg180BusChassisExpInvldProtnValTmr "MICROSAR RTE" ULONG NO_COMPU_METHOD 0 0 0 4294967295 ECU_ADDRESS 0 SYMBOL_LINK "Rte_GmMsg180BusChassisExp_GmMsg180BusChassisExpInvldProtnValTmr" 0 DISPLAY_IDENTIFIER GmMsg180BusChassisExp.PerInstanceMemories.GmMsg180BusChassisExpInvldProtnValTmr /end MEASUREMENT
/begin MEASUREMENT GmMsg180BusChassisExp.GmMsg180BusChassisExpInvldRollgCntrTmr "MICROSAR RTE" ULONG NO_COMPU_METHOD 0 0 0 4294967295 ECU_ADDRESS 0 SYMBOL_LINK "Rte_GmMsg180BusChassisExp_GmMsg180BusChassisExpInvldRollgCntrTmr" 0 DISPLAY_IDENTIFIER GmMsg180BusChassisExp.PerInstanceMemories.GmMsg180BusChassisExpInvldRollgCntrTmr /end MEASUREMENT
/begin MEASUREMENT GmMsg180BusChassisExp.GmMsg180BusChassisExpPrevEscCmd "MICROSAR RTE" FLOAT32_IEEE NO_COMPU_METHOD 0 0 -3.402823466e+38 3.402823466e+38 ECU_ADDRESS 0 SYMBOL_LINK "Rte_GmMsg180BusChassisExp_GmMsg180BusChassisExpPrevEscCmd" 0 DISPLAY_IDENTIFIER GmMsg180BusChassisExp.PerInstanceMemories.GmMsg180BusChassisExpPrevEscCmd /end MEASUREMENT
/begin MEASUREMENT GmMsg180BusChassisExp.GmMsg180BusChassisExpPrevEscCmdActv "MICROSAR RTE" UBYTE RTE_CM_BOOLEAN 0 0 0 255 ECU_ADDRESS 0 SYMBOL_LINK "Rte_GmMsg180BusChassisExp_GmMsg180BusChassisExpPrevEscCmdActv" 0 DISPLAY_IDENTIFIER GmMsg180BusChassisExp.PerInstanceMemories.GmMsg180BusChassisExpPrevEscCmdActv /end MEASUREMENT
/begin MEASUREMENT GmMsg180BusChassisExp.GmMsg180BusChassisExpPrevInvld "MICROSAR RTE" UBYTE RTE_CM_BOOLEAN 0 0 0 255 ECU_ADDRESS 0 SYMBOL_LINK "Rte_GmMsg180BusChassisExp_GmMsg180BusChassisExpPrevInvld" 0 DISPLAY_IDENTIFIER GmMsg180BusChassisExp.PerInstanceMemories.GmMsg180BusChassisExpPrevInvld /end MEASUREMENT
/begin MEASUREMENT GmMsg180BusChassisExp.GmMsg180BusChassisExpPrevRollgCntrVal "MICROSAR RTE" UBYTE NO_COMPU_METHOD 0 0 0 255 ECU_ADDRESS 0 SYMBOL_LINK "Rte_GmMsg180BusChassisExp_GmMsg180BusChassisExpPrevRollgCntrVal" 0 DISPLAY_IDENTIFIER GmMsg180BusChassisExp.PerInstanceMemories.GmMsg180BusChassisExpPrevRollgCntrVal /end MEASUREMENT
/begin MEASUREMENT GmMsg180BusChassisExp.GmMsg180BusChassisExpPrevRxnTi "MICROSAR RTE" ULONG NO_COMPU_METHOD 0 0 0 4294967295 ECU_ADDRESS 0 SYMBOL_LINK "Rte_GmMsg180BusChassisExp_GmMsg180BusChassisExpPrevRxnTi" 0 DISPLAY_IDENTIFIER GmMsg180BusChassisExp.PerInstanceMemories.GmMsg180BusChassisExpPrevRxnTi /end MEASUREMENT
/begin MEASUREMENT GmMsg180BusChassisExp.GmMsg180BusChassisExpRollgCntrRst "MICROSAR RTE" UBYTE RTE_CM_BOOLEAN 0 0 0 255 ECU_ADDRESS 0 SYMBOL_LINK "Rte_GmMsg180BusChassisExp_GmMsg180BusChassisExpRollgCntrRst" 0 DISPLAY_IDENTIFIER GmMsg180BusChassisExp.PerInstanceMemories.GmMsg180BusChassisExpRollgCntrRst /end MEASUREMENT
/begin MEASUREMENT GmMsg180BusChassisExp.InvldMsg180BusChassisExp.Logl "MICROSAR RTE" UBYTE RTE_CM_BOOLEAN 0 0 0 255 ECU_ADDRESS 0 SYMBOL_LINK "Rte_GmMsg180BusChassisExp_InvldMsg180BusChassisExp_Logl" 0 DISPLAY_IDENTIFIER GmMsg180BusChassisExp.SenderPorts.InvldMsg180BusChassisExp.Logl /end MEASUREMENT
/begin MEASUREMENT GmMsg180BusChassisExp.LstRxnTiMsg180BusChassisExp.Val "MICROSAR RTE" ULONG NO_COMPU_METHOD 0 0 0 4294967295 ECU_ADDRESS 0 SYMBOL_LINK "Rte_SerlComInpProxy_LstRxnTiMsg180BusChassisExp_Val" 0 DISPLAY_IDENTIFIER GmMsg180BusChassisExp.ReceiverPorts.LstRxnTiMsg180BusChassisExp.Val /end MEASUREMENT
/begin MEASUREMENT GmMsg180BusChassisExp.MissMsg180BusChassisExp.Logl "MICROSAR RTE" UBYTE RTE_CM_BOOLEAN 0 0 0 255 ECU_ADDRESS 0 SYMBOL_LINK "Rte_GmMsg180BusChassisExp_MissMsg180BusChassisExp_Logl" 0 DISPLAY_IDENTIFIER GmMsg180BusChassisExp.SenderPorts.MissMsg180BusChassisExp.Logl /end MEASUREMENT
/begin MEASUREMENT GmMsg180BusChassisExp.TqOvrlAlvRollgCntrRaw.Val "MICROSAR RTE" UBYTE NO_COMPU_METHOD 0 0 0 255 ECU_ADDRESS 0 SYMBOL_LINK "Rte_SerlComInpProxy_TqOvrlAlvRollgCntrRaw_Val" 0 DISPLAY_IDENTIFIER GmMsg180BusChassisExp.ReceiverPorts.TqOvrlAlvRollgCntrRaw.Val /end MEASUREMENT
/begin MEASUREMENT GmMsg180BusChassisExp.TqOvrlCmdChksRaw.Val "MICROSAR RTE" UWORD NO_COMPU_METHOD 0 0 0 65535 ECU_ADDRESS 0 SYMBOL_LINK "Rte_SerlComInpProxy_TqOvrlCmdChksRaw_Val" 0 DISPLAY_IDENTIFIER GmMsg180BusChassisExp.ReceiverPorts.TqOvrlCmdChksRaw.Val /end MEASUREMENT
/begin MEASUREMENT GmMsg180BusChassisExp.TqOvrlDeltaTqCmdActvRaw.Val "MICROSAR RTE" UBYTE NO_COMPU_METHOD 0 0 0 255 ECU_ADDRESS 0 SYMBOL_LINK "Rte_SerlComInpProxy_TqOvrlDeltaTqCmdActvRaw_Val" 0 DISPLAY_IDENTIFIER GmMsg180BusChassisExp.ReceiverPorts.TqOvrlDeltaTqCmdActvRaw.Val /end MEASUREMENT
/begin MEASUREMENT GmMsg180BusChassisExp.TqOvrlDeltaTqCmdValRaw.Val "MICROSAR RTE" UWORD NO_COMPU_METHOD 0 0 0 65535 ECU_ADDRESS 0 SYMBOL_LINK "Rte_SerlComInpProxy_TqOvrlDeltaTqCmdValRaw_Val" 0 DISPLAY_IDENTIFIER GmMsg180BusChassisExp.ReceiverPorts.TqOvrlDeltaTqCmdValRaw.Val /end MEASUREMENT
/begin MEASUREMENT GmMsg180BusHiSpd.GmMsg180BusHiSpdInvldCrcTmr "MICROSAR RTE" ULONG NO_COMPU_METHOD 0 0 0 4294967295 ECU_ADDRESS 0 SYMBOL_LINK "Rte_GmMsg180BusHiSpd_GmMsg180BusHiSpdInvldCrcTmr" 0 DISPLAY_IDENTIFIER GmMsg180BusHiSpd.PerInstanceMemories.GmMsg180BusHiSpdInvldCrcTmr /end MEASUREMENT
/begin MEASUREMENT GmMsg180BusHiSpd.GmMsg180BusHiSpdInvldRollgCntrTmr "MICROSAR RTE" ULONG NO_COMPU_METHOD 0 0 0 4294967295 ECU_ADDRESS 0 SYMBOL_LINK "Rte_GmMsg180BusHiSpd_GmMsg180BusHiSpdInvldRollgCntrTmr" 0 DISPLAY_IDENTIFIER GmMsg180BusHiSpd.PerInstanceMemories.GmMsg180BusHiSpdInvldRollgCntrTmr /end MEASUREMENT
/begin MEASUREMENT GmMsg180BusHiSpd.GmMsg180BusHiSpdPrevInvld "MICROSAR RTE" UBYTE RTE_CM_BOOLEAN 0 0 0 255 ECU_ADDRESS 0 SYMBOL_LINK "Rte_GmMsg180BusHiSpd_GmMsg180BusHiSpdPrevInvld" 0 DISPLAY_IDENTIFIER GmMsg180BusHiSpd.PerInstanceMemories.GmMsg180BusHiSpdPrevInvld /end MEASUREMENT
/begin MEASUREMENT GmMsg180BusHiSpd.GmMsg180BusHiSpdPrevRollgCntrVal "MICROSAR RTE" UBYTE NO_COMPU_METHOD 0 0 0 255 ECU_ADDRESS 0 SYMBOL_LINK "Rte_GmMsg180BusHiSpd_GmMsg180BusHiSpdPrevRollgCntrVal" 0 DISPLAY_IDENTIFIER GmMsg180BusHiSpd.PerInstanceMemories.GmMsg180BusHiSpdPrevRollgCntrVal /end MEASUREMENT
/begin MEASUREMENT GmMsg180BusHiSpd.GmMsg180BusHiSpdPrevRxnTi "MICROSAR RTE" ULONG NO_COMPU_METHOD 0 0 0 4294967295 ECU_ADDRESS 0 SYMBOL_LINK "Rte_GmMsg180BusHiSpd_GmMsg180BusHiSpdPrevRxnTi" 0 DISPLAY_IDENTIFIER GmMsg180BusHiSpd.PerInstanceMemories.GmMsg180BusHiSpdPrevRxnTi /end MEASUREMENT
/begin MEASUREMENT GmMsg180BusHiSpd.GmMsg180BusHiSpdPrevTqCmd "MICROSAR RTE" FLOAT32_IEEE NO_COMPU_METHOD 0 0 -3.402823466e+38 3.402823466e+38 ECU_ADDRESS 0 SYMBOL_LINK "Rte_GmMsg180BusHiSpd_GmMsg180BusHiSpdPrevTqCmd" 0 DISPLAY_IDENTIFIER GmMsg180BusHiSpd.PerInstanceMemories.GmMsg180BusHiSpdPrevTqCmd /end MEASUREMENT
/begin MEASUREMENT GmMsg180BusHiSpd.GmMsg180BusHiSpdPrevTqReq "MICROSAR RTE" UBYTE RTE_CM_BOOLEAN 0 0 0 255 ECU_ADDRESS 0 SYMBOL_LINK "Rte_GmMsg180BusHiSpd_GmMsg180BusHiSpdPrevTqReq" 0 DISPLAY_IDENTIFIER GmMsg180BusHiSpd.PerInstanceMemories.GmMsg180BusHiSpdPrevTqReq /end MEASUREMENT
/begin MEASUREMENT GmMsg180BusHiSpd.GmMsg180BusHiSpdRollgCntrRst "MICROSAR RTE" UBYTE RTE_CM_BOOLEAN 0 0 0 255 ECU_ADDRESS 0 SYMBOL_LINK "Rte_GmMsg180BusHiSpd_GmMsg180BusHiSpdRollgCntrRst" 0 DISPLAY_IDENTIFIER GmMsg180BusHiSpd.PerInstanceMemories.GmMsg180BusHiSpdRollgCntrRst /end MEASUREMENT
/begin MEASUREMENT GmMsg180BusHiSpd.InvldMsg180BusHiSpd.Logl "MICROSAR RTE" UBYTE RTE_CM_BOOLEAN 0 0 0 255 ECU_ADDRESS 0 SYMBOL_LINK "Rte_GmMsg180BusHiSpd_InvldMsg180BusHiSpd_Logl" 0 DISPLAY_IDENTIFIER GmMsg180BusHiSpd.SenderPorts.InvldMsg180BusHiSpd.Logl /end MEASUREMENT
/begin MEASUREMENT GmMsg180BusHiSpd.LkaCmd.Val "MICROSAR RTE" FLOAT32_IEEE NO_COMPU_METHOD 0 0 -3.402823466e+38 3.402823466e+38 ECU_ADDRESS 0 SYMBOL_LINK "Rte_GmMsg180BusHiSpd_LkaCmd_Val" 0 DISPLAY_IDENTIFIER GmMsg180BusHiSpd.SenderPorts.LkaCmd.Val /end MEASUREMENT
/begin MEASUREMENT GmMsg180BusHiSpd.LkaCmdProtnValRaw.Val "MICROSAR RTE" UWORD NO_COMPU_METHOD 0 0 0 65535 ECU_ADDRESS 0 SYMBOL_LINK "Rte_SerlComInpProxy_LkaCmdProtnValRaw_Val" 0 DISPLAY_IDENTIFIER GmMsg180BusHiSpd.ReceiverPorts.LkaCmdProtnValRaw.Val /end MEASUREMENT
/begin MEASUREMENT GmMsg180BusHiSpd.LkaCmdRollgCntrRaw.Val "MICROSAR RTE" UBYTE NO_COMPU_METHOD 0 0 0 255 ECU_ADDRESS 0 SYMBOL_LINK "Rte_SerlComInpProxy_LkaCmdRollgCntrRaw_Val" 0 DISPLAY_IDENTIFIER GmMsg180BusHiSpd.ReceiverPorts.LkaCmdRollgCntrRaw.Val /end MEASUREMENT
/begin MEASUREMENT GmMsg180BusHiSpd.LkaCmdTqReqActvRaw.Val "MICROSAR RTE" UBYTE NO_COMPU_METHOD 0 0 0 255 ECU_ADDRESS 0 SYMBOL_LINK "Rte_SerlComInpProxy_LkaCmdTqReqActvRaw_Val" 0 DISPLAY_IDENTIFIER GmMsg180BusHiSpd.ReceiverPorts.LkaCmdTqReqActvRaw.Val /end MEASUREMENT
/begin MEASUREMENT GmMsg180BusHiSpd.LkaCmdTqValRaw.Val "MICROSAR RTE" UWORD NO_COMPU_METHOD 0 0 0 65535 ECU_ADDRESS 0 SYMBOL_LINK "Rte_SerlComInpProxy_LkaCmdTqValRaw_Val" 0 DISPLAY_IDENTIFIER GmMsg180BusHiSpd.ReceiverPorts.LkaCmdTqValRaw.Val /end MEASUREMENT
/begin MEASUREMENT GmMsg180BusHiSpd.LkaReqActv.Logl "MICROSAR RTE" UBYTE RTE_CM_BOOLEAN 0 0 0 255 ECU_ADDRESS 0 SYMBOL_LINK "Rte_GmMsg180BusHiSpd_LkaReqActv_Logl" 0 DISPLAY_IDENTIFIER GmMsg180BusHiSpd.SenderPorts.LkaReqActv.Logl /end MEASUREMENT
/begin MEASUREMENT GmMsg180BusHiSpd.LstRxnTiMsg180BusHiSpd.Val "MICROSAR RTE" ULONG NO_COMPU_METHOD 0 0 0 4294967295 ECU_ADDRESS 0 SYMBOL_LINK "Rte_SerlComInpProxy_LstRxnTiMsg180BusHiSpd_Val" 0 DISPLAY_IDENTIFIER GmMsg180BusHiSpd.ReceiverPorts.LstRxnTiMsg180BusHiSpd.Val /end MEASUREMENT
/begin MEASUREMENT GmMsg180BusHiSpd.MissMsg180BusHiSpd.Logl "MICROSAR RTE" UBYTE RTE_CM_BOOLEAN 0 0 0 255 ECU_ADDRESS 0 SYMBOL_LINK "Rte_GmMsg180BusHiSpd_MissMsg180BusHiSpd_Logl" 0 DISPLAY_IDENTIFIER GmMsg180BusHiSpd.SenderPorts.MissMsg180BusHiSpd.Logl /end MEASUREMENT
/begin MEASUREMENT GmMsg182BusChassisExp.GmMsg182BusChassisExpInvldTmr "MICROSAR RTE" ULONG NO_COMPU_METHOD 0 0 0 4294967295 ECU_ADDRESS 0 SYMBOL_LINK "Rte_GmMsg182BusChassisExp_GmMsg182BusChassisExpInvldTmr" 0 DISPLAY_IDENTIFIER GmMsg182BusChassisExp.PerInstanceMemories.GmMsg182BusChassisExpInvldTmr /end MEASUREMENT
/begin MEASUREMENT GmMsg182BusChassisExp.GmMsg182BusChassisExpPrevVehLgtA "MICROSAR RTE" FLOAT32_IEEE NO_COMPU_METHOD 0 0 -3.402823466e+38 3.402823466e+38 ECU_ADDRESS 0 SYMBOL_LINK "Rte_GmMsg182BusChassisExp_GmMsg182BusChassisExpPrevVehLgtA" 0 DISPLAY_IDENTIFIER GmMsg182BusChassisExp.PerInstanceMemories.GmMsg182BusChassisExpPrevVehLgtA /end MEASUREMENT
/begin MEASUREMENT GmMsg182BusChassisExp.LstRxnTiMsg182.Val "MICROSAR RTE" ULONG NO_COMPU_METHOD 0 0 0 4294967295 ECU_ADDRESS 0 SYMBOL_LINK "Rte_SerlComInpProxy_LstRxnTiMsg182_Val" 0 DISPLAY_IDENTIFIER GmMsg182BusChassisExp.ReceiverPorts.LstRxnTiMsg182.Val /end MEASUREMENT
/begin MEASUREMENT GmMsg182BusChassisExp.SerlComVehLgtA.Val "MICROSAR RTE" FLOAT32_IEEE NO_COMPU_METHOD 0 0 -3.402823466e+38 3.402823466e+38 ECU_ADDRESS 0 SYMBOL_LINK "Rte_GmMsg182BusChassisExp_SerlComVehLgtA_Val" 0 DISPLAY_IDENTIFIER GmMsg182BusChassisExp.SenderPorts.SerlComVehLgtA.Val /end MEASUREMENT
/begin MEASUREMENT GmMsg182BusChassisExp.VehDynOverUnderSteerVldRaw.Val "MICROSAR RTE" UBYTE NO_COMPU_METHOD 0 0 0 255 ECU_ADDRESS 0 SYMBOL_LINK "Rte_SerlComInpProxy_VehDynOverUnderSteerVldRaw_Val" 0 DISPLAY_IDENTIFIER GmMsg182BusChassisExp.ReceiverPorts.VehDynOverUnderSteerVldRaw.Val /end MEASUREMENT
/begin MEASUREMENT GmMsg182BusChassisExp.VehStabyEnhmtLgtALoReslRaw.Val "MICROSAR RTE" UWORD NO_COMPU_METHOD 0 0 0 65535 ECU_ADDRESS 0 SYMBOL_LINK "Rte_SerlComInpProxy_VehStabyEnhmtLgtALoReslRaw_Val" 0 DISPLAY_IDENTIFIER GmMsg182BusChassisExp.ReceiverPorts.VehStabyEnhmtLgtALoReslRaw.Val /end MEASUREMENT
/begin MEASUREMENT GmMsg182BusChassisExp.VehStabyEnhmtLgtALoReslVldRaw.Val "MICROSAR RTE" UBYTE NO_COMPU_METHOD 0 0 0 255 ECU_ADDRESS 0 SYMBOL_LINK "Rte_SerlComInpProxy_VehStabyEnhmtLgtALoReslVldRaw_Val" 0 DISPLAY_IDENTIFIER GmMsg182BusChassisExp.ReceiverPorts.VehStabyEnhmtLgtALoReslVldRaw.Val /end MEASUREMENT
/begin MEASUREMENT GmMsg184BusHiSpd.GmMsg184BusHiSpdRollgCntr "MICROSAR RTE" UBYTE NO_COMPU_METHOD 0 0 0 255 ECU_ADDRESS 0 SYMBOL_LINK "Rte_GmMsg184BusHiSpd_GmMsg184BusHiSpdRollgCntr" 0 DISPLAY_IDENTIFIER GmMsg184BusHiSpd.PerInstanceMemories.GmMsg184BusHiSpdRollgCntr /end MEASUREMENT
/begin MEASUREMENT GmMsg184BusHiSpd.HandsOffSteerWhlDetnMod.Val "MICROSAR RTE" UBYTE NO_COMPU_METHOD 0 0 0 255 ECU_ADDRESS 0 SYMBOL_LINK "Rte_GmMsg184BusHiSpd_HandsOffSteerWhlDetnMod_Val" 0 DISPLAY_IDENTIFIER GmMsg184BusHiSpd.SenderPorts.HandsOffSteerWhlDetnMod.Val /end MEASUREMENT
/begin MEASUREMENT GmMsg184BusHiSpd.HandsOffSteerWhlDetnSt.Val "MICROSAR RTE" UBYTE NO_COMPU_METHOD 0 0 0 255 ECU_ADDRESS 0 SYMBOL_LINK "Rte_GmMsg184BusHiSpd_HandsOffSteerWhlDetnSt_Val" 0 DISPLAY_IDENTIFIER GmMsg184BusHiSpd.SenderPorts.HandsOffSteerWhlDetnSt.Val /end MEASUREMENT
/begin MEASUREMENT GmMsg184BusHiSpd.HandsOffSteerWhlDetnStVld.Val "MICROSAR RTE" UBYTE NO_COMPU_METHOD 0 0 0 255 ECU_ADDRESS 0 SYMBOL_LINK "Rte_GmMsg184BusHiSpd_HandsOffSteerWhlDetnStVld_Val" 0 DISPLAY_IDENTIFIER GmMsg184BusHiSpd.SenderPorts.HandsOffSteerWhlDetnStVld.Val /end MEASUREMENT
/begin MEASUREMENT GmMsg184BusHiSpd.HandsOnWhlEstim.Val "MICROSAR RTE" FLOAT32_IEEE NO_COMPU_METHOD 0 0 -3.402823466e+38 3.402823466e+38 ECU_ADDRESS 0 SYMBOL_LINK "Rte_HowDetn_HowDetnEstimn_Val" 0 DISPLAY_IDENTIFIER GmMsg184BusHiSpd.ReceiverPorts.HandsOnWhlEstim.Val /end MEASUREMENT
/begin MEASUREMENT GmMsg184BusHiSpd.HwTq.Val "MICROSAR RTE" FLOAT32_IEEE NO_COMPU_METHOD 0 0 -3.402823466e+38 3.402823466e+38 ECU_ADDRESS 0 SYMBOL_LINK "Rte_Swp_HwTqSwp_Val" 0 DISPLAY_IDENTIFIER GmMsg184BusHiSpd.ReceiverPorts.HwTq.Val /end MEASUREMENT
/begin MEASUREMENT GmMsg184BusHiSpd.HwTqIdptSig.Val "MICROSAR RTE" UBYTE NO_COMPU_METHOD 0 0 0 255 ECU_ADDRESS 0 SYMBOL_LINK "Rte_HwTqCorrln_HwTqIdptSig_Val" 0 DISPLAY_IDENTIFIER GmMsg184BusHiSpd.ReceiverPorts.HwTqIdptSig.Val /end MEASUREMENT
/begin MEASUREMENT GmMsg184BusHiSpd.LkaDrvrAppldTq.Val "MICROSAR RTE" UWORD NO_COMPU_METHOD 0 0 0 65535 ECU_ADDRESS 0 SYMBOL_LINK "Rte_GmMsg184BusHiSpd_LkaDrvrAppldTq_Val" 0 DISPLAY_IDENTIFIER GmMsg184BusHiSpd.SenderPorts.LkaDrvrAppldTq.Val /end MEASUREMENT
/begin MEASUREMENT GmMsg184BusHiSpd.LkaDrvrAppldTqVld.Val "MICROSAR RTE" UBYTE NO_COMPU_METHOD 0 0 0 255 ECU_ADDRESS 0 SYMBOL_LINK "Rte_GmMsg184BusHiSpd_LkaDrvrAppldTqVld_Val" 0 DISPLAY_IDENTIFIER GmMsg184BusHiSpd.SenderPorts.LkaDrvrAppldTqVld.Val /end MEASUREMENT
/begin MEASUREMENT GmMsg184BusHiSpd.LkaElecPwrSteerTotTqDlvd.Val "MICROSAR RTE" UWORD NO_COMPU_METHOD 0 0 0 65535 ECU_ADDRESS 0 SYMBOL_LINK "Rte_GmMsg184BusHiSpd_LkaElecPwrSteerTotTqDlvd_Val" 0 DISPLAY_IDENTIFIER GmMsg184BusHiSpd.SenderPorts.LkaElecPwrSteerTotTqDlvd.Val /end MEASUREMENT
/begin MEASUREMENT GmMsg184BusHiSpd.LkaSt.Val "MICROSAR RTE" UBYTE NO_COMPU_METHOD 0 0 0 255 ECU_ADDRESS 0 SYMBOL_LINK "Rte_GmOvrlStMgr_LkaSt_Val" 0 DISPLAY_IDENTIFIER GmMsg184BusHiSpd.ReceiverPorts.LkaSt.Val /end MEASUREMENT
/begin MEASUREMENT GmMsg184BusHiSpd.LkaTqDlvd.Val "MICROSAR RTE" FLOAT32_IEEE NO_COMPU_METHOD 0 0 -3.402823466e+38 3.402823466e+38 ECU_ADDRESS 0 SYMBOL_LINK "Rte_GmTqArbn_LkaTqCmdCdnd_Val" 0 DISPLAY_IDENTIFIER GmMsg184BusHiSpd.ReceiverPorts.LkaTqDlvd.Val /end MEASUREMENT
/begin MEASUREMENT GmMsg184BusHiSpd.LkaTqOvrlDeltaTqDlvd.Val "MICROSAR RTE" UWORD NO_COMPU_METHOD 0 0 0 65535 ECU_ADDRESS 0 SYMBOL_LINK "Rte_GmMsg184BusHiSpd_LkaTqOvrlDeltaTqDlvd_Val" 0 DISPLAY_IDENTIFIER GmMsg184BusHiSpd.SenderPorts.LkaTqOvrlDeltaTqDlvd.Val /end MEASUREMENT
/begin MEASUREMENT GmMsg184BusHiSpd.LkaTqOvrlDlvdRollgCntr.Val "MICROSAR RTE" UBYTE NO_COMPU_METHOD 0 0 0 255 ECU_ADDRESS 0 SYMBOL_LINK "Rte_GmMsg184BusHiSpd_LkaTqOvrlDlvdRollgCntr_Val" 0 DISPLAY_IDENTIFIER GmMsg184BusHiSpd.SenderPorts.LkaTqOvrlDlvdRollgCntr.Val /end MEASUREMENT
/begin MEASUREMENT GmMsg184BusHiSpd.LkaTqOvrlStsChks.Val "MICROSAR RTE" UWORD NO_COMPU_METHOD 0 0 0 65535 ECU_ADDRESS 0 SYMBOL_LINK "Rte_GmMsg184BusHiSpd_LkaTqOvrlStsChks_Val" 0 DISPLAY_IDENTIFIER GmMsg184BusHiSpd.SenderPorts.LkaTqOvrlStsChks.Val /end MEASUREMENT
/begin MEASUREMENT GmMsg184BusHiSpd.LkaTqOvrlTqDlvdSts.Val "MICROSAR RTE" UBYTE NO_COMPU_METHOD 0 0 0 255 ECU_ADDRESS 0 SYMBOL_LINK "Rte_GmMsg184BusHiSpd_LkaTqOvrlTqDlvdSts_Val" 0 DISPLAY_IDENTIFIER GmMsg184BusHiSpd.SenderPorts.LkaTqOvrlTqDlvdSts.Val /end MEASUREMENT
/begin MEASUREMENT GmMsg184BusHiSpd.SysStFltOutpReqDi.Logl "MICROSAR RTE" UBYTE RTE_CM_BOOLEAN 0 0 0 255 ECU_ADDRESS 0 SYMBOL_LINK "Rte_DiagcMgr_SysStFltOutpReqDi_Logl" 0 DISPLAY_IDENTIFIER GmMsg184BusHiSpd.ReceiverPorts.SysStFltOutpReqDi.Logl /end MEASUREMENT
/begin MEASUREMENT GmMsg184BusHiSpd.VehSpdVld.Logl "MICROSAR RTE" UBYTE RTE_CM_BOOLEAN 0 0 0 255 ECU_ADDRESS 0 SYMBOL_LINK "Rte_VehSigCdng_VehSpdVld_Logl" 0 DISPLAY_IDENTIFIER GmMsg184BusHiSpd.ReceiverPorts.VehSpdVld.Logl /end MEASUREMENT
/begin MEASUREMENT GmMsg1CABusChassisExp.ElecPwrSteerTotTqDlvd.Val "MICROSAR RTE" UWORD NO_COMPU_METHOD 0 0 0 65535 ECU_ADDRESS 0 SYMBOL_LINK "Rte_GmMsg1CABusChassisExp_ElecPwrSteerTotTqDlvd_Val" 0 DISPLAY_IDENTIFIER GmMsg1CABusChassisExp.SenderPorts.ElecPwrSteerTotTqDlvd.Val /end MEASUREMENT
/begin MEASUREMENT GmMsg1CABusChassisExp.EscSt.Val "MICROSAR RTE" UBYTE NO_COMPU_METHOD 0 0 0 255 ECU_ADDRESS 0 SYMBOL_LINK "Rte_GmOvrlStMgr_EscSt_Val" 0 DISPLAY_IDENTIFIER GmMsg1CABusChassisExp.ReceiverPorts.EscSt.Val /end MEASUREMENT
/begin MEASUREMENT GmMsg1CABusChassisExp.EscTqDlvd.Val "MICROSAR RTE" FLOAT32_IEEE NO_COMPU_METHOD 0 0 -3.402823466e+38 3.402823466e+38 ECU_ADDRESS 0 SYMBOL_LINK "Rte_GmTqArbn_EscCmdArbd_Val" 0 DISPLAY_IDENTIFIER GmMsg1CABusChassisExp.ReceiverPorts.EscTqDlvd.Val /end MEASUREMENT
/begin MEASUREMENT GmMsg1CABusChassisExp.GmMsg1CABusChassisExpRollgCntr "MICROSAR RTE" UBYTE NO_COMPU_METHOD 0 0 0 255 ECU_ADDRESS 0 SYMBOL_LINK "Rte_GmMsg1CABusChassisExp_GmMsg1CABusChassisExpRollgCntr" 0 DISPLAY_IDENTIFIER GmMsg1CABusChassisExp.PerInstanceMemories.GmMsg1CABusChassisExpRollgCntr /end MEASUREMENT
/begin MEASUREMENT GmMsg1CABusChassisExp.HwTq.Val "MICROSAR RTE" FLOAT32_IEEE NO_COMPU_METHOD 0 0 -3.402823466e+38 3.402823466e+38 ECU_ADDRESS 0 SYMBOL_LINK "Rte_Swp_HwTqSwp_Val" 0 DISPLAY_IDENTIFIER GmMsg1CABusChassisExp.ReceiverPorts.HwTq.Val /end MEASUREMENT
/begin MEASUREMENT GmMsg1CABusChassisExp.TqOvrlDeltaTqDlvd.Val "MICROSAR RTE" UWORD NO_COMPU_METHOD 0 0 0 65535 ECU_ADDRESS 0 SYMBOL_LINK "Rte_GmMsg1CABusChassisExp_TqOvrlDeltaTqDlvd_Val" 0 DISPLAY_IDENTIFIER GmMsg1CABusChassisExp.SenderPorts.TqOvrlDeltaTqDlvd.Val /end MEASUREMENT
/begin MEASUREMENT GmMsg1CABusChassisExp.TqOvrlDlvdChks.Val "MICROSAR RTE" UWORD NO_COMPU_METHOD 0 0 0 65535 ECU_ADDRESS 0 SYMBOL_LINK "Rte_GmMsg1CABusChassisExp_TqOvrlDlvdChks_Val" 0 DISPLAY_IDENTIFIER GmMsg1CABusChassisExp.SenderPorts.TqOvrlDlvdChks.Val /end MEASUREMENT
/begin MEASUREMENT GmMsg1CABusChassisExp.TqOvrlDlvdRollgCntr.Val "MICROSAR RTE" UBYTE NO_COMPU_METHOD 0 0 0 255 ECU_ADDRESS 0 SYMBOL_LINK "Rte_GmMsg1CABusChassisExp_TqOvrlDlvdRollgCntr_Val" 0 DISPLAY_IDENTIFIER GmMsg1CABusChassisExp.SenderPorts.TqOvrlDlvdRollgCntr.Val /end MEASUREMENT
/begin MEASUREMENT GmMsg1CABusChassisExp.TqOvrlTqDlvdSts.Val "MICROSAR RTE" UBYTE NO_COMPU_METHOD 0 0 0 255 ECU_ADDRESS 0 SYMBOL_LINK "Rte_GmMsg1CABusChassisExp_TqOvrlTqDlvdSts_Val" 0 DISPLAY_IDENTIFIER GmMsg1CABusChassisExp.SenderPorts.TqOvrlTqDlvdSts.Val /end MEASUREMENT
/begin MEASUREMENT GmMsg1E5BusChassisExp.GmMsg1E5BusChassisExpRollgCntr "MICROSAR RTE" UBYTE NO_COMPU_METHOD 0 0 0 255 ECU_ADDRESS 0 SYMBOL_LINK "Rte_GmMsg1E5BusChassisExp_GmMsg1E5BusChassisExpRollgCntr" 0 DISPLAY_IDENTIFIER GmMsg1E5BusChassisExp.PerInstanceMemories.GmMsg1E5BusChassisExpRollgCntr /end MEASUREMENT
/begin MEASUREMENT GmMsg1E5BusChassisExp.HwAg.Val "MICROSAR RTE" FLOAT32_IEEE NO_COMPU_METHOD 0 0 -3.402823466e+38 3.402823466e+38 ECU_ADDRESS 0 SYMBOL_LINK "Rte_HwAgSysArbn_HwAgToSerlCom_Val" 0 DISPLAY_IDENTIFIER GmMsg1E5BusChassisExp.ReceiverPorts.HwAg.Val /end MEASUREMENT
/begin MEASUREMENT GmMsg1E5BusChassisExp.HwAgStsToSerlCom.Logl "MICROSAR RTE" UBYTE RTE_CM_BOOLEAN 0 0 0 255 ECU_ADDRESS 0 SYMBOL_LINK "Rte_HwAgSysArbn_HwAgStsToSerlCom_Logl" 0 DISPLAY_IDENTIFIER GmMsg1E5BusChassisExp.ReceiverPorts.HwAgStsToSerlCom.Logl /end MEASUREMENT
/begin MEASUREMENT GmMsg1E5BusChassisExp.HwAgTrimPrfmd.Logl "MICROSAR RTE" UBYTE RTE_CM_BOOLEAN 0 0 0 255 ECU_ADDRESS 0 SYMBOL_LINK "Rte_HwAgVehCentrTrim_HwAgTrimPrfmd_Logl" 0 DISPLAY_IDENTIFIER GmMsg1E5BusChassisExp.ReceiverPorts.HwAgTrimPrfmd.Logl /end MEASUREMENT
/begin MEASUREMENT GmMsg1E5BusChassisExp.HwVel.Val "MICROSAR RTE" FLOAT32_IEEE NO_COMPU_METHOD 0 0 -3.402823466e+38 3.402823466e+38 ECU_ADDRESS 0 SYMBOL_LINK "Rte_CDD_MotVel_HwVel_Val" 0 DISPLAY_IDENTIFIER GmMsg1E5BusChassisExp.ReceiverPorts.HwVel.Val /end MEASUREMENT
/begin MEASUREMENT GmMsg1E5BusChassisExp.MotAgLoaMtgtnEna.Logl "MICROSAR RTE" UBYTE RTE_CM_BOOLEAN 0 0 0 255 ECU_ADDRESS 0 SYMBOL_LINK "Rte_LoaMgr_MotAgLoaMtgtnEna_Logl" 0 DISPLAY_IDENTIFIER GmMsg1E5BusChassisExp.ReceiverPorts.MotAgLoaMtgtnEna.Logl /end MEASUREMENT
/begin MEASUREMENT GmMsg1E5BusChassisExp.SteerWhlAgAlvRollgCntBusChassisExp.Val "MICROSAR RTE" UBYTE NO_COMPU_METHOD 0 0 0 255 ECU_ADDRESS 0 SYMBOL_LINK "Rte_GmMsg1E5BusChassisExp_SteerWhlAgAlvRollgCntBusChassisExp_Val" 0 DISPLAY_IDENTIFIER GmMsg1E5BusChassisExp.SenderPorts.SteerWhlAgAlvRollgCntBusChassisExp.Val /end MEASUREMENT
/begin MEASUREMENT GmMsg1E5BusChassisExp.SteerWhlAgBusChassisExp.Val "MICROSAR RTE" UWORD NO_COMPU_METHOD 0 0 0 65535 ECU_ADDRESS 0 SYMBOL_LINK "Rte_GmMsg1E5BusChassisExp_SteerWhlAgBusChassisExp_Val" 0 DISPLAY_IDENTIFIER GmMsg1E5BusChassisExp.SenderPorts.SteerWhlAgBusChassisExp.Val /end MEASUREMENT
/begin MEASUREMENT GmMsg1E5BusChassisExp.SteerWhlAgGrdtBusChassisExp.Val "MICROSAR RTE" UWORD NO_COMPU_METHOD 0 0 0 65535 ECU_ADDRESS 0 SYMBOL_LINK "Rte_GmMsg1E5BusChassisExp_SteerWhlAgGrdtBusChassisExp_Val" 0 DISPLAY_IDENTIFIER GmMsg1E5BusChassisExp.SenderPorts.SteerWhlAgGrdtBusChassisExp.Val /end MEASUREMENT
/begin MEASUREMENT GmMsg1E5BusChassisExp.SteerWhlAgGrdtMaskBusChassisExp.Val "MICROSAR RTE" UBYTE NO_COMPU_METHOD 0 0 0 255 ECU_ADDRESS 0 SYMBOL_LINK "Rte_GmMsg1E5BusChassisExp_SteerWhlAgGrdtMaskBusChassisExp_Val" 0 DISPLAY_IDENTIFIER GmMsg1E5BusChassisExp.SenderPorts.SteerWhlAgGrdtMaskBusChassisExp.Val /end MEASUREMENT
/begin MEASUREMENT GmMsg1E5BusChassisExp.SteerWhlAgGrdtVldBusChassisExp.Val "MICROSAR RTE" UBYTE NO_COMPU_METHOD 0 0 0 255 ECU_ADDRESS 0 SYMBOL_LINK "Rte_GmMsg1E5BusChassisExp_SteerWhlAgGrdtVldBusChassisExp_Val" 0 DISPLAY_IDENTIFIER GmMsg1E5BusChassisExp.SenderPorts.SteerWhlAgGrdtVldBusChassisExp.Val /end MEASUREMENT
/begin MEASUREMENT GmMsg1E5BusChassisExp.SteerWhlAgMaskBusChassisExp.Val "MICROSAR RTE" UBYTE NO_COMPU_METHOD 0 0 0 255 ECU_ADDRESS 0 SYMBOL_LINK "Rte_GmMsg1E5BusChassisExp_SteerWhlAgMaskBusChassisExp_Val" 0 DISPLAY_IDENTIFIER GmMsg1E5BusChassisExp.SenderPorts.SteerWhlAgMaskBusChassisExp.Val /end MEASUREMENT
/begin MEASUREMENT GmMsg1E5BusChassisExp.SteerWhlAgSnsrCalStsBusChassisExp.Val "MICROSAR RTE" UBYTE NO_COMPU_METHOD 0 0 0 255 ECU_ADDRESS 0 SYMBOL_LINK "Rte_GmMsg1E5BusChassisExp_SteerWhlAgSnsrCalStsBusChassisExp_Val" 0 DISPLAY_IDENTIFIER GmMsg1E5BusChassisExp.SenderPorts.SteerWhlAgSnsrCalStsBusChassisExp.Val /end MEASUREMENT
/begin MEASUREMENT GmMsg1E5BusChassisExp.SteerWhlAgSnsrChksBusChassisExp.Val "MICROSAR RTE" UWORD NO_COMPU_METHOD 0 0 0 65535 ECU_ADDRESS 0 SYMBOL_LINK "Rte_GmMsg1E5BusChassisExp_SteerWhlAgSnsrChksBusChassisExp_Val" 0 DISPLAY_IDENTIFIER GmMsg1E5BusChassisExp.SenderPorts.SteerWhlAgSnsrChksBusChassisExp.Val /end MEASUREMENT
/begin MEASUREMENT GmMsg1E5BusChassisExp.SteerWhlAgSnsrTypBusChassisExp.Val "MICROSAR RTE" UBYTE NO_COMPU_METHOD 0 0 0 255 ECU_ADDRESS 0 SYMBOL_LINK "Rte_GmMsg1E5BusChassisExp_SteerWhlAgSnsrTypBusChassisExp_Val" 0 DISPLAY_IDENTIFIER GmMsg1E5BusChassisExp.SenderPorts.SteerWhlAgSnsrTypBusChassisExp.Val /end MEASUREMENT
/begin MEASUREMENT GmMsg1E5BusChassisExp.SteerWhlAgVldBusChassisExp.Val "MICROSAR RTE" UBYTE NO_COMPU_METHOD 0 0 0 255 ECU_ADDRESS 0 SYMBOL_LINK "Rte_GmMsg1E5BusChassisExp_SteerWhlAgVldBusChassisExp_Val" 0 DISPLAY_IDENTIFIER GmMsg1E5BusChassisExp.SenderPorts.SteerWhlAgVldBusChassisExp.Val /end MEASUREMENT
/begin MEASUREMENT GmMsg1E5BusHiSpd.GmMsg1E5BusHiSpdRollgCntr "MICROSAR RTE" UBYTE NO_COMPU_METHOD 0 0 0 255 ECU_ADDRESS 0 SYMBOL_LINK "Rte_GmMsg1E5BusHiSpd_GmMsg1E5BusHiSpdRollgCntr" 0 DISPLAY_IDENTIFIER GmMsg1E5BusHiSpd.PerInstanceMemories.GmMsg1E5BusHiSpdRollgCntr /end MEASUREMENT
/begin MEASUREMENT GmMsg1E5BusHiSpd.HwAg.Val "MICROSAR RTE" FLOAT32_IEEE NO_COMPU_METHOD 0 0 -3.402823466e+38 3.402823466e+38 ECU_ADDRESS 0 SYMBOL_LINK "Rte_HwAgSysArbn_HwAgToSerlCom_Val" 0 DISPLAY_IDENTIFIER GmMsg1E5BusHiSpd.ReceiverPorts.HwAg.Val /end MEASUREMENT
/begin MEASUREMENT GmMsg1E5BusHiSpd.HwAgStsToSerlCom.Logl "MICROSAR RTE" UBYTE RTE_CM_BOOLEAN 0 0 0 255 ECU_ADDRESS 0 SYMBOL_LINK "Rte_HwAgSysArbn_HwAgStsToSerlCom_Logl" 0 DISPLAY_IDENTIFIER GmMsg1E5BusHiSpd.ReceiverPorts.HwAgStsToSerlCom.Logl /end MEASUREMENT
/begin MEASUREMENT GmMsg1E5BusHiSpd.HwAgTrimPrfmd.Logl "MICROSAR RTE" UBYTE RTE_CM_BOOLEAN 0 0 0 255 ECU_ADDRESS 0 SYMBOL_LINK "Rte_HwAgVehCentrTrim_HwAgTrimPrfmd_Logl" 0 DISPLAY_IDENTIFIER GmMsg1E5BusHiSpd.ReceiverPorts.HwAgTrimPrfmd.Logl /end MEASUREMENT
/begin MEASUREMENT GmMsg1E5BusHiSpd.HwVel.Val "MICROSAR RTE" FLOAT32_IEEE NO_COMPU_METHOD 0 0 -3.402823466e+38 3.402823466e+38 ECU_ADDRESS 0 SYMBOL_LINK "Rte_CDD_MotVel_HwVel_Val" 0 DISPLAY_IDENTIFIER GmMsg1E5BusHiSpd.ReceiverPorts.HwVel.Val /end MEASUREMENT
/begin MEASUREMENT GmMsg1E5BusHiSpd.MotAgLoaMtgtnEna.Logl "MICROSAR RTE" UBYTE RTE_CM_BOOLEAN 0 0 0 255 ECU_ADDRESS 0 SYMBOL_LINK "Rte_LoaMgr_MotAgLoaMtgtnEna_Logl" 0 DISPLAY_IDENTIFIER GmMsg1E5BusHiSpd.ReceiverPorts.MotAgLoaMtgtnEna.Logl /end MEASUREMENT
/begin MEASUREMENT GmMsg1E5BusHiSpd.SteerWhlAgAlvRollgCntBusHiSpd.Val "MICROSAR RTE" UBYTE NO_COMPU_METHOD 0 0 0 255 ECU_ADDRESS 0 SYMBOL_LINK "Rte_GmMsg1E5BusHiSpd_SteerWhlAgAlvRollgCntBusHiSpd_Val" 0 DISPLAY_IDENTIFIER GmMsg1E5BusHiSpd.SenderPorts.SteerWhlAgAlvRollgCntBusHiSpd.Val /end MEASUREMENT
/begin MEASUREMENT GmMsg1E5BusHiSpd.SteerWhlAgBusHiSpd.Val "MICROSAR RTE" UWORD NO_COMPU_METHOD 0 0 0 65535 ECU_ADDRESS 0 SYMBOL_LINK "Rte_GmMsg1E5BusHiSpd_SteerWhlAgBusHiSpd_Val" 0 DISPLAY_IDENTIFIER GmMsg1E5BusHiSpd.SenderPorts.SteerWhlAgBusHiSpd.Val /end MEASUREMENT
/begin MEASUREMENT GmMsg1E5BusHiSpd.SteerWhlAgGrdtBusHiSpd.Val "MICROSAR RTE" UWORD NO_COMPU_METHOD 0 0 0 65535 ECU_ADDRESS 0 SYMBOL_LINK "Rte_GmMsg1E5BusHiSpd_SteerWhlAgGrdtBusHiSpd_Val" 0 DISPLAY_IDENTIFIER GmMsg1E5BusHiSpd.SenderPorts.SteerWhlAgGrdtBusHiSpd.Val /end MEASUREMENT
/begin MEASUREMENT GmMsg1E5BusHiSpd.SteerWhlAgGrdtMaskBusHiSpd.Val "MICROSAR RTE" UBYTE NO_COMPU_METHOD 0 0 0 255 ECU_ADDRESS 0 SYMBOL_LINK "Rte_GmMsg1E5BusHiSpd_SteerWhlAgGrdtMaskBusHiSpd_Val" 0 DISPLAY_IDENTIFIER GmMsg1E5BusHiSpd.SenderPorts.SteerWhlAgGrdtMaskBusHiSpd.Val /end MEASUREMENT
/begin MEASUREMENT GmMsg1E5BusHiSpd.SteerWhlAgGrdtVldBusHiSpd.Val "MICROSAR RTE" UBYTE NO_COMPU_METHOD 0 0 0 255 ECU_ADDRESS 0 SYMBOL_LINK "Rte_GmMsg1E5BusHiSpd_SteerWhlAgGrdtVldBusHiSpd_Val" 0 DISPLAY_IDENTIFIER GmMsg1E5BusHiSpd.SenderPorts.SteerWhlAgGrdtVldBusHiSpd.Val /end MEASUREMENT
/begin MEASUREMENT GmMsg1E5BusHiSpd.SteerWhlAgMaskBusHiSpd.Val "MICROSAR RTE" UBYTE NO_COMPU_METHOD 0 0 0 255 ECU_ADDRESS 0 SYMBOL_LINK "Rte_GmMsg1E5BusHiSpd_SteerWhlAgMaskBusHiSpd_Val" 0 DISPLAY_IDENTIFIER GmMsg1E5BusHiSpd.SenderPorts.SteerWhlAgMaskBusHiSpd.Val /end MEASUREMENT
/begin MEASUREMENT GmMsg1E5BusHiSpd.SteerWhlAgSnsrCalStsBusHiSpd.Val "MICROSAR RTE" UBYTE NO_COMPU_METHOD 0 0 0 255 ECU_ADDRESS 0 SYMBOL_LINK "Rte_GmMsg1E5BusHiSpd_SteerWhlAgSnsrCalStsBusHiSpd_Val" 0 DISPLAY_IDENTIFIER GmMsg1E5BusHiSpd.SenderPorts.SteerWhlAgSnsrCalStsBusHiSpd.Val /end MEASUREMENT
/begin MEASUREMENT GmMsg1E5BusHiSpd.SteerWhlAgSnsrChksBusHiSpd.Val "MICROSAR RTE" UWORD NO_COMPU_METHOD 0 0 0 65535 ECU_ADDRESS 0 SYMBOL_LINK "Rte_GmMsg1E5BusHiSpd_SteerWhlAgSnsrChksBusHiSpd_Val" 0 DISPLAY_IDENTIFIER GmMsg1E5BusHiSpd.SenderPorts.SteerWhlAgSnsrChksBusHiSpd.Val /end MEASUREMENT
/begin MEASUREMENT GmMsg1E5BusHiSpd.SteerWhlAgSnsrTypBusHiSpd.Val "MICROSAR RTE" UBYTE NO_COMPU_METHOD 0 0 0 255 ECU_ADDRESS 0 SYMBOL_LINK "Rte_GmMsg1E5BusHiSpd_SteerWhlAgSnsrTypBusHiSpd_Val" 0 DISPLAY_IDENTIFIER GmMsg1E5BusHiSpd.SenderPorts.SteerWhlAgSnsrTypBusHiSpd.Val /end MEASUREMENT
/begin MEASUREMENT GmMsg1E5BusHiSpd.SteerWhlAgVldBusHiSpd.Val "MICROSAR RTE" UBYTE NO_COMPU_METHOD 0 0 0 255 ECU_ADDRESS 0 SYMBOL_LINK "Rte_GmMsg1E5BusHiSpd_SteerWhlAgVldBusHiSpd_Val" 0 DISPLAY_IDENTIFIER GmMsg1E5BusHiSpd.SenderPorts.SteerWhlAgVldBusHiSpd.Val /end MEASUREMENT
/begin MEASUREMENT GmMsg1E9BusHiSpd.AbsActvRaw.Val "MICROSAR RTE" UBYTE NO_COMPU_METHOD 0 0 0 255 ECU_ADDRESS 0 SYMBOL_LINK "Rte_SerlComInpProxy_AbsActvRaw_Val" 0 DISPLAY_IDENTIFIER GmMsg1E9BusHiSpd.ReceiverPorts.AbsActvRaw.Val /end MEASUREMENT
/begin MEASUREMENT GmMsg1E9BusHiSpd.AbsFaildRaw.Val "MICROSAR RTE" UBYTE NO_COMPU_METHOD 0 0 0 255 ECU_ADDRESS 0 SYMBOL_LINK "Rte_SerlComInpProxy_AbsFaildRaw_Val" 0 DISPLAY_IDENTIFIER GmMsg1E9BusHiSpd.ReceiverPorts.AbsFaildRaw.Val /end MEASUREMENT
/begin MEASUREMENT GmMsg1E9BusHiSpd.GmMsg1E9BusHiSpdAbsFaildTmr "MICROSAR RTE" ULONG NO_COMPU_METHOD 0 0 0 4294967295 ECU_ADDRESS 0 SYMBOL_LINK "Rte_GmMsg1E9BusHiSpd_GmMsg1E9BusHiSpdAbsFaildTmr" 0 DISPLAY_IDENTIFIER GmMsg1E9BusHiSpd.PerInstanceMemories.GmMsg1E9BusHiSpdAbsFaildTmr /end MEASUREMENT
/begin MEASUREMENT GmMsg1E9BusHiSpd.GmMsg1E9BusHiSpdLatAInvldTmr "MICROSAR RTE" ULONG NO_COMPU_METHOD 0 0 0 4294967295 ECU_ADDRESS 0 SYMBOL_LINK "Rte_GmMsg1E9BusHiSpd_GmMsg1E9BusHiSpdLatAInvldTmr" 0 DISPLAY_IDENTIFIER GmMsg1E9BusHiSpd.PerInstanceMemories.GmMsg1E9BusHiSpdLatAInvldTmr /end MEASUREMENT
/begin MEASUREMENT GmMsg1E9BusHiSpd.GmMsg1E9BusHiSpdRdntVehStabyEnhmtTmr "MICROSAR RTE" ULONG NO_COMPU_METHOD 0 0 0 4294967295 ECU_ADDRESS 0 SYMBOL_LINK "Rte_GmMsg1E9BusHiSpd_GmMsg1E9BusHiSpdRdntVehStabyEnhmtTmr" 0 DISPLAY_IDENTIFIER GmMsg1E9BusHiSpd.PerInstanceMemories.GmMsg1E9BusHiSpdRdntVehStabyEnhmtTmr /end MEASUREMENT
/begin MEASUREMENT GmMsg1E9BusHiSpd.GmMsg1E9BusHiSpdTcsEnaTmr "MICROSAR RTE" ULONG NO_COMPU_METHOD 0 0 0 4294967295 ECU_ADDRESS 0 SYMBOL_LINK "Rte_GmMsg1E9BusHiSpd_GmMsg1E9BusHiSpdTcsEnaTmr" 0 DISPLAY_IDENTIFIER GmMsg1E9BusHiSpd.PerInstanceMemories.GmMsg1E9BusHiSpdTcsEnaTmr /end MEASUREMENT
/begin MEASUREMENT GmMsg1E9BusHiSpd.GmMsg1E9BusHiSpdVehDynCtrlSysStTmr "MICROSAR RTE" ULONG NO_COMPU_METHOD 0 0 0 4294967295 ECU_ADDRESS 0 SYMBOL_LINK "Rte_GmMsg1E9BusHiSpd_GmMsg1E9BusHiSpdVehDynCtrlSysStTmr" 0 DISPLAY_IDENTIFIER GmMsg1E9BusHiSpd.PerInstanceMemories.GmMsg1E9BusHiSpdVehDynCtrlSysStTmr /end MEASUREMENT
/begin MEASUREMENT GmMsg1E9BusHiSpd.GmMsg1E9BusHiSpdYawRateInvldTmr "MICROSAR RTE" ULONG NO_COMPU_METHOD 0 0 0 4294967295 ECU_ADDRESS 0 SYMBOL_LINK "Rte_GmMsg1E9BusHiSpd_GmMsg1E9BusHiSpdYawRateInvldTmr" 0 DISPLAY_IDENTIFIER GmMsg1E9BusHiSpd.PerInstanceMemories.GmMsg1E9BusHiSpdYawRateInvldTmr /end MEASUREMENT
/begin MEASUREMENT GmMsg1E9BusHiSpd.InvldMsg1E9.Logl "MICROSAR RTE" UBYTE RTE_CM_BOOLEAN 0 0 0 255 ECU_ADDRESS 0 SYMBOL_LINK "Rte_GmMsg1E9BusHiSpd_InvldMsg1E9_Logl" 0 DISPLAY_IDENTIFIER GmMsg1E9BusHiSpd.SenderPorts.InvldMsg1E9.Logl /end MEASUREMENT
/begin MEASUREMENT GmMsg1E9BusHiSpd.LstRxnTiMsg1E9.Val "MICROSAR RTE" ULONG NO_COMPU_METHOD 0 0 0 4294967295 ECU_ADDRESS 0 SYMBOL_LINK "Rte_SerlComInpProxy_LstRxnTiMsg1E9_Val" 0 DISPLAY_IDENTIFIER GmMsg1E9BusHiSpd.ReceiverPorts.LstRxnTiMsg1E9.Val /end MEASUREMENT
/begin MEASUREMENT GmMsg1E9BusHiSpd.MissMsg1E9.Logl "MICROSAR RTE" UBYTE RTE_CM_BOOLEAN 0 0 0 255 ECU_ADDRESS 0 SYMBOL_LINK "Rte_GmMsg1E9BusHiSpd_MissMsg1E9_Logl" 0 DISPLAY_IDENTIFIER GmMsg1E9BusHiSpd.SenderPorts.MissMsg1E9.Logl /end MEASUREMENT
/begin MEASUREMENT GmMsg1E9BusHiSpd.RdntVehStabyEnhmtActv.Logl "MICROSAR RTE" UBYTE RTE_CM_BOOLEAN 0 0 0 255 ECU_ADDRESS 0 SYMBOL_LINK "Rte_GmMsg214BusHiSpd_RdntVehStabyEnhmtActv_Logl" 0 DISPLAY_IDENTIFIER GmMsg1E9BusHiSpd.ReceiverPorts.RdntVehStabyEnhmtActv.Logl /end MEASUREMENT
/begin MEASUREMENT GmMsg1E9BusHiSpd.SerlComAbsActv.Logl "MICROSAR RTE" UBYTE RTE_CM_BOOLEAN 0 0 0 255 ECU_ADDRESS 0 SYMBOL_LINK "Rte_GmMsg1E9BusHiSpd_SerlComAbsActv_Logl" 0 DISPLAY_IDENTIFIER GmMsg1E9BusHiSpd.SenderPorts.SerlComAbsActv.Logl /end MEASUREMENT
/begin MEASUREMENT GmMsg1E9BusHiSpd.SerlComLatA.Val "MICROSAR RTE" FLOAT32_IEEE NO_COMPU_METHOD 0 0 -3.402823466e+38 3.402823466e+38 ECU_ADDRESS 0 SYMBOL_LINK "Rte_GmMsg1E9BusHiSpd_SerlComLatA_Val" 0 DISPLAY_IDENTIFIER GmMsg1E9BusHiSpd.SenderPorts.SerlComLatA.Val /end MEASUREMENT
/begin MEASUREMENT GmMsg1E9BusHiSpd.SerlComTcsActv.Logl "MICROSAR RTE" UBYTE RTE_CM_BOOLEAN 0 0 0 255 ECU_ADDRESS 0 SYMBOL_LINK "Rte_GmMsg1E9BusHiSpd_SerlComTcsActv_Logl" 0 DISPLAY_IDENTIFIER GmMsg1E9BusHiSpd.SenderPorts.SerlComTcsActv.Logl /end MEASUREMENT
/begin MEASUREMENT GmMsg1E9BusHiSpd.SerlComYawRate.Val "MICROSAR RTE" FLOAT32_IEEE NO_COMPU_METHOD 0 0 -3.402823466e+38 3.402823466e+38 ECU_ADDRESS 0 SYMBOL_LINK "Rte_GmMsg1E9BusHiSpd_SerlComYawRate_Val" 0 DISPLAY_IDENTIFIER GmMsg1E9BusHiSpd.SenderPorts.SerlComYawRate.Val /end MEASUREMENT
/begin MEASUREMENT GmMsg1E9BusHiSpd.SerlComYawRateVld.Logl "MICROSAR RTE" UBYTE RTE_CM_BOOLEAN 0 0 0 255 ECU_ADDRESS 0 SYMBOL_LINK "Rte_GmMsg1E9BusHiSpd_SerlComYawRateVld_Logl" 0 DISPLAY_IDENTIFIER GmMsg1E9BusHiSpd.SenderPorts.SerlComYawRateVld.Logl /end MEASUREMENT
/begin MEASUREMENT GmMsg1E9BusHiSpd.TracCtrlSysActvRaw.Val "MICROSAR RTE" UBYTE NO_COMPU_METHOD 0 0 0 255 ECU_ADDRESS 0 SYMBOL_LINK "Rte_SerlComInpProxy_TracCtrlSysActvRaw_Val" 0 DISPLAY_IDENTIFIER GmMsg1E9BusHiSpd.ReceiverPorts.TracCtrlSysActvRaw.Val /end MEASUREMENT
/begin MEASUREMENT GmMsg1E9BusHiSpd.TracCtrlSysEnaRaw.Val "MICROSAR RTE" UBYTE NO_COMPU_METHOD 0 0 0 255 ECU_ADDRESS 0 SYMBOL_LINK "Rte_SerlComInpProxy_TracCtrlSysEnaRaw_Val" 0 DISPLAY_IDENTIFIER GmMsg1E9BusHiSpd.ReceiverPorts.TracCtrlSysEnaRaw.Val /end MEASUREMENT
/begin MEASUREMENT GmMsg1E9BusHiSpd.VehDynCtrlSysStRaw.Val "MICROSAR RTE" UBYTE NO_COMPU_METHOD 0 0 0 255 ECU_ADDRESS 0 SYMBOL_LINK "Rte_SerlComInpProxy_VehDynCtrlSysStRaw_Val" 0 DISPLAY_IDENTIFIER GmMsg1E9BusHiSpd.ReceiverPorts.VehDynCtrlSysStRaw.Val /end MEASUREMENT
/begin MEASUREMENT GmMsg1E9BusHiSpd.VehDynYawRateRaw.Val "MICROSAR RTE" UWORD NO_COMPU_METHOD 0 0 0 65535 ECU_ADDRESS 0 SYMBOL_LINK "Rte_SerlComInpProxy_VehDynYawRateRaw_Val" 0 DISPLAY_IDENTIFIER GmMsg1E9BusHiSpd.ReceiverPorts.VehDynYawRateRaw.Val /end MEASUREMENT
/begin MEASUREMENT GmMsg1E9BusHiSpd.VehDynYawRateVldRaw.Val "MICROSAR RTE" UBYTE NO_COMPU_METHOD 0 0 0 255 ECU_ADDRESS 0 SYMBOL_LINK "Rte_SerlComInpProxy_VehDynYawRateVldRaw_Val" 0 DISPLAY_IDENTIFIER GmMsg1E9BusHiSpd.ReceiverPorts.VehDynYawRateVldRaw.Val /end MEASUREMENT
/begin MEASUREMENT GmMsg1E9BusHiSpd.VehLatAVldSerlCom.Logl "MICROSAR RTE" UBYTE RTE_CM_BOOLEAN 0 0 0 255 ECU_ADDRESS 0 SYMBOL_LINK "Rte_GmMsg1E9BusHiSpd_VehLatAVldSerlCom_Logl" 0 DISPLAY_IDENTIFIER GmMsg1E9BusHiSpd.SenderPorts.VehLatAVldSerlCom.Logl /end MEASUREMENT
/begin MEASUREMENT GmMsg1E9BusHiSpd.VehStabyEnhmtActv.Logl "MICROSAR RTE" UBYTE RTE_CM_BOOLEAN 0 0 0 255 ECU_ADDRESS 0 SYMBOL_LINK "Rte_GmMsg1E9BusHiSpd_VehStabyEnhmtActv_Logl" 0 DISPLAY_IDENTIFIER GmMsg1E9BusHiSpd.SenderPorts.VehStabyEnhmtActv.Logl /end MEASUREMENT
/begin MEASUREMENT GmMsg1E9BusHiSpd.VehStabyEnhmtActvRaw.Val "MICROSAR RTE" UBYTE NO_COMPU_METHOD 0 0 0 255 ECU_ADDRESS 0 SYMBOL_LINK "Rte_SerlComInpProxy_VehStabyEnhmtActvRaw_Val" 0 DISPLAY_IDENTIFIER GmMsg1E9BusHiSpd.ReceiverPorts.VehStabyEnhmtActvRaw.Val /end MEASUREMENT
/begin MEASUREMENT GmMsg1E9BusHiSpd.VehStabyEnhmtLatARaw.Val "MICROSAR RTE" UWORD NO_COMPU_METHOD 0 0 0 65535 ECU_ADDRESS 0 SYMBOL_LINK "Rte_SerlComInpProxy_VehStabyEnhmtLatARaw_Val" 0 DISPLAY_IDENTIFIER GmMsg1E9BusHiSpd.ReceiverPorts.VehStabyEnhmtLatARaw.Val /end MEASUREMENT
/begin MEASUREMENT GmMsg1E9BusHiSpd.VehStabyEnhmtLatAVldRaw.Val "MICROSAR RTE" UBYTE NO_COMPU_METHOD 0 0 0 255 ECU_ADDRESS 0 SYMBOL_LINK "Rte_SerlComInpProxy_VehStabyEnhmtLatAVldRaw_Val" 0 DISPLAY_IDENTIFIER GmMsg1E9BusHiSpd.ReceiverPorts.VehStabyEnhmtLatAVldRaw.Val /end MEASUREMENT
/begin MEASUREMENT GmMsg1F1BusHiSpd.BackUpPwrModMstVirtDevAuthyRaw.Val "MICROSAR RTE" UBYTE NO_COMPU_METHOD 0 0 0 255 ECU_ADDRESS 0 SYMBOL_LINK "Rte_SerlComInpProxy_BackUpPwrModMstVirtDevAuthyRaw_Val" 0 DISPLAY_IDENTIFIER GmMsg1F1BusHiSpd.ReceiverPorts.BackUpPwrModMstVirtDevAuthyRaw.Val /end MEASUREMENT
/begin MEASUREMENT GmMsg1F1BusHiSpd.EngRunActv.Logl "MICROSAR RTE" UBYTE RTE_CM_BOOLEAN 0 0 0 255 ECU_ADDRESS 0 SYMBOL_LINK "Rte_GmMsg0C9BusHiSpd_EngRunActv_Logl" 0 DISPLAY_IDENTIFIER GmMsg1F1BusHiSpd.ReceiverPorts.EngRunActv.Logl /end MEASUREMENT
/begin MEASUREMENT GmMsg1F1BusHiSpd.GmMsg1F1BusHiSpdPrevPrevSysPwrModRun "MICROSAR RTE" UBYTE RTE_CM_BOOLEAN 0 0 0 255 ECU_ADDRESS 0 SYMBOL_LINK "Rte_GmMsg1F1BusHiSpd_GmMsg1F1BusHiSpdPrevPrevSysPwrModRun" 0 DISPLAY_IDENTIFIER GmMsg1F1BusHiSpd.PerInstanceMemories.GmMsg1F1BusHiSpdPrevPrevSysPwrModRun /end MEASUREMENT
/begin MEASUREMENT GmMsg1F1BusHiSpd.LstRxnTiMsg1F1.Val "MICROSAR RTE" ULONG NO_COMPU_METHOD 0 0 0 4294967295 ECU_ADDRESS 0 SYMBOL_LINK "Rte_SerlComInpProxy_LstRxnTiMsg1F1_Val" 0 DISPLAY_IDENTIFIER GmMsg1F1BusHiSpd.ReceiverPorts.LstRxnTiMsg1F1.Val /end MEASUREMENT
/begin MEASUREMENT GmMsg1F1BusHiSpd.MissMsg1F1.Logl "MICROSAR RTE" UBYTE RTE_CM_BOOLEAN 0 0 0 255 ECU_ADDRESS 0 SYMBOL_LINK "Rte_GmMsg1F1BusHiSpd_MissMsg1F1_Logl" 0 DISPLAY_IDENTIFIER GmMsg1F1BusHiSpd.SenderPorts.MissMsg1F1.Logl /end MEASUREMENT
/begin MEASUREMENT GmMsg1F1BusHiSpd.SysBackUpPwrModEnaRaw.Val "MICROSAR RTE" UBYTE NO_COMPU_METHOD 0 0 0 255 ECU_ADDRESS 0 SYMBOL_LINK "Rte_SerlComInpProxy_SysBackUpPwrModEnaRaw_Val" 0 DISPLAY_IDENTIFIER GmMsg1F1BusHiSpd.ReceiverPorts.SysBackUpPwrModEnaRaw.Val /end MEASUREMENT
/begin MEASUREMENT GmMsg1F1BusHiSpd.SysBackUpPwrModRaw.Val "MICROSAR RTE" UBYTE NO_COMPU_METHOD 0 0 0 255 ECU_ADDRESS 0 SYMBOL_LINK "Rte_SerlComInpProxy_SysBackUpPwrModRaw_Val" 0 DISPLAY_IDENTIFIER GmMsg1F1BusHiSpd.ReceiverPorts.SysBackUpPwrModRaw.Val /end MEASUREMENT
/begin MEASUREMENT GmMsg1F1BusHiSpd.SysPwrModRaw.Val "MICROSAR RTE" UBYTE NO_COMPU_METHOD 0 0 0 255 ECU_ADDRESS 0 SYMBOL_LINK "Rte_SerlComInpProxy_SysPwrModRaw_Val" 0 DISPLAY_IDENTIFIER GmMsg1F1BusHiSpd.ReceiverPorts.SysPwrModRaw.Val /end MEASUREMENT
/begin MEASUREMENT GmMsg1F1BusHiSpd.SysPwrModRun.Logl "MICROSAR RTE" UBYTE RTE_CM_BOOLEAN 0 0 0 255 ECU_ADDRESS 0 SYMBOL_LINK "Rte_GmMsg1F1BusHiSpd_SysPwrModRun_Logl" 0 DISPLAY_IDENTIFIER GmMsg1F1BusHiSpd.SenderPorts.SysPwrModRun.Logl /end MEASUREMENT
/begin MEASUREMENT GmMsg1F5BusHiSpd.GmMsg1F5BusHiSpdInvldTmr "MICROSAR RTE" ULONG NO_COMPU_METHOD 0 0 0 4294967295 ECU_ADDRESS 0 SYMBOL_LINK "Rte_GmMsg1F5BusHiSpd_GmMsg1F5BusHiSpdInvldTmr" 0 DISPLAY_IDENTIFIER GmMsg1F5BusHiSpd.PerInstanceMemories.GmMsg1F5BusHiSpdInvldTmr /end MEASUREMENT
/begin MEASUREMENT GmMsg1F5BusHiSpd.GmMsg1F5BusHiSpdPrevShiftLvrInRvs "MICROSAR RTE" UBYTE RTE_CM_BOOLEAN 0 0 0 255 ECU_ADDRESS 0 SYMBOL_LINK "Rte_GmMsg1F5BusHiSpd_GmMsg1F5BusHiSpdPrevShiftLvrInRvs" 0 DISPLAY_IDENTIFIER GmMsg1F5BusHiSpd.PerInstanceMemories.GmMsg1F5BusHiSpdPrevShiftLvrInRvs /end MEASUREMENT
/begin MEASUREMENT GmMsg1F5BusHiSpd.InvldMsg1F5.Logl "MICROSAR RTE" UBYTE RTE_CM_BOOLEAN 0 0 0 255 ECU_ADDRESS 0 SYMBOL_LINK "Rte_GmMsg1F5BusHiSpd_InvldMsg1F5_Logl" 0 DISPLAY_IDENTIFIER GmMsg1F5BusHiSpd.SenderPorts.InvldMsg1F5.Logl /end MEASUREMENT
/begin MEASUREMENT GmMsg1F5BusHiSpd.LstRxnTiMsg1F5.Val "MICROSAR RTE" ULONG NO_COMPU_METHOD 0 0 0 4294967295 ECU_ADDRESS 0 SYMBOL_LINK "Rte_SerlComInpProxy_LstRxnTiMsg1F5_Val" 0 DISPLAY_IDENTIFIER GmMsg1F5BusHiSpd.ReceiverPorts.LstRxnTiMsg1F5.Val /end MEASUREMENT
/begin MEASUREMENT GmMsg1F5BusHiSpd.ShiftLvrInRvs.Logl "MICROSAR RTE" UBYTE RTE_CM_BOOLEAN 0 0 0 255 ECU_ADDRESS 0 SYMBOL_LINK "Rte_GmMsg1F5BusHiSpd_ShiftLvrInRvs_Logl" 0 DISPLAY_IDENTIFIER GmMsg1F5BusHiSpd.SenderPorts.ShiftLvrInRvs.Logl /end MEASUREMENT
/begin MEASUREMENT GmMsg1F5BusHiSpd.ShiftLvrPosnRaw.Val "MICROSAR RTE" UBYTE NO_COMPU_METHOD 0 0 0 255 ECU_ADDRESS 0 SYMBOL_LINK "Rte_SerlComInpProxy_ShiftLvrPosnRaw_Val" 0 DISPLAY_IDENTIFIER GmMsg1F5BusHiSpd.ReceiverPorts.ShiftLvrPosnRaw.Val /end MEASUREMENT
/begin MEASUREMENT GmMsg1F5BusHiSpd.ShiftLvrPosnVldRaw.Val "MICROSAR RTE" UBYTE NO_COMPU_METHOD 0 0 0 255 ECU_ADDRESS 0 SYMBOL_LINK "Rte_SerlComInpProxy_ShiftLvrPosnVldRaw_Val" 0 DISPLAY_IDENTIFIER GmMsg1F5BusHiSpd.ReceiverPorts.ShiftLvrPosnVldRaw.Val /end MEASUREMENT
/begin MEASUREMENT GmMsg214BusHiSpd.AbsActvProtdProtnValRaw.Val "MICROSAR RTE" UBYTE NO_COMPU_METHOD 0 0 0 255 ECU_ADDRESS 0 SYMBOL_LINK "Rte_SerlComInpProxy_AbsActvProtdProtnValRaw_Val" 0 DISPLAY_IDENTIFIER GmMsg214BusHiSpd.ReceiverPorts.AbsActvProtdProtnValRaw.Val /end MEASUREMENT
/begin MEASUREMENT GmMsg214BusHiSpd.AbsActvProtdRaw.Val "MICROSAR RTE" UBYTE NO_COMPU_METHOD 0 0 0 255 ECU_ADDRESS 0 SYMBOL_LINK "Rte_SerlComInpProxy_AbsActvProtdRaw_Val" 0 DISPLAY_IDENTIFIER GmMsg214BusHiSpd.ReceiverPorts.AbsActvProtdRaw.Val /end MEASUREMENT
/begin MEASUREMENT GmMsg214BusHiSpd.AbsActvProtdRollgCntrRaw.Val "MICROSAR RTE" UBYTE NO_COMPU_METHOD 0 0 0 255 ECU_ADDRESS 0 SYMBOL_LINK "Rte_SerlComInpProxy_AbsActvProtdRollgCntrRaw_Val" 0 DISPLAY_IDENTIFIER GmMsg214BusHiSpd.ReceiverPorts.AbsActvProtdRollgCntrRaw.Val /end MEASUREMENT
/begin MEASUREMENT GmMsg214BusHiSpd.AbsInvld.Logl "MICROSAR RTE" UBYTE RTE_CM_BOOLEAN 0 0 0 255 ECU_ADDRESS 0 SYMBOL_LINK "Rte_GmMsg214BusHiSpd_AbsInvld_Logl" 0 DISPLAY_IDENTIFIER GmMsg214BusHiSpd.SenderPorts.AbsInvld.Logl /end MEASUREMENT
/begin MEASUREMENT GmMsg214BusHiSpd.AbsProtd.Logl "MICROSAR RTE" UBYTE RTE_CM_BOOLEAN 0 0 0 255 ECU_ADDRESS 0 SYMBOL_LINK "Rte_GmMsg214BusHiSpd_AbsProtd_Logl" 0 DISPLAY_IDENTIFIER GmMsg214BusHiSpd.SenderPorts.AbsProtd.Logl /end MEASUREMENT
/begin MEASUREMENT GmMsg214BusHiSpd.GmMsg214BusHiSpdAbsActvProtdInvldProtnValTmr "MICROSAR RTE" ULONG NO_COMPU_METHOD 0 0 0 4294967295 ECU_ADDRESS 0 SYMBOL_LINK "Rte_GmMsg214BusHiSpd_GmMsg214BusHiSpdAbsActvProtdInvldProtnValTmr" 0 DISPLAY_IDENTIFIER GmMsg214BusHiSpd.PerInstanceMemories.GmMsg214BusHiSpdAbsActvProtdInvldProtnValTmr /end MEASUREMENT
/begin MEASUREMENT GmMsg214BusHiSpd.GmMsg214BusHiSpdAbsActvProtdInvldRollgCntrTmr "MICROSAR RTE" ULONG NO_COMPU_METHOD 0 0 0 4294967295 ECU_ADDRESS 0 SYMBOL_LINK "Rte_GmMsg214BusHiSpd_GmMsg214BusHiSpdAbsActvProtdInvldRollgCntrTmr" 0 DISPLAY_IDENTIFIER GmMsg214BusHiSpd.PerInstanceMemories.GmMsg214BusHiSpdAbsActvProtdInvldRollgCntrTmr /end MEASUREMENT
/begin GROUP GmFctDiArbn.HwAgEotCcw.Val "MICROSAR RTE" /begin SUB_GROUP /end SUB_GROUP /begin FUNCTION_LIST /end FUNCTION_LIST /begin REF_CHARACTERISTIC /end REF_CHARACTERISTIC /begin REF_MEASUREMENT GmFctDiArbn.HwAgEotCcw.Val /end REF_MEASUREMENT /end GROUP
/begin GROUP GmFctDiArbn.HwAgEotCw.Val "MICROSAR RTE" /begin SUB_GROUP /end SUB_GROUP /begin FUNCTION_LIST /end FUNCTION_LIST /begin REF_CHARACTERISTIC /end REF_CHARACTERISTIC /begin REF_MEASUREMENT GmFctDiArbn.HwAgEotCw.Val /end REF_MEASUREMENT /end GROUP
/begin GROUP GmFctDiArbn.HwTq.Val "MICROSAR RTE" /begin SUB_GROUP /end SUB_GROUP /begin FUNCTION_LIST /end FUNCTION_LIST /begin REF_CHARACTERISTIC /end REF_CHARACTERISTIC /begin REF_MEASUREMENT GmFctDiArbn.HwTq.Val /end REF_MEASUREMENT /end GROUP
/begin GROUP GmFctDiArbn.InCcwEotRng "MICROSAR RTE" /begin SUB_GROUP /end SUB_GROUP /begin FUNCTION_LIST /end FUNCTION_LIST /begin REF_CHARACTERISTIC /end REF_CHARACTERISTIC /begin REF_MEASUREMENT GmFctDiArbn.InCcwEotRng /end REF_MEASUREMENT /end GROUP
/begin GROUP GmFctDiArbn.InCcwEotRngElpdTi "MICROSAR RTE" /begin SUB_GROUP /end SUB_GROUP /begin FUNCTION_LIST /end FUNCTION_LIST /begin REF_CHARACTERISTIC /end REF_CHARACTERISTIC /begin REF_MEASUREMENT GmFctDiArbn.InCcwEotRngElpdTi /end REF_MEASUREMENT /end GROUP
/begin GROUP GmFctDiArbn.InCwEotRng "MICROSAR RTE" /begin SUB_GROUP /end SUB_GROUP /begin FUNCTION_LIST /end FUNCTION_LIST /begin REF_CHARACTERISTIC /end REF_CHARACTERISTIC /begin REF_MEASUREMENT GmFctDiArbn.InCwEotRng /end REF_MEASUREMENT /end GROUP
/begin GROUP GmFctDiArbn.InCwEotRngElpdTi "MICROSAR RTE" /begin SUB_GROUP /end SUB_GROUP /begin FUNCTION_LIST /end FUNCTION_LIST /begin REF_CHARACTERISTIC /end REF_CHARACTERISTIC /begin REF_MEASUREMENT GmFctDiArbn.InCwEotRngElpdTi /end REF_MEASUREMENT /end GROUP
/begin GROUP GmFctDiArbn.InOnCentrRng "MICROSAR RTE" /begin SUB_GROUP /end SUB_GROUP /begin FUNCTION_LIST /end FUNCTION_LIST /begin REF_CHARACTERISTIC /end REF_CHARACTERISTIC /begin REF_MEASUREMENT GmFctDiArbn.InOnCentrRng /end REF_MEASUREMENT /end GROUP
/begin GROUP GmFctDiArbn.InertiaCmpDecelGainDi.Logl "MICROSAR RTE" /begin SUB_GROUP /end SUB_GROUP /begin FUNCTION_LIST /end FUNCTION_LIST /begin REF_CHARACTERISTIC /end REF_CHARACTERISTIC /begin REF_MEASUREMENT GmFctDiArbn.InertiaCmpDecelGainDi.Logl /end REF_MEASUREMENT /end GROUP
/begin GROUP GmFctDiArbn.LkaEna.Logl "MICROSAR RTE" /begin SUB_GROUP /end SUB_GROUP /begin FUNCTION_LIST /end FUNCTION_LIST /begin REF_CHARACTERISTIC /end REF_CHARACTERISTIC /begin REF_MEASUREMENT GmFctDiArbn.LkaEna.Logl /end REF_MEASUREMENT /end GROUP
/begin GROUP GmFctDiArbn.LkaEnaArbn.Logl "MICROSAR RTE" /begin SUB_GROUP /end SUB_GROUP /begin FUNCTION_LIST /end FUNCTION_LIST /begin REF_CHARACTERISTIC /end REF_CHARACTERISTIC /begin REF_MEASUREMENT GmFctDiArbn.LkaEnaArbn.Logl /end REF_MEASUREMENT /end GROUP
/begin GROUP GmFctDiArbn.LoaSt.Val "MICROSAR RTE" /begin SUB_GROUP /end SUB_GROUP /begin FUNCTION_LIST /end FUNCTION_LIST /begin REF_CHARACTERISTIC /end REF_CHARACTERISTIC /begin REF_MEASUREMENT GmFctDiArbn.LoaSt.Val /end REF_MEASUREMENT /end GROUP
/begin GROUP GmFctDiArbn.OnCentrElpdTi "MICROSAR RTE" /begin SUB_GROUP /end SUB_GROUP /begin FUNCTION_LIST /end FUNCTION_LIST /begin REF_CHARACTERISTIC /end REF_CHARACTERISTIC /begin REF_MEASUREMENT GmFctDiArbn.OnCentrElpdTi /end REF_MEASUREMENT /end GROUP
/begin GROUP GmFctDiArbn.PerInstanceMemories "MICROSAR RTE"
 /begin SUB_GROUP GmFctDiArbn.CcwEotEnad GmFctDiArbn.CwEotEnad GmFctDiArbn.FctDiLtch GmFctDiArbn.InCcwEotRng GmFctDiArbn.InCcwEotRngElpdTi GmFctDiArbn.InCwEotRng GmFctDiArbn.InCwEotRngElpdTi GmFctDiArbn.InOnCentrRng GmFctDiArbn.OnCentrElpdTi /end SUB_GROUP
 /begin FUNCTION_LIST /end FUNCTION_LIST
 /begin REF_CHARACTERISTIC /end REF_CHARACTERISTIC
 /begin REF_MEASUREMENT /end REF_MEASUREMENT
/end GROUP
/begin GROUP GmFctDiArbn.PullCmpActvDi.Logl "MICROSAR RTE" /begin SUB_GROUP /end SUB_GROUP /begin FUNCTION_LIST /end FUNCTION_LIST /begin REF_CHARACTERISTIC /end REF_CHARACTERISTIC /begin REF_MEASUREMENT GmFctDiArbn.PullCmpActvDi.Logl /end REF_MEASUREMENT /end GROUP
/begin GROUP GmFctDiArbn.ReceiverPorts "MICROSAR RTE"
 /begin SUB_GROUP GmFctDiArbn.ApaEna.Logl GmFctDiArbn.EscEna.Logl GmFctDiArbn.HwAg.Val GmFctDiArbn.HwAgEotCcw.Val GmFctDiArbn.HwAgEotCw.Val GmFctDiArbn.HwTq.Val GmFctDiArbn.LkaEna.Logl GmFctDiArbn.LoaSt.Val /end SUB_GROUP
 /begin FUNCTION_LIST /end FUNCTION_LIST
 /begin REF_CHARACTERISTIC /end REF_CHARACTERISTIC
 /begin REF_MEASUREMENT /end REF_MEASUREMENT
/end GROUP
/begin GROUP GmFctDiArbn.SenderPorts "MICROSAR RTE"
 /begin SUB_GROUP GmFctDiArbn.ApaEnaArbn.Logl GmFctDiArbn.EscEnaArbn.Logl GmFctDiArbn.GmFctDiSts.Val GmFctDiArbn.InertiaCmpDecelGainDi.Logl GmFctDiArbn.LkaEnaArbn.Logl GmFctDiArbn.PullCmpActvDi.Logl GmFctDiArbn.TunSetRtDi.Logl GmFctDiArbn.WhlImbRejctnDi.Logl /end SUB_GROUP
 /begin FUNCTION_LIST /end FUNCTION_LIST
 /begin REF_CHARACTERISTIC /end REF_CHARACTERISTIC
 /begin REF_MEASUREMENT /end REF_MEASUREMENT
/end GROUP
/begin GROUP GmFctDiArbn.TunSetRtDi.Logl "MICROSAR RTE" /begin SUB_GROUP /end SUB_GROUP /begin FUNCTION_LIST /end FUNCTION_LIST /begin REF_CHARACTERISTIC /end REF_CHARACTERISTIC /begin REF_MEASUREMENT GmFctDiArbn.TunSetRtDi.Logl /end REF_MEASUREMENT /end GROUP
/begin GROUP GmFctDiArbn.WhlImbRejctnDi.Logl "MICROSAR RTE" /begin SUB_GROUP /end SUB_GROUP /begin FUNCTION_LIST /end FUNCTION_LIST /begin REF_CHARACTERISTIC /end REF_CHARACTERISTIC /begin REF_MEASUREMENT GmFctDiArbn.WhlImbRejctnDi.Logl /end REF_MEASUREMENT /end GROUP
/begin GROUP GmMsg0C5BusHiSpd "MICROSAR RTE"
 /begin SUB_GROUP GmMsg0C5BusHiSpd.CalibrationPorts GmMsg0C5BusHiSpd.PerInstanceMemories GmMsg0C5BusHiSpd.ReceiverPorts GmMsg0C5BusHiSpd.SenderPorts /end SUB_GROUP
 /begin FUNCTION_LIST /end FUNCTION_LIST
 /begin REF_CHARACTERISTIC /end REF_CHARACTERISTIC
 /begin REF_MEASUREMENT /end REF_MEASUREMENT
/end GROUP
/begin GROUP GmMsg0C5BusHiSpd.CalibrationPorts "MICROSAR RTE"
 /begin SUB_GROUP GmMsg0C5BusHiSpd.GmMsg0C5BusHiSpdInvldTiOut.Val GmMsg0C5BusHiSpd.GmMsg0C5BusHiSpdMissTiOut.Val GmMsg0C5BusHiSpd.GmMsg0C5BusHiSpdRstTiOut.Val GmMsg0C5BusHiSpd.GmMsg0C5BusHiSpdSeqNrTiOut.Val /end SUB_GROUP
 /begin FUNCTION_LIST /end FUNCTION_LIST
 /begin REF_CHARACTERISTIC /end REF_CHARACTERISTIC
 /begin REF_MEASUREMENT /end REF_MEASUREMENT
/end GROUP
/begin GROUP GmMsg0C5BusHiSpd.GmMsg0C5BusHiSpdInvldTiOut.Val "MICROSAR RTE" /begin SUB_GROUP /end SUB_GROUP /begin FUNCTION_LIST /end FUNCTION_LIST /begin REF_CHARACTERISTIC GmMsg0C5BusHiSpd.GmMsg0C5BusHiSpdInvldTiOut.Val /end REF_CHARACTERISTIC /begin REF_MEASUREMENT /end REF_MEASUREMENT /end GROUP
/begin GROUP GmMsg0C5BusHiSpd.GmMsg0C5BusHiSpdLeInvldTmr "MICROSAR RTE" /begin SUB_GROUP /end SUB_GROUP /begin FUNCTION_LIST /end FUNCTION_LIST /begin REF_CHARACTERISTIC /end REF_CHARACTERISTIC /begin REF_MEASUREMENT GmMsg0C5BusHiSpd.GmMsg0C5BusHiSpdLeInvldTmr /end REF_MEASUREMENT /end GROUP
/begin GROUP GmMsg0C5BusHiSpd.GmMsg0C5BusHiSpdLeRstTmr "MICROSAR RTE" /begin SUB_GROUP /end SUB_GROUP /begin FUNCTION_LIST /end FUNCTION_LIST /begin REF_CHARACTERISTIC /end REF_CHARACTERISTIC /begin REF_MEASUREMENT GmMsg0C5BusHiSpd.GmMsg0C5BusHiSpdLeRstTmr /end REF_MEASUREMENT /end GROUP
/begin GROUP GmMsg0C5BusHiSpd.GmMsg0C5BusHiSpdLeSeqNrTmr "MICROSAR RTE" /begin SUB_GROUP /end SUB_GROUP /begin FUNCTION_LIST /end FUNCTION_LIST /begin REF_CHARACTERISTIC /end REF_CHARACTERISTIC /begin REF_MEASUREMENT GmMsg0C5BusHiSpd.GmMsg0C5BusHiSpdLeSeqNrTmr /end REF_MEASUREMENT /end GROUP
/begin GROUP GmMsg0C5BusHiSpd.GmMsg0C5BusHiSpdMissTiOut.Val "MICROSAR RTE" /begin SUB_GROUP /end SUB_GROUP /begin FUNCTION_LIST /end FUNCTION_LIST /begin REF_CHARACTERISTIC GmMsg0C5BusHiSpd.GmMsg0C5BusHiSpdMissTiOut.Val /end REF_CHARACTERISTIC /begin REF_MEASUREMENT /end REF_MEASUREMENT /end GROUP
/begin GROUP GmMsg0C5BusHiSpd.GmMsg0C5BusHiSpdPrevLeDstPlsCnt "MICROSAR RTE" /begin SUB_GROUP /end SUB_GROUP /begin FUNCTION_LIST /end FUNCTION_LIST /begin REF_CHARACTERISTIC /end REF_CHARACTERISTIC /begin REF_MEASUREMENT GmMsg0C5BusHiSpd.GmMsg0C5BusHiSpdPrevLeDstPlsCnt /end REF_MEASUREMENT /end GROUP
/begin GROUP GmMsg0C5BusHiSpd.GmMsg0C5BusHiSpdPrevLeDstTiStamp "MICROSAR RTE" /begin SUB_GROUP /end SUB_GROUP /begin FUNCTION_LIST /end FUNCTION_LIST /begin REF_CHARACTERISTIC /end REF_CHARACTERISTIC /begin REF_MEASUREMENT GmMsg0C5BusHiSpd.GmMsg0C5BusHiSpdPrevLeDstTiStamp /end REF_MEASUREMENT /end GROUP
/begin GROUP GmMsg0C5BusHiSpd.GmMsg0C5BusHiSpdPrevLeSeqNr "MICROSAR RTE" /begin SUB_GROUP /end SUB_GROUP /begin FUNCTION_LIST /end FUNCTION_LIST /begin REF_CHARACTERISTIC /end REF_CHARACTERISTIC /begin REF_MEASUREMENT GmMsg0C5BusHiSpd.GmMsg0C5BusHiSpdPrevLeSeqNr /end REF_MEASUREMENT /end GROUP
/begin GROUP GmMsg0C5BusHiSpd.GmMsg0C5BusHiSpdPrevLeVld "MICROSAR RTE" /begin SUB_GROUP /end SUB_GROUP /begin FUNCTION_LIST /end FUNCTION_LIST /begin REF_CHARACTERISTIC /end REF_CHARACTERISTIC /begin REF_MEASUREMENT GmMsg0C5BusHiSpd.GmMsg0C5BusHiSpdPrevLeVld /end REF_MEASUREMENT /end GROUP
/begin GROUP GmMsg0C5BusHiSpd.GmMsg0C5BusHiSpdPrevRiDstPlsCnt "MICROSAR RTE" /begin SUB_GROUP /end SUB_GROUP /begin FUNCTION_LIST /end FUNCTION_LIST /begin REF_CHARACTERISTIC /end REF_CHARACTERISTIC /begin REF_MEASUREMENT GmMsg0C5BusHiSpd.GmMsg0C5BusHiSpdPrevRiDstPlsCnt /end REF_MEASUREMENT /end GROUP
/begin GROUP GmMsg0C5BusHiSpd.GmMsg0C5BusHiSpdPrevRiDstTiStamp "MICROSAR RTE" /begin SUB_GROUP /end SUB_GROUP /begin FUNCTION_LIST /end FUNCTION_LIST /begin REF_CHARACTERISTIC /end REF_CHARACTERISTIC /begin REF_MEASUREMENT GmMsg0C5BusHiSpd.GmMsg0C5BusHiSpdPrevRiDstTiStamp /end REF_MEASUREMENT /end GROUP
/begin GROUP GmMsg0C5BusHiSpd.GmMsg0C5BusHiSpdPrevRiSeqNr "MICROSAR RTE" /begin SUB_GROUP /end SUB_GROUP /begin FUNCTION_LIST /end FUNCTION_LIST /begin REF_CHARACTERISTIC /end REF_CHARACTERISTIC /begin REF_MEASUREMENT GmMsg0C5BusHiSpd.GmMsg0C5BusHiSpdPrevRiSeqNr /end REF_MEASUREMENT /end GROUP
/begin GROUP GmMsg0C5BusHiSpd.GmMsg0C5BusHiSpdPrevRiVld "MICROSAR RTE" /begin SUB_GROUP /end SUB_GROUP /begin FUNCTION_LIST /end FUNCTION_LIST /begin REF_CHARACTERISTIC /end REF_CHARACTERISTIC /begin REF_MEASUREMENT GmMsg0C5BusHiSpd.GmMsg0C5BusHiSpdPrevRiVld /end REF_MEASUREMENT /end GROUP
/begin GROUP GmMsg0C5BusHiSpd.GmMsg0C5BusHiSpdPrevRxnTi "MICROSAR RTE" /begin SUB_GROUP /end SUB_GROUP /begin FUNCTION_LIST /end FUNCTION_LIST /begin REF_CHARACTERISTIC /end REF_CHARACTERISTIC /begin REF_MEASUREMENT GmMsg0C5BusHiSpd.GmMsg0C5BusHiSpdPrevRxnTi /end REF_MEASUREMENT /end GROUP
/begin GROUP GmMsg0C5BusHiSpd.GmMsg0C5BusHiSpdRiInvldTmr "MICROSAR RTE" /begin SUB_GROUP /end SUB_GROUP /begin FUNCTION_LIST /end FUNCTION_LIST /begin REF_CHARACTERISTIC /end REF_CHARACTERISTIC /begin REF_MEASUREMENT GmMsg0C5BusHiSpd.GmMsg0C5BusHiSpdRiInvldTmr /end REF_MEASUREMENT /end GROUP
/begin GROUP GmMsg0C5BusHiSpd.GmMsg0C5BusHiSpdRiRstTmr "MICROSAR RTE" /begin SUB_GROUP /end SUB_GROUP /begin FUNCTION_LIST /end FUNCTION_LIST /begin REF_CHARACTERISTIC /end REF_CHARACTERISTIC /begin REF_MEASUREMENT GmMsg0C5BusHiSpd.GmMsg0C5BusHiSpdRiRstTmr /end REF_MEASUREMENT /end GROUP
/begin GROUP GmMsg0C5BusHiSpd.GmMsg0C5BusHiSpdRiSeqNrTmr "MICROSAR RTE" /begin SUB_GROUP /end SUB_GROUP /begin FUNCTION_LIST /end FUNCTION_LIST /begin REF_CHARACTERISTIC /end REF_CHARACTERISTIC /begin REF_MEASUREMENT GmMsg0C5BusHiSpd.GmMsg0C5BusHiSpdRiSeqNrTmr /end REF_MEASUREMENT /end GROUP
/begin GROUP GmMsg0C5BusHiSpd.GmMsg0C5BusHiSpdRollgCntrRst "MICROSAR RTE" /begin SUB_GROUP /end SUB_GROUP /begin FUNCTION_LIST /end FUNCTION_LIST /begin REF_CHARACTERISTIC /end REF_CHARACTERISTIC /begin REF_MEASUREMENT GmMsg0C5BusHiSpd.GmMsg0C5BusHiSpdRollgCntrRst /end REF_MEASUREMENT /end GROUP
/begin GROUP GmMsg0C5BusHiSpd.GmMsg0C5BusHiSpdRstTiOut.Val "MICROSAR RTE" /begin SUB_GROUP /end SUB_GROUP /begin FUNCTION_LIST /end FUNCTION_LIST /begin REF_CHARACTERISTIC GmMsg0C5BusHiSpd.GmMsg0C5BusHiSpdRstTiOut.Val /end REF_CHARACTERISTIC /begin REF_MEASUREMENT /end REF_MEASUREMENT /end GROUP
/begin GROUP GmMsg0C5BusHiSpd.GmMsg0C5BusHiSpdSeqNrTiOut.Val "MICROSAR RTE" /begin SUB_GROUP /end SUB_GROUP /begin FUNCTION_LIST /end FUNCTION_LIST /begin REF_CHARACTERISTIC GmMsg0C5BusHiSpd.GmMsg0C5BusHiSpdSeqNrTiOut.Val /end REF_CHARACTERISTIC /begin REF_MEASUREMENT /end REF_MEASUREMENT /end GROUP
/begin GROUP GmMsg0C5BusHiSpd.LeWhlDstPlsCntr.Val "MICROSAR RTE" /begin SUB_GROUP /end SUB_GROUP /begin FUNCTION_LIST /end FUNCTION_LIST /begin REF_CHARACTERISTIC /end REF_CHARACTERISTIC /begin REF_MEASUREMENT GmMsg0C5BusHiSpd.LeWhlDstPlsCntr.Val /end REF_MEASUREMENT /end GROUP
/begin GROUP GmMsg0C5BusHiSpd.LeWhlDstPlsCntrRaw.Val "MICROSAR RTE" /begin SUB_GROUP /end SUB_GROUP /begin FUNCTION_LIST /end FUNCTION_LIST /begin REF_CHARACTERISTIC /end REF_CHARACTERISTIC /begin REF_MEASUREMENT GmMsg0C5BusHiSpd.LeWhlDstPlsCntrRaw.Val /end REF_MEASUREMENT /end GROUP
/begin GROUP GmMsg0C5BusHiSpd.LeWhlDstTiStamp.Val "MICROSAR RTE" /begin SUB_GROUP /end SUB_GROUP /begin FUNCTION_LIST /end FUNCTION_LIST /begin REF_CHARACTERISTIC /end REF_CHARACTERISTIC /begin REF_MEASUREMENT GmMsg0C5BusHiSpd.LeWhlDstTiStamp.Val /end REF_MEASUREMENT /end GROUP
/begin GROUP GmMsg0C5BusHiSpd.LeWhlDstTiStampRaw.Val "MICROSAR RTE" /begin SUB_GROUP /end SUB_GROUP /begin FUNCTION_LIST /end FUNCTION_LIST /begin REF_CHARACTERISTIC /end REF_CHARACTERISTIC /begin REF_MEASUREMENT GmMsg0C5BusHiSpd.LeWhlDstTiStampRaw.Val /end REF_MEASUREMENT /end GROUP
/begin GROUP GmMsg0C5BusHiSpd.LeWhlDstVld.Logl "MICROSAR RTE" /begin SUB_GROUP /end SUB_GROUP /begin FUNCTION_LIST /end FUNCTION_LIST /begin REF_CHARACTERISTIC /end REF_CHARACTERISTIC /begin REF_MEASUREMENT GmMsg0C5BusHiSpd.LeWhlDstVld.Logl /end REF_MEASUREMENT /end GROUP
/begin GROUP GmMsg0C5BusHiSpd.LeWhlDstVldRaw.Val "MICROSAR RTE" /begin SUB_GROUP /end SUB_GROUP /begin FUNCTION_LIST /end FUNCTION_LIST /begin REF_CHARACTERISTIC /end REF_CHARACTERISTIC /begin REF_MEASUREMENT GmMsg0C5BusHiSpd.LeWhlDstVldRaw.Val /end REF_MEASUREMENT /end GROUP
/begin GROUP GmMsg0C5BusHiSpd.LeWhlRotlStsRstRaw.Val "MICROSAR RTE" /begin SUB_GROUP /end SUB_GROUP /begin FUNCTION_LIST /end FUNCTION_LIST /begin REF_CHARACTERISTIC /end REF_CHARACTERISTIC /begin REF_MEASUREMENT GmMsg0C5BusHiSpd.LeWhlRotlStsRstRaw.Val /end REF_MEASUREMENT /end GROUP
/begin GROUP GmMsg0C5BusHiSpd.LeWhlSeqNrRaw.Val "MICROSAR RTE" /begin SUB_GROUP /end SUB_GROUP /begin FUNCTION_LIST /end FUNCTION_LIST /begin REF_CHARACTERISTIC /end REF_CHARACTERISTIC /begin REF_MEASUREMENT GmMsg0C5BusHiSpd.LeWhlSeqNrRaw.Val /end REF_MEASUREMENT /end GROUP
/begin GROUP GmMsg0C5BusHiSpd.LstRxnTiMsg0C5BusHiSpd.Val "MICROSAR RTE" /begin SUB_GROUP /end SUB_GROUP /begin FUNCTION_LIST /end FUNCTION_LIST /begin REF_CHARACTERISTIC /end REF_CHARACTERISTIC /begin REF_MEASUREMENT GmMsg0C5BusHiSpd.LstRxnTiMsg0C5BusHiSpd.Val /end REF_MEASUREMENT /end GROUP
/begin GROUP GmMsg0C5BusHiSpd.PerInstanceMemories "MICROSAR RTE"
 /begin SUB_GROUP GmMsg0C5BusHiSpd.GmMsg0C5BusHiSpdLeInvldTmr GmMsg0C5BusHiSpd.GmMsg0C5BusHiSpdLeRstTmr GmMsg0C5BusHiSpd.GmMsg0C5BusHiSpdLeSeqNrTmr GmMsg0C5BusHiSpd.GmMsg0C5BusHiSpdPrevLeDstPlsCnt GmMsg0C5BusHiSpd.GmMsg0C5BusHiSpdPrevLeDstTiStamp GmMsg0C5BusHiSpd.GmMsg0C5BusHiSpdPrevLeSeqNr GmMsg0C5BusHiSpd.GmMsg0C5BusHiSpdPrevLeVld GmMsg0C5BusHiSpd.GmMsg0C5BusHiSpdPrevRiDstPlsCnt GmMsg0C5BusHiSpd.GmMsg0C5BusHiSpdPrevRiDstTiStamp GmMsg0C5BusHiSpd.GmMsg0C5BusHiSpdPrevRiSeqNr GmMsg0C5BusHiSpd.GmMsg0C5BusHiSpdPrevRiVld GmMsg0C5BusHiSpd.GmMsg0C5BusHiSpdPrevRxnTi GmMsg0C5BusHiSpd.GmMsg0C5BusHiSpdRiInvldTmr GmMsg0C5BusHiSpd.GmMsg0C5BusHiSpdRiRstTmr GmMsg0C5BusHiSpd.GmMsg0C5BusHiSpdRiSeqNrTmr GmMsg0C5BusHiSpd.GmMsg0C5BusHiSpdRollgCntrRst /end SUB_GROUP
 /begin FUNCTION_LIST /end FUNCTION_LIST
 /begin REF_CHARACTERISTIC /end REF_CHARACTERISTIC
 /begin REF_MEASUREMENT /end REF_MEASUREMENT
/end GROUP
/begin GROUP GmMsg0C5BusHiSpd.ReceiverPorts "MICROSAR RTE"
 /begin SUB_GROUP GmMsg0C5BusHiSpd.LeWhlDstPlsCntrRaw.Val GmMsg0C5BusHiSpd.LeWhlDstTiStampRaw.Val GmMsg0C5BusHiSpd.LeWhlDstVldRaw.Val GmMsg0C5BusHiSpd.LeWhlRotlStsRstRaw.Val GmMsg0C5BusHiSpd.LeWhlSeqNrRaw.Val GmMsg0C5BusHiSpd.LstRxnTiMsg0C5BusHiSpd.Val GmMsg0C5BusHiSpd.RiWhlDstPlsCntrRaw.Val GmMsg0C5BusHiSpd.RiWhlDstTiStampRaw.Val GmMsg0C5BusHiSpd.RiWhlDstVldRaw.Val GmMsg0C5BusHiSpd.RiWhlRotlStsRstRaw.Val GmMsg0C5BusHiSpd.RiWhlSeqNrRaw.Val /end SUB_GROUP
 /begin FUNCTION_LIST /end FUNCTION_LIST
 /begin REF_CHARACTERISTIC /end REF_CHARACTERISTIC
 /begin REF_MEASUREMENT /end REF_MEASUREMENT
/end GROUP
/begin GROUP GmMsg0C5BusHiSpd.RiWhlDstPlsCntr.Val "MICROSAR RTE" /begin SUB_GROUP /end SUB_GROUP /begin FUNCTION_LIST /end FUNCTION_LIST /begin REF_CHARACTERISTIC /end REF_CHARACTERISTIC /begin REF_MEASUREMENT GmMsg0C5BusHiSpd.RiWhlDstPlsCntr.Val /end REF_MEASUREMENT /end GROUP
/begin GROUP GmMsg0C5BusHiSpd.RiWhlDstPlsCntrRaw.Val "MICROSAR RTE" /begin SUB_GROUP /end SUB_GROUP /begin FUNCTION_LIST /end FUNCTION_LIST /begin REF_CHARACTERISTIC /end REF_CHARACTERISTIC /begin REF_MEASUREMENT GmMsg0C5BusHiSpd.RiWhlDstPlsCntrRaw.Val /end REF_MEASUREMENT /end GROUP
/begin GROUP GmMsg0C5BusHiSpd.RiWhlDstTiStamp.Val "MICROSAR RTE" /begin SUB_GROUP /end SUB_GROUP /begin FUNCTION_LIST /end FUNCTION_LIST /begin REF_CHARACTERISTIC /end REF_CHARACTERISTIC /begin REF_MEASUREMENT GmMsg0C5BusHiSpd.RiWhlDstTiStamp.Val /end REF_MEASUREMENT /end GROUP
/begin GROUP GmMsg0C5BusHiSpd.RiWhlDstTiStampRaw.Val "MICROSAR RTE" /begin SUB_GROUP /end SUB_GROUP /begin FUNCTION_LIST /end FUNCTION_LIST /begin REF_CHARACTERISTIC /end REF_CHARACTERISTIC /begin REF_MEASUREMENT GmMsg0C5BusHiSpd.RiWhlDstTiStampRaw.Val /end REF_MEASUREMENT /end GROUP
/begin GROUP GmMsg0C5BusHiSpd.RiWhlDstVld.Logl "MICROSAR RTE" /begin SUB_GROUP /end SUB_GROUP /begin FUNCTION_LIST /end FUNCTION_LIST /begin REF_CHARACTERISTIC /end REF_CHARACTERISTIC /begin REF_MEASUREMENT GmMsg0C5BusHiSpd.RiWhlDstVld.Logl /end REF_MEASUREMENT /end GROUP
/begin GROUP GmMsg0C5BusHiSpd.RiWhlDstVldRaw.Val "MICROSAR RTE" /begin SUB_GROUP /end SUB_GROUP /begin FUNCTION_LIST /end FUNCTION_LIST /begin REF_CHARACTERISTIC /end REF_CHARACTERISTIC /begin REF_MEASUREMENT GmMsg0C5BusHiSpd.RiWhlDstVldRaw.Val /end REF_MEASUREMENT /end GROUP
/begin GROUP GmMsg0C5BusHiSpd.RiWhlRotlStsRstRaw.Val "MICROSAR RTE" /begin SUB_GROUP /end SUB_GROUP /begin FUNCTION_LIST /end FUNCTION_LIST /begin REF_CHARACTERISTIC /end REF_CHARACTERISTIC /begin REF_MEASUREMENT GmMsg0C5BusHiSpd.RiWhlRotlStsRstRaw.Val /end REF_MEASUREMENT /end GROUP
/begin GROUP GmMsg0C5BusHiSpd.RiWhlSeqNrRaw.Val "MICROSAR RTE" /begin SUB_GROUP /end SUB_GROUP /begin FUNCTION_LIST /end FUNCTION_LIST /begin REF_CHARACTERISTIC /end REF_CHARACTERISTIC /begin REF_MEASUREMENT GmMsg0C5BusHiSpd.RiWhlSeqNrRaw.Val /end REF_MEASUREMENT /end GROUP
/begin GROUP GmMsg0C5BusHiSpd.SenderPorts "MICROSAR RTE"
 /begin SUB_GROUP GmMsg0C5BusHiSpd.LeWhlDstPlsCntr.Val GmMsg0C5BusHiSpd.LeWhlDstTiStamp.Val GmMsg0C5BusHiSpd.LeWhlDstVld.Logl GmMsg0C5BusHiSpd.RiWhlDstPlsCntr.Val GmMsg0C5BusHiSpd.RiWhlDstTiStamp.Val GmMsg0C5BusHiSpd.RiWhlDstVld.Logl /end SUB_GROUP
 /begin FUNCTION_LIST /end FUNCTION_LIST
 /begin REF_CHARACTERISTIC /end REF_CHARACTERISTIC
 /begin REF_MEASUREMENT /end REF_MEASUREMENT
/end GROUP
/begin GROUP GmMsg0C9BusHiSpd "MICROSAR RTE"
 /begin SUB_GROUP GmMsg0C9BusHiSpd.CalibrationPorts GmMsg0C9BusHiSpd.PerInstanceMemories GmMsg0C9BusHiSpd.ReceiverPorts GmMsg0C9BusHiSpd.SenderPorts /end SUB_GROUP
 /begin FUNCTION_LIST /end FUNCTION_LIST
 /begin REF_CHARACTERISTIC /end REF_CHARACTERISTIC
 /begin REF_MEASUREMENT /end REF_MEASUREMENT
/end GROUP
/begin GROUP GmMsg0C9BusHiSpd.CalibrationPorts "MICROSAR RTE"
 /begin SUB_GROUP GmMsg0C9BusHiSpd.GmMsg0C9BusHiSpdInvldTiOut.Val GmMsg0C9BusHiSpd.GmMsg0C9BusHiSpdMissTiOut.Val GmMsg0C9BusHiSpd.GmMsg0C9BusHiSpdVehSpdThd.Val /end SUB_GROUP
 /begin FUNCTION_LIST /end FUNCTION_LIST
 /begin REF_CHARACTERISTIC /end REF_CHARACTERISTIC
 /begin REF_MEASUREMENT /end REF_MEASUREMENT
/end GROUP
/begin GROUP GmMsg0C9BusHiSpd.EngRunActv.Logl "MICROSAR RTE" /begin SUB_GROUP /end SUB_GROUP /begin FUNCTION_LIST /end FUNCTION_LIST /begin REF_CHARACTERISTIC /end REF_CHARACTERISTIC /begin REF_MEASUREMENT GmMsg0C9BusHiSpd.EngRunActv.Logl /end REF_MEASUREMENT /end GROUP
/begin GROUP GmMsg0C9BusHiSpd.EngRunActvRaw.Val "MICROSAR RTE" /begin SUB_GROUP /end SUB_GROUP /begin FUNCTION_LIST /end FUNCTION_LIST /begin REF_CHARACTERISTIC /end REF_CHARACTERISTIC /begin REF_MEASUREMENT GmMsg0C9BusHiSpd.EngRunActvRaw.Val /end REF_MEASUREMENT /end GROUP
/begin GROUP GmMsg0C9BusHiSpd.EngSpd.Val "MICROSAR RTE" /begin SUB_GROUP /end SUB_GROUP /begin FUNCTION_LIST /end FUNCTION_LIST /begin REF_CHARACTERISTIC /end REF_CHARACTERISTIC /begin REF_MEASUREMENT GmMsg0C9BusHiSpd.EngSpd.Val /end REF_MEASUREMENT /end GROUP
/begin GROUP GmMsg0C9BusHiSpd.EngSpdRaw.Val "MICROSAR RTE" /begin SUB_GROUP /end SUB_GROUP /begin FUNCTION_LIST /end FUNCTION_LIST /begin REF_CHARACTERISTIC /end REF_CHARACTERISTIC /begin REF_MEASUREMENT GmMsg0C9BusHiSpd.EngSpdRaw.Val /end REF_MEASUREMENT /end GROUP
/begin GROUP GmMsg0C9BusHiSpd.EngSpdStsNorm.Logl "MICROSAR RTE" /begin SUB_GROUP /end SUB_GROUP /begin FUNCTION_LIST /end FUNCTION_LIST /begin REF_CHARACTERISTIC /end REF_CHARACTERISTIC /begin REF_MEASUREMENT GmMsg0C9BusHiSpd.EngSpdStsNorm.Logl /end REF_MEASUREMENT /end GROUP
/begin GROUP GmMsg0C9BusHiSpd.EngSpdStsRaw.Val "MICROSAR RTE" /begin SUB_GROUP /end SUB_GROUP /begin FUNCTION_LIST /end FUNCTION_LIST /begin REF_CHARACTERISTIC /end REF_CHARACTERISTIC /begin REF_MEASUREMENT GmMsg0C9BusHiSpd.EngSpdStsRaw.Val /end REF_MEASUREMENT /end GROUP
/begin GROUP GmMsg0C9BusHiSpd.GmMsg0C9BusHiSpdInvldMsgTmr "MICROSAR RTE" /begin SUB_GROUP /end SUB_GROUP /begin FUNCTION_LIST /end FUNCTION_LIST /begin REF_CHARACTERISTIC /end REF_CHARACTERISTIC /begin REF_MEASUREMENT GmMsg0C9BusHiSpd.GmMsg0C9BusHiSpdInvldMsgTmr /end REF_MEASUREMENT /end GROUP
/begin GROUP GmMsg0C9BusHiSpd.GmMsg0C9BusHiSpdInvldTiOut.Val "MICROSAR RTE" /begin SUB_GROUP /end SUB_GROUP /begin FUNCTION_LIST /end FUNCTION_LIST /begin REF_CHARACTERISTIC GmMsg0C9BusHiSpd.GmMsg0C9BusHiSpdInvldTiOut.Val /end REF_CHARACTERISTIC /begin REF_MEASUREMENT /end REF_MEASUREMENT /end GROUP
/begin GROUP GmMsg0C9BusHiSpd.GmMsg0C9BusHiSpdMissTiOut.Val "MICROSAR RTE" /begin SUB_GROUP /end SUB_GROUP /begin FUNCTION_LIST /end FUNCTION_LIST /begin REF_CHARACTERISTIC GmMsg0C9BusHiSpd.GmMsg0C9BusHiSpdMissTiOut.Val /end REF_CHARACTERISTIC /begin REF_MEASUREMENT /end REF_MEASUREMENT /end GROUP
/begin GROUP GmMsg0C9BusHiSpd.GmMsg0C9BusHiSpdPrevEndSpd "MICROSAR RTE" /begin SUB_GROUP /end SUB_GROUP /begin FUNCTION_LIST /end FUNCTION_LIST /begin REF_CHARACTERISTIC /end REF_CHARACTERISTIC /begin REF_MEASUREMENT GmMsg0C9BusHiSpd.GmMsg0C9BusHiSpdPrevEndSpd /end REF_MEASUREMENT /end GROUP
/begin GROUP GmMsg0C9BusHiSpd.GmMsg0C9BusHiSpdPrevEngRunActv "MICROSAR RTE" /begin SUB_GROUP /end SUB_GROUP /begin FUNCTION_LIST /end FUNCTION_LIST /begin REF_CHARACTERISTIC /end REF_CHARACTERISTIC /begin REF_MEASUREMENT GmMsg0C9BusHiSpd.GmMsg0C9BusHiSpdPrevEngRunActv /end REF_MEASUREMENT /end GROUP
/begin GROUP GmMsg0C9BusHiSpd.GmMsg0C9BusHiSpdVehSpdThd.Val "MICROSAR RTE" /begin SUB_GROUP /end SUB_GROUP /begin FUNCTION_LIST /end FUNCTION_LIST /begin REF_CHARACTERISTIC GmMsg0C9BusHiSpd.GmMsg0C9BusHiSpdVehSpdThd.Val /end REF_CHARACTERISTIC /begin REF_MEASUREMENT /end REF_MEASUREMENT /end GROUP
/begin GROUP GmMsg0C9BusHiSpd.InvldMsg0C9.Logl "MICROSAR RTE" /begin SUB_GROUP /end SUB_GROUP /begin FUNCTION_LIST /end FUNCTION_LIST /begin REF_CHARACTERISTIC /end REF_CHARACTERISTIC /begin REF_MEASUREMENT GmMsg0C9BusHiSpd.InvldMsg0C9.Logl /end REF_MEASUREMENT /end GROUP
/begin GROUP GmMsg0C9BusHiSpd.LstRxnTiMsg0C9.Val "MICROSAR RTE" /begin SUB_GROUP /end SUB_GROUP /begin FUNCTION_LIST /end FUNCTION_LIST /begin REF_CHARACTERISTIC /end REF_CHARACTERISTIC /begin REF_MEASUREMENT GmMsg0C9BusHiSpd.LstRxnTiMsg0C9.Val /end REF_MEASUREMENT /end GROUP
/begin GROUP GmMsg0C9BusHiSpd.MissMsg0C9.Logl "MICROSAR RTE" /begin SUB_GROUP /end SUB_GROUP /begin FUNCTION_LIST /end FUNCTION_LIST /begin REF_CHARACTERISTIC /end REF_CHARACTERISTIC /begin REF_MEASUREMENT GmMsg0C9BusHiSpd.MissMsg0C9.Logl /end REF_MEASUREMENT /end GROUP
/begin GROUP GmMsg0C9BusHiSpd.PerInstanceMemories "MICROSAR RTE"
 /begin SUB_GROUP GmMsg0C9BusHiSpd.GmMsg0C9BusHiSpdInvldMsgTmr GmMsg0C9BusHiSpd.GmMsg0C9BusHiSpdPrevEndSpd GmMsg0C9BusHiSpd.GmMsg0C9BusHiSpdPrevEngRunActv /end SUB_GROUP
 /begin FUNCTION_LIST /end FUNCTION_LIST
 /begin REF_CHARACTERISTIC /end REF_CHARACTERISTIC
 /begin REF_MEASUREMENT /end REF_MEASUREMENT
/end GROUP
/begin GROUP GmMsg0C9BusHiSpd.PtCrkActv.Logl "MICROSAR RTE" /begin SUB_GROUP /end SUB_GROUP /begin FUNCTION_LIST /end FUNCTION_LIST /begin REF_CHARACTERISTIC /end REF_CHARACTERISTIC /begin REF_MEASUREMENT GmMsg0C9BusHiSpd.PtCrkActv.Logl /end REF_MEASUREMENT /end GROUP
/begin GROUP GmMsg0C9BusHiSpd.PtCrkActvRaw.Val "MICROSAR RTE" /begin SUB_GROUP /end SUB_GROUP /begin FUNCTION_LIST /end FUNCTION_LIST /begin REF_CHARACTERISTIC /end REF_CHARACTERISTIC /begin REF_MEASUREMENT GmMsg0C9BusHiSpd.PtCrkActvRaw.Val /end REF_MEASUREMENT /end GROUP
/begin GROUP GmMsg0C9BusHiSpd.ReceiverPorts "MICROSAR RTE"
 /begin SUB_GROUP GmMsg0C9BusHiSpd.EngRunActvRaw.Val GmMsg0C9BusHiSpd.EngSpdRaw.Val GmMsg0C9BusHiSpd.EngSpdStsRaw.Val GmMsg0C9BusHiSpd.LstRxnTiMsg0C9.Val GmMsg0C9BusHiSpd.PtCrkActvRaw.Val GmMsg0C9BusHiSpd.VehSpd.Val GmMsg0C9BusHiSpd.VehSpdVld.Logl /end SUB_GROUP
 /begin FUNCTION_LIST /end FUNCTION_LIST
 /begin REF_CHARACTERISTIC /end REF_CHARACTERISTIC
 /begin REF_MEASUREMENT /end REF_MEASUREMENT
/end GROUP
/begin GROUP GmMsg0C9BusHiSpd.SenderPorts "MICROSAR RTE"
 /begin SUB_GROUP GmMsg0C9BusHiSpd.EngRunActv.Logl GmMsg0C9BusHiSpd.EngSpd.Val GmMsg0C9BusHiSpd.EngSpdStsNorm.Logl GmMsg0C9BusHiSpd.InvldMsg0C9.Logl GmMsg0C9BusHiSpd.MissMsg0C9.Logl GmMsg0C9BusHiSpd.PtCrkActv.Logl /end SUB_GROUP
 /begin FUNCTION_LIST /end FUNCTION_LIST
 /begin REF_CHARACTERISTIC /end REF_CHARACTERISTIC
 /begin REF_MEASUREMENT /end REF_MEASUREMENT
/end GROUP
/begin GROUP GmMsg0C9BusHiSpd.VehSpd.Val "MICROSAR RTE" /begin SUB_GROUP /end SUB_GROUP /begin FUNCTION_LIST /end FUNCTION_LIST /begin REF_CHARACTERISTIC /end REF_CHARACTERISTIC /begin REF_MEASUREMENT GmMsg0C9BusHiSpd.VehSpd.Val /end REF_MEASUREMENT /end GROUP
/begin GROUP GmMsg0C9BusHiSpd.VehSpdVld.Logl "MICROSAR RTE" /begin SUB_GROUP /end SUB_GROUP /begin FUNCTION_LIST /end FUNCTION_LIST /begin REF_CHARACTERISTIC /end REF_CHARACTERISTIC /begin REF_MEASUREMENT GmMsg0C9BusHiSpd.VehSpdVld.Logl /end REF_MEASUREMENT /end GROUP
/begin GROUP GmMsg148BusHiSpd "MICROSAR RTE"
 /begin SUB_GROUP GmMsg148BusHiSpd.ReceiverPorts GmMsg148BusHiSpd.SenderPorts /end SUB_GROUP
 /begin FUNCTION_LIST /end FUNCTION_LIST
 /begin REF_CHARACTERISTIC /end REF_CHARACTERISTIC
 /begin REF_MEASUREMENT /end REF_MEASUREMENT
/end GROUP
/begin GROUP GmMsg148BusHiSpd.PwrSteerIndcr.Val "MICROSAR RTE" /begin SUB_GROUP /end SUB_GROUP /begin FUNCTION_LIST /end FUNCTION_LIST /begin REF_CHARACTERISTIC /end REF_CHARACTERISTIC /begin REF_MEASUREMENT GmMsg148BusHiSpd.PwrSteerIndcr.Val /end REF_MEASUREMENT /end GROUP
/begin GROUP GmMsg148BusHiSpd.ReceiverPorts "MICROSAR RTE" /begin SUB_GROUP GmMsg148BusHiSpd.SysSt.Val /end SUB_GROUP /begin FUNCTION_LIST /end FUNCTION_LIST /begin REF_CHARACTERISTIC /end REF_CHARACTERISTIC /begin REF_MEASUREMENT /end REF_MEASUREMENT /end GROUP
/begin GROUP GmMsg148BusHiSpd.SenderPorts "MICROSAR RTE"
 /begin SUB_GROUP GmMsg148BusHiSpd.PwrSteerIndcr.Val GmMsg148BusHiSpd.SteerAssiLimd.Val GmMsg148BusHiSpd.SteerAssiLimdLvl2.Val GmMsg148BusHiSpd.SteerAssiLimdLvl3.Val /end SUB_GROUP
 /begin FUNCTION_LIST /end FUNCTION_LIST
 /begin REF_CHARACTERISTIC /end REF_CHARACTERISTIC
 /begin REF_MEASUREMENT /end REF_MEASUREMENT
/end GROUP
/begin GROUP GmMsg148BusHiSpd.SteerAssiLimd.Val "MICROSAR RTE" /begin SUB_GROUP /end SUB_GROUP /begin FUNCTION_LIST /end FUNCTION_LIST /begin REF_CHARACTERISTIC /end REF_CHARACTERISTIC /begin REF_MEASUREMENT GmMsg148BusHiSpd.SteerAssiLimd.Val /end REF_MEASUREMENT /end GROUP
/begin GROUP GmMsg148BusHiSpd.SteerAssiLimdLvl2.Val "MICROSAR RTE" /begin SUB_GROUP /end SUB_GROUP /begin FUNCTION_LIST /end FUNCTION_LIST /begin REF_CHARACTERISTIC /end REF_CHARACTERISTIC /begin REF_MEASUREMENT GmMsg148BusHiSpd.SteerAssiLimdLvl2.Val /end REF_MEASUREMENT /end GROUP
/begin GROUP GmMsg148BusHiSpd.SteerAssiLimdLvl3.Val "MICROSAR RTE" /begin SUB_GROUP /end SUB_GROUP /begin FUNCTION_LIST /end FUNCTION_LIST /begin REF_CHARACTERISTIC /end REF_CHARACTERISTIC /begin REF_MEASUREMENT GmMsg148BusHiSpd.SteerAssiLimdLvl3.Val /end REF_MEASUREMENT /end GROUP
/begin GROUP GmMsg148BusHiSpd.SysSt.Val "MICROSAR RTE" /begin SUB_GROUP /end SUB_GROUP /begin FUNCTION_LIST /end FUNCTION_LIST /begin REF_CHARACTERISTIC /end REF_CHARACTERISTIC /begin REF_MEASUREMENT GmMsg148BusHiSpd.SysSt.Val /end REF_MEASUREMENT /end GROUP
/begin GROUP GmMsg17DBusHiSpd "MICROSAR RTE"
 /begin SUB_GROUP GmMsg17DBusHiSpd.CalibrationPorts GmMsg17DBusHiSpd.PerInstanceMemories GmMsg17DBusHiSpd.ReceiverPorts GmMsg17DBusHiSpd.SenderPorts /end SUB_GROUP
 /begin FUNCTION_LIST /end FUNCTION_LIST
 /begin REF_CHARACTERISTIC /end REF_CHARACTERISTIC
 /begin REF_MEASUREMENT /end REF_MEASUREMENT
/end GROUP
/begin GROUP GmMsg17DBusHiSpd.CalibrationPorts "MICROSAR RTE"
 /begin SUB_GROUP GmMsg17DBusHiSpd.GmMsg17DBusHiSpdInvldTiOut.Val GmMsg17DBusHiSpd.GmMsg17DBusHiSpdMissTiOut.Val /end SUB_GROUP
 /begin FUNCTION_LIST /end FUNCTION_LIST
 /begin REF_CHARACTERISTIC /end REF_CHARACTERISTIC
 /begin REF_MEASUREMENT /end REF_MEASUREMENT
/end GROUP
/begin GROUP GmMsg17DBusHiSpd.GmMsg17DBusHiSpdInvldMsgTmr "MICROSAR RTE" /begin SUB_GROUP /end SUB_GROUP /begin FUNCTION_LIST /end FUNCTION_LIST /begin REF_CHARACTERISTIC /end REF_CHARACTERISTIC /begin REF_MEASUREMENT GmMsg17DBusHiSpd.GmMsg17DBusHiSpdInvldMsgTmr /end REF_MEASUREMENT /end GROUP
/begin GROUP GmMsg17DBusHiSpd.GmMsg17DBusHiSpdInvldTiOut.Val "MICROSAR RTE" /begin SUB_GROUP /end SUB_GROUP /begin FUNCTION_LIST /end FUNCTION_LIST /begin REF_CHARACTERISTIC GmMsg17DBusHiSpd.GmMsg17DBusHiSpdInvldTiOut.Val /end REF_CHARACTERISTIC /begin REF_MEASUREMENT /end REF_MEASUREMENT /end GROUP
/begin GROUP GmMsg17DBusHiSpd.GmMsg17DBusHiSpdMissTiOut.Val "MICROSAR RTE" /begin SUB_GROUP /end SUB_GROUP /begin FUNCTION_LIST /end FUNCTION_LIST /begin REF_CHARACTERISTIC GmMsg17DBusHiSpd.GmMsg17DBusHiSpdMissTiOut.Val /end REF_CHARACTERISTIC /begin REF_MEASUREMENT /end REF_MEASUREMENT /end GROUP
/begin GROUP GmMsg17DBusHiSpd.InvldMsg17D.Logl "MICROSAR RTE" /begin SUB_GROUP /end SUB_GROUP /begin FUNCTION_LIST /end FUNCTION_LIST /begin REF_CHARACTERISTIC /end REF_CHARACTERISTIC /begin REF_MEASUREMENT GmMsg17DBusHiSpd.InvldMsg17D.Logl /end REF_MEASUREMENT /end GROUP
/begin GROUP GmMsg17DBusHiSpd.LstRxnTiMsg17D.Val "MICROSAR RTE" /begin SUB_GROUP /end SUB_GROUP /begin FUNCTION_LIST /end FUNCTION_LIST /begin REF_CHARACTERISTIC /end REF_CHARACTERISTIC /begin REF_MEASUREMENT GmMsg17DBusHiSpd.LstRxnTiMsg17D.Val /end REF_MEASUREMENT /end GROUP
/begin GROUP GmMsg17DBusHiSpd.MissMsg17D.Logl "MICROSAR RTE" /begin SUB_GROUP /end SUB_GROUP /begin FUNCTION_LIST /end FUNCTION_LIST /begin REF_CHARACTERISTIC /end REF_CHARACTERISTIC /begin REF_MEASUREMENT GmMsg17DBusHiSpd.MissMsg17D.Logl /end REF_MEASUREMENT /end GROUP
/begin GROUP GmMsg17DBusHiSpd.PerInstanceMemories "MICROSAR RTE" /begin SUB_GROUP GmMsg17DBusHiSpd.GmMsg17DBusHiSpdInvldMsgTmr /end SUB_GROUP /begin FUNCTION_LIST /end FUNCTION_LIST /begin REF_CHARACTERISTIC /end REF_CHARACTERISTIC /begin REF_MEASUREMENT /end REF_MEASUREMENT /end GROUP
/begin GROUP GmMsg17DBusHiSpd.ReceiverPorts "MICROSAR RTE"
 /begin SUB_GROUP GmMsg17DBusHiSpd.LstRxnTiMsg17D.Val GmMsg17DBusHiSpd.VehStabyEnhmtStsRaw.Val /end SUB_GROUP
 /begin FUNCTION_LIST /end FUNCTION_LIST
 /begin REF_CHARACTERISTIC /end REF_CHARACTERISTIC
 /begin REF_MEASUREMENT /end REF_MEASUREMENT
/end GROUP
/begin GROUP GmMsg17DBusHiSpd.SenderPorts "MICROSAR RTE"
 /begin SUB_GROUP GmMsg17DBusHiSpd.InvldMsg17D.Logl GmMsg17DBusHiSpd.MissMsg17D.Logl /end SUB_GROUP
 /begin FUNCTION_LIST /end FUNCTION_LIST
 /begin REF_CHARACTERISTIC /end REF_CHARACTERISTIC
 /begin REF_MEASUREMENT /end REF_MEASUREMENT
/end GROUP
/begin GROUP GmMsg17DBusHiSpd.VehStabyEnhmtStsRaw.Val "MICROSAR RTE" /begin SUB_GROUP /end SUB_GROUP /begin FUNCTION_LIST /end FUNCTION_LIST /begin REF_CHARACTERISTIC /end REF_CHARACTERISTIC /begin REF_MEASUREMENT GmMsg17DBusHiSpd.VehStabyEnhmtStsRaw.Val /end REF_MEASUREMENT /end GROUP
/begin GROUP GmMsg180BusChassisExp "MICROSAR RTE"
 /begin SUB_GROUP GmMsg180BusChassisExp.CalibrationPorts GmMsg180BusChassisExp.PerInstanceMemories GmMsg180BusChassisExp.ReceiverPorts GmMsg180BusChassisExp.SenderPorts /end SUB_GROUP
 /begin FUNCTION_LIST /end FUNCTION_LIST
 /begin REF_CHARACTERISTIC /end REF_CHARACTERISTIC
 /begin REF_MEASUREMENT /end REF_MEASUREMENT
/end GROUP
/begin GROUP GmMsg180BusChassisExp.CalibrationPorts "MICROSAR RTE"
 /begin SUB_GROUP GmMsg180BusChassisExp.GmMsg180BusChassisExpInvldProtnValTiOut.Val GmMsg180BusChassisExp.GmMsg180BusChassisExpMissTiOut.Val GmMsg180BusChassisExp.GmMsg180BusChassisExpRollgCntrInvldTiOut.Val GmMsg180BusChassisExp.GmMsg180BusChassisExpTqPolarity.Val /end SUB_GROUP
 /begin FUNCTION_LIST /end FUNCTION_LIST
 /begin REF_CHARACTERISTIC /end REF_CHARACTERISTIC
 /begin REF_MEASUREMENT /end REF_MEASUREMENT
/end GROUP
/begin GROUP GmMsg180BusChassisExp.EscCmd.Val "MICROSAR RTE" /begin SUB_GROUP /end SUB_GROUP /begin FUNCTION_LIST /end FUNCTION_LIST /begin REF_CHARACTERISTIC /end REF_CHARACTERISTIC /begin REF_MEASUREMENT GmMsg180BusChassisExp.EscCmd.Val /end REF_MEASUREMENT /end GROUP
/begin GROUP GmMsg180BusChassisExp.EscReqActv.Logl "MICROSAR RTE" /begin SUB_GROUP /end SUB_GROUP /begin FUNCTION_LIST /end FUNCTION_LIST /begin REF_CHARACTERISTIC /end REF_CHARACTERISTIC /begin REF_MEASUREMENT GmMsg180BusChassisExp.EscReqActv.Logl /end REF_MEASUREMENT /end GROUP
/begin GROUP GmMsg180BusChassisExp.GmMsg180BusChassisExpInvldProtnValTiOut.Val "MICROSAR RTE" /begin SUB_GROUP /end SUB_GROUP /begin FUNCTION_LIST /end FUNCTION_LIST
 /begin REF_CHARACTERISTIC GmMsg180BusChassisExp.GmMsg180BusChassisExpInvldProtnValTiOut.Val /end REF_CHARACTERISTIC
 /begin REF_MEASUREMENT /end REF_MEASUREMENT
/end GROUP
/begin GROUP GmMsg180BusChassisExp.GmMsg180BusChassisExpInvldProtnValTmr "MICROSAR RTE" /begin SUB_GROUP /end SUB_GROUP /begin FUNCTION_LIST /end FUNCTION_LIST /begin REF_CHARACTERISTIC /end REF_CHARACTERISTIC
 /begin REF_MEASUREMENT GmMsg180BusChassisExp.GmMsg180BusChassisExpInvldProtnValTmr /end REF_MEASUREMENT
/end GROUP
/begin GROUP GmMsg180BusChassisExp.GmMsg180BusChassisExpInvldRollgCntrTmr "MICROSAR RTE" /begin SUB_GROUP /end SUB_GROUP /begin FUNCTION_LIST /end FUNCTION_LIST /begin REF_CHARACTERISTIC /end REF_CHARACTERISTIC
 /begin REF_MEASUREMENT GmMsg180BusChassisExp.GmMsg180BusChassisExpInvldRollgCntrTmr /end REF_MEASUREMENT
/end GROUP
/begin GROUP GmMsg180BusChassisExp.GmMsg180BusChassisExpMissTiOut.Val "MICROSAR RTE" /begin SUB_GROUP /end SUB_GROUP /begin FUNCTION_LIST /end FUNCTION_LIST /begin REF_CHARACTERISTIC GmMsg180BusChassisExp.GmMsg180BusChassisExpMissTiOut.Val /end REF_CHARACTERISTIC /begin REF_MEASUREMENT /end REF_MEASUREMENT /end GROUP
/begin GROUP GmMsg180BusChassisExp.GmMsg180BusChassisExpPrevEscCmd "MICROSAR RTE" /begin SUB_GROUP /end SUB_GROUP /begin FUNCTION_LIST /end FUNCTION_LIST /begin REF_CHARACTERISTIC /end REF_CHARACTERISTIC /begin REF_MEASUREMENT GmMsg180BusChassisExp.GmMsg180BusChassisExpPrevEscCmd /end REF_MEASUREMENT /end GROUP
/begin GROUP GmMsg180BusChassisExp.GmMsg180BusChassisExpPrevEscCmdActv "MICROSAR RTE" /begin SUB_GROUP /end SUB_GROUP /begin FUNCTION_LIST /end FUNCTION_LIST /begin REF_CHARACTERISTIC /end REF_CHARACTERISTIC /begin REF_MEASUREMENT GmMsg180BusChassisExp.GmMsg180BusChassisExpPrevEscCmdActv /end REF_MEASUREMENT /end GROUP
/begin GROUP GmMsg180BusChassisExp.GmMsg180BusChassisExpPrevInvld "MICROSAR RTE" /begin SUB_GROUP /end SUB_GROUP /begin FUNCTION_LIST /end FUNCTION_LIST /begin REF_CHARACTERISTIC /end REF_CHARACTERISTIC /begin REF_MEASUREMENT GmMsg180BusChassisExp.GmMsg180BusChassisExpPrevInvld /end REF_MEASUREMENT /end GROUP
/begin GROUP GmMsg180BusChassisExp.GmMsg180BusChassisExpPrevRollgCntrVal "MICROSAR RTE" /begin SUB_GROUP /end SUB_GROUP /begin FUNCTION_LIST /end FUNCTION_LIST /begin REF_CHARACTERISTIC /end REF_CHARACTERISTIC
 /begin REF_MEASUREMENT GmMsg180BusChassisExp.GmMsg180BusChassisExpPrevRollgCntrVal /end REF_MEASUREMENT
/end GROUP
/begin GROUP GmMsg180BusChassisExp.GmMsg180BusChassisExpPrevRxnTi "MICROSAR RTE" /begin SUB_GROUP /end SUB_GROUP /begin FUNCTION_LIST /end FUNCTION_LIST /begin REF_CHARACTERISTIC /end REF_CHARACTERISTIC /begin REF_MEASUREMENT GmMsg180BusChassisExp.GmMsg180BusChassisExpPrevRxnTi /end REF_MEASUREMENT /end GROUP
/begin GROUP GmMsg180BusChassisExp.GmMsg180BusChassisExpRollgCntrInvldTiOut.Val "MICROSAR RTE" /begin SUB_GROUP /end SUB_GROUP /begin FUNCTION_LIST /end FUNCTION_LIST
 /begin REF_CHARACTERISTIC GmMsg180BusChassisExp.GmMsg180BusChassisExpRollgCntrInvldTiOut.Val /end REF_CHARACTERISTIC
 /begin REF_MEASUREMENT /end REF_MEASUREMENT
/end GROUP
/begin GROUP GmMsg180BusChassisExp.GmMsg180BusChassisExpRollgCntrRst "MICROSAR RTE" /begin SUB_GROUP /end SUB_GROUP /begin FUNCTION_LIST /end FUNCTION_LIST /begin REF_CHARACTERISTIC /end REF_CHARACTERISTIC /begin REF_MEASUREMENT GmMsg180BusChassisExp.GmMsg180BusChassisExpRollgCntrRst /end REF_MEASUREMENT /end GROUP
/begin GROUP GmMsg180BusChassisExp.GmMsg180BusChassisExpTqPolarity.Val "MICROSAR RTE" /begin SUB_GROUP /end SUB_GROUP /begin FUNCTION_LIST /end FUNCTION_LIST /begin REF_CHARACTERISTIC GmMsg180BusChassisExp.GmMsg180BusChassisExpTqPolarity.Val /end REF_CHARACTERISTIC /begin REF_MEASUREMENT /end REF_MEASUREMENT /end GROUP
/begin GROUP GmMsg180BusChassisExp.InvldMsg180BusChassisExp.Logl "MICROSAR RTE" /begin SUB_GROUP /end SUB_GROUP /begin FUNCTION_LIST /end FUNCTION_LIST /begin REF_CHARACTERISTIC /end REF_CHARACTERISTIC /begin REF_MEASUREMENT GmMsg180BusChassisExp.InvldMsg180BusChassisExp.Logl /end REF_MEASUREMENT /end GROUP
/begin GROUP GmMsg180BusChassisExp.LstRxnTiMsg180BusChassisExp.Val "MICROSAR RTE" /begin SUB_GROUP /end SUB_GROUP /begin FUNCTION_LIST /end FUNCTION_LIST /begin REF_CHARACTERISTIC /end REF_CHARACTERISTIC /begin REF_MEASUREMENT GmMsg180BusChassisExp.LstRxnTiMsg180BusChassisExp.Val /end REF_MEASUREMENT /end GROUP
/begin GROUP GmMsg180BusChassisExp.MissMsg180BusChassisExp.Logl "MICROSAR RTE" /begin SUB_GROUP /end SUB_GROUP /begin FUNCTION_LIST /end FUNCTION_LIST /begin REF_CHARACTERISTIC /end REF_CHARACTERISTIC /begin REF_MEASUREMENT GmMsg180BusChassisExp.MissMsg180BusChassisExp.Logl /end REF_MEASUREMENT /end GROUP
/begin GROUP GmMsg180BusChassisExp.PerInstanceMemories "MICROSAR RTE"
 /begin SUB_GROUP GmMsg180BusChassisExp.GmMsg180BusChassisExpInvldProtnValTmr GmMsg180BusChassisExp.GmMsg180BusChassisExpInvldRollgCntrTmr GmMsg180BusChassisExp.GmMsg180BusChassisExpPrevEscCmd GmMsg180BusChassisExp.GmMsg180BusChassisExpPrevEscCmdActv GmMsg180BusChassisExp.GmMsg180BusChassisExpPrevInvld GmMsg180BusChassisExp.GmMsg180BusChassisExpPrevRollgCntrVal GmMsg180BusChassisExp.GmMsg180BusChassisExpPrevRxnTi GmMsg180BusChassisExp.GmMsg180BusChassisExpRollgCntrRst /end SUB_GROUP
 /begin FUNCTION_LIST /end FUNCTION_LIST
 /begin REF_CHARACTERISTIC /end REF_CHARACTERISTIC
 /begin REF_MEASUREMENT /end REF_MEASUREMENT
/end GROUP
/begin GROUP GmMsg180BusChassisExp.ReceiverPorts "MICROSAR RTE"
 /begin SUB_GROUP GmMsg180BusChassisExp.LstRxnTiMsg180BusChassisExp.Val GmMsg180BusChassisExp.TqOvrlAlvRollgCntrRaw.Val GmMsg180BusChassisExp.TqOvrlCmdChksRaw.Val GmMsg180BusChassisExp.TqOvrlDeltaTqCmdActvRaw.Val GmMsg180BusChassisExp.TqOvrlDeltaTqCmdValRaw.Val /end SUB_GROUP
 /begin FUNCTION_LIST /end FUNCTION_LIST
 /begin REF_CHARACTERISTIC /end REF_CHARACTERISTIC
 /begin REF_MEASUREMENT /end REF_MEASUREMENT
/end GROUP
/begin GROUP GmMsg180BusChassisExp.SenderPorts "MICROSAR RTE"
 /begin SUB_GROUP GmMsg180BusChassisExp.EscCmd.Val GmMsg180BusChassisExp.EscReqActv.Logl GmMsg180BusChassisExp.InvldMsg180BusChassisExp.Logl GmMsg180BusChassisExp.MissMsg180BusChassisExp.Logl /end SUB_GROUP
 /begin FUNCTION_LIST /end FUNCTION_LIST
 /begin REF_CHARACTERISTIC /end REF_CHARACTERISTIC
 /begin REF_MEASUREMENT /end REF_MEASUREMENT
/end GROUP
/begin GROUP GmMsg180BusChassisExp.TqOvrlAlvRollgCntrRaw.Val "MICROSAR RTE" /begin SUB_GROUP /end SUB_GROUP /begin FUNCTION_LIST /end FUNCTION_LIST /begin REF_CHARACTERISTIC /end REF_CHARACTERISTIC /begin REF_MEASUREMENT GmMsg180BusChassisExp.TqOvrlAlvRollgCntrRaw.Val /end REF_MEASUREMENT /end GROUP
/begin GROUP GmMsg180BusChassisExp.TqOvrlCmdChksRaw.Val "MICROSAR RTE" /begin SUB_GROUP /end SUB_GROUP /begin FUNCTION_LIST /end FUNCTION_LIST /begin REF_CHARACTERISTIC /end REF_CHARACTERISTIC /begin REF_MEASUREMENT GmMsg180BusChassisExp.TqOvrlCmdChksRaw.Val /end REF_MEASUREMENT /end GROUP
/begin GROUP GmMsg180BusChassisExp.TqOvrlDeltaTqCmdActvRaw.Val "MICROSAR RTE" /begin SUB_GROUP /end SUB_GROUP /begin FUNCTION_LIST /end FUNCTION_LIST /begin REF_CHARACTERISTIC /end REF_CHARACTERISTIC /begin REF_MEASUREMENT GmMsg180BusChassisExp.TqOvrlDeltaTqCmdActvRaw.Val /end REF_MEASUREMENT /end GROUP
/begin GROUP GmMsg180BusChassisExp.TqOvrlDeltaTqCmdValRaw.Val "MICROSAR RTE" /begin SUB_GROUP /end SUB_GROUP /begin FUNCTION_LIST /end FUNCTION_LIST /begin REF_CHARACTERISTIC /end REF_CHARACTERISTIC /begin REF_MEASUREMENT GmMsg180BusChassisExp.TqOvrlDeltaTqCmdValRaw.Val /end REF_MEASUREMENT /end GROUP
/begin GROUP GmMsg180BusHiSpd "MICROSAR RTE"
 /begin SUB_GROUP GmMsg180BusHiSpd.CalibrationPorts GmMsg180BusHiSpd.PerInstanceMemories GmMsg180BusHiSpd.ReceiverPorts GmMsg180BusHiSpd.SenderPorts /end SUB_GROUP
 /begin FUNCTION_LIST /end FUNCTION_LIST
 /begin REF_CHARACTERISTIC /end REF_CHARACTERISTIC
 /begin REF_MEASUREMENT /end REF_MEASUREMENT
/end GROUP
/begin GROUP GmMsg180BusHiSpd.CalibrationPorts "MICROSAR RTE"
 /begin SUB_GROUP GmMsg180BusHiSpd.GmMsg180BusHiSpdCrcInvldTiOut.Val GmMsg180BusHiSpd.GmMsg180BusHiSpdMissTiOut.Val GmMsg180BusHiSpd.GmMsg180BusHiSpdRollgCntrInvldTiOut.Val GmMsg180BusHiSpd.GmMsg180BusHiSpdTqPolarity.Val /end SUB_GROUP
 /begin FUNCTION_LIST /end FUNCTION_LIST
 /begin REF_CHARACTERISTIC /end REF_CHARACTERISTIC
 /begin REF_MEASUREMENT /end REF_MEASUREMENT
/end GROUP
/begin GROUP GmMsg180BusHiSpd.GmMsg180BusHiSpdCrcInvldTiOut.Val "MICROSAR RTE" /begin SUB_GROUP /end SUB_GROUP /begin FUNCTION_LIST /end FUNCTION_LIST /begin REF_CHARACTERISTIC GmMsg180BusHiSpd.GmMsg180BusHiSpdCrcInvldTiOut.Val /end REF_CHARACTERISTIC /begin REF_MEASUREMENT /end REF_MEASUREMENT /end GROUP
/begin GROUP GmMsg180BusHiSpd.GmMsg180BusHiSpdInvldCrcTmr "MICROSAR RTE" /begin SUB_GROUP /end SUB_GROUP /begin FUNCTION_LIST /end FUNCTION_LIST /begin REF_CHARACTERISTIC /end REF_CHARACTERISTIC /begin REF_MEASUREMENT GmMsg180BusHiSpd.GmMsg180BusHiSpdInvldCrcTmr /end REF_MEASUREMENT /end GROUP
/begin GROUP GmMsg180BusHiSpd.GmMsg180BusHiSpdInvldRollgCntrTmr "MICROSAR RTE" /begin SUB_GROUP /end SUB_GROUP /begin FUNCTION_LIST /end FUNCTION_LIST /begin REF_CHARACTERISTIC /end REF_CHARACTERISTIC /begin REF_MEASUREMENT GmMsg180BusHiSpd.GmMsg180BusHiSpdInvldRollgCntrTmr /end REF_MEASUREMENT /end GROUP
/begin GROUP GmMsg180BusHiSpd.GmMsg180BusHiSpdMissTiOut.Val "MICROSAR RTE" /begin SUB_GROUP /end SUB_GROUP /begin FUNCTION_LIST /end FUNCTION_LIST /begin REF_CHARACTERISTIC GmMsg180BusHiSpd.GmMsg180BusHiSpdMissTiOut.Val /end REF_CHARACTERISTIC /begin REF_MEASUREMENT /end REF_MEASUREMENT /end GROUP
/begin GROUP GmMsg180BusHiSpd.GmMsg180BusHiSpdPrevInvld "MICROSAR RTE" /begin SUB_GROUP /end SUB_GROUP /begin FUNCTION_LIST /end FUNCTION_LIST /begin REF_CHARACTERISTIC /end REF_CHARACTERISTIC /begin REF_MEASUREMENT GmMsg180BusHiSpd.GmMsg180BusHiSpdPrevInvld /end REF_MEASUREMENT /end GROUP
/begin GROUP GmMsg180BusHiSpd.GmMsg180BusHiSpdPrevRollgCntrVal "MICROSAR RTE" /begin SUB_GROUP /end SUB_GROUP /begin FUNCTION_LIST /end FUNCTION_LIST /begin REF_CHARACTERISTIC /end REF_CHARACTERISTIC /begin REF_MEASUREMENT GmMsg180BusHiSpd.GmMsg180BusHiSpdPrevRollgCntrVal /end REF_MEASUREMENT /end GROUP
/begin GROUP GmMsg180BusHiSpd.GmMsg180BusHiSpdPrevRxnTi "MICROSAR RTE" /begin SUB_GROUP /end SUB_GROUP /begin FUNCTION_LIST /end FUNCTION_LIST /begin REF_CHARACTERISTIC /end REF_CHARACTERISTIC /begin REF_MEASUREMENT GmMsg180BusHiSpd.GmMsg180BusHiSpdPrevRxnTi /end REF_MEASUREMENT /end GROUP
/begin GROUP GmMsg180BusHiSpd.GmMsg180BusHiSpdPrevTqCmd "MICROSAR RTE" /begin SUB_GROUP /end SUB_GROUP /begin FUNCTION_LIST /end FUNCTION_LIST /begin REF_CHARACTERISTIC /end REF_CHARACTERISTIC /begin REF_MEASUREMENT GmMsg180BusHiSpd.GmMsg180BusHiSpdPrevTqCmd /end REF_MEASUREMENT /end GROUP
/begin GROUP GmMsg180BusHiSpd.GmMsg180BusHiSpdPrevTqReq "MICROSAR RTE" /begin SUB_GROUP /end SUB_GROUP /begin FUNCTION_LIST /end FUNCTION_LIST /begin REF_CHARACTERISTIC /end REF_CHARACTERISTIC /begin REF_MEASUREMENT GmMsg180BusHiSpd.GmMsg180BusHiSpdPrevTqReq /end REF_MEASUREMENT /end GROUP
/begin GROUP GmMsg180BusHiSpd.GmMsg180BusHiSpdRollgCntrInvldTiOut.Val "MICROSAR RTE" /begin SUB_GROUP /end SUB_GROUP /begin FUNCTION_LIST /end FUNCTION_LIST /begin REF_CHARACTERISTIC GmMsg180BusHiSpd.GmMsg180BusHiSpdRollgCntrInvldTiOut.Val /end REF_CHARACTERISTIC /begin REF_MEASUREMENT /end REF_MEASUREMENT /end GROUP
/begin GROUP GmMsg180BusHiSpd.GmMsg180BusHiSpdRollgCntrRst "MICROSAR RTE" /begin SUB_GROUP /end SUB_GROUP /begin FUNCTION_LIST /end FUNCTION_LIST /begin REF_CHARACTERISTIC /end REF_CHARACTERISTIC /begin REF_MEASUREMENT GmMsg180BusHiSpd.GmMsg180BusHiSpdRollgCntrRst /end REF_MEASUREMENT /end GROUP
/begin GROUP GmMsg180BusHiSpd.GmMsg180BusHiSpdTqPolarity.Val "MICROSAR RTE" /begin SUB_GROUP /end SUB_GROUP /begin FUNCTION_LIST /end FUNCTION_LIST /begin REF_CHARACTERISTIC GmMsg180BusHiSpd.GmMsg180BusHiSpdTqPolarity.Val /end REF_CHARACTERISTIC /begin REF_MEASUREMENT /end REF_MEASUREMENT /end GROUP
/begin GROUP GmMsg180BusHiSpd.InvldMsg180BusHiSpd.Logl "MICROSAR RTE" /begin SUB_GROUP /end SUB_GROUP /begin FUNCTION_LIST /end FUNCTION_LIST /begin REF_CHARACTERISTIC /end REF_CHARACTERISTIC /begin REF_MEASUREMENT GmMsg180BusHiSpd.InvldMsg180BusHiSpd.Logl /end REF_MEASUREMENT /end GROUP
/begin GROUP GmMsg180BusHiSpd.LkaCmd.Val "MICROSAR RTE" /begin SUB_GROUP /end SUB_GROUP /begin FUNCTION_LIST /end FUNCTION_LIST /begin REF_CHARACTERISTIC /end REF_CHARACTERISTIC /begin REF_MEASUREMENT GmMsg180BusHiSpd.LkaCmd.Val /end REF_MEASUREMENT /end GROUP
/begin GROUP GmMsg180BusHiSpd.LkaCmdProtnValRaw.Val "MICROSAR RTE" /begin SUB_GROUP /end SUB_GROUP /begin FUNCTION_LIST /end FUNCTION_LIST /begin REF_CHARACTERISTIC /end REF_CHARACTERISTIC /begin REF_MEASUREMENT GmMsg180BusHiSpd.LkaCmdProtnValRaw.Val /end REF_MEASUREMENT /end GROUP
/begin GROUP GmMsg180BusHiSpd.LkaCmdRollgCntrRaw.Val "MICROSAR RTE" /begin SUB_GROUP /end SUB_GROUP /begin FUNCTION_LIST /end FUNCTION_LIST /begin REF_CHARACTERISTIC /end REF_CHARACTERISTIC /begin REF_MEASUREMENT GmMsg180BusHiSpd.LkaCmdRollgCntrRaw.Val /end REF_MEASUREMENT /end GROUP
/begin GROUP GmMsg180BusHiSpd.LkaCmdTqReqActvRaw.Val "MICROSAR RTE" /begin SUB_GROUP /end SUB_GROUP /begin FUNCTION_LIST /end FUNCTION_LIST /begin REF_CHARACTERISTIC /end REF_CHARACTERISTIC /begin REF_MEASUREMENT GmMsg180BusHiSpd.LkaCmdTqReqActvRaw.Val /end REF_MEASUREMENT /end GROUP
/begin GROUP GmMsg180BusHiSpd.LkaCmdTqValRaw.Val "MICROSAR RTE" /begin SUB_GROUP /end SUB_GROUP /begin FUNCTION_LIST /end FUNCTION_LIST /begin REF_CHARACTERISTIC /end REF_CHARACTERISTIC /begin REF_MEASUREMENT GmMsg180BusHiSpd.LkaCmdTqValRaw.Val /end REF_MEASUREMENT /end GROUP
/begin GROUP GmMsg180BusHiSpd.LkaReqActv.Logl "MICROSAR RTE" /begin SUB_GROUP /end SUB_GROUP /begin FUNCTION_LIST /end FUNCTION_LIST /begin REF_CHARACTERISTIC /end REF_CHARACTERISTIC /begin REF_MEASUREMENT GmMsg180BusHiSpd.LkaReqActv.Logl /end REF_MEASUREMENT /end GROUP
/begin GROUP GmMsg180BusHiSpd.LstRxnTiMsg180BusHiSpd.Val "MICROSAR RTE" /begin SUB_GROUP /end SUB_GROUP /begin FUNCTION_LIST /end FUNCTION_LIST /begin REF_CHARACTERISTIC /end REF_CHARACTERISTIC /begin REF_MEASUREMENT GmMsg180BusHiSpd.LstRxnTiMsg180BusHiSpd.Val /end REF_MEASUREMENT /end GROUP
/begin GROUP GmMsg180BusHiSpd.MissMsg180BusHiSpd.Logl "MICROSAR RTE" /begin SUB_GROUP /end SUB_GROUP /begin FUNCTION_LIST /end FUNCTION_LIST /begin REF_CHARACTERISTIC /end REF_CHARACTERISTIC /begin REF_MEASUREMENT GmMsg180BusHiSpd.MissMsg180BusHiSpd.Logl /end REF_MEASUREMENT /end GROUP
/begin GROUP GmMsg180BusHiSpd.PerInstanceMemories "MICROSAR RTE"
 /begin SUB_GROUP GmMsg180BusHiSpd.GmMsg180BusHiSpdInvldCrcTmr GmMsg180BusHiSpd.GmMsg180BusHiSpdInvldRollgCntrTmr GmMsg180BusHiSpd.GmMsg180BusHiSpdPrevInvld GmMsg180BusHiSpd.GmMsg180BusHiSpdPrevRollgCntrVal GmMsg180BusHiSpd.GmMsg180BusHiSpdPrevRxnTi GmMsg180BusHiSpd.GmMsg180BusHiSpdPrevTqCmd GmMsg180BusHiSpd.GmMsg180BusHiSpdPrevTqReq GmMsg180BusHiSpd.GmMsg180BusHiSpdRollgCntrRst /end SUB_GROUP
 /begin FUNCTION_LIST /end FUNCTION_LIST
 /begin REF_CHARACTERISTIC /end REF_CHARACTERISTIC
 /begin REF_MEASUREMENT /end REF_MEASUREMENT
/end GROUP
/begin GROUP GmMsg180BusHiSpd.ReceiverPorts "MICROSAR RTE"
 /begin SUB_GROUP GmMsg180BusHiSpd.LkaCmdProtnValRaw.Val GmMsg180BusHiSpd.LkaCmdRollgCntrRaw.Val GmMsg180BusHiSpd.LkaCmdTqReqActvRaw.Val GmMsg180BusHiSpd.LkaCmdTqValRaw.Val GmMsg180BusHiSpd.LstRxnTiMsg180BusHiSpd.Val /end SUB_GROUP
 /begin FUNCTION_LIST /end FUNCTION_LIST
 /begin REF_CHARACTERISTIC /end REF_CHARACTERISTIC
 /begin REF_MEASUREMENT /end REF_MEASUREMENT
/end GROUP
/begin GROUP GmMsg180BusHiSpd.SenderPorts "MICROSAR RTE"
 /begin SUB_GROUP GmMsg180BusHiSpd.InvldMsg180BusHiSpd.Logl GmMsg180BusHiSpd.LkaCmd.Val GmMsg180BusHiSpd.LkaReqActv.Logl GmMsg180BusHiSpd.MissMsg180BusHiSpd.Logl /end SUB_GROUP
 /begin FUNCTION_LIST /end FUNCTION_LIST
 /begin REF_CHARACTERISTIC /end REF_CHARACTERISTIC
 /begin REF_MEASUREMENT /end REF_MEASUREMENT
/end GROUP
/begin GROUP GmMsg182BusChassisExp "MICROSAR RTE"
 /begin SUB_GROUP GmMsg182BusChassisExp.CalibrationPorts GmMsg182BusChassisExp.PerInstanceMemories GmMsg182BusChassisExp.ReceiverPorts GmMsg182BusChassisExp.SenderPorts /end SUB_GROUP
 /begin FUNCTION_LIST /end FUNCTION_LIST
 /begin REF_CHARACTERISTIC /end REF_CHARACTERISTIC
 /begin REF_MEASUREMENT /end REF_MEASUREMENT
/end GROUP
/begin GROUP GmMsg182BusChassisExp.CalibrationPorts "MICROSAR RTE"
 /begin SUB_GROUP GmMsg182BusChassisExp.GmMsg182BusChassisExpInvldTiOut.Val GmMsg182BusChassisExp.GmMsg182BusChassisExpMissTiOut.Val /end SUB_GROUP
 /begin FUNCTION_LIST /end FUNCTION_LIST
 /begin REF_CHARACTERISTIC /end REF_CHARACTERISTIC
 /begin REF_MEASUREMENT /end REF_MEASUREMENT
/end GROUP
/begin GROUP GmMsg182BusChassisExp.GmMsg182BusChassisExpInvldTiOut.Val "MICROSAR RTE" /begin SUB_GROUP /end SUB_GROUP /begin FUNCTION_LIST /end FUNCTION_LIST /begin REF_CHARACTERISTIC GmMsg182BusChassisExp.GmMsg182BusChassisExpInvldTiOut.Val /end REF_CHARACTERISTIC /begin REF_MEASUREMENT /end REF_MEASUREMENT /end GROUP
/begin GROUP GmMsg182BusChassisExp.GmMsg182BusChassisExpInvldTmr "MICROSAR RTE" /begin SUB_GROUP /end SUB_GROUP /begin FUNCTION_LIST /end FUNCTION_LIST /begin REF_CHARACTERISTIC /end REF_CHARACTERISTIC /begin REF_MEASUREMENT GmMsg182BusChassisExp.GmMsg182BusChassisExpInvldTmr /end REF_MEASUREMENT /end GROUP
/begin GROUP GmMsg182BusChassisExp.GmMsg182BusChassisExpMissTiOut.Val "MICROSAR RTE" /begin SUB_GROUP /end SUB_GROUP /begin FUNCTION_LIST /end FUNCTION_LIST /begin REF_CHARACTERISTIC GmMsg182BusChassisExp.GmMsg182BusChassisExpMissTiOut.Val /end REF_CHARACTERISTIC /begin REF_MEASUREMENT /end REF_MEASUREMENT /end GROUP
/begin GROUP GmMsg182BusChassisExp.GmMsg182BusChassisExpPrevVehLgtA "MICROSAR RTE" /begin SUB_GROUP /end SUB_GROUP /begin FUNCTION_LIST /end FUNCTION_LIST /begin REF_CHARACTERISTIC /end REF_CHARACTERISTIC /begin REF_MEASUREMENT GmMsg182BusChassisExp.GmMsg182BusChassisExpPrevVehLgtA /end REF_MEASUREMENT /end GROUP
/begin GROUP GmMsg182BusChassisExp.LstRxnTiMsg182.Val "MICROSAR RTE" /begin SUB_GROUP /end SUB_GROUP /begin FUNCTION_LIST /end FUNCTION_LIST /begin REF_CHARACTERISTIC /end REF_CHARACTERISTIC /begin REF_MEASUREMENT GmMsg182BusChassisExp.LstRxnTiMsg182.Val /end REF_MEASUREMENT /end GROUP
/begin GROUP GmMsg182BusChassisExp.PerInstanceMemories "MICROSAR RTE"
 /begin SUB_GROUP GmMsg182BusChassisExp.GmMsg182BusChassisExpInvldTmr GmMsg182BusChassisExp.GmMsg182BusChassisExpPrevVehLgtA /end SUB_GROUP
 /begin FUNCTION_LIST /end FUNCTION_LIST
 /begin REF_CHARACTERISTIC /end REF_CHARACTERISTIC
 /begin REF_MEASUREMENT /end REF_MEASUREMENT
/end GROUP
/begin GROUP GmMsg182BusChassisExp.ReceiverPorts "MICROSAR RTE"
 /begin SUB_GROUP GmMsg182BusChassisExp.LstRxnTiMsg182.Val GmMsg182BusChassisExp.VehDynOverUnderSteerVldRaw.Val GmMsg182BusChassisExp.VehStabyEnhmtLgtALoReslRaw.Val GmMsg182BusChassisExp.VehStabyEnhmtLgtALoReslVldRaw.Val /end SUB_GROUP
 /begin FUNCTION_LIST /end FUNCTION_LIST
 /begin REF_CHARACTERISTIC /end REF_CHARACTERISTIC
 /begin REF_MEASUREMENT /end REF_MEASUREMENT
/end GROUP
/begin GROUP GmMsg182BusChassisExp.SenderPorts "MICROSAR RTE" /begin SUB_GROUP GmMsg182BusChassisExp.SerlComVehLgtA.Val /end SUB_GROUP /begin FUNCTION_LIST /end FUNCTION_LIST /begin REF_CHARACTERISTIC /end REF_CHARACTERISTIC /begin REF_MEASUREMENT /end REF_MEASUREMENT /end GROUP
/begin GROUP GmMsg182BusChassisExp.SerlComVehLgtA.Val "MICROSAR RTE" /begin SUB_GROUP /end SUB_GROUP /begin FUNCTION_LIST /end FUNCTION_LIST /begin REF_CHARACTERISTIC /end REF_CHARACTERISTIC /begin REF_MEASUREMENT GmMsg182BusChassisExp.SerlComVehLgtA.Val /end REF_MEASUREMENT /end GROUP
/begin GROUP GmMsg182BusChassisExp.VehDynOverUnderSteerVldRaw.Val "MICROSAR RTE" /begin SUB_GROUP /end SUB_GROUP /begin FUNCTION_LIST /end FUNCTION_LIST /begin REF_CHARACTERISTIC /end REF_CHARACTERISTIC /begin REF_MEASUREMENT GmMsg182BusChassisExp.VehDynOverUnderSteerVldRaw.Val /end REF_MEASUREMENT /end GROUP
/begin GROUP GmMsg182BusChassisExp.VehStabyEnhmtLgtALoReslRaw.Val "MICROSAR RTE" /begin SUB_GROUP /end SUB_GROUP /begin FUNCTION_LIST /end FUNCTION_LIST /begin REF_CHARACTERISTIC /end REF_CHARACTERISTIC /begin REF_MEASUREMENT GmMsg182BusChassisExp.VehStabyEnhmtLgtALoReslRaw.Val /end REF_MEASUREMENT /end GROUP
/begin GROUP GmMsg182BusChassisExp.VehStabyEnhmtLgtALoReslVldRaw.Val "MICROSAR RTE" /begin SUB_GROUP /end SUB_GROUP /begin FUNCTION_LIST /end FUNCTION_LIST /begin REF_CHARACTERISTIC /end REF_CHARACTERISTIC /begin REF_MEASUREMENT GmMsg182BusChassisExp.VehStabyEnhmtLgtALoReslVldRaw.Val /end REF_MEASUREMENT /end GROUP
/begin GROUP GmMsg184BusHiSpd "MICROSAR RTE"
 /begin SUB_GROUP GmMsg184BusHiSpd.CalibrationPorts GmMsg184BusHiSpd.PerInstanceMemories GmMsg184BusHiSpd.ReceiverPorts GmMsg184BusHiSpd.SenderPorts /end SUB_GROUP
 /begin FUNCTION_LIST /end FUNCTION_LIST
 /begin REF_CHARACTERISTIC /end REF_CHARACTERISTIC
 /begin REF_MEASUREMENT /end REF_MEASUREMENT
/end GROUP
/begin GROUP GmMsg184BusHiSpd.CalibrationPorts "MICROSAR RTE"
 /begin SUB_GROUP GmMsg184BusHiSpd.GmMsg184BusHiSpdHandsOnThd.Val GmMsg184BusHiSpd.GmMsg184BusHiSpdTqPolarity.Val GmMsg184BusHiSpd.GmOvrlStMgrLkaMfgEna.Logl GmMsg184BusHiSpd.LoaMgrHwTqIdptSigFltThd.Val /end SUB_GROUP
 /begin FUNCTION_LIST /end FUNCTION_LIST
 /begin REF_CHARACTERISTIC /end REF_CHARACTERISTIC
 /begin REF_MEASUREMENT /end REF_MEASUREMENT
/end GROUP
/begin GROUP GmMsg184BusHiSpd.GmMsg184BusHiSpdHandsOnThd.Val "MICROSAR RTE" /begin SUB_GROUP /end SUB_GROUP /begin FUNCTION_LIST /end FUNCTION_LIST /begin REF_CHARACTERISTIC GmMsg184BusHiSpd.GmMsg184BusHiSpdHandsOnThd.Val /end REF_CHARACTERISTIC /begin REF_MEASUREMENT /end REF_MEASUREMENT /end GROUP
/begin GROUP GmMsg184BusHiSpd.GmMsg184BusHiSpdRollgCntr "MICROSAR RTE" /begin SUB_GROUP /end SUB_GROUP /begin FUNCTION_LIST /end FUNCTION_LIST /begin REF_CHARACTERISTIC /end REF_CHARACTERISTIC /begin REF_MEASUREMENT GmMsg184BusHiSpd.GmMsg184BusHiSpdRollgCntr /end REF_MEASUREMENT /end GROUP
/begin GROUP GmMsg184BusHiSpd.GmMsg184BusHiSpdTqPolarity.Val "MICROSAR RTE" /begin SUB_GROUP /end SUB_GROUP /begin FUNCTION_LIST /end FUNCTION_LIST /begin REF_CHARACTERISTIC GmMsg184BusHiSpd.GmMsg184BusHiSpdTqPolarity.Val /end REF_CHARACTERISTIC /begin REF_MEASUREMENT /end REF_MEASUREMENT /end GROUP
/begin GROUP GmMsg184BusHiSpd.GmOvrlStMgrLkaMfgEna.Logl "MICROSAR RTE" /begin SUB_GROUP /end SUB_GROUP /begin FUNCTION_LIST /end FUNCTION_LIST /begin REF_CHARACTERISTIC GmMsg184BusHiSpd.GmOvrlStMgrLkaMfgEna.Logl /end REF_CHARACTERISTIC /begin REF_MEASUREMENT /end REF_MEASUREMENT /end GROUP
/begin GROUP GmMsg184BusHiSpd.HandsOffSteerWhlDetnMod.Val "MICROSAR RTE" /begin SUB_GROUP /end SUB_GROUP /begin FUNCTION_LIST /end FUNCTION_LIST /begin REF_CHARACTERISTIC /end REF_CHARACTERISTIC /begin REF_MEASUREMENT GmMsg184BusHiSpd.HandsOffSteerWhlDetnMod.Val /end REF_MEASUREMENT /end GROUP
/begin GROUP GmMsg184BusHiSpd.HandsOffSteerWhlDetnSt.Val "MICROSAR RTE" /begin SUB_GROUP /end SUB_GROUP /begin FUNCTION_LIST /end FUNCTION_LIST /begin REF_CHARACTERISTIC /end REF_CHARACTERISTIC /begin REF_MEASUREMENT GmMsg184BusHiSpd.HandsOffSteerWhlDetnSt.Val /end REF_MEASUREMENT /end GROUP
/begin GROUP GmMsg184BusHiSpd.HandsOffSteerWhlDetnStVld.Val "MICROSAR RTE" /begin SUB_GROUP /end SUB_GROUP /begin FUNCTION_LIST /end FUNCTION_LIST /begin REF_CHARACTERISTIC /end REF_CHARACTERISTIC /begin REF_MEASUREMENT GmMsg184BusHiSpd.HandsOffSteerWhlDetnStVld.Val /end REF_MEASUREMENT /end GROUP
/begin GROUP GmMsg184BusHiSpd.HandsOnWhlEstim.Val "MICROSAR RTE" /begin SUB_GROUP /end SUB_GROUP /begin FUNCTION_LIST /end FUNCTION_LIST /begin REF_CHARACTERISTIC /end REF_CHARACTERISTIC /begin REF_MEASUREMENT GmMsg184BusHiSpd.HandsOnWhlEstim.Val /end REF_MEASUREMENT /end GROUP
/begin GROUP GmMsg184BusHiSpd.HwTq.Val "MICROSAR RTE" /begin SUB_GROUP /end SUB_GROUP /begin FUNCTION_LIST /end FUNCTION_LIST /begin REF_CHARACTERISTIC /end REF_CHARACTERISTIC /begin REF_MEASUREMENT GmMsg184BusHiSpd.HwTq.Val /end REF_MEASUREMENT /end GROUP
/begin GROUP GmMsg184BusHiSpd.HwTqIdptSig.Val "MICROSAR RTE" /begin SUB_GROUP /end SUB_GROUP /begin FUNCTION_LIST /end FUNCTION_LIST /begin REF_CHARACTERISTIC /end REF_CHARACTERISTIC /begin REF_MEASUREMENT GmMsg184BusHiSpd.HwTqIdptSig.Val /end REF_MEASUREMENT /end GROUP
/begin GROUP GmMsg184BusHiSpd.LkaDrvrAppldTq.Val "MICROSAR RTE" /begin SUB_GROUP /end SUB_GROUP /begin FUNCTION_LIST /end FUNCTION_LIST /begin REF_CHARACTERISTIC /end REF_CHARACTERISTIC /begin REF_MEASUREMENT GmMsg184BusHiSpd.LkaDrvrAppldTq.Val /end REF_MEASUREMENT /end GROUP
/begin GROUP GmMsg184BusHiSpd.LkaDrvrAppldTqVld.Val "MICROSAR RTE" /begin SUB_GROUP /end SUB_GROUP /begin FUNCTION_LIST /end FUNCTION_LIST /begin REF_CHARACTERISTIC /end REF_CHARACTERISTIC /begin REF_MEASUREMENT GmMsg184BusHiSpd.LkaDrvrAppldTqVld.Val /end REF_MEASUREMENT /end GROUP
/begin GROUP GmMsg184BusHiSpd.LkaElecPwrSteerTotTqDlvd.Val "MICROSAR RTE" /begin SUB_GROUP /end SUB_GROUP /begin FUNCTION_LIST /end FUNCTION_LIST /begin REF_CHARACTERISTIC /end REF_CHARACTERISTIC /begin REF_MEASUREMENT GmMsg184BusHiSpd.LkaElecPwrSteerTotTqDlvd.Val /end REF_MEASUREMENT /end GROUP
/begin GROUP GmMsg184BusHiSpd.LkaSt.Val "MICROSAR RTE" /begin SUB_GROUP /end SUB_GROUP /begin FUNCTION_LIST /end FUNCTION_LIST /begin REF_CHARACTERISTIC /end REF_CHARACTERISTIC /begin REF_MEASUREMENT GmMsg184BusHiSpd.LkaSt.Val /end REF_MEASUREMENT /end GROUP
/begin GROUP GmMsg184BusHiSpd.LkaTqDlvd.Val "MICROSAR RTE" /begin SUB_GROUP /end SUB_GROUP /begin FUNCTION_LIST /end FUNCTION_LIST /begin REF_CHARACTERISTIC /end REF_CHARACTERISTIC /begin REF_MEASUREMENT GmMsg184BusHiSpd.LkaTqDlvd.Val /end REF_MEASUREMENT /end GROUP
/begin GROUP GmMsg184BusHiSpd.LkaTqOvrlDeltaTqDlvd.Val "MICROSAR RTE" /begin SUB_GROUP /end SUB_GROUP /begin FUNCTION_LIST /end FUNCTION_LIST /begin REF_CHARACTERISTIC /end REF_CHARACTERISTIC /begin REF_MEASUREMENT GmMsg184BusHiSpd.LkaTqOvrlDeltaTqDlvd.Val /end REF_MEASUREMENT /end GROUP
/begin GROUP GmMsg184BusHiSpd.LkaTqOvrlDlvdRollgCntr.Val "MICROSAR RTE" /begin SUB_GROUP /end SUB_GROUP /begin FUNCTION_LIST /end FUNCTION_LIST /begin REF_CHARACTERISTIC /end REF_CHARACTERISTIC /begin REF_MEASUREMENT GmMsg184BusHiSpd.LkaTqOvrlDlvdRollgCntr.Val /end REF_MEASUREMENT /end GROUP
/begin GROUP GmMsg184BusHiSpd.LkaTqOvrlStsChks.Val "MICROSAR RTE" /begin SUB_GROUP /end SUB_GROUP /begin FUNCTION_LIST /end FUNCTION_LIST /begin REF_CHARACTERISTIC /end REF_CHARACTERISTIC /begin REF_MEASUREMENT GmMsg184BusHiSpd.LkaTqOvrlStsChks.Val /end REF_MEASUREMENT /end GROUP
/begin GROUP GmMsg184BusHiSpd.LkaTqOvrlTqDlvdSts.Val "MICROSAR RTE" /begin SUB_GROUP /end SUB_GROUP /begin FUNCTION_LIST /end FUNCTION_LIST /begin REF_CHARACTERISTIC /end REF_CHARACTERISTIC /begin REF_MEASUREMENT GmMsg184BusHiSpd.LkaTqOvrlTqDlvdSts.Val /end REF_MEASUREMENT /end GROUP
/begin GROUP GmMsg184BusHiSpd.LoaMgrHwTqIdptSigFltThd.Val "MICROSAR RTE" /begin SUB_GROUP /end SUB_GROUP /begin FUNCTION_LIST /end FUNCTION_LIST /begin REF_CHARACTERISTIC GmMsg184BusHiSpd.LoaMgrHwTqIdptSigFltThd.Val /end REF_CHARACTERISTIC /begin REF_MEASUREMENT /end REF_MEASUREMENT /end GROUP
/begin GROUP GmMsg184BusHiSpd.PerInstanceMemories "MICROSAR RTE" /begin SUB_GROUP GmMsg184BusHiSpd.GmMsg184BusHiSpdRollgCntr /end SUB_GROUP /begin FUNCTION_LIST /end FUNCTION_LIST /begin REF_CHARACTERISTIC /end REF_CHARACTERISTIC /begin REF_MEASUREMENT /end REF_MEASUREMENT /end GROUP
/begin GROUP GmMsg184BusHiSpd.ReceiverPorts "MICROSAR RTE"
 /begin SUB_GROUP GmMsg184BusHiSpd.HandsOnWhlEstim.Val GmMsg184BusHiSpd.HwTq.Val GmMsg184BusHiSpd.HwTqIdptSig.Val GmMsg184BusHiSpd.LkaSt.Val GmMsg184BusHiSpd.LkaTqDlvd.Val GmMsg184BusHiSpd.SysStFltOutpReqDi.Logl GmMsg184BusHiSpd.VehSpdVld.Logl /end SUB_GROUP
 /begin FUNCTION_LIST /end FUNCTION_LIST
 /begin REF_CHARACTERISTIC /end REF_CHARACTERISTIC
 /begin REF_MEASUREMENT /end REF_MEASUREMENT
/end GROUP
/begin GROUP GmMsg184BusHiSpd.SenderPorts "MICROSAR RTE"
 /begin SUB_GROUP GmMsg184BusHiSpd.HandsOffSteerWhlDetnMod.Val GmMsg184BusHiSpd.HandsOffSteerWhlDetnSt.Val GmMsg184BusHiSpd.HandsOffSteerWhlDetnStVld.Val GmMsg184BusHiSpd.LkaDrvrAppldTq.Val GmMsg184BusHiSpd.LkaDrvrAppldTqVld.Val GmMsg184BusHiSpd.LkaElecPwrSteerTotTqDlvd.Val GmMsg184BusHiSpd.LkaTqOvrlDeltaTqDlvd.Val GmMsg184BusHiSpd.LkaTqOvrlDlvdRollgCntr.Val GmMsg184BusHiSpd.LkaTqOvrlStsChks.Val GmMsg184BusHiSpd.LkaTqOvrlTqDlvdSts.Val /end SUB_GROUP
 /begin FUNCTION_LIST /end FUNCTION_LIST
 /begin REF_CHARACTERISTIC /end REF_CHARACTERISTIC
 /begin REF_MEASUREMENT /end REF_MEASUREMENT
/end GROUP
/begin GROUP GmMsg184BusHiSpd.SysStFltOutpReqDi.Logl "MICROSAR RTE" /begin SUB_GROUP /end SUB_GROUP /begin FUNCTION_LIST /end FUNCTION_LIST /begin REF_CHARACTERISTIC /end REF_CHARACTERISTIC /begin REF_MEASUREMENT GmMsg184BusHiSpd.SysStFltOutpReqDi.Logl /end REF_MEASUREMENT /end GROUP
/begin GROUP GmMsg184BusHiSpd.VehSpdVld.Logl "MICROSAR RTE" /begin SUB_GROUP /end SUB_GROUP /begin FUNCTION_LIST /end FUNCTION_LIST /begin REF_CHARACTERISTIC /end REF_CHARACTERISTIC /begin REF_MEASUREMENT GmMsg184BusHiSpd.VehSpdVld.Logl /end REF_MEASUREMENT /end GROUP
/begin GROUP GmMsg1CABusChassisExp "MICROSAR RTE"
 /begin SUB_GROUP GmMsg1CABusChassisExp.CalibrationPorts GmMsg1CABusChassisExp.PerInstanceMemories GmMsg1CABusChassisExp.ReceiverPorts GmMsg1CABusChassisExp.SenderPorts /end SUB_GROUP
 /begin FUNCTION_LIST /end FUNCTION_LIST
 /begin REF_CHARACTERISTIC /end REF_CHARACTERISTIC
 /begin REF_MEASUREMENT /end REF_MEASUREMENT
/end GROUP
/begin GROUP GmMsg1CABusChassisExp.CalibrationPorts "MICROSAR RTE" /begin SUB_GROUP GmMsg1CABusChassisExp.GmMsg1CaBusChassisExpTqPolarity.Val /end SUB_GROUP /begin FUNCTION_LIST /end FUNCTION_LIST /begin REF_CHARACTERISTIC /end REF_CHARACTERISTIC /begin REF_MEASUREMENT /end REF_MEASUREMENT /end GROUP
/begin GROUP GmMsg1CABusChassisExp.ElecPwrSteerTotTqDlvd.Val "MICROSAR RTE" /begin SUB_GROUP /end SUB_GROUP /begin FUNCTION_LIST /end FUNCTION_LIST /begin REF_CHARACTERISTIC /end REF_CHARACTERISTIC /begin REF_MEASUREMENT GmMsg1CABusChassisExp.ElecPwrSteerTotTqDlvd.Val /end REF_MEASUREMENT /end GROUP
/begin GROUP GmMsg1CABusChassisExp.EscSt.Val "MICROSAR RTE" /begin SUB_GROUP /end SUB_GROUP /begin FUNCTION_LIST /end FUNCTION_LIST /begin REF_CHARACTERISTIC /end REF_CHARACTERISTIC /begin REF_MEASUREMENT GmMsg1CABusChassisExp.EscSt.Val /end REF_MEASUREMENT /end GROUP
/begin GROUP GmMsg1CABusChassisExp.EscTqDlvd.Val "MICROSAR RTE" /begin SUB_GROUP /end SUB_GROUP /begin FUNCTION_LIST /end FUNCTION_LIST /begin REF_CHARACTERISTIC /end REF_CHARACTERISTIC /begin REF_MEASUREMENT GmMsg1CABusChassisExp.EscTqDlvd.Val /end REF_MEASUREMENT /end GROUP
/begin GROUP GmMsg1CABusChassisExp.GmMsg1CABusChassisExpRollgCntr "MICROSAR RTE" /begin SUB_GROUP /end SUB_GROUP /begin FUNCTION_LIST /end FUNCTION_LIST /begin REF_CHARACTERISTIC /end REF_CHARACTERISTIC /begin REF_MEASUREMENT GmMsg1CABusChassisExp.GmMsg1CABusChassisExpRollgCntr /end REF_MEASUREMENT /end GROUP
/begin GROUP GmMsg1CABusChassisExp.GmMsg1CaBusChassisExpTqPolarity.Val "MICROSAR RTE" /begin SUB_GROUP /end SUB_GROUP /begin FUNCTION_LIST /end FUNCTION_LIST /begin REF_CHARACTERISTIC GmMsg1CABusChassisExp.GmMsg1CaBusChassisExpTqPolarity.Val /end REF_CHARACTERISTIC /begin REF_MEASUREMENT /end REF_MEASUREMENT /end GROUP
/begin GROUP GmMsg1CABusChassisExp.HwTq.Val "MICROSAR RTE" /begin SUB_GROUP /end SUB_GROUP /begin FUNCTION_LIST /end FUNCTION_LIST /begin REF_CHARACTERISTIC /end REF_CHARACTERISTIC /begin REF_MEASUREMENT GmMsg1CABusChassisExp.HwTq.Val /end REF_MEASUREMENT /end GROUP
/begin GROUP GmMsg1CABusChassisExp.PerInstanceMemories "MICROSAR RTE" /begin SUB_GROUP GmMsg1CABusChassisExp.GmMsg1CABusChassisExpRollgCntr /end SUB_GROUP /begin FUNCTION_LIST /end FUNCTION_LIST /begin REF_CHARACTERISTIC /end REF_CHARACTERISTIC /begin REF_MEASUREMENT /end REF_MEASUREMENT /end GROUP
/begin GROUP GmMsg1CABusChassisExp.ReceiverPorts "MICROSAR RTE"
 /begin SUB_GROUP GmMsg1CABusChassisExp.EscSt.Val GmMsg1CABusChassisExp.EscTqDlvd.Val GmMsg1CABusChassisExp.HwTq.Val /end SUB_GROUP
 /begin FUNCTION_LIST /end FUNCTION_LIST
 /begin REF_CHARACTERISTIC /end REF_CHARACTERISTIC
 /begin REF_MEASUREMENT /end REF_MEASUREMENT
/end GROUP
/begin GROUP GmMsg1CABusChassisExp.SenderPorts "MICROSAR RTE"
 /begin SUB_GROUP GmMsg1CABusChassisExp.ElecPwrSteerTotTqDlvd.Val GmMsg1CABusChassisExp.TqOvrlDeltaTqDlvd.Val GmMsg1CABusChassisExp.TqOvrlDlvdChks.Val GmMsg1CABusChassisExp.TqOvrlDlvdRollgCntr.Val GmMsg1CABusChassisExp.TqOvrlTqDlvdSts.Val /end SUB_GROUP
 /begin FUNCTION_LIST /end FUNCTION_LIST
 /begin REF_CHARACTERISTIC /end REF_CHARACTERISTIC
 /begin REF_MEASUREMENT /end REF_MEASUREMENT
/end GROUP
/begin GROUP GmMsg1CABusChassisExp.TqOvrlDeltaTqDlvd.Val "MICROSAR RTE" /begin SUB_GROUP /end SUB_GROUP /begin FUNCTION_LIST /end FUNCTION_LIST /begin REF_CHARACTERISTIC /end REF_CHARACTERISTIC /begin REF_MEASUREMENT GmMsg1CABusChassisExp.TqOvrlDeltaTqDlvd.Val /end REF_MEASUREMENT /end GROUP
/begin GROUP GmMsg1CABusChassisExp.TqOvrlDlvdChks.Val "MICROSAR RTE" /begin SUB_GROUP /end SUB_GROUP /begin FUNCTION_LIST /end FUNCTION_LIST /begin REF_CHARACTERISTIC /end REF_CHARACTERISTIC /begin REF_MEASUREMENT GmMsg1CABusChassisExp.TqOvrlDlvdChks.Val /end REF_MEASUREMENT /end GROUP
/begin GROUP GmMsg1CABusChassisExp.TqOvrlDlvdRollgCntr.Val "MICROSAR RTE" /begin SUB_GROUP /end SUB_GROUP /begin FUNCTION_LIST /end FUNCTION_LIST /begin REF_CHARACTERISTIC /end REF_CHARACTERISTIC /begin REF_MEASUREMENT GmMsg1CABusChassisExp.TqOvrlDlvdRollgCntr.Val /end REF_MEASUREMENT /end GROUP
/begin GROUP GmMsg1CABusChassisExp.TqOvrlTqDlvdSts.Val "MICROSAR RTE" /begin SUB_GROUP /end SUB_GROUP /begin FUNCTION_LIST /end FUNCTION_LIST /begin REF_CHARACTERISTIC /end REF_CHARACTERISTIC /begin REF_MEASUREMENT GmMsg1CABusChassisExp.TqOvrlTqDlvdSts.Val /end REF_MEASUREMENT /end GROUP
/begin GROUP GmMsg1E5BusChassisExp "MICROSAR RTE"
 /begin SUB_GROUP GmMsg1E5BusChassisExp.PerInstanceMemories GmMsg1E5BusChassisExp.ReceiverPorts GmMsg1E5BusChassisExp.SenderPorts /end SUB_GROUP
 /begin FUNCTION_LIST /end FUNCTION_LIST
 /begin REF_CHARACTERISTIC /end REF_CHARACTERISTIC
 /begin REF_MEASUREMENT /end REF_MEASUREMENT
/end GROUP
/begin GROUP GmMsg1E5BusChassisExp.GmMsg1E5BusChassisExpRollgCntr "MICROSAR RTE" /begin SUB_GROUP /end SUB_GROUP /begin FUNCTION_LIST /end FUNCTION_LIST /begin REF_CHARACTERISTIC /end REF_CHARACTERISTIC /begin REF_MEASUREMENT GmMsg1E5BusChassisExp.GmMsg1E5BusChassisExpRollgCntr /end REF_MEASUREMENT /end GROUP
/begin GROUP GmMsg1E5BusChassisExp.HwAg.Val "MICROSAR RTE" /begin SUB_GROUP /end SUB_GROUP /begin FUNCTION_LIST /end FUNCTION_LIST /begin REF_CHARACTERISTIC /end REF_CHARACTERISTIC /begin REF_MEASUREMENT GmMsg1E5BusChassisExp.HwAg.Val /end REF_MEASUREMENT /end GROUP
/begin GROUP GmMsg1E5BusChassisExp.HwAgStsToSerlCom.Logl "MICROSAR RTE" /begin SUB_GROUP /end SUB_GROUP /begin FUNCTION_LIST /end FUNCTION_LIST /begin REF_CHARACTERISTIC /end REF_CHARACTERISTIC /begin REF_MEASUREMENT GmMsg1E5BusChassisExp.HwAgStsToSerlCom.Logl /end REF_MEASUREMENT /end GROUP
/begin GROUP GmMsg1E5BusChassisExp.HwAgTrimPrfmd.Logl "MICROSAR RTE" /begin SUB_GROUP /end SUB_GROUP /begin FUNCTION_LIST /end FUNCTION_LIST /begin REF_CHARACTERISTIC /end REF_CHARACTERISTIC /begin REF_MEASUREMENT GmMsg1E5BusChassisExp.HwAgTrimPrfmd.Logl /end REF_MEASUREMENT /end GROUP
/begin GROUP GmMsg1E5BusChassisExp.HwVel.Val "MICROSAR RTE" /begin SUB_GROUP /end SUB_GROUP /begin FUNCTION_LIST /end FUNCTION_LIST /begin REF_CHARACTERISTIC /end REF_CHARACTERISTIC /begin REF_MEASUREMENT GmMsg1E5BusChassisExp.HwVel.Val /end REF_MEASUREMENT /end GROUP
/begin GROUP GmMsg1E5BusChassisExp.MotAgLoaMtgtnEna.Logl "MICROSAR RTE" /begin SUB_GROUP /end SUB_GROUP /begin FUNCTION_LIST /end FUNCTION_LIST /begin REF_CHARACTERISTIC /end REF_CHARACTERISTIC /begin REF_MEASUREMENT GmMsg1E5BusChassisExp.MotAgLoaMtgtnEna.Logl /end REF_MEASUREMENT /end GROUP
/begin GROUP GmMsg1E5BusChassisExp.PerInstanceMemories "MICROSAR RTE" /begin SUB_GROUP GmMsg1E5BusChassisExp.GmMsg1E5BusChassisExpRollgCntr /end SUB_GROUP /begin FUNCTION_LIST /end FUNCTION_LIST /begin REF_CHARACTERISTIC /end REF_CHARACTERISTIC /begin REF_MEASUREMENT /end REF_MEASUREMENT /end GROUP
/begin GROUP GmMsg1E5BusChassisExp.ReceiverPorts "MICROSAR RTE"
 /begin SUB_GROUP GmMsg1E5BusChassisExp.HwAg.Val GmMsg1E5BusChassisExp.HwAgStsToSerlCom.Logl GmMsg1E5BusChassisExp.HwAgTrimPrfmd.Logl GmMsg1E5BusChassisExp.HwVel.Val GmMsg1E5BusChassisExp.MotAgLoaMtgtnEna.Logl /end SUB_GROUP
 /begin FUNCTION_LIST /end FUNCTION_LIST
 /begin REF_CHARACTERISTIC /end REF_CHARACTERISTIC
 /begin REF_MEASUREMENT /end REF_MEASUREMENT
/end GROUP
/begin GROUP GmMsg1E5BusChassisExp.SenderPorts "MICROSAR RTE"
 /begin SUB_GROUP GmMsg1E5BusChassisExp.SteerWhlAgAlvRollgCntBusChassisExp.Val GmMsg1E5BusChassisExp.SteerWhlAgBusChassisExp.Val GmMsg1E5BusChassisExp.SteerWhlAgGrdtBusChassisExp.Val GmMsg1E5BusChassisExp.SteerWhlAgGrdtMaskBusChassisExp.Val GmMsg1E5BusChassisExp.SteerWhlAgGrdtVldBusChassisExp.Val GmMsg1E5BusChassisExp.SteerWhlAgMaskBusChassisExp.Val GmMsg1E5BusChassisExp.SteerWhlAgSnsrCalStsBusChassisExp.Val GmMsg1E5BusChassisExp.SteerWhlAgSnsrChksBusChassisExp.Val GmMsg1E5BusChassisExp.SteerWhlAgSnsrTypBusChassisExp.Val GmMsg1E5BusChassisExp.SteerWhlAgVldBusChassisExp.Val /end SUB_GROUP
 /begin FUNCTION_LIST /end FUNCTION_LIST
 /begin REF_CHARACTERISTIC /end REF_CHARACTERISTIC
 /begin REF_MEASUREMENT /end REF_MEASUREMENT
/end GROUP
/begin GROUP GmMsg1E5BusChassisExp.SteerWhlAgAlvRollgCntBusChassisExp.Val "MICROSAR RTE" /begin SUB_GROUP /end SUB_GROUP /begin FUNCTION_LIST /end FUNCTION_LIST /begin REF_CHARACTERISTIC /end REF_CHARACTERISTIC
 /begin REF_MEASUREMENT GmMsg1E5BusChassisExp.SteerWhlAgAlvRollgCntBusChassisExp.Val /end REF_MEASUREMENT
/end GROUP
/begin GROUP GmMsg1E5BusChassisExp.SteerWhlAgBusChassisExp.Val "MICROSAR RTE" /begin SUB_GROUP /end SUB_GROUP /begin FUNCTION_LIST /end FUNCTION_LIST /begin REF_CHARACTERISTIC /end REF_CHARACTERISTIC /begin REF_MEASUREMENT GmMsg1E5BusChassisExp.SteerWhlAgBusChassisExp.Val /end REF_MEASUREMENT /end GROUP
/begin GROUP GmMsg1E5BusChassisExp.SteerWhlAgGrdtBusChassisExp.Val "MICROSAR RTE" /begin SUB_GROUP /end SUB_GROUP /begin FUNCTION_LIST /end FUNCTION_LIST /begin REF_CHARACTERISTIC /end REF_CHARACTERISTIC /begin REF_MEASUREMENT GmMsg1E5BusChassisExp.SteerWhlAgGrdtBusChassisExp.Val /end REF_MEASUREMENT /end GROUP
/begin GROUP GmMsg1E5BusChassisExp.SteerWhlAgGrdtMaskBusChassisExp.Val "MICROSAR RTE" /begin SUB_GROUP /end SUB_GROUP /begin FUNCTION_LIST /end FUNCTION_LIST /begin REF_CHARACTERISTIC /end REF_CHARACTERISTIC /begin REF_MEASUREMENT GmMsg1E5BusChassisExp.SteerWhlAgGrdtMaskBusChassisExp.Val /end REF_MEASUREMENT /end GROUP
/begin GROUP GmMsg1E5BusChassisExp.SteerWhlAgGrdtVldBusChassisExp.Val "MICROSAR RTE" /begin SUB_GROUP /end SUB_GROUP /begin FUNCTION_LIST /end FUNCTION_LIST /begin REF_CHARACTERISTIC /end REF_CHARACTERISTIC /begin REF_MEASUREMENT GmMsg1E5BusChassisExp.SteerWhlAgGrdtVldBusChassisExp.Val /end REF_MEASUREMENT /end GROUP
/begin GROUP GmMsg1E5BusChassisExp.SteerWhlAgMaskBusChassisExp.Val "MICROSAR RTE" /begin SUB_GROUP /end SUB_GROUP /begin FUNCTION_LIST /end FUNCTION_LIST /begin REF_CHARACTERISTIC /end REF_CHARACTERISTIC /begin REF_MEASUREMENT GmMsg1E5BusChassisExp.SteerWhlAgMaskBusChassisExp.Val /end REF_MEASUREMENT /end GROUP
/begin GROUP GmMsg1E5BusChassisExp.SteerWhlAgSnsrCalStsBusChassisExp.Val "MICROSAR RTE" /begin SUB_GROUP /end SUB_GROUP /begin FUNCTION_LIST /end FUNCTION_LIST /begin REF_CHARACTERISTIC /end REF_CHARACTERISTIC
 /begin REF_MEASUREMENT GmMsg1E5BusChassisExp.SteerWhlAgSnsrCalStsBusChassisExp.Val /end REF_MEASUREMENT
/end GROUP
/begin GROUP GmMsg1E5BusChassisExp.SteerWhlAgSnsrChksBusChassisExp.Val "MICROSAR RTE" /begin SUB_GROUP /end SUB_GROUP /begin FUNCTION_LIST /end FUNCTION_LIST /begin REF_CHARACTERISTIC /end REF_CHARACTERISTIC /begin REF_MEASUREMENT GmMsg1E5BusChassisExp.SteerWhlAgSnsrChksBusChassisExp.Val /end REF_MEASUREMENT /end GROUP
/begin GROUP GmMsg1E5BusChassisExp.SteerWhlAgSnsrTypBusChassisExp.Val "MICROSAR RTE" /begin SUB_GROUP /end SUB_GROUP /begin FUNCTION_LIST /end FUNCTION_LIST /begin REF_CHARACTERISTIC /end REF_CHARACTERISTIC /begin REF_MEASUREMENT GmMsg1E5BusChassisExp.SteerWhlAgSnsrTypBusChassisExp.Val /end REF_MEASUREMENT /end GROUP
/begin GROUP GmMsg1E5BusChassisExp.SteerWhlAgVldBusChassisExp.Val "MICROSAR RTE" /begin SUB_GROUP /end SUB_GROUP /begin FUNCTION_LIST /end FUNCTION_LIST /begin REF_CHARACTERISTIC /end REF_CHARACTERISTIC /begin REF_MEASUREMENT GmMsg1E5BusChassisExp.SteerWhlAgVldBusChassisExp.Val /end REF_MEASUREMENT /end GROUP
/begin GROUP GmMsg1E5BusHiSpd "MICROSAR RTE"
 /begin SUB_GROUP GmMsg1E5BusHiSpd.PerInstanceMemories GmMsg1E5BusHiSpd.ReceiverPorts GmMsg1E5BusHiSpd.SenderPorts /end SUB_GROUP
 /begin FUNCTION_LIST /end FUNCTION_LIST
 /begin REF_CHARACTERISTIC /end REF_CHARACTERISTIC
 /begin REF_MEASUREMENT /end REF_MEASUREMENT
/end GROUP
/begin GROUP GmMsg1E5BusHiSpd.GmMsg1E5BusHiSpdRollgCntr "MICROSAR RTE" /begin SUB_GROUP /end SUB_GROUP /begin FUNCTION_LIST /end FUNCTION_LIST /begin REF_CHARACTERISTIC /end REF_CHARACTERISTIC /begin REF_MEASUREMENT GmMsg1E5BusHiSpd.GmMsg1E5BusHiSpdRollgCntr /end REF_MEASUREMENT /end GROUP
/begin GROUP GmMsg1E5BusHiSpd.HwAg.Val "MICROSAR RTE" /begin SUB_GROUP /end SUB_GROUP /begin FUNCTION_LIST /end FUNCTION_LIST /begin REF_CHARACTERISTIC /end REF_CHARACTERISTIC /begin REF_MEASUREMENT GmMsg1E5BusHiSpd.HwAg.Val /end REF_MEASUREMENT /end GROUP
/begin GROUP GmMsg1E5BusHiSpd.HwAgStsToSerlCom.Logl "MICROSAR RTE" /begin SUB_GROUP /end SUB_GROUP /begin FUNCTION_LIST /end FUNCTION_LIST /begin REF_CHARACTERISTIC /end REF_CHARACTERISTIC /begin REF_MEASUREMENT GmMsg1E5BusHiSpd.HwAgStsToSerlCom.Logl /end REF_MEASUREMENT /end GROUP
/begin GROUP GmMsg1E5BusHiSpd.HwAgTrimPrfmd.Logl "MICROSAR RTE" /begin SUB_GROUP /end SUB_GROUP /begin FUNCTION_LIST /end FUNCTION_LIST /begin REF_CHARACTERISTIC /end REF_CHARACTERISTIC /begin REF_MEASUREMENT GmMsg1E5BusHiSpd.HwAgTrimPrfmd.Logl /end REF_MEASUREMENT /end GROUP
/begin GROUP GmMsg1E5BusHiSpd.HwVel.Val "MICROSAR RTE" /begin SUB_GROUP /end SUB_GROUP /begin FUNCTION_LIST /end FUNCTION_LIST /begin REF_CHARACTERISTIC /end REF_CHARACTERISTIC /begin REF_MEASUREMENT GmMsg1E5BusHiSpd.HwVel.Val /end REF_MEASUREMENT /end GROUP
/begin GROUP GmMsg1E5BusHiSpd.MotAgLoaMtgtnEna.Logl "MICROSAR RTE" /begin SUB_GROUP /end SUB_GROUP /begin FUNCTION_LIST /end FUNCTION_LIST /begin REF_CHARACTERISTIC /end REF_CHARACTERISTIC /begin REF_MEASUREMENT GmMsg1E5BusHiSpd.MotAgLoaMtgtnEna.Logl /end REF_MEASUREMENT /end GROUP
/begin GROUP GmMsg1E5BusHiSpd.PerInstanceMemories "MICROSAR RTE" /begin SUB_GROUP GmMsg1E5BusHiSpd.GmMsg1E5BusHiSpdRollgCntr /end SUB_GROUP /begin FUNCTION_LIST /end FUNCTION_LIST /begin REF_CHARACTERISTIC /end REF_CHARACTERISTIC /begin REF_MEASUREMENT /end REF_MEASUREMENT /end GROUP
/begin GROUP GmMsg1E5BusHiSpd.ReceiverPorts "MICROSAR RTE"
 /begin SUB_GROUP GmMsg1E5BusHiSpd.HwAg.Val GmMsg1E5BusHiSpd.HwAgStsToSerlCom.Logl GmMsg1E5BusHiSpd.HwAgTrimPrfmd.Logl GmMsg1E5BusHiSpd.HwVel.Val GmMsg1E5BusHiSpd.MotAgLoaMtgtnEna.Logl /end SUB_GROUP
 /begin FUNCTION_LIST /end FUNCTION_LIST
 /begin REF_CHARACTERISTIC /end REF_CHARACTERISTIC
 /begin REF_MEASUREMENT /end REF_MEASUREMENT
/end GROUP
/begin GROUP GmMsg1E5BusHiSpd.SenderPorts "MICROSAR RTE"
 /begin SUB_GROUP GmMsg1E5BusHiSpd.SteerWhlAgAlvRollgCntBusHiSpd.Val GmMsg1E5BusHiSpd.SteerWhlAgBusHiSpd.Val GmMsg1E5BusHiSpd.SteerWhlAgGrdtBusHiSpd.Val GmMsg1E5BusHiSpd.SteerWhlAgGrdtMaskBusHiSpd.Val GmMsg1E5BusHiSpd.SteerWhlAgGrdtVldBusHiSpd.Val GmMsg1E5BusHiSpd.SteerWhlAgMaskBusHiSpd.Val GmMsg1E5BusHiSpd.SteerWhlAgSnsrCalStsBusHiSpd.Val GmMsg1E5BusHiSpd.SteerWhlAgSnsrChksBusHiSpd.Val GmMsg1E5BusHiSpd.SteerWhlAgSnsrTypBusHiSpd.Val GmMsg1E5BusHiSpd.SteerWhlAgVldBusHiSpd.Val /end SUB_GROUP
 /begin FUNCTION_LIST /end FUNCTION_LIST
 /begin REF_CHARACTERISTIC /end REF_CHARACTERISTIC
 /begin REF_MEASUREMENT /end REF_MEASUREMENT
/end GROUP
/begin GROUP GmMsg1E5BusHiSpd.SteerWhlAgAlvRollgCntBusHiSpd.Val "MICROSAR RTE" /begin SUB_GROUP /end SUB_GROUP /begin FUNCTION_LIST /end FUNCTION_LIST /begin REF_CHARACTERISTIC /end REF_CHARACTERISTIC /begin REF_MEASUREMENT GmMsg1E5BusHiSpd.SteerWhlAgAlvRollgCntBusHiSpd.Val /end REF_MEASUREMENT /end GROUP
/begin GROUP GmMsg1E5BusHiSpd.SteerWhlAgBusHiSpd.Val "MICROSAR RTE" /begin SUB_GROUP /end SUB_GROUP /begin FUNCTION_LIST /end FUNCTION_LIST /begin REF_CHARACTERISTIC /end REF_CHARACTERISTIC /begin REF_MEASUREMENT GmMsg1E5BusHiSpd.SteerWhlAgBusHiSpd.Val /end REF_MEASUREMENT /end GROUP
/begin GROUP GmMsg1E5BusHiSpd.SteerWhlAgGrdtBusHiSpd.Val "MICROSAR RTE" /begin SUB_GROUP /end SUB_GROUP /begin FUNCTION_LIST /end FUNCTION_LIST /begin REF_CHARACTERISTIC /end REF_CHARACTERISTIC /begin REF_MEASUREMENT GmMsg1E5BusHiSpd.SteerWhlAgGrdtBusHiSpd.Val /end REF_MEASUREMENT /end GROUP
/begin GROUP GmMsg1E5BusHiSpd.SteerWhlAgGrdtMaskBusHiSpd.Val "MICROSAR RTE" /begin SUB_GROUP /end SUB_GROUP /begin FUNCTION_LIST /end FUNCTION_LIST /begin REF_CHARACTERISTIC /end REF_CHARACTERISTIC /begin REF_MEASUREMENT GmMsg1E5BusHiSpd.SteerWhlAgGrdtMaskBusHiSpd.Val /end REF_MEASUREMENT /end GROUP
/begin GROUP GmMsg1E5BusHiSpd.SteerWhlAgGrdtVldBusHiSpd.Val "MICROSAR RTE" /begin SUB_GROUP /end SUB_GROUP /begin FUNCTION_LIST /end FUNCTION_LIST /begin REF_CHARACTERISTIC /end REF_CHARACTERISTIC /begin REF_MEASUREMENT GmMsg1E5BusHiSpd.SteerWhlAgGrdtVldBusHiSpd.Val /end REF_MEASUREMENT /end GROUP
/begin GROUP GmMsg1E5BusHiSpd.SteerWhlAgMaskBusHiSpd.Val "MICROSAR RTE" /begin SUB_GROUP /end SUB_GROUP /begin FUNCTION_LIST /end FUNCTION_LIST /begin REF_CHARACTERISTIC /end REF_CHARACTERISTIC /begin REF_MEASUREMENT GmMsg1E5BusHiSpd.SteerWhlAgMaskBusHiSpd.Val /end REF_MEASUREMENT /end GROUP
/begin GROUP GmMsg1E5BusHiSpd.SteerWhlAgSnsrCalStsBusHiSpd.Val "MICROSAR RTE" /begin SUB_GROUP /end SUB_GROUP /begin FUNCTION_LIST /end FUNCTION_LIST /begin REF_CHARACTERISTIC /end REF_CHARACTERISTIC /begin REF_MEASUREMENT GmMsg1E5BusHiSpd.SteerWhlAgSnsrCalStsBusHiSpd.Val /end REF_MEASUREMENT /end GROUP
/begin GROUP GmMsg1E5BusHiSpd.SteerWhlAgSnsrChksBusHiSpd.Val "MICROSAR RTE" /begin SUB_GROUP /end SUB_GROUP /begin FUNCTION_LIST /end FUNCTION_LIST /begin REF_CHARACTERISTIC /end REF_CHARACTERISTIC /begin REF_MEASUREMENT GmMsg1E5BusHiSpd.SteerWhlAgSnsrChksBusHiSpd.Val /end REF_MEASUREMENT /end GROUP
/begin GROUP GmMsg1E5BusHiSpd.SteerWhlAgSnsrTypBusHiSpd.Val "MICROSAR RTE" /begin SUB_GROUP /end SUB_GROUP /begin FUNCTION_LIST /end FUNCTION_LIST /begin REF_CHARACTERISTIC /end REF_CHARACTERISTIC /begin REF_MEASUREMENT GmMsg1E5BusHiSpd.SteerWhlAgSnsrTypBusHiSpd.Val /end REF_MEASUREMENT /end GROUP
/begin GROUP GmMsg1E5BusHiSpd.SteerWhlAgVldBusHiSpd.Val "MICROSAR RTE" /begin SUB_GROUP /end SUB_GROUP /begin FUNCTION_LIST /end FUNCTION_LIST /begin REF_CHARACTERISTIC /end REF_CHARACTERISTIC /begin REF_MEASUREMENT GmMsg1E5BusHiSpd.SteerWhlAgVldBusHiSpd.Val /end REF_MEASUREMENT /end GROUP
/begin GROUP GmMsg1E9BusHiSpd "MICROSAR RTE"
 /begin SUB_GROUP GmMsg1E9BusHiSpd.CalibrationPorts GmMsg1E9BusHiSpd.PerInstanceMemories GmMsg1E9BusHiSpd.ReceiverPorts GmMsg1E9BusHiSpd.SenderPorts /end SUB_GROUP
 /begin FUNCTION_LIST /end FUNCTION_LIST
 /begin REF_CHARACTERISTIC /end REF_CHARACTERISTIC
 /begin REF_MEASUREMENT /end REF_MEASUREMENT
/end GROUP
/begin GROUP GmMsg1E9BusHiSpd.AbsActvRaw.Val "MICROSAR RTE" /begin SUB_GROUP /end SUB_GROUP /begin FUNCTION_LIST /end FUNCTION_LIST /begin REF_CHARACTERISTIC /end REF_CHARACTERISTIC /begin REF_MEASUREMENT GmMsg1E9BusHiSpd.AbsActvRaw.Val /end REF_MEASUREMENT /end GROUP
/begin GROUP GmMsg1E9BusHiSpd.AbsFaildRaw.Val "MICROSAR RTE" /begin SUB_GROUP /end SUB_GROUP /begin FUNCTION_LIST /end FUNCTION_LIST /begin REF_CHARACTERISTIC /end REF_CHARACTERISTIC /begin REF_MEASUREMENT GmMsg1E9BusHiSpd.AbsFaildRaw.Val /end REF_MEASUREMENT /end GROUP
/begin GROUP GmMsg1E9BusHiSpd.CalibrationPorts "MICROSAR RTE"
 /begin SUB_GROUP GmMsg1E9BusHiSpd.GmMsg1E9BusHiSpdAbsFaildTiOut.Val GmMsg1E9BusHiSpd.GmMsg1E9BusHiSpdLatADft.Val GmMsg1E9BusHiSpd.GmMsg1E9BusHiSpdLatAInvldTiOut.Val GmMsg1E9BusHiSpd.GmMsg1E9BusHiSpdMissTiOut.Val GmMsg1E9BusHiSpd.GmMsg1E9BusHiSpdTcsDisadTiOut.Val GmMsg1E9BusHiSpd.GmMsg1E9BusHiSpdVehDynCtrlStTiOut.Val GmMsg1E9BusHiSpd.GmMsg1E9BusHiSpdVehStabyEnhmtActvVldTiOut.Val GmMsg1E9BusHiSpd.GmMsg1E9BusHiSpdYawRateDft.Val GmMsg1E9BusHiSpd.GmMsg1E9BusHiSpdYawRateInvldTiOut.Val /end SUB_GROUP
 /begin FUNCTION_LIST /end FUNCTION_LIST
 /begin REF_CHARACTERISTIC /end REF_CHARACTERISTIC
 /begin REF_MEASUREMENT /end REF_MEASUREMENT
/end GROUP
/begin GROUP GmMsg1E9BusHiSpd.GmMsg1E9BusHiSpdAbsFaildTiOut.Val "MICROSAR RTE" /begin SUB_GROUP /end SUB_GROUP /begin FUNCTION_LIST /end FUNCTION_LIST /begin REF_CHARACTERISTIC GmMsg1E9BusHiSpd.GmMsg1E9BusHiSpdAbsFaildTiOut.Val /end REF_CHARACTERISTIC /begin REF_MEASUREMENT /end REF_MEASUREMENT /end GROUP
/begin GROUP GmMsg1E9BusHiSpd.GmMsg1E9BusHiSpdAbsFaildTmr "MICROSAR RTE" /begin SUB_GROUP /end SUB_GROUP /begin FUNCTION_LIST /end FUNCTION_LIST /begin REF_CHARACTERISTIC /end REF_CHARACTERISTIC /begin REF_MEASUREMENT GmMsg1E9BusHiSpd.GmMsg1E9BusHiSpdAbsFaildTmr /end REF_MEASUREMENT /end GROUP
/begin GROUP GmMsg1E9BusHiSpd.GmMsg1E9BusHiSpdLatADft.Val "MICROSAR RTE" /begin SUB_GROUP /end SUB_GROUP /begin FUNCTION_LIST /end FUNCTION_LIST /begin REF_CHARACTERISTIC GmMsg1E9BusHiSpd.GmMsg1E9BusHiSpdLatADft.Val /end REF_CHARACTERISTIC /begin REF_MEASUREMENT /end REF_MEASUREMENT /end GROUP
/begin GROUP GmMsg1E9BusHiSpd.GmMsg1E9BusHiSpdLatAInvldTiOut.Val "MICROSAR RTE" /begin SUB_GROUP /end SUB_GROUP /begin FUNCTION_LIST /end FUNCTION_LIST /begin REF_CHARACTERISTIC GmMsg1E9BusHiSpd.GmMsg1E9BusHiSpdLatAInvldTiOut.Val /end REF_CHARACTERISTIC /begin REF_MEASUREMENT /end REF_MEASUREMENT /end GROUP
/begin GROUP GmMsg1E9BusHiSpd.GmMsg1E9BusHiSpdLatAInvldTmr "MICROSAR RTE" /begin SUB_GROUP /end SUB_GROUP /begin FUNCTION_LIST /end FUNCTION_LIST /begin REF_CHARACTERISTIC /end REF_CHARACTERISTIC /begin REF_MEASUREMENT GmMsg1E9BusHiSpd.GmMsg1E9BusHiSpdLatAInvldTmr /end REF_MEASUREMENT /end GROUP
/begin GROUP GmMsg1E9BusHiSpd.GmMsg1E9BusHiSpdMissTiOut.Val "MICROSAR RTE" /begin SUB_GROUP /end SUB_GROUP /begin FUNCTION_LIST /end FUNCTION_LIST /begin REF_CHARACTERISTIC GmMsg1E9BusHiSpd.GmMsg1E9BusHiSpdMissTiOut.Val /end REF_CHARACTERISTIC /begin REF_MEASUREMENT /end REF_MEASUREMENT /end GROUP
/begin GROUP GmMsg1E9BusHiSpd.GmMsg1E9BusHiSpdRdntVehStabyEnhmtTmr "MICROSAR RTE" /begin SUB_GROUP /end SUB_GROUP /begin FUNCTION_LIST /end FUNCTION_LIST /begin REF_CHARACTERISTIC /end REF_CHARACTERISTIC /begin REF_MEASUREMENT GmMsg1E9BusHiSpd.GmMsg1E9BusHiSpdRdntVehStabyEnhmtTmr /end REF_MEASUREMENT /end GROUP
/begin GROUP GmMsg1E9BusHiSpd.GmMsg1E9BusHiSpdTcsDisadTiOut.Val "MICROSAR RTE" /begin SUB_GROUP /end SUB_GROUP /begin FUNCTION_LIST /end FUNCTION_LIST /begin REF_CHARACTERISTIC GmMsg1E9BusHiSpd.GmMsg1E9BusHiSpdTcsDisadTiOut.Val /end REF_CHARACTERISTIC /begin REF_MEASUREMENT /end REF_MEASUREMENT /end GROUP
/begin GROUP GmMsg1E9BusHiSpd.GmMsg1E9BusHiSpdTcsEnaTmr "MICROSAR RTE" /begin SUB_GROUP /end SUB_GROUP /begin FUNCTION_LIST /end FUNCTION_LIST /begin REF_CHARACTERISTIC /end REF_CHARACTERISTIC /begin REF_MEASUREMENT GmMsg1E9BusHiSpd.GmMsg1E9BusHiSpdTcsEnaTmr /end REF_MEASUREMENT /end GROUP
/begin GROUP GmMsg1E9BusHiSpd.GmMsg1E9BusHiSpdVehDynCtrlStTiOut.Val "MICROSAR RTE" /begin SUB_GROUP /end SUB_GROUP /begin FUNCTION_LIST /end FUNCTION_LIST /begin REF_CHARACTERISTIC GmMsg1E9BusHiSpd.GmMsg1E9BusHiSpdVehDynCtrlStTiOut.Val /end REF_CHARACTERISTIC /begin REF_MEASUREMENT /end REF_MEASUREMENT /end GROUP
/begin GROUP GmMsg1E9BusHiSpd.GmMsg1E9BusHiSpdVehDynCtrlSysStTmr "MICROSAR RTE" /begin SUB_GROUP /end SUB_GROUP /begin FUNCTION_LIST /end FUNCTION_LIST /begin REF_CHARACTERISTIC /end REF_CHARACTERISTIC /begin REF_MEASUREMENT GmMsg1E9BusHiSpd.GmMsg1E9BusHiSpdVehDynCtrlSysStTmr /end REF_MEASUREMENT /end GROUP
/begin GROUP GmMsg1E9BusHiSpd.GmMsg1E9BusHiSpdVehStabyEnhmtActvVldTiOut.Val "MICROSAR RTE" /begin SUB_GROUP /end SUB_GROUP /begin FUNCTION_LIST /end FUNCTION_LIST
 /begin REF_CHARACTERISTIC GmMsg1E9BusHiSpd.GmMsg1E9BusHiSpdVehStabyEnhmtActvVldTiOut.Val /end REF_CHARACTERISTIC
 /begin REF_MEASUREMENT /end REF_MEASUREMENT
/end GROUP
/begin GROUP GmMsg1E9BusHiSpd.GmMsg1E9BusHiSpdYawRateDft.Val "MICROSAR RTE" /begin SUB_GROUP /end SUB_GROUP /begin FUNCTION_LIST /end FUNCTION_LIST /begin REF_CHARACTERISTIC GmMsg1E9BusHiSpd.GmMsg1E9BusHiSpdYawRateDft.Val /end REF_CHARACTERISTIC /begin REF_MEASUREMENT /end REF_MEASUREMENT /end GROUP
/begin GROUP GmMsg1E9BusHiSpd.GmMsg1E9BusHiSpdYawRateInvldTiOut.Val "MICROSAR RTE" /begin SUB_GROUP /end SUB_GROUP /begin FUNCTION_LIST /end FUNCTION_LIST /begin REF_CHARACTERISTIC GmMsg1E9BusHiSpd.GmMsg1E9BusHiSpdYawRateInvldTiOut.Val /end REF_CHARACTERISTIC /begin REF_MEASUREMENT /end REF_MEASUREMENT /end GROUP
/begin GROUP GmMsg1E9BusHiSpd.GmMsg1E9BusHiSpdYawRateInvldTmr "MICROSAR RTE" /begin SUB_GROUP /end SUB_GROUP /begin FUNCTION_LIST /end FUNCTION_LIST /begin REF_CHARACTERISTIC /end REF_CHARACTERISTIC /begin REF_MEASUREMENT GmMsg1E9BusHiSpd.GmMsg1E9BusHiSpdYawRateInvldTmr /end REF_MEASUREMENT /end GROUP
/begin GROUP GmMsg1E9BusHiSpd.InvldMsg1E9.Logl "MICROSAR RTE" /begin SUB_GROUP /end SUB_GROUP /begin FUNCTION_LIST /end FUNCTION_LIST /begin REF_CHARACTERISTIC /end REF_CHARACTERISTIC /begin REF_MEASUREMENT GmMsg1E9BusHiSpd.InvldMsg1E9.Logl /end REF_MEASUREMENT /end GROUP
/begin GROUP GmMsg1E9BusHiSpd.LstRxnTiMsg1E9.Val "MICROSAR RTE" /begin SUB_GROUP /end SUB_GROUP /begin FUNCTION_LIST /end FUNCTION_LIST /begin REF_CHARACTERISTIC /end REF_CHARACTERISTIC /begin REF_MEASUREMENT GmMsg1E9BusHiSpd.LstRxnTiMsg1E9.Val /end REF_MEASUREMENT /end GROUP
/begin GROUP GmMsg1E9BusHiSpd.MissMsg1E9.Logl "MICROSAR RTE" /begin SUB_GROUP /end SUB_GROUP /begin FUNCTION_LIST /end FUNCTION_LIST /begin REF_CHARACTERISTIC /end REF_CHARACTERISTIC /begin REF_MEASUREMENT GmMsg1E9BusHiSpd.MissMsg1E9.Logl /end REF_MEASUREMENT /end GROUP
/begin GROUP GmMsg1E9BusHiSpd.PerInstanceMemories "MICROSAR RTE"
 /begin SUB_GROUP GmMsg1E9BusHiSpd.GmMsg1E9BusHiSpdAbsFaildTmr GmMsg1E9BusHiSpd.GmMsg1E9BusHiSpdLatAInvldTmr GmMsg1E9BusHiSpd.GmMsg1E9BusHiSpdRdntVehStabyEnhmtTmr GmMsg1E9BusHiSpd.GmMsg1E9BusHiSpdTcsEnaTmr GmMsg1E9BusHiSpd.GmMsg1E9BusHiSpdVehDynCtrlSysStTmr GmMsg1E9BusHiSpd.GmMsg1E9BusHiSpdYawRateInvldTmr /end SUB_GROUP
 /begin FUNCTION_LIST /end FUNCTION_LIST
 /begin REF_CHARACTERISTIC /end REF_CHARACTERISTIC
 /begin REF_MEASUREMENT /end REF_MEASUREMENT
/end GROUP
/begin GROUP GmMsg1E9BusHiSpd.RdntVehStabyEnhmtActv.Logl "MICROSAR RTE" /begin SUB_GROUP /end SUB_GROUP /begin FUNCTION_LIST /end FUNCTION_LIST /begin REF_CHARACTERISTIC /end REF_CHARACTERISTIC /begin REF_MEASUREMENT GmMsg1E9BusHiSpd.RdntVehStabyEnhmtActv.Logl /end REF_MEASUREMENT /end GROUP
/begin GROUP GmMsg1E9BusHiSpd.ReceiverPorts "MICROSAR RTE"
 /begin SUB_GROUP GmMsg1E9BusHiSpd.AbsActvRaw.Val GmMsg1E9BusHiSpd.AbsFaildRaw.Val GmMsg1E9BusHiSpd.LstRxnTiMsg1E9.Val GmMsg1E9BusHiSpd.RdntVehStabyEnhmtActv.Logl GmMsg1E9BusHiSpd.TracCtrlSysActvRaw.Val GmMsg1E9BusHiSpd.TracCtrlSysEnaRaw.Val GmMsg1E9BusHiSpd.VehDynCtrlSysStRaw.Val GmMsg1E9BusHiSpd.VehDynYawRateRaw.Val GmMsg1E9BusHiSpd.VehDynYawRateVldRaw.Val GmMsg1E9BusHiSpd.VehStabyEnhmtActvRaw.Val GmMsg1E9BusHiSpd.VehStabyEnhmtLatARaw.Val GmMsg1E9BusHiSpd.VehStabyEnhmtLatAVldRaw.Val /end SUB_GROUP
 /begin FUNCTION_LIST /end FUNCTION_LIST
 /begin REF_CHARACTERISTIC /end REF_CHARACTERISTIC
 /begin REF_MEASUREMENT /end REF_MEASUREMENT
/end GROUP
/begin GROUP GmMsg1E9BusHiSpd.SenderPorts "MICROSAR RTE"
 /begin SUB_GROUP GmMsg1E9BusHiSpd.InvldMsg1E9.Logl GmMsg1E9BusHiSpd.MissMsg1E9.Logl GmMsg1E9BusHiSpd.SerlComAbsActv.Logl GmMsg1E9BusHiSpd.SerlComLatA.Val GmMsg1E9BusHiSpd.SerlComTcsActv.Logl GmMsg1E9BusHiSpd.SerlComYawRate.Val GmMsg1E9BusHiSpd.SerlComYawRateVld.Logl GmMsg1E9BusHiSpd.VehLatAVldSerlCom.Logl GmMsg1E9BusHiSpd.VehStabyEnhmtActv.Logl /end SUB_GROUP
 /begin FUNCTION_LIST /end FUNCTION_LIST
 /begin REF_CHARACTERISTIC /end REF_CHARACTERISTIC
 /begin REF_MEASUREMENT /end REF_MEASUREMENT
/end GROUP
/begin GROUP GmMsg1E9BusHiSpd.SerlComAbsActv.Logl "MICROSAR RTE" /begin SUB_GROUP /end SUB_GROUP /begin FUNCTION_LIST /end FUNCTION_LIST /begin REF_CHARACTERISTIC /end REF_CHARACTERISTIC /begin REF_MEASUREMENT GmMsg1E9BusHiSpd.SerlComAbsActv.Logl /end REF_MEASUREMENT /end GROUP
/begin GROUP GmMsg1E9BusHiSpd.SerlComLatA.Val "MICROSAR RTE" /begin SUB_GROUP /end SUB_GROUP /begin FUNCTION_LIST /end FUNCTION_LIST /begin REF_CHARACTERISTIC /end REF_CHARACTERISTIC /begin REF_MEASUREMENT GmMsg1E9BusHiSpd.SerlComLatA.Val /end REF_MEASUREMENT /end GROUP
/begin GROUP GmMsg1E9BusHiSpd.SerlComTcsActv.Logl "MICROSAR RTE" /begin SUB_GROUP /end SUB_GROUP /begin FUNCTION_LIST /end FUNCTION_LIST /begin REF_CHARACTERISTIC /end REF_CHARACTERISTIC /begin REF_MEASUREMENT GmMsg1E9BusHiSpd.SerlComTcsActv.Logl /end REF_MEASUREMENT /end GROUP
/begin GROUP GmMsg1E9BusHiSpd.SerlComYawRate.Val "MICROSAR RTE" /begin SUB_GROUP /end SUB_GROUP /begin FUNCTION_LIST /end FUNCTION_LIST /begin REF_CHARACTERISTIC /end REF_CHARACTERISTIC /begin REF_MEASUREMENT GmMsg1E9BusHiSpd.SerlComYawRate.Val /end REF_MEASUREMENT /end GROUP
/begin GROUP GmMsg1E9BusHiSpd.SerlComYawRateVld.Logl "MICROSAR RTE" /begin SUB_GROUP /end SUB_GROUP /begin FUNCTION_LIST /end FUNCTION_LIST /begin REF_CHARACTERISTIC /end REF_CHARACTERISTIC /begin REF_MEASUREMENT GmMsg1E9BusHiSpd.SerlComYawRateVld.Logl /end REF_MEASUREMENT /end GROUP
/begin GROUP GmMsg1E9BusHiSpd.TracCtrlSysActvRaw.Val "MICROSAR RTE" /begin SUB_GROUP /end SUB_GROUP /begin FUNCTION_LIST /end FUNCTION_LIST /begin REF_CHARACTERISTIC /end REF_CHARACTERISTIC /begin REF_MEASUREMENT GmMsg1E9BusHiSpd.TracCtrlSysActvRaw.Val /end REF_MEASUREMENT /end GROUP
/begin GROUP GmMsg1E9BusHiSpd.TracCtrlSysEnaRaw.Val "MICROSAR RTE" /begin SUB_GROUP /end SUB_GROUP /begin FUNCTION_LIST /end FUNCTION_LIST /begin REF_CHARACTERISTIC /end REF_CHARACTERISTIC /begin REF_MEASUREMENT GmMsg1E9BusHiSpd.TracCtrlSysEnaRaw.Val /end REF_MEASUREMENT /end GROUP
/begin GROUP GmMsg1E9BusHiSpd.VehDynCtrlSysStRaw.Val "MICROSAR RTE" /begin SUB_GROUP /end SUB_GROUP /begin FUNCTION_LIST /end FUNCTION_LIST /begin REF_CHARACTERISTIC /end REF_CHARACTERISTIC /begin REF_MEASUREMENT GmMsg1E9BusHiSpd.VehDynCtrlSysStRaw.Val /end REF_MEASUREMENT /end GROUP
/begin GROUP GmMsg1E9BusHiSpd.VehDynYawRateRaw.Val "MICROSAR RTE" /begin SUB_GROUP /end SUB_GROUP /begin FUNCTION_LIST /end FUNCTION_LIST /begin REF_CHARACTERISTIC /end REF_CHARACTERISTIC /begin REF_MEASUREMENT GmMsg1E9BusHiSpd.VehDynYawRateRaw.Val /end REF_MEASUREMENT /end GROUP
/begin GROUP GmMsg1E9BusHiSpd.VehDynYawRateVldRaw.Val "MICROSAR RTE" /begin SUB_GROUP /end SUB_GROUP /begin FUNCTION_LIST /end FUNCTION_LIST /begin REF_CHARACTERISTIC /end REF_CHARACTERISTIC /begin REF_MEASUREMENT GmMsg1E9BusHiSpd.VehDynYawRateVldRaw.Val /end REF_MEASUREMENT /end GROUP
/begin GROUP GmMsg1E9BusHiSpd.VehLatAVldSerlCom.Logl "MICROSAR RTE" /begin SUB_GROUP /end SUB_GROUP /begin FUNCTION_LIST /end FUNCTION_LIST /begin REF_CHARACTERISTIC /end REF_CHARACTERISTIC /begin REF_MEASUREMENT GmMsg1E9BusHiSpd.VehLatAVldSerlCom.Logl /end REF_MEASUREMENT /end GROUP
/begin GROUP GmMsg1E9BusHiSpd.VehStabyEnhmtActv.Logl "MICROSAR RTE" /begin SUB_GROUP /end SUB_GROUP /begin FUNCTION_LIST /end FUNCTION_LIST /begin REF_CHARACTERISTIC /end REF_CHARACTERISTIC /begin REF_MEASUREMENT GmMsg1E9BusHiSpd.VehStabyEnhmtActv.Logl /end REF_MEASUREMENT /end GROUP
/begin GROUP GmMsg1E9BusHiSpd.VehStabyEnhmtActvRaw.Val "MICROSAR RTE" /begin SUB_GROUP /end SUB_GROUP /begin FUNCTION_LIST /end FUNCTION_LIST /begin REF_CHARACTERISTIC /end REF_CHARACTERISTIC /begin REF_MEASUREMENT GmMsg1E9BusHiSpd.VehStabyEnhmtActvRaw.Val /end REF_MEASUREMENT /end GROUP
/begin GROUP GmMsg1E9BusHiSpd.VehStabyEnhmtLatARaw.Val "MICROSAR RTE" /begin SUB_GROUP /end SUB_GROUP /begin FUNCTION_LIST /end FUNCTION_LIST /begin REF_CHARACTERISTIC /end REF_CHARACTERISTIC /begin REF_MEASUREMENT GmMsg1E9BusHiSpd.VehStabyEnhmtLatARaw.Val /end REF_MEASUREMENT /end GROUP
/begin GROUP GmMsg1E9BusHiSpd.VehStabyEnhmtLatAVldRaw.Val "MICROSAR RTE" /begin SUB_GROUP /end SUB_GROUP /begin FUNCTION_LIST /end FUNCTION_LIST /begin REF_CHARACTERISTIC /end REF_CHARACTERISTIC /begin REF_MEASUREMENT GmMsg1E9BusHiSpd.VehStabyEnhmtLatAVldRaw.Val /end REF_MEASUREMENT /end GROUP
/begin GROUP GmMsg1F1BusHiSpd "MICROSAR RTE"
 /begin SUB_GROUP GmMsg1F1BusHiSpd.CalibrationPorts GmMsg1F1BusHiSpd.PerInstanceMemories GmMsg1F1BusHiSpd.ReceiverPorts GmMsg1F1BusHiSpd.SenderPorts /end SUB_GROUP
 /begin FUNCTION_LIST /end FUNCTION_LIST
 /begin REF_CHARACTERISTIC /end REF_CHARACTERISTIC
 /begin REF_MEASUREMENT /end REF_MEASUREMENT
/end GROUP
/begin GROUP GmMsg1F1BusHiSpd.BackUpPwrModMstVirtDevAuthyRaw.Val "MICROSAR RTE" /begin SUB_GROUP /end SUB_GROUP /begin FUNCTION_LIST /end FUNCTION_LIST /begin REF_CHARACTERISTIC /end REF_CHARACTERISTIC /begin REF_MEASUREMENT GmMsg1F1BusHiSpd.BackUpPwrModMstVirtDevAuthyRaw.Val /end REF_MEASUREMENT /end GROUP
/begin GROUP GmMsg1F1BusHiSpd.CalibrationPorts "MICROSAR RTE" /begin SUB_GROUP GmMsg1F1BusHiSpd.GmMsg1F1BusHiSpdMissTiOut.Val /end SUB_GROUP /begin FUNCTION_LIST /end FUNCTION_LIST /begin REF_CHARACTERISTIC /end REF_CHARACTERISTIC /begin REF_MEASUREMENT /end REF_MEASUREMENT /end GROUP
/begin GROUP GmMsg1F1BusHiSpd.EngRunActv.Logl "MICROSAR RTE" /begin SUB_GROUP /end SUB_GROUP /begin FUNCTION_LIST /end FUNCTION_LIST /begin REF_CHARACTERISTIC /end REF_CHARACTERISTIC /begin REF_MEASUREMENT GmMsg1F1BusHiSpd.EngRunActv.Logl /end REF_MEASUREMENT /end GROUP
/begin GROUP GmMsg1F1BusHiSpd.GmMsg1F1BusHiSpdMissTiOut.Val "MICROSAR RTE" /begin SUB_GROUP /end SUB_GROUP /begin FUNCTION_LIST /end FUNCTION_LIST /begin REF_CHARACTERISTIC GmMsg1F1BusHiSpd.GmMsg1F1BusHiSpdMissTiOut.Val /end REF_CHARACTERISTIC /begin REF_MEASUREMENT /end REF_MEASUREMENT /end GROUP
/begin GROUP GmMsg1F1BusHiSpd.GmMsg1F1BusHiSpdPrevPrevSysPwrModRun "MICROSAR RTE" /begin SUB_GROUP /end SUB_GROUP /begin FUNCTION_LIST /end FUNCTION_LIST /begin REF_CHARACTERISTIC /end REF_CHARACTERISTIC /begin REF_MEASUREMENT GmMsg1F1BusHiSpd.GmMsg1F1BusHiSpdPrevPrevSysPwrModRun /end REF_MEASUREMENT /end GROUP
/begin GROUP GmMsg1F1BusHiSpd.LstRxnTiMsg1F1.Val "MICROSAR RTE" /begin SUB_GROUP /end SUB_GROUP /begin FUNCTION_LIST /end FUNCTION_LIST /begin REF_CHARACTERISTIC /end REF_CHARACTERISTIC /begin REF_MEASUREMENT GmMsg1F1BusHiSpd.LstRxnTiMsg1F1.Val /end REF_MEASUREMENT /end GROUP
/begin GROUP GmMsg1F1BusHiSpd.MissMsg1F1.Logl "MICROSAR RTE" /begin SUB_GROUP /end SUB_GROUP /begin FUNCTION_LIST /end FUNCTION_LIST /begin REF_CHARACTERISTIC /end REF_CHARACTERISTIC /begin REF_MEASUREMENT GmMsg1F1BusHiSpd.MissMsg1F1.Logl /end REF_MEASUREMENT /end GROUP
/begin GROUP GmMsg1F1BusHiSpd.PerInstanceMemories "MICROSAR RTE" /begin SUB_GROUP GmMsg1F1BusHiSpd.GmMsg1F1BusHiSpdPrevPrevSysPwrModRun /end SUB_GROUP /begin FUNCTION_LIST /end FUNCTION_LIST /begin REF_CHARACTERISTIC /end REF_CHARACTERISTIC /begin REF_MEASUREMENT /end REF_MEASUREMENT /end GROUP
/begin GROUP GmMsg1F1BusHiSpd.ReceiverPorts "MICROSAR RTE"
 /begin SUB_GROUP GmMsg1F1BusHiSpd.BackUpPwrModMstVirtDevAuthyRaw.Val GmMsg1F1BusHiSpd.EngRunActv.Logl GmMsg1F1BusHiSpd.LstRxnTiMsg1F1.Val GmMsg1F1BusHiSpd.SysBackUpPwrModEnaRaw.Val GmMsg1F1BusHiSpd.SysBackUpPwrModRaw.Val GmMsg1F1BusHiSpd.SysPwrModRaw.Val /end SUB_GROUP
 /begin FUNCTION_LIST /end FUNCTION_LIST
 /begin REF_CHARACTERISTIC /end REF_CHARACTERISTIC
 /begin REF_MEASUREMENT /end REF_MEASUREMENT
/end GROUP
/begin GROUP GmMsg1F1BusHiSpd.SenderPorts "MICROSAR RTE"
 /begin SUB_GROUP GmMsg1F1BusHiSpd.MissMsg1F1.Logl GmMsg1F1BusHiSpd.SysPwrModRun.Logl /end SUB_GROUP
 /begin FUNCTION_LIST /end FUNCTION_LIST
 /begin REF_CHARACTERISTIC /end REF_CHARACTERISTIC
 /begin REF_MEASUREMENT /end REF_MEASUREMENT
/end GROUP
/begin GROUP GmMsg1F1BusHiSpd.SysBackUpPwrModEnaRaw.Val "MICROSAR RTE" /begin SUB_GROUP /end SUB_GROUP /begin FUNCTION_LIST /end FUNCTION_LIST /begin REF_CHARACTERISTIC /end REF_CHARACTERISTIC /begin REF_MEASUREMENT GmMsg1F1BusHiSpd.SysBackUpPwrModEnaRaw.Val /end REF_MEASUREMENT /end GROUP
/begin GROUP GmMsg1F1BusHiSpd.SysBackUpPwrModRaw.Val "MICROSAR RTE" /begin SUB_GROUP /end SUB_GROUP /begin FUNCTION_LIST /end FUNCTION_LIST /begin REF_CHARACTERISTIC /end REF_CHARACTERISTIC /begin REF_MEASUREMENT GmMsg1F1BusHiSpd.SysBackUpPwrModRaw.Val /end REF_MEASUREMENT /end GROUP
/begin GROUP GmMsg1F1BusHiSpd.SysPwrModRaw.Val "MICROSAR RTE" /begin SUB_GROUP /end SUB_GROUP /begin FUNCTION_LIST /end FUNCTION_LIST /begin REF_CHARACTERISTIC /end REF_CHARACTERISTIC /begin REF_MEASUREMENT GmMsg1F1BusHiSpd.SysPwrModRaw.Val /end REF_MEASUREMENT /end GROUP
/begin GROUP GmMsg1F1BusHiSpd.SysPwrModRun.Logl "MICROSAR RTE" /begin SUB_GROUP /end SUB_GROUP /begin FUNCTION_LIST /end FUNCTION_LIST /begin REF_CHARACTERISTIC /end REF_CHARACTERISTIC /begin REF_MEASUREMENT GmMsg1F1BusHiSpd.SysPwrModRun.Logl /end REF_MEASUREMENT /end GROUP
/begin GROUP GmMsg1F5BusHiSpd "MICROSAR RTE"
 /begin SUB_GROUP GmMsg1F5BusHiSpd.CalibrationPorts GmMsg1F5BusHiSpd.PerInstanceMemories GmMsg1F5BusHiSpd.ReceiverPorts GmMsg1F5BusHiSpd.SenderPorts /end SUB_GROUP
 /begin FUNCTION_LIST /end FUNCTION_LIST
 /begin REF_CHARACTERISTIC /end REF_CHARACTERISTIC
 /begin REF_MEASUREMENT /end REF_MEASUREMENT
/end GROUP
/begin GROUP GmMsg1F5BusHiSpd.CalibrationPorts "MICROSAR RTE"
 /begin SUB_GROUP GmMsg1F5BusHiSpd.GmMsg1F5BusHiSpdInvldTiOut.Val GmMsg1F5BusHiSpd.GmMsg1F5BusHiSpdMissTiOut.Val /end SUB_GROUP
 /begin FUNCTION_LIST /end FUNCTION_LIST
 /begin REF_CHARACTERISTIC /end REF_CHARACTERISTIC
 /begin REF_MEASUREMENT /end REF_MEASUREMENT
/end GROUP
/begin GROUP GmMsg1F5BusHiSpd.GmMsg1F5BusHiSpdInvldTiOut.Val "MICROSAR RTE" /begin SUB_GROUP /end SUB_GROUP /begin FUNCTION_LIST /end FUNCTION_LIST /begin REF_CHARACTERISTIC GmMsg1F5BusHiSpd.GmMsg1F5BusHiSpdInvldTiOut.Val /end REF_CHARACTERISTIC /begin REF_MEASUREMENT /end REF_MEASUREMENT /end GROUP
/begin GROUP GmMsg1F5BusHiSpd.GmMsg1F5BusHiSpdInvldTmr "MICROSAR RTE" /begin SUB_GROUP /end SUB_GROUP /begin FUNCTION_LIST /end FUNCTION_LIST /begin REF_CHARACTERISTIC /end REF_CHARACTERISTIC /begin REF_MEASUREMENT GmMsg1F5BusHiSpd.GmMsg1F5BusHiSpdInvldTmr /end REF_MEASUREMENT /end GROUP
/begin GROUP GmMsg1F5BusHiSpd.GmMsg1F5BusHiSpdMissTiOut.Val "MICROSAR RTE" /begin SUB_GROUP /end SUB_GROUP /begin FUNCTION_LIST /end FUNCTION_LIST /begin REF_CHARACTERISTIC GmMsg1F5BusHiSpd.GmMsg1F5BusHiSpdMissTiOut.Val /end REF_CHARACTERISTIC /begin REF_MEASUREMENT /end REF_MEASUREMENT /end GROUP
/begin GROUP GmMsg1F5BusHiSpd.GmMsg1F5BusHiSpdPrevShiftLvrInRvs "MICROSAR RTE" /begin SUB_GROUP /end SUB_GROUP /begin FUNCTION_LIST /end FUNCTION_LIST /begin REF_CHARACTERISTIC /end REF_CHARACTERISTIC /begin REF_MEASUREMENT GmMsg1F5BusHiSpd.GmMsg1F5BusHiSpdPrevShiftLvrInRvs /end REF_MEASUREMENT /end GROUP
/begin GROUP GmMsg1F5BusHiSpd.InvldMsg1F5.Logl "MICROSAR RTE" /begin SUB_GROUP /end SUB_GROUP /begin FUNCTION_LIST /end FUNCTION_LIST /begin REF_CHARACTERISTIC /end REF_CHARACTERISTIC /begin REF_MEASUREMENT GmMsg1F5BusHiSpd.InvldMsg1F5.Logl /end REF_MEASUREMENT /end GROUP
/begin GROUP GmMsg1F5BusHiSpd.LstRxnTiMsg1F5.Val "MICROSAR RTE" /begin SUB_GROUP /end SUB_GROUP /begin FUNCTION_LIST /end FUNCTION_LIST /begin REF_CHARACTERISTIC /end REF_CHARACTERISTIC /begin REF_MEASUREMENT GmMsg1F5BusHiSpd.LstRxnTiMsg1F5.Val /end REF_MEASUREMENT /end GROUP
/begin GROUP GmMsg1F5BusHiSpd.PerInstanceMemories "MICROSAR RTE"
 /begin SUB_GROUP GmMsg1F5BusHiSpd.GmMsg1F5BusHiSpdInvldTmr GmMsg1F5BusHiSpd.GmMsg1F5BusHiSpdPrevShiftLvrInRvs /end SUB_GROUP
 /begin FUNCTION_LIST /end FUNCTION_LIST
 /begin REF_CHARACTERISTIC /end REF_CHARACTERISTIC
 /begin REF_MEASUREMENT /end REF_MEASUREMENT
/end GROUP
/begin GROUP GmMsg1F5BusHiSpd.ReceiverPorts "MICROSAR RTE"
 /begin SUB_GROUP GmMsg1F5BusHiSpd.LstRxnTiMsg1F5.Val GmMsg1F5BusHiSpd.ShiftLvrPosnRaw.Val GmMsg1F5BusHiSpd.ShiftLvrPosnVldRaw.Val /end SUB_GROUP
 /begin FUNCTION_LIST /end FUNCTION_LIST
 /begin REF_CHARACTERISTIC /end REF_CHARACTERISTIC
 /begin REF_MEASUREMENT /end REF_MEASUREMENT
/end GROUP
/begin GROUP GmMsg1F5BusHiSpd.SenderPorts "MICROSAR RTE"
 /begin SUB_GROUP GmMsg1F5BusHiSpd.InvldMsg1F5.Logl GmMsg1F5BusHiSpd.ShiftLvrInRvs.Logl /end SUB_GROUP
 /begin FUNCTION_LIST /end FUNCTION_LIST
 /begin REF_CHARACTERISTIC /end REF_CHARACTERISTIC
 /begin REF_MEASUREMENT /end REF_MEASUREMENT
/end GROUP
/begin GROUP GmMsg1F5BusHiSpd.ShiftLvrInRvs.Logl "MICROSAR RTE" /begin SUB_GROUP /end SUB_GROUP /begin FUNCTION_LIST /end FUNCTION_LIST /begin REF_CHARACTERISTIC /end REF_CHARACTERISTIC /begin REF_MEASUREMENT GmMsg1F5BusHiSpd.ShiftLvrInRvs.Logl /end REF_MEASUREMENT /end GROUP
/begin GROUP GmMsg1F5BusHiSpd.ShiftLvrPosnRaw.Val "MICROSAR RTE" /begin SUB_GROUP /end SUB_GROUP /begin FUNCTION_LIST /end FUNCTION_LIST /begin REF_CHARACTERISTIC /end REF_CHARACTERISTIC /begin REF_MEASUREMENT GmMsg1F5BusHiSpd.ShiftLvrPosnRaw.Val /end REF_MEASUREMENT /end GROUP
/begin GROUP GmMsg1F5BusHiSpd.ShiftLvrPosnVldRaw.Val "MICROSAR RTE" /begin SUB_GROUP /end SUB_GROUP /begin FUNCTION_LIST /end FUNCTION_LIST /begin REF_CHARACTERISTIC /end REF_CHARACTERISTIC /begin REF_MEASUREMENT GmMsg1F5BusHiSpd.ShiftLvrPosnVldRaw.Val /end REF_MEASUREMENT /end GROUP
/begin GROUP GmMsg214BusHiSpd "MICROSAR RTE"
 /begin SUB_GROUP GmMsg214BusHiSpd.CalibrationPorts GmMsg214BusHiSpd.PerInstanceMemories GmMsg214BusHiSpd.ReceiverPorts GmMsg214BusHiSpd.SenderPorts /end SUB_GROUP
 /begin FUNCTION_LIST /end FUNCTION_LIST
 /begin REF_CHARACTERISTIC /end REF_CHARACTERISTIC
 /begin REF_MEASUREMENT /end REF_MEASUREMENT
/end GROUP
/begin GROUP GmMsg214BusHiSpd.AbsActvProtdProtnValRaw.Val "MICROSAR RTE" /begin SUB_GROUP /end SUB_GROUP /begin FUNCTION_LIST /end FUNCTION_LIST /begin REF_CHARACTERISTIC /end REF_CHARACTERISTIC /begin REF_MEASUREMENT GmMsg214BusHiSpd.AbsActvProtdProtnValRaw.Val /end REF_MEASUREMENT /end GROUP
/begin GROUP GmMsg214BusHiSpd.AbsActvProtdRaw.Val "MICROSAR RTE" /begin SUB_GROUP /end SUB_GROUP /begin FUNCTION_LIST /end FUNCTION_LIST /begin REF_CHARACTERISTIC /end REF_CHARACTERISTIC /begin REF_MEASUREMENT GmMsg214BusHiSpd.AbsActvProtdRaw.Val /end REF_MEASUREMENT /end GROUP
/begin GROUP GmMsg214BusHiSpd.AbsActvProtdRollgCntrRaw.Val "MICROSAR RTE" /begin SUB_GROUP /end SUB_GROUP /begin FUNCTION_LIST /end FUNCTION_LIST /begin REF_CHARACTERISTIC /end REF_CHARACTERISTIC /begin REF_MEASUREMENT GmMsg214BusHiSpd.AbsActvProtdRollgCntrRaw.Val /end REF_MEASUREMENT /end GROUP
/begin GROUP GmMsg214BusHiSpd.AbsInvld.Logl "MICROSAR RTE" /begin SUB_GROUP /end SUB_GROUP /begin FUNCTION_LIST /end FUNCTION_LIST /begin REF_CHARACTERISTIC /end REF_CHARACTERISTIC /begin REF_MEASUREMENT GmMsg214BusHiSpd.AbsInvld.Logl /end REF_MEASUREMENT /end GROUP
/begin GROUP GmMsg214BusHiSpd.AbsProtd.Logl "MICROSAR RTE" /begin SUB_GROUP /end SUB_GROUP /begin FUNCTION_LIST /end FUNCTION_LIST /begin REF_CHARACTERISTIC /end REF_CHARACTERISTIC /begin REF_MEASUREMENT GmMsg214BusHiSpd.AbsProtd.Logl /end REF_MEASUREMENT /end GROUP
/begin GROUP GmMsg214BusHiSpd.CalibrationPorts "MICROSAR RTE"
 /begin SUB_GROUP GmMsg214BusHiSpd.GmMsg214BusHiSpdAbsActvProtdInvldTiOut.Val GmMsg214BusHiSpd.GmMsg214BusHiSpdAbsActvProtdProtnValInvldTiOut.Val GmMsg214BusHiSpd.GmMsg214BusHiSpdAbsActvProtdRollgCntrInvldTiOut.Val GmMsg214BusHiSpd.GmMsg214BusHiSpdMissTiOut.Val GmMsg214BusHiSpd.GmMsg214BusHiSpdRdntVehStabyEnhmtActvInvldTiOut.Val GmMsg214BusHiSpd.GmMsg214BusHiSpdRdntVehStabyEnhmtActvRollgCntrInvldTiOut.Val /end SUB_GROUP
 /begin FUNCTION_LIST /end FUNCTION_LIST
 /begin REF_CHARACTERISTIC /end REF_CHARACTERISTIC
 /begin REF_MEASUREMENT /end REF_MEASUREMENT
/end GROUP
/begin GROUP GmMsg214BusHiSpd.GmMsg214BusHiSpdAbsActvProtdInvldProtnValTmr "MICROSAR RTE" /begin SUB_GROUP /end SUB_GROUP /begin FUNCTION_LIST /end FUNCTION_LIST /begin REF_CHARACTERISTIC /end REF_CHARACTERISTIC
 /begin REF_MEASUREMENT GmMsg214BusHiSpd.GmMsg214BusHiSpdAbsActvProtdInvldProtnValTmr /end REF_MEASUREMENT
/end GROUP
/begin GROUP GmMsg214BusHiSpd.GmMsg214BusHiSpdAbsActvProtdInvldRollgCntrTmr "MICROSAR RTE" /begin SUB_GROUP /end SUB_GROUP /begin FUNCTION_LIST /end FUNCTION_LIST /begin REF_CHARACTERISTIC /end REF_CHARACTERISTIC
 /begin REF_MEASUREMENT GmMsg214BusHiSpd.GmMsg214BusHiSpdAbsActvProtdInvldRollgCntrTmr /end REF_MEASUREMENT
/end GROUP
/begin GROUP GmMsg214BusHiSpd.GmMsg214BusHiSpdAbsActvProtdInvldTiOut.Val "MICROSAR RTE" /begin SUB_GROUP /end SUB_GROUP /begin FUNCTION_LIST /end FUNCTION_LIST
 /begin REF_CHARACTERISTIC GmMsg214BusHiSpd.GmMsg214BusHiSpdAbsActvProtdInvldTiOut.Val /end REF_CHARACTERISTIC
 /begin REF_MEASUREMENT /end REF_MEASUREMENT
/end GROUP
/**********************************************************************************************************************
* RECORD_LAYOUT
*********************************************************************************************************************/
/begin RECORD_LAYOUT RTE_RL_UBYTE FNC_VALUES 1 UBYTE ROW_DIR DIRECT /end RECORD_LAYOUT
/begin RECORD_LAYOUT RTE_RL_UWORD FNC_VALUES 1 UWORD ROW_DIR DIRECT /end RECORD_LAYOUT
/begin RECORD_LAYOUT RTE_RL_SBYTE FNC_VALUES 1 SBYTE ROW_DIR DIRECT /end RECORD_LAYOUT
/begin RECORD_LAYOUT RTE_RL_FLOAT32_IEEE FNC_VALUES 1 FLOAT32_IEEE ROW_DIR DIRECT /end RECORD_LAYOUT
/begin RECORD_LAYOUT RTE_RL_BOOLEAN FNC_VALUES 1 UBYTE ROW_DIR DIRECT /end RECORD_LAYOUT
/**********************************************************************************************************************
* COMPU_METHOD / COMPU_VTAB_RANGE
*********************************************************************************************************************/
/begin COMPU_METHOD RTE_CM_BOOLEAN "" TAB_VERB "%3.1" "" COMPU_TAB_REF RTE_CM_BOOLEAN /end COMPU_METHOD
/begin COMPU_VTAB_RANGE RTE_CM_BOOLEAN "" 2 0 0 "false" 1 255 "true" /end COMPU_VTAB_RANGE
/begin COMPU_METHOD RTE_CM_ENUM_SysSt1 "" TAB_VERB "%.1" "" COMPU_TAB_REF RTE_CM_ENUM_SysSt1 /end COMPU_METHOD
/begin COMPU_VTAB_RANGE RTE_CM_ENUM_SysSt1 "" 4 0 0 "SYSST_DI" 1 1 "SYSST_OFF" 2 2 "SYSST_ENA" 3 3 "SYSST_WRMININ" /end COMPU_VTAB_RANGE
/begin COMPU_METHOD RTE_CM_ENUM_LoaSt1 "" TAB_VERB "%.1" "" COMPU_TAB_REF RTE_CM_ENUM_LoaSt1 /end COMPU_METHOD
/begin COMPU_VTAB_RANGE RTE_CM_ENUM_LoaSt1 "" 6 0 0 "LOAST_NORM" 1 1 "LOAST_LIMD" 2 2 "LOAST_SWBASDMTGTN" 3 3 "LOAST_FADEOUT" 4 4 "LOAST_CTRLDSHTDWNREQD" 5 5 "LOAST_IMDTSHTDWNREQD" /end COMPU_VTAB_RANGE
