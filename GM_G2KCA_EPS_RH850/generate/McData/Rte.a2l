/begin CHARACTERISTIC CDD_MotCurrRegVltgLimr.MotCurrRegCfgCurrLoopSecOrderTrfFcnEn.Logl "MICROSAR RTE" VALUE 0x0 RTE_RL_BOOLEAN 0 RTE_CM_BOOLEAN 0 255 SYMBOL_LINK "Rte_CalprmRom_CalRegn01Cmn_DEFAULT_RTE_CALPRM_GROUP.MotCurrRegCfgCurrLoopSecOrderTrfFctEna_Logl" 0 DISPLAY_IDENTIFIER CDD_MotCurrRegVltgLimr.CalibrationPorts.MotCurrRegCfgCurrLoopSecOrderTrfFcnEn.Logl /end CHARACTERISTIC
/begin CHARACTERISTIC CDD_MotCurrRegVltgLimr.MotCurrRegCfgMotRVirtDax.Val "MICROSAR RTE" VALUE 0x0 RTE_RL_FLOAT32_IEEE 0 NO_COMPU_METHOD 0.0 0.2 SYMBOL_LINK "Rte_CalprmRom_CalRegn01Cmn_DEFAULT_RTE_CALPRM_GROUP.MotCurrRegCfgMotRVirtDax_Val" 0 DISPLAY_IDENTIFIER CDD_MotCurrRegVltgLimr.CalibrationPorts.MotCurrRegCfgMotRVirtDax.Val /end CHARACTERISTIC
/begin CHARACTERISTIC CDD_MotCurrRegVltgLimr.MotCurrRegCfgMotRVirtQax.Val "MICROSAR RTE" VALUE 0x0 RTE_RL_FLOAT32_IEEE 0 NO_COMPU_METHOD 0.0 0.2 SYMBOL_LINK "Rte_CalprmRom_CalRegn01Cmn_DEFAULT_RTE_CALPRM_GROUP.MotCurrRegCfgMotRVirtQax_Val" 0 DISPLAY_IDENTIFIER CDD_MotCurrRegVltgLimr.CalibrationPorts.MotCurrRegCfgMotRVirtQax.Val /end CHARACTERISTIC
/begin CHARACTERISTIC CDD_MotCurrRegVltgLimr.MotCurrRegVltgLimrCurrLoaScarSlewRate.Val "MICROSAR RTE" VALUE 0x0 RTE_RL_FLOAT32_IEEE 0 NO_COMPU_METHOD 0.0 1000.0 SYMBOL_LINK "Rte_CalprmRom_CalRegn01Cmn_DEFAULT_RTE_CALPRM_GROUP.MotCurrRegVltgLimrCurrLoaScarSlewRate_Val" 0 DISPLAY_IDENTIFIER CDD_MotCurrRegVltgLimr.CalibrationPorts.MotCurrRegVltgLimrCurrLoaScarSlewRate.Val /end CHARACTERISTIC
/begin CHARACTERISTIC CDD_MotCurrRegVltgLimr.MotCurrRegVltgLimrDaxAntiWdupCoeff.Val "MICROSAR RTE" VALUE 0x0 RTE_RL_FLOAT32_IEEE 0 NO_COMPU_METHOD -25 25 SYMBOL_LINK "Rte_CalprmRom_CalRegn01Cmn_DEFAULT_RTE_CALPRM_GROUP.MotCurrRegVltgLimrDaxAntiWdupCoeff_Val" 0 DISPLAY_IDENTIFIER CDD_MotCurrRegVltgLimr.CalibrationPorts.MotCurrRegVltgLimrDaxAntiWdupCoeff.Val /end CHARACTERISTIC
/begin CHARACTERISTIC CDD_MotCurrRegVltgLimr.MotCurrRegVltgLimrDualEcuLoaScarSlewRate.Val "MICROSAR RTE" VALUE 0x0 RTE_RL_FLOAT32_IEEE 0 NO_COMPU_METHOD -3.402823466e+38 3.402823466e+38 SYMBOL_LINK "Rte_CalprmRom_CalRegn01Cmn_DEFAULT_RTE_CALPRM_GROUP.MotCurrRegVltgLimrDualEcuLoaScarSlewRate_Val" 0 DISPLAY_IDENTIFIER CDD_MotCurrRegVltgLimr.CalibrationPorts.MotCurrRegVltgLimrDualEcuLoaScarSlewRate.Val /end CHARACTERISTIC
/begin CHARACTERISTIC CDD_MotCurrRegVltgLimr.MotCurrRegVltgLimrIvtrLoaScarSlewRate.Val "MICROSAR RTE" VALUE 0x0 RTE_RL_FLOAT32_IEEE 0 NO_COMPU_METHOD 0.0 1000.0 SYMBOL_LINK "Rte_CalprmRom_CalRegn01Cmn_DEFAULT_RTE_CALPRM_GROUP.MotCurrRegVltgLimrIvtrLoaScarSlewRate_Val" 0 DISPLAY_IDENTIFIER CDD_MotCurrRegVltgLimr.CalibrationPorts.MotCurrRegVltgLimrIvtrLoaScarSlewRate.Val /end CHARACTERISTIC
/begin CHARACTERISTIC CDD_MotCurrRegVltgLimr.MotCurrRegVltgLimrMotCurrPredEna.Logl "MICROSAR RTE" VALUE 0x0 RTE_RL_BOOLEAN 0 RTE_CM_BOOLEAN 0 255 SYMBOL_LINK "Rte_CalprmRom_CalRegn01Cmn_DEFAULT_RTE_CALPRM_GROUP.MotCurrRegVltgLimrMotCurrPredEna_Logl" 0 DISPLAY_IDENTIFIER CDD_MotCurrRegVltgLimr.CalibrationPorts.MotCurrRegVltgLimrMotCurrPredEna.Logl /end CHARACTERISTIC
/begin CHARACTERISTIC CDD_MotCurrRegVltgLimr.MotCurrRegVltgLimrMotCurrPredTi.Val "MICROSAR RTE" VALUE 0x0 RTE_RL_FLOAT32_IEEE 0 NO_COMPU_METHOD -3.402823466e+38 3.402823466e+38 SYMBOL_LINK "Rte_CalprmRom_CalRegn01Cmn_DEFAULT_RTE_CALPRM_GROUP.MotCurrRegVltgLimrMotCurrPredTi_Val" 0 DISPLAY_IDENTIFIER CDD_MotCurrRegVltgLimr.CalibrationPorts.MotCurrRegVltgLimrMotCurrPredTi.Val /end CHARACTERISTIC
/begin CHARACTERISTIC CDD_MotCurrRegVltgLimr.MotCurrRegVltgLimrMotCurrQaxRefMdfnRplEna.Logl "MICROSAR RTE" VALUE 0x0 RTE_RL_BOOLEAN 0 RTE_CM_BOOLEAN 0 255 SYMBOL_LINK "Rte_CalprmRom_CalRegn01Cmn_DEFAULT_RTE_CALPRM_GROUP.MotCurrRegVltgLimrMotCurrQaxRefMdfnRplEna_Logl" 0 DISPLAY_IDENTIFIER CDD_MotCurrRegVltgLimr.CalibrationPorts.MotCurrRegVltgLimrMotCurrQaxRefMdfnRplEna.Logl /end CHARACTERISTIC
/begin CHARACTERISTIC CDD_MotCurrRegVltgLimr.MotCurrRegVltgLimrMotVltgBrdgFilEna.Logl "MICROSAR RTE" VALUE 0x0 RTE_RL_BOOLEAN 0 RTE_CM_BOOLEAN 0 255 SYMBOL_LINK "Rte_CalprmRom_CalRegn01Cmn_DEFAULT_RTE_CALPRM_GROUP.MotCurrRegVltgLimrMotVltgBrdgFilEna_Logl" 0 DISPLAY_IDENTIFIER CDD_MotCurrRegVltgLimr.CalibrationPorts.MotCurrRegVltgLimrMotVltgBrdgFilEna.Logl /end CHARACTERISTIC
/begin CHARACTERISTIC CDD_MotCurrRegVltgLimr.MotCurrRegVltgLimrMotVltgBrdgLpFilFrq.Val "MICROSAR RTE" VALUE 0x0 RTE_RL_FLOAT32_IEEE 0 NO_COMPU_METHOD -3.402823466e+38 3.402823466e+38 SYMBOL_LINK "Rte_CalprmRom_CalRegn01Cmn_DEFAULT_RTE_CALPRM_GROUP.MotCurrRegVltgLimrMotVltgBrdgLpFilFrq_Val" 0 DISPLAY_IDENTIFIER CDD_MotCurrRegVltgLimr.CalibrationPorts.MotCurrRegVltgLimrMotVltgBrdgLpFilFrq.Val /end CHARACTERISTIC
/begin CHARACTERISTIC CDD_MotCurrRegVltgLimr.MotCurrRegVltgLimrMotVltgDaxIntglHiLim.Val "MICROSAR RTE" VALUE 0x0 RTE_RL_FLOAT32_IEEE 0 NO_COMPU_METHOD -3.402823466e+38 3.402823466e+38 SYMBOL_LINK "Rte_CalprmRom_CalRegn01Cmn_DEFAULT_RTE_CALPRM_GROUP.MotCurrRegVltgLimrMotVltgDaxIntglHiLim_Val" 0 DISPLAY_IDENTIFIER CDD_MotCurrRegVltgLimr.CalibrationPorts.MotCurrRegVltgLimrMotVltgDaxIntglHiLim.Val /end CHARACTERISTIC
/begin CHARACTERISTIC CDD_MotCurrRegVltgLimr.MotCurrRegVltgLimrMotVltgDaxIntglLoLim.Val "MICROSAR RTE" VALUE 0x0 RTE_RL_FLOAT32_IEEE 0 NO_COMPU_METHOD -3.402823466e+38 3.402823466e+38 SYMBOL_LINK "Rte_CalprmRom_CalRegn01Cmn_DEFAULT_RTE_CALPRM_GROUP.MotCurrRegVltgLimrMotVltgDaxIntglLoLim_Val" 0 DISPLAY_IDENTIFIER CDD_MotCurrRegVltgLimr.CalibrationPorts.MotCurrRegVltgLimrMotVltgDaxIntglLoLim.Val /end CHARACTERISTIC
/begin CHARACTERISTIC CDD_MotCurrRegVltgLimr.MotCurrRegVltgLimrMotVltgQaxFfFilEna.Logl "MICROSAR RTE" VALUE 0x0 RTE_RL_BOOLEAN 0 RTE_CM_BOOLEAN 0 255 SYMBOL_LINK "Rte_CalprmRom_CalRegn01Cmn_DEFAULT_RTE_CALPRM_GROUP.MotCurrRegVltgLimrMotVltgQaxFfFilEna_Logl" 0 DISPLAY_IDENTIFIER CDD_MotCurrRegVltgLimr.CalibrationPorts.MotCurrRegVltgLimrMotVltgQaxFfFilEna.Logl /end CHARACTERISTIC
/begin CHARACTERISTIC CDD_MotCurrRegVltgLimr.MotCurrRegVltgLimrMotVltgQaxFfLpFilFrq.Val "MICROSAR RTE" VALUE 0x0 RTE_RL_FLOAT32_IEEE 0 NO_COMPU_METHOD -3.402823466e+38 3.402823466e+38 SYMBOL_LINK "Rte_CalprmRom_CalRegn01Cmn_DEFAULT_RTE_CALPRM_GROUP.MotCurrRegVltgLimrMotVltgQaxFfLpFilFrq_Val" 0 DISPLAY_IDENTIFIER CDD_MotCurrRegVltgLimr.CalibrationPorts.MotCurrRegVltgLimrMotVltgQaxFfLpFilFrq.Val /end CHARACTERISTIC
/begin CHARACTERISTIC CDD_MotCurrRegVltgLimr.MotCurrRegVltgLimrMotVltgQaxIntglHiLim.Val "MICROSAR RTE" VALUE 0x0 RTE_RL_FLOAT32_IEEE 0 NO_COMPU_METHOD -3.402823466e+38 3.402823466e+38 SYMBOL_LINK "Rte_CalprmRom_CalRegn01Cmn_DEFAULT_RTE_CALPRM_GROUP.MotCurrRegVltgLimrMotVltgQaxIntglHiLim_Val" 0 DISPLAY_IDENTIFIER CDD_MotCurrRegVltgLimr.CalibrationPorts.MotCurrRegVltgLimrMotVltgQaxIntglHiLim.Val /end CHARACTERISTIC
/begin CHARACTERISTIC CDD_MotCurrRegVltgLimr.MotCurrRegVltgLimrMotVltgQaxIntglLoLim.Val "MICROSAR RTE" VALUE 0x0 RTE_RL_FLOAT32_IEEE 0 NO_COMPU_METHOD -3.402823466e+38 3.402823466e+38 SYMBOL_LINK "Rte_CalprmRom_CalRegn01Cmn_DEFAULT_RTE_CALPRM_GROUP.MotCurrRegVltgLimrMotVltgQaxIntglLoLim_Val" 0 DISPLAY_IDENTIFIER CDD_MotCurrRegVltgLimr.CalibrationPorts.MotCurrRegVltgLimrMotVltgQaxIntglLoLim.Val /end CHARACTERISTIC
/begin CHARACTERISTIC CDD_MotCurrRegVltgLimr.MotCurrRegVltgLimrQaxAntiWdupCoeff.Val "MICROSAR RTE" VALUE 0x0 RTE_RL_FLOAT32_IEEE 0 NO_COMPU_METHOD -25 25 SYMBOL_LINK "Rte_CalprmRom_CalRegn01Cmn_DEFAULT_RTE_CALPRM_GROUP.MotCurrRegVltgLimrQaxAntiWdupCoeff_Val" 0 DISPLAY_IDENTIFIER CDD_MotCurrRegVltgLimr.CalibrationPorts.MotCurrRegVltgLimrQaxAntiWdupCoeff.Val /end CHARACTERISTIC
/begin CHARACTERISTIC CDD_MotCurrRegVltgLimr.MotCurrRegVltgLimrQaxAntiWdupScagDi.Logl "MICROSAR RTE" VALUE 0x0 RTE_RL_BOOLEAN 0 RTE_CM_BOOLEAN 0 255 SYMBOL_LINK "Rte_CalprmRom_CalRegn01Cmn_DEFAULT_RTE_CALPRM_GROUP.MotCurrRegVltgLimrQaxAntiWdupScagDi_Logl" 0 DISPLAY_IDENTIFIER CDD_MotCurrRegVltgLimr.CalibrationPorts.MotCurrRegVltgLimrQaxAntiWdupScagDi.Logl /end CHARACTERISTIC
/begin CHARACTERISTIC CDD_MotCurrRegVltgLimr.MotRefMdlFbCtrlDi.Logl "MICROSAR RTE" VALUE 0x0 RTE_RL_BOOLEAN 0 RTE_CM_BOOLEAN 0 255 SYMBOL_LINK "Rte_CalprmRom_CalRegn01Cmn_DEFAULT_RTE_CALPRM_GROUP.MotRefMdlFbCtrlDi_Logl" 0 DISPLAY_IDENTIFIER CDD_MotCurrRegVltgLimr.CalibrationPorts.MotRefMdlFbCtrlDi.Logl /end CHARACTERISTIC
/begin CHARACTERISTIC CDD_MotCurrRegVltgLimr.MotRefMdlIvtrDeadTiBrdgVltgSca.Val "MICROSAR RTE" VALUE 0x0 RTE_RL_FLOAT32_IEEE 0 NO_COMPU_METHOD 0.98 1 SYMBOL_LINK "Rte_CalprmRom_CalRegn01Cmn_DEFAULT_RTE_CALPRM_GROUP.MotRefMdlIvtrDeadTiBrdgVltgSca_Val" 0 DISPLAY_IDENTIFIER CDD_MotCurrRegVltgLimr.CalibrationPorts.MotRefMdlIvtrDeadTiBrdgVltgSca.Val /end CHARACTERISTIC
/begin CHARACTERISTIC CDD_MotRplCoggCmd.MotRplCoggCmdHrmncOrder1Elec.Val "MICROSAR RTE" VALUE 0x0 RTE_RL_UBYTE 0 NO_COMPU_METHOD 0 255 SYMBOL_LINK "Rte_CalprmRom_CalRegn01Cmn_DEFAULT_RTE_CALPRM_GROUP.MotRplCoggCmdHrmncOrder1Elec_Val" 0 DISPLAY_IDENTIFIER CDD_MotRplCoggCmd.CalibrationPorts.MotRplCoggCmdHrmncOrder1Elec.Val /end CHARACTERISTIC
/begin CHARACTERISTIC CDD_MotRplCoggCmd.MotRplCoggCmdHrmncOrder2Elec.Val "MICROSAR RTE" VALUE 0x0 RTE_RL_UBYTE 0 NO_COMPU_METHOD 0 255 SYMBOL_LINK "Rte_CalprmRom_CalRegn01Cmn_DEFAULT_RTE_CALPRM_GROUP.MotRplCoggCmdHrmncOrder2Elec_Val" 0 DISPLAY_IDENTIFIER CDD_MotRplCoggCmd.CalibrationPorts.MotRplCoggCmdHrmncOrder2Elec.Val /end CHARACTERISTIC
/begin CHARACTERISTIC CDD_MotRplCoggCmd.MotRplCoggCmdHrmncOrder3Elec.Val "MICROSAR RTE" VALUE 0x0 RTE_RL_UBYTE 0 NO_COMPU_METHOD 0 255 SYMBOL_LINK "Rte_CalprmRom_CalRegn01Cmn_DEFAULT_RTE_CALPRM_GROUP.MotRplCoggCmdHrmncOrder3Elec_Val" 0 DISPLAY_IDENTIFIER CDD_MotRplCoggCmd.CalibrationPorts.MotRplCoggCmdHrmncOrder3Elec.Val /end CHARACTERISTIC
/begin CHARACTERISTIC CDD_MotVel.SysGlbPrmSysKineRat.Val "MICROSAR RTE" VALUE 0x0 RTE_RL_FLOAT32_IEEE 0 NO_COMPU_METHOD 10 40 SYMBOL_LINK "Rte_CalprmRom_CalRegn03Inin00_DEFAULT_RTE_CALPRM_GROUP.SysGlbPrmSysKineRat_Val" 0 DISPLAY_IDENTIFIER CDD_MotVel.CalibrationPorts.SysGlbPrmSysKineRat.Val /end CHARACTERISTIC
/begin CHARACTERISTIC CDD_SinVltgGenn.SinVltgGennDthrLpFilCoeff.Val "MICROSAR RTE" VALUE 0x0 RTE_RL_FLOAT32_IEEE 0 NO_COMPU_METHOD 0.0 1.0 SYMBOL_LINK "Rte_CalprmRom_CalRegn01Cmn_DEFAULT_RTE_CALPRM_GROUP.SinVltgGennDthrLpFilCoeff_Val" 0 DISPLAY_IDENTIFIER CDD_SinVltgGenn.CalibrationPorts.SinVltgGennDthrLpFilCoeff.Val /end CHARACTERISTIC
/begin CHARACTERISTIC CDD_SnsrMeasStrt.SnsrMeasStrtTrigDly.Val "MICROSAR RTE" VALUE 0x0 RTE_RL_UWORD 0 NO_COMPU_METHOD 0 65535 SYMBOL_LINK "Rte_CalprmRom_CalRegn01Inin00_DEFAULT_RTE_CALPRM_GROUP.SnsrMeasStrtTrigDly_Val" 0 DISPLAY_IDENTIFIER CDD_SnsrMeasStrt.CalibrationPorts.SnsrMeasStrtTrigDly.Val /end CHARACTERISTIC
/begin CHARACTERISTIC CDD_TSG31CfgAndUse.CurrMeasEolFixdPwmPerd.Val "MICROSAR RTE" VALUE 0x0 RTE_RL_ULONG 0 NO_COMPU_METHOD 55555 71429 SYMBOL_LINK "Rte_CalprmRom_CalRegn01Cmn_DEFAULT_RTE_CALPRM_GROUP.CurrMeasEolFixdPwmPerd_Val" 0 DISPLAY_IDENTIFIER CDD_TSG31CfgAndUse.CalibrationPorts.CurrMeasEolFixdPwmPerd.Val /end CHARACTERISTIC
/begin CHARACTERISTIC CDD_TSG31CfgAndUse.CurrMeasEolOffsHiCmuOffs.Val "MICROSAR RTE" VALUE 0x0 RTE_RL_ULONG 0 NO_COMPU_METHOD 0 71429 SYMBOL_LINK "Rte_CalprmRom_CalRegn01Cmn_DEFAULT_RTE_CALPRM_GROUP.CurrMeasEolOffsHiCmuOffs_Val" 0 DISPLAY_IDENTIFIER CDD_TSG31CfgAndUse.CalibrationPorts.CurrMeasEolOffsHiCmuOffs.Val /end CHARACTERISTIC
/begin CHARACTERISTIC CDD_TSG31CfgAndUse.CurrMeasEolOffsLoCmuOffs.Val "MICROSAR RTE" VALUE 0x0 RTE_RL_ULONG 0 NO_COMPU_METHOD 0 71429 SYMBOL_LINK "Rte_CalprmRom_CalRegn01Cmn_DEFAULT_RTE_CALPRM_GROUP.CurrMeasEolOffsLoCmuOffs_Val" 0 DISPLAY_IDENTIFIER CDD_TSG31CfgAndUse.CalibrationPorts.CurrMeasEolOffsLoCmuOffs.Val /end CHARACTERISTIC
/begin CHARACTERISTIC CDD_TSG31CfgAndUse.TSG31CfgAndUseAdcStrtOfCnvn2Offs.Val "MICROSAR RTE" VALUE 0x0 RTE_RL_ULONG 0 NO_COMPU_METHOD 0 25000 SYMBOL_LINK "Rte_CalprmRom_CalRegn01Cmn_DEFAULT_RTE_CALPRM_GROUP.TSG31CfgAndUseAdcStrtOfCnvn2Offs_Val" 0 DISPLAY_IDENTIFIER CDD_TSG31CfgAndUse.CalibrationPorts.TSG31CfgAndUseAdcStrtOfCnvn2Offs.Val /end CHARACTERISTIC
/begin CHARACTERISTIC CDD_TSG31CfgAndUse.TSG31CfgAndUseAdcStrtOfCnvnMotCtrlPeakOffs.Val "MICROSAR RTE" VALUE 0x0 RTE_RL_ULONG 0 NO_COMPU_METHOD 0 25000 SYMBOL_LINK "Rte_CalprmRom_CalRegn01Cmn_DEFAULT_RTE_CALPRM_GROUP.TSG31CfgAndUseAdcStrtOfCnvnMotCtrlPeakOffs_Val" 0 DISPLAY_IDENTIFIER CDD_TSG31CfgAndUse.CalibrationPorts.TSG31CfgAndUseAdcStrtOfCnvnMotCtrlPeakOffs.Val /end CHARACTERISTIC
/begin CHARACTERISTIC CDD_TSG31CfgAndUse.TSG31CfgAndUseAdcStrtOfCnvnMotCtrlVlyOffs.Val "MICROSAR RTE" VALUE 0x0 RTE_RL_ULONG 0 NO_COMPU_METHOD 0 25000 SYMBOL_LINK "Rte_CalprmRom_CalRegn01Cmn_DEFAULT_RTE_CALPRM_GROUP.TSG31CfgAndUseAdcStrtOfCnvnMotCtrlVlyOffs_Val" 0 DISPLAY_IDENTIFIER CDD_TSG31CfgAndUse.CalibrationPorts.TSG31CfgAndUseAdcStrtOfCnvnMotCtrlVlyOffs.Val /end CHARACTERISTIC
/begin CHARACTERISTIC CDD_TSG31CfgAndUse.TSG31CfgAndUseMtrAg0SPIStart.Val "MICROSAR RTE" VALUE 0x0 RTE_RL_ULONG 0 NO_COMPU_METHOD 0 71429 SYMBOL_LINK "Rte_CalprmRom_CalRegn01Cmn_DEFAULT_RTE_CALPRM_GROUP.TSG31CfgAndUseMtrAg0SPIStart_Val" 0 DISPLAY_IDENTIFIER CDD_TSG31CfgAndUse.CalibrationPorts.TSG31CfgAndUseMtrAg0SPIStart.Val /end CHARACTERISTIC
/begin CHARACTERISTIC CDD_TSG31CfgAndUse.TSG31CfgAndUsePwmDbnd.Val "MICROSAR RTE" VALUE 0x0 RTE_RL_ULONG 0 NO_COMPU_METHOD 1 1000 SYMBOL_LINK "Rte_CalprmRom_CalRegn01Cmn_DEFAULT_RTE_CALPRM_GROUP.TSG31CfgAndUsePwmDbnd_Val" 0 DISPLAY_IDENTIFIER CDD_TSG31CfgAndUse.CalibrationPorts.TSG31CfgAndUsePwmDbnd.Val /end CHARACTERISTIC
/begin CHARACTERISTIC CalRegn01Cmn.AdcDiagcNtc0x032FailStep.Val "MICROSAR RTE" VALUE 0x0 RTE_RL_UWORD 0 NO_COMPU_METHOD 0 65535 SYMBOL_LINK "Rte_CalprmRom_CalRegn01Cmn_DEFAULT_RTE_CALPRM_GROUP.AdcDiagcNtc0x032FailStep_Val" 0 DISPLAY_IDENTIFIER CalRegn01Cmn.CalibrationPorts.AdcDiagcNtc0x032FailStep.Val /end CHARACTERISTIC
/begin CHARACTERISTIC CalRegn01Cmn.AdcDiagcNtc0x032PassStep.Val "MICROSAR RTE" VALUE 0x0 RTE_RL_UWORD 0 NO_COMPU_METHOD 0 65535 SYMBOL_LINK "Rte_CalprmRom_CalRegn01Cmn_DEFAULT_RTE_CALPRM_GROUP.AdcDiagcNtc0x032PassStep_Val" 0 DISPLAY_IDENTIFIER CalRegn01Cmn.CalibrationPorts.AdcDiagcNtc0x032PassStep.Val /end CHARACTERISTIC
/begin CHARACTERISTIC CalRegn01Cmn.AdcDiagcNtc0x033FailStep.Val "MICROSAR RTE" VALUE 0x0 RTE_RL_UWORD 0 NO_COMPU_METHOD 0 65535 SYMBOL_LINK "Rte_CalprmRom_CalRegn01Cmn_DEFAULT_RTE_CALPRM_GROUP.AdcDiagcNtc0x033FailStep_Val" 0 DISPLAY_IDENTIFIER CalRegn01Cmn.CalibrationPorts.AdcDiagcNtc0x033FailStep.Val /end CHARACTERISTIC
/begin CHARACTERISTIC CalRegn01Cmn.AdcDiagcNtc0x033PassStep.Val "MICROSAR RTE" VALUE 0x0 RTE_RL_UWORD 0 NO_COMPU_METHOD 0 65535 SYMBOL_LINK "Rte_CalprmRom_CalRegn01Cmn_DEFAULT_RTE_CALPRM_GROUP.AdcDiagcNtc0x033PassStep_Val" 0 DISPLAY_IDENTIFIER CalRegn01Cmn.CalibrationPorts.AdcDiagcNtc0x033PassStep.Val /end CHARACTERISTIC
/begin CHARACTERISTIC CalRegn01Cmn.AssiPahFwlDiRcvr.Logl "MICROSAR RTE" VALUE 0x0 RTE_RL_BOOLEAN 0 RTE_CM_BOOLEAN 0 255 SYMBOL_LINK "Rte_CalprmRom_CalRegn01Cmn_DEFAULT_RTE_CALPRM_GROUP.AssiPahFwlDiRcvr_Logl" 0 DISPLAY_IDENTIFIER CalRegn01Cmn.CalibrationPorts.AssiPahFwlDiRcvr.Logl /end CHARACTERISTIC
/begin CHARACTERISTIC CalRegn01Cmn.AssiPahFwlVehSpd.Ary1D "MICROSAR RTE" VAL_BLK 0x0 RTE_RL_UWORD 0 NO_COMPU_METHOD 0 65535 MATRIX_DIM 12 1 1 SYMBOL_LINK "Rte_CalprmRom_CalRegn01Cmn_DEFAULT_RTE_CALPRM_GROUP.AssiPahFwlVehSpd_Ary1D" 0 DISPLAY_IDENTIFIER CalRegn01Cmn.CalibrationPorts.AssiPahFwlVehSpd.Ary1D /end CHARACTERISTIC
/begin CHARACTERISTIC CalRegn01Cmn.AssiSumLimNtc0x0C4FailStep.Val "MICROSAR RTE" VALUE 0x0 RTE_RL_UWORD 0 NO_COMPU_METHOD 0 65535 SYMBOL_LINK "Rte_CalprmRom_CalRegn01Cmn_DEFAULT_RTE_CALPRM_GROUP.AssiSumLimNtc0x0C4FailStep_Val" 0 DISPLAY_IDENTIFIER CalRegn01Cmn.CalibrationPorts.AssiSumLimNtc0x0C4FailStep.Val /end CHARACTERISTIC
/begin CHARACTERISTIC CalRegn01Cmn.AssiSumLimNtc0x0C4PassStep.Val "MICROSAR RTE" VALUE 0x0 RTE_RL_UWORD 0 NO_COMPU_METHOD 0 65535 SYMBOL_LINK "Rte_CalprmRom_CalRegn01Cmn_DEFAULT_RTE_CALPRM_GROUP.AssiSumLimNtc0x0C4PassStep_Val" 0 DISPLAY_IDENTIFIER CalRegn01Cmn.CalibrationPorts.AssiSumLimNtc0x0C4PassStep.Val /end CHARACTERISTIC
/begin CHARACTERISTIC CalRegn01Cmn.AssiSumLimPullCmpLim.Val "MICROSAR RTE" VALUE 0x0 RTE_RL_FLOAT32_IEEE 0 NO_COMPU_METHOD 0 8.8 SYMBOL_LINK "Rte_CalprmRom_CalRegn01Cmn_DEFAULT_RTE_CALPRM_GROUP.AssiSumLimPullCmpLim_Val" 0 DISPLAY_IDENTIFIER CalRegn01Cmn.CalibrationPorts.AssiSumLimPullCmpLim.Val /end CHARACTERISTIC
/begin CHARACTERISTIC CalRegn01Cmn.BasAssiPahFwlOverLimDiagcFailStep.Val "MICROSAR RTE" VALUE 0x0 RTE_RL_UWORD 0 NO_COMPU_METHOD 0 65535 SYMBOL_LINK "Rte_CalprmRom_CalRegn01Cmn_DEFAULT_RTE_CALPRM_GROUP.BasAssiPahFwlOverLimDiagcFailStep_Val" 0 DISPLAY_IDENTIFIER CalRegn01Cmn.CalibrationPorts.BasAssiPahFwlOverLimDiagcFailStep.Val /end CHARACTERISTIC
/begin CHARACTERISTIC CalRegn01Cmn.BasAssiPahFwlOverLimDiagcPassStep.Val "MICROSAR RTE" VALUE 0x0 RTE_RL_UWORD 0 NO_COMPU_METHOD 0 65535 SYMBOL_LINK "Rte_CalprmRom_CalRegn01Cmn_DEFAULT_RTE_CALPRM_GROUP.BasAssiPahFwlOverLimDiagcPassStep_Val" 0 DISPLAY_IDENTIFIER CalRegn01Cmn.CalibrationPorts.BasAssiPahFwlOverLimDiagcPassStep.Val /end CHARACTERISTIC
/begin CHARACTERISTIC CalRegn01Cmn.BattVltgCorrlnAllwdVltgDif.Val "MICROSAR RTE" VALUE 0x0 RTE_RL_FLOAT32_IEEE 0 NO_COMPU_METHOD -3.402823466e+38 3.402823466e+38 SYMBOL_LINK "Rte_CalprmRom_CalRegn01Cmn_DEFAULT_RTE_CALPRM_GROUP.BattVltgCorrlnAllwdVltgDif_Val" 0 DISPLAY_IDENTIFIER CalRegn01Cmn.CalibrationPorts.BattVltgCorrlnAllwdVltgDif.Val /end CHARACTERISTIC
/begin CHARACTERISTIC CalRegn01Cmn.BattVltgCorrlnBattLoVltg.Val "MICROSAR RTE" VALUE 0x0 RTE_RL_FLOAT32_IEEE 0 NO_COMPU_METHOD -3.402823466e+38 3.402823466e+38 SYMBOL_LINK "Rte_CalprmRom_CalRegn01Cmn_DEFAULT_RTE_CALPRM_GROUP.BattVltgCorrlnBattLoVltg_Val" 0 DISPLAY_IDENTIFIER CalRegn01Cmn.CalibrationPorts.BattVltgCorrlnBattLoVltg.Val /end CHARACTERISTIC
/begin CHARACTERISTIC CalRegn01Cmn.BattVltgCorrlnBattOverVltg.Val "MICROSAR RTE" VALUE 0x0 RTE_RL_FLOAT32_IEEE 0 NO_COMPU_METHOD -3.402823466e+38 3.402823466e+38 SYMBOL_LINK "Rte_CalprmRom_CalRegn01Cmn_DEFAULT_RTE_CALPRM_GROUP.BattVltgCorrlnBattOverVltg_Val" 0 DISPLAY_IDENTIFIER CalRegn01Cmn.CalibrationPorts.BattVltgCorrlnBattOverVltg.Val /end CHARACTERISTIC
/begin CHARACTERISTIC CalRegn01Cmn.BattVltgCorrlnBattUnderVltg.Val "MICROSAR RTE" VALUE 0x0 RTE_RL_FLOAT32_IEEE 0 NO_COMPU_METHOD -3.402823466e+38 3.402823466e+38 SYMBOL_LINK "Rte_CalprmRom_CalRegn01Cmn_DEFAULT_RTE_CALPRM_GROUP.BattVltgCorrlnBattUnderVltg_Val" 0 DISPLAY_IDENTIFIER CalRegn01Cmn.CalibrationPorts.BattVltgCorrlnBattUnderVltg.Val /end CHARACTERISTIC
/begin CHARACTERISTIC CalRegn01Cmn.BattVltgCorrlnNtc0x03C0x0440x04CFailStep.Val "MICROSAR RTE" VALUE 0x0 RTE_RL_UWORD 0 NO_COMPU_METHOD 0 65535 SYMBOL_LINK "Rte_CalprmRom_CalRegn01Cmn_DEFAULT_RTE_CALPRM_GROUP.BattVltgCorrlnNtc0x03C0x0440x04CFailStep_Val" 0 DISPLAY_IDENTIFIER CalRegn01Cmn.CalibrationPorts.BattVltgCorrlnNtc0x03C0x0440x04CFailStep.Val /end CHARACTERISTIC
/begin CHARACTERISTIC CalRegn01Cmn.BattVltgCorrlnNtc0x03C0x0440x04CPassStep.Val "MICROSAR RTE" VALUE 0x0 RTE_RL_UWORD 0 NO_COMPU_METHOD 0 65535 SYMBOL_LINK "Rte_CalprmRom_CalRegn01Cmn_DEFAULT_RTE_CALPRM_GROUP.BattVltgCorrlnNtc0x03C0x0440x04CPassStep_Val" 0 DISPLAY_IDENTIFIER CalRegn01Cmn.CalibrationPorts.BattVltgCorrlnNtc0x03C0x0440x04CPassStep.Val /end CHARACTERISTIC
/begin CHARACTERISTIC CalRegn01Cmn.BattVltgCorrlnNtc0x03DFailStep.Val "MICROSAR RTE" VALUE 0x0 RTE_RL_UWORD 0 NO_COMPU_METHOD 0 65535 SYMBOL_LINK "Rte_CalprmRom_CalRegn01Cmn_DEFAULT_RTE_CALPRM_GROUP.BattVltgCorrlnNtc0x03DFailStep_Val" 0 DISPLAY_IDENTIFIER CalRegn01Cmn.CalibrationPorts.BattVltgCorrlnNtc0x03DFailStep.Val /end CHARACTERISTIC
/begin CHARACTERISTIC CalRegn01Cmn.BattVltgCorrlnNtc0x03DPassStep.Val "MICROSAR RTE" VALUE 0x0 RTE_RL_UWORD 0 NO_COMPU_METHOD 0 65535 SYMBOL_LINK "Rte_CalprmRom_CalRegn01Cmn_DEFAULT_RTE_CALPRM_GROUP.BattVltgCorrlnNtc0x03DPassStep_Val" 0 DISPLAY_IDENTIFIER CalRegn01Cmn.CalibrationPorts.BattVltgCorrlnNtc0x03DPassStep.Val /end CHARACTERISTIC
/begin CHARACTERISTIC CalRegn01Cmn.BattVltgCorrlnNtc0x0B0FailStep.Val "MICROSAR RTE" VALUE 0x0 RTE_RL_UWORD 0 NO_COMPU_METHOD 0 65535 SYMBOL_LINK "Rte_CalprmRom_CalRegn01Cmn_DEFAULT_RTE_CALPRM_GROUP.BattVltgCorrlnNtc0x0B0FailStep_Val" 0 DISPLAY_IDENTIFIER CalRegn01Cmn.CalibrationPorts.BattVltgCorrlnNtc0x0B0FailStep.Val /end CHARACTERISTIC
/begin CHARACTERISTIC CalRegn01Cmn.BattVltgCorrlnNtc0x0B0PassStep.Val "MICROSAR RTE" VALUE 0x0 RTE_RL_UWORD 0 NO_COMPU_METHOD 0 65535 SYMBOL_LINK "Rte_CalprmRom_CalRegn01Cmn_DEFAULT_RTE_CALPRM_GROUP.BattVltgCorrlnNtc0x0B0PassStep_Val" 0 DISPLAY_IDENTIFIER CalRegn01Cmn.CalibrationPorts.BattVltgCorrlnNtc0x0B0PassStep.Val /end CHARACTERISTIC
/begin MEASUREMENT CDD_MotCtrlMgr.IvtrLoaMtgtnEna.Logl "MICROSAR RTE" UBYTE RTE_CM_BOOLEAN 0 0 0 255 ECU_ADDRESS 0 SYMBOL_LINK "Rte_LoaMgr_IvtrLoaMtgtnEna_Logl" 0 DISPLAY_IDENTIFIER CDD_MotCtrlMgr.ReceiverPorts.IvtrLoaMtgtnEna.Logl /end MEASUREMENT
/begin MEASUREMENT CDD_MotCtrlMgr.LoopCntr2MilliSec.Val "MICROSAR RTE" UWORD NO_COMPU_METHOD 0 0 0 65535 ECU_ADDRESS 0 SYMBOL_LINK "Rte_CDD_McuDiagc_LoopCntr2MilliSec_Val" 0 DISPLAY_IDENTIFIER CDD_MotCtrlMgr.ReceiverPorts.LoopCntr2MilliSec.Val /end MEASUREMENT
/begin MEASUREMENT CDD_MotCtrlMgr.MotAg0Mecl.Val "MICROSAR RTE" UWORD RTE_CM_Ag5 0 0 0 0 ECU_ADDRESS 0 SYMBOL_LINK "Rte_CDD_MotCtrlMgr_MotAg0Mecl_Val" 0 DISPLAY_IDENTIFIER CDD_MotCtrlMgr.SenderPorts.MotAg0Mecl.Val /end MEASUREMENT
/begin MEASUREMENT CDD_MotCtrlMgr.MotAg0MeclQlfr.Val "MICROSAR RTE" UBYTE RTE_CM_ENUM_SigQlfr1 0 0 0 255 ECU_ADDRESS 0 SYMBOL_LINK "Rte_CDD_MotAg0Meas_MotAg0MeclQlfr_Val" 0 DISPLAY_IDENTIFIER CDD_MotCtrlMgr.ReceiverPorts.MotAg0MeclQlfr.Val /end MEASUREMENT
/begin MEASUREMENT CDD_MotCtrlMgr.MotAg0MeclRollgCntr.Val "MICROSAR RTE" UBYTE NO_COMPU_METHOD 0 0 0 255 ECU_ADDRESS 0 SYMBOL_LINK "Rte_CDD_MotAg0Meas_MotAg0MeclRollgCntr_Val" 0 DISPLAY_IDENTIFIER CDD_MotCtrlMgr.ReceiverPorts.MotAg0MeclRollgCntr.Val /end MEASUREMENT
/begin MEASUREMENT CDD_MotCtrlMgr.MotAg0Offs.Val "MICROSAR RTE" SLONG NO_COMPU_METHOD 0 0 -2147483648 2147483647 ECU_ADDRESS 0 SYMBOL_LINK "Rte_CDD_MotAg0Meas_MotAg0Offs_Val" 0 DISPLAY_IDENTIFIER CDD_MotCtrlMgr.ReceiverPorts.MotAg0Offs.Val /end MEASUREMENT
/begin MEASUREMENT CDD_MotCtrlMgr.MotAg1Mecl.Val "MICROSAR RTE" UWORD RTE_CM_Ag5 0 0 0 0 ECU_ADDRESS 0 SYMBOL_LINK "Rte_CDD_MotCtrlMgr_MotAg1Mecl_Val" 0 DISPLAY_IDENTIFIER CDD_MotCtrlMgr.SenderPorts.MotAg1Mecl.Val /end MEASUREMENT
/begin MEASUREMENT CDD_MotCtrlMgr.MotAg1MeclQlfr.Val "MICROSAR RTE" UBYTE RTE_CM_ENUM_SigQlfr1 0 0 0 255 ECU_ADDRESS 0 SYMBOL_LINK "Rte_CDD_MotAg1Meas_MotAg1MeclQlfr_Val" 0 DISPLAY_IDENTIFIER CDD_MotCtrlMgr.ReceiverPorts.MotAg1MeclQlfr.Val /end MEASUREMENT
/begin MEASUREMENT CDD_MotCtrlMgr.MotAg1MeclRollgCntr.Val "MICROSAR RTE" UBYTE NO_COMPU_METHOD 0 0 0 255 ECU_ADDRESS 0 SYMBOL_LINK "Rte_CDD_MotAg1Meas_MotAg1MeclRollgCntr_Val" 0 DISPLAY_IDENTIFIER CDD_MotCtrlMgr.ReceiverPorts.MotAg1MeclRollgCntr.Val /end MEASUREMENT
/begin MEASUREMENT CDD_MotCtrlMgr.MotAg1Offs.Val "MICROSAR RTE" SLONG NO_COMPU_METHOD 0 0 -2147483648 2147483647 ECU_ADDRESS 0 SYMBOL_LINK "Rte_CDD_MotAg1Meas_MotAg1Offs_Val" 0 DISPLAY_IDENTIFIER CDD_MotCtrlMgr.ReceiverPorts.MotAg1Offs.Val /end MEASUREMENT
/begin MEASUREMENT CDD_MotCtrlMgr.MotAgBuf.Ary1D "MICROSAR RTE" UWORD RTE_CM_Ag5 0 0 0 0 MATRIX_DIM 8 1 1 ECU_ADDRESS 0 SYMBOL_LINK "Rte_CDD_MotCtrlMgr_MotAgBuf_Ary1D" 0 DISPLAY_IDENTIFIER CDD_MotCtrlMgr.SenderPorts.MotAgBuf.Ary1D /end MEASUREMENT
/begin MEASUREMENT CDD_MotCtrlMgr.MotAgBufIdx.Val "MICROSAR RTE" UBYTE NO_COMPU_METHOD 0 0 0 7 ECU_ADDRESS 0 SYMBOL_LINK "Rte_CDD_MotCtrlMgr_MotAgBufIdx_Val" 0 DISPLAY_IDENTIFIER CDD_MotCtrlMgr.SenderPorts.MotAgBufIdx.Val /end MEASUREMENT
/begin MEASUREMENT CDD_MotCtrlMgr.MotAgCumvAlgndMrfRev.Val "MICROSAR RTE" SLONG RTE_CM_Ag8 0 0 0 0 ECU_ADDRESS 0 SYMBOL_LINK "Rte_CDD_MotCtrlMgr_MotAgCumvAlgndMrfRev_Val" 0 DISPLAY_IDENTIFIER CDD_MotCtrlMgr.SenderPorts.MotAgCumvAlgndMrfRev.Val /end MEASUREMENT
/begin MEASUREMENT CDD_MotCtrlMgr.MotAgElecDly.Val "MICROSAR RTE" FLOAT32_IEEE NO_COMPU_METHOD 0 0 -1.62 1.62 ECU_ADDRESS 0 SYMBOL_LINK "Rte_MotCurrRegCfg_MotAgElecDly_Val" 0 DISPLAY_IDENTIFIER CDD_MotCtrlMgr.ReceiverPorts.MotAgElecDly.Val /end MEASUREMENT
/begin MEASUREMENT CDD_MotCtrlMgr.MotAgElecDlyRpl.Val "MICROSAR RTE" FLOAT32_IEEE NO_COMPU_METHOD 0 0 -3.402823466e+38 3.402823466e+38 ECU_ADDRESS 0 SYMBOL_LINK "Rte_MotRplCoggCfg_MotAgElecDlyRpl_Val" 0 DISPLAY_IDENTIFIER CDD_MotCtrlMgr.ReceiverPorts.MotAgElecDlyRpl.Val /end MEASUREMENT
/begin MEASUREMENT CDD_MotCtrlMgr.MotAgMecl0Polarity.Val "MICROSAR RTE" SBYTE NO_COMPU_METHOD 0 0 -1.0 1.0 ECU_ADDRESS 0 SYMBOL_LINK "Rte_PolarityCfg_MotAgMecl0Polarity_Val" 0 DISPLAY_IDENTIFIER CDD_MotCtrlMgr.ReceiverPorts.MotAgMecl0Polarity.Val /end MEASUREMENT
/begin MEASUREMENT CDD_MotCtrlMgr.MotAgMecl1Polarity.Val "MICROSAR RTE" SBYTE NO_COMPU_METHOD 0 0 -1.0 1.0 ECU_ADDRESS 0 SYMBOL_LINK "Rte_PolarityCfg_MotAgMecl1Polarity_Val" 0 DISPLAY_IDENTIFIER CDD_MotCtrlMgr.ReceiverPorts.MotAgMecl1Polarity.Val /end MEASUREMENT
/begin MEASUREMENT CDD_MotCtrlMgr.MotAgMeclCorrlnSt.Val "MICROSAR RTE" UBYTE NO_COMPU_METHOD 0 0 0 7 ECU_ADDRESS 0 SYMBOL_LINK "Rte_MotAgCorrln_MotAgMeclCorrlnSt_Val" 0 DISPLAY_IDENTIFIER CDD_MotCtrlMgr.ReceiverPorts.MotAgMeclCorrlnSt.Val /end MEASUREMENT
/begin MEASUREMENT CDD_MotCtrlMgr.MotAgTiBuf.Ary1D "MICROSAR RTE" ULONG NO_COMPU_METHOD 0 0 0 4294967295 MATRIX_DIM 8 1 1 ECU_ADDRESS 0 SYMBOL_LINK "Rte_CDD_MotCtrlMgr_MotAgTiBuf_Ary1D" 0 DISPLAY_IDENTIFIER CDD_MotCtrlMgr.SenderPorts.MotAgTiBuf.Ary1D /end MEASUREMENT
/begin MEASUREMENT CDD_MotCtrlMgr.MotCurrAdcVlyA.Val "MICROSAR RTE" FLOAT32_IEEE NO_COMPU_METHOD 0 0 0.0 5.0 ECU_ADDRESS 0 SYMBOL_LINK "Rte_CDD_MotCtrlMgr_MotCurrAdcVlyA_Val" 0 DISPLAY_IDENTIFIER CDD_MotCtrlMgr.SenderPorts.MotCurrAdcVlyA.Val /end MEASUREMENT
/begin MEASUREMENT CDD_MotCtrlMgr.MotCurrAdcVlyAAdcFaild.Logl "MICROSAR RTE" UBYTE RTE_CM_BOOLEAN 0 0 0 255 ECU_ADDRESS 0 SYMBOL_LINK "Rte_CDD_GmG2kcaMcuCfg_MotCurrAdcVlyAAdcFaild_Logl" 0 DISPLAY_IDENTIFIER CDD_MotCtrlMgr.ReceiverPorts.MotCurrAdcVlyAAdcFaild.Logl /end MEASUREMENT
/begin MEASUREMENT CDD_MotCtrlMgr.MotCurrAdcVlyB.Val "MICROSAR RTE" FLOAT32_IEEE NO_COMPU_METHOD 0 0 0.0 5.0 ECU_ADDRESS 0 SYMBOL_LINK "Rte_CDD_MotCtrlMgr_MotCurrAdcVlyB_Val" 0 DISPLAY_IDENTIFIER CDD_MotCtrlMgr.SenderPorts.MotCurrAdcVlyB.Val /end MEASUREMENT
/begin MEASUREMENT CDD_MotCtrlMgr.MotCurrAdcVlyBAdcFaild.Logl "MICROSAR RTE" UBYTE RTE_CM_BOOLEAN 0 0 0 255 ECU_ADDRESS 0 SYMBOL_LINK "Rte_CDD_GmG2kcaMcuCfg_MotCurrAdcVlyBAdcFaild_Logl" 0 DISPLAY_IDENTIFIER CDD_MotCtrlMgr.ReceiverPorts.MotCurrAdcVlyBAdcFaild.Logl /end MEASUREMENT
/begin MEASUREMENT CDD_MotCtrlMgr.MotCurrAdcVlyC.Val "MICROSAR RTE" FLOAT32_IEEE NO_COMPU_METHOD 0 0 0.0 5.0 ECU_ADDRESS 0 SYMBOL_LINK "Rte_CDD_MotCtrlMgr_MotCurrAdcVlyC_Val" 0 DISPLAY_IDENTIFIER CDD_MotCtrlMgr.SenderPorts.MotCurrAdcVlyC.Val /end MEASUREMENT
/begin MEASUREMENT CDD_MotCtrlMgr.MotCurrAdcVlyCAdcFaild.Logl "MICROSAR RTE" UBYTE RTE_CM_BOOLEAN 0 0 0 255 ECU_ADDRESS 0 SYMBOL_LINK "Rte_CDD_GmG2kcaMcuCfg_MotCurrAdcVlyCAdcFaild_Logl" 0 DISPLAY_IDENTIFIER CDD_MotCtrlMgr.ReceiverPorts.MotCurrAdcVlyCAdcFaild.Logl /end MEASUREMENT
/begin MEASUREMENT CDD_MotCtrlMgr.MotCurrAdcVlyD.Val "MICROSAR RTE" FLOAT32_IEEE NO_COMPU_METHOD 0 0 0.0 5.0 ECU_ADDRESS 0 SYMBOL_LINK "Rte_CDD_MotCtrlMgr_MotCurrAdcVlyD_Val" 0 DISPLAY_IDENTIFIER CDD_MotCtrlMgr.SenderPorts.MotCurrAdcVlyD.Val /end MEASUREMENT
/begin MEASUREMENT CDD_MotCtrlMgr.MotCurrAdcVlyDAdcFaild.Logl "MICROSAR RTE" UBYTE RTE_CM_BOOLEAN 0 0 0 255 ECU_ADDRESS 0 SYMBOL_LINK "Rte_CDD_GmG2kcaMcuCfg_MotCurrAdcVlyDAdcFaild_Logl" 0 DISPLAY_IDENTIFIER CDD_MotCtrlMgr.ReceiverPorts.MotCurrAdcVlyDAdcFaild.Logl /end MEASUREMENT
/begin MEASUREMENT CDD_MotCtrlMgr.MotCurrAdcVlyE.Val "MICROSAR RTE" FLOAT32_IEEE NO_COMPU_METHOD 0 0 0.0 5.0 ECU_ADDRESS 0 SYMBOL_LINK "Rte_CDD_MotCtrlMgr_MotCurrAdcVlyE_Val" 0 DISPLAY_IDENTIFIER CDD_MotCtrlMgr.SenderPorts.MotCurrAdcVlyE.Val /end MEASUREMENT
/begin MEASUREMENT CDD_MotCtrlMgr.MotCurrAdcVlyEAdcFaild.Logl "MICROSAR RTE" UBYTE RTE_CM_BOOLEAN 0 0 0 255 ECU_ADDRESS 0 SYMBOL_LINK "Rte_CDD_GmG2kcaMcuCfg_MotCurrAdcVlyEAdcFaild_Logl" 0 DISPLAY_IDENTIFIER CDD_MotCtrlMgr.ReceiverPorts.MotCurrAdcVlyEAdcFaild.Logl /end MEASUREMENT
/begin MEASUREMENT CDD_MotCtrlMgr.MotCurrAdcVlyF.Val "MICROSAR RTE" FLOAT32_IEEE NO_COMPU_METHOD 0 0 0.0 5.0 ECU_ADDRESS 0 SYMBOL_LINK "Rte_CDD_MotCtrlMgr_MotCurrAdcVlyF_Val" 0 DISPLAY_IDENTIFIER CDD_MotCtrlMgr.SenderPorts.MotCurrAdcVlyF.Val /end MEASUREMENT
/begin MEASUREMENT CDD_MotCtrlMgr.MotCurrAdcVlyFAdcFaild.Logl "MICROSAR RTE" UBYTE RTE_CM_BOOLEAN 0 0 0 255 ECU_ADDRESS 0 SYMBOL_LINK "Rte_CDD_GmG2kcaMcuCfg_MotCurrAdcVlyFAdcFaild_Logl" 0 DISPLAY_IDENTIFIER CDD_MotCtrlMgr.ReceiverPorts.MotCurrAdcVlyFAdcFaild.Logl /end MEASUREMENT
/begin MEASUREMENT CDD_MotCtrlMgr.MotCurrCorrdA.Val "MICROSAR RTE" FLOAT32_IEEE NO_COMPU_METHOD 0 0 -145.0 145.0 ECU_ADDRESS 0 SYMBOL_LINK "Rte_CDD_MotCtrlMgr_MotCurrCorrdA_Val" 0 DISPLAY_IDENTIFIER CDD_MotCtrlMgr.SenderPorts.MotCurrCorrdA.Val /end MEASUREMENT
/begin MEASUREMENT CDD_MotCtrlMgr.MotCurrCorrdB.Val "MICROSAR RTE" FLOAT32_IEEE NO_COMPU_METHOD 0 0 -145.0 145.0 ECU_ADDRESS 0 SYMBOL_LINK "Rte_CDD_MotCtrlMgr_MotCurrCorrdB_Val" 0 DISPLAY_IDENTIFIER CDD_MotCtrlMgr.SenderPorts.MotCurrCorrdB.Val /end MEASUREMENT
/begin MEASUREMENT CDD_MotCtrlMgr.MotCurrCorrdC.Val "MICROSAR RTE" FLOAT32_IEEE NO_COMPU_METHOD 0 0 -145.0 145.0 ECU_ADDRESS 0 SYMBOL_LINK "Rte_CDD_MotCtrlMgr_MotCurrCorrdC_Val" 0 DISPLAY_IDENTIFIER CDD_MotCtrlMgr.SenderPorts.MotCurrCorrdC.Val /end MEASUREMENT
/begin MEASUREMENT CDD_MotCtrlMgr.MotCurrCorrdD.Val "MICROSAR RTE" FLOAT32_IEEE NO_COMPU_METHOD 0 0 -145.0 145.0 ECU_ADDRESS 0 SYMBOL_LINK "Rte_CDD_MotCtrlMgr_MotCurrCorrdD_Val" 0 DISPLAY_IDENTIFIER CDD_MotCtrlMgr.SenderPorts.MotCurrCorrdD.Val /end MEASUREMENT
/begin MEASUREMENT CDD_MotCtrlMgr.MotCurrCorrdE.Val "MICROSAR RTE" FLOAT32_IEEE NO_COMPU_METHOD 0 0 -145.0 145.0 ECU_ADDRESS 0 SYMBOL_LINK "Rte_CDD_MotCtrlMgr_MotCurrCorrdE_Val" 0 DISPLAY_IDENTIFIER CDD_MotCtrlMgr.SenderPorts.MotCurrCorrdE.Val /end MEASUREMENT
/begin MEASUREMENT CDD_MotCtrlMgr.MotCurrCorrdF.Val "MICROSAR RTE" FLOAT32_IEEE NO_COMPU_METHOD 0 0 -145.0 145.0 ECU_ADDRESS 0 SYMBOL_LINK "Rte_CDD_MotCtrlMgr_MotCurrCorrdF_Val" 0 DISPLAY_IDENTIFIER CDD_MotCtrlMgr.SenderPorts.MotCurrCorrdF.Val /end MEASUREMENT
/begin MEASUREMENT CDD_MotCtrlMgr.MotCurrDax.Val "MICROSAR RTE" FLOAT32_IEEE NO_COMPU_METHOD 0 0 -3.402823466e+38 3.402823466e+38 ECU_ADDRESS 0 SYMBOL_LINK "Rte_CDD_MotCtrlMgr_MotCurrDax_Val" 0 DISPLAY_IDENTIFIER CDD_MotCtrlMgr.SenderPorts.MotCurrDax.Val /end MEASUREMENT
/begin MEASUREMENT CDD_MotCtrlMgr.MotCurrDaxCmd.Val "MICROSAR RTE" FLOAT32_IEEE NO_COMPU_METHOD 0 0 0.0 200.0 ECU_ADDRESS 0 SYMBOL_LINK "Rte_MotRefMdl_MotCurrDaxCmd_Val" 0 DISPLAY_IDENTIFIER CDD_MotCtrlMgr.ReceiverPorts.MotCurrDaxCmd.Val /end MEASUREMENT
/begin MEASUREMENT CDD_MotCtrlMgr.MotCurrDaxMax.Val "MICROSAR RTE" FLOAT32_IEEE NO_COMPU_METHOD 0 0 0.0 200.0 ECU_ADDRESS 0 SYMBOL_LINK "Rte_MotRefMdl_MotCurrDaxMax_Val" 0 DISPLAY_IDENTIFIER CDD_MotCtrlMgr.ReceiverPorts.MotCurrDaxMax.Val /end MEASUREMENT
/begin MEASUREMENT CDD_MotCtrlMgr.MotCurrEolCalSt.Val "MICROSAR RTE" UBYTE RTE_CM_ENUM_MotCurrEolCalSt2 0 0 0 255 ECU_ADDRESS 0 SYMBOL_LINK "Rte_CDD_CurrMeas_MotCurrEolCalSt_Val" 0 DISPLAY_IDENTIFIER CDD_MotCtrlMgr.ReceiverPorts.MotCurrEolCalSt.Val /end MEASUREMENT
/begin MEASUREMENT CDD_MotCtrlMgr.MotCurrQax.Val "MICROSAR RTE" FLOAT32_IEEE NO_COMPU_METHOD 0 0 -3.402823466e+38 3.402823466e+38 ECU_ADDRESS 0 SYMBOL_LINK "Rte_CDD_MotCtrlMgr_MotCurrQax_Val" 0 DISPLAY_IDENTIFIER CDD_MotCtrlMgr.SenderPorts.MotCurrQax.Val /end MEASUREMENT
/begin MEASUREMENT CDD_MotCtrlMgr.MotCurrQaxCmd.Val "MICROSAR RTE" FLOAT32_IEEE NO_COMPU_METHOD 0 0 -200 200 ECU_ADDRESS 0 SYMBOL_LINK "Rte_MotRefMdl_MotCurrQaxCmd_Val" 0 DISPLAY_IDENTIFIER CDD_MotCtrlMgr.ReceiverPorts.MotCurrQaxCmd.Val /end MEASUREMENT
/begin MEASUREMENT CDD_MotCtrlMgr.MotCurrQaxToMotTqGain.Val "MICROSAR RTE" FLOAT32_IEEE NO_COMPU_METHOD 0 0 -3.402823466e+38 3.402823466e+38 ECU_ADDRESS 0 SYMBOL_LINK "Rte_MotRplCoggCfg_MotCurrQaxToMotTqGain_Val" 0 DISPLAY_IDENTIFIER CDD_MotCtrlMgr.ReceiverPorts.MotCurrQaxToMotTqGain.Val /end MEASUREMENT
/begin MEASUREMENT CDD_MotCtrlMgr.MotCurrQlfr1.Val "MICROSAR RTE" UBYTE RTE_CM_ENUM_SigQlfr1 0 0 0 255 ECU_ADDRESS 0 SYMBOL_LINK "Rte_CDD_CurrMeas_MotCurrQlfr1_Val" 0 DISPLAY_IDENTIFIER CDD_MotCtrlMgr.ReceiverPorts.MotCurrQlfr1.Val /end MEASUREMENT
/begin MEASUREMENT CDD_MotCtrlMgr.MotCurrQlfr2.Val "MICROSAR RTE" UBYTE RTE_CM_ENUM_SigQlfr1 0 0 0 255 ECU_ADDRESS 0 SYMBOL_LINK "Rte_CDD_CurrMeas_MotCurrQlfr2_Val" 0 DISPLAY_IDENTIFIER CDD_MotCtrlMgr.ReceiverPorts.MotCurrQlfr2.Val /end MEASUREMENT
/begin MEASUREMENT CDD_MotCtrlMgr.MotCurrRollgCntr1.Val "MICROSAR RTE" UBYTE NO_COMPU_METHOD 0 0 0 255 ECU_ADDRESS 0 SYMBOL_LINK "Rte_CDD_MotCtrlMgr_MotCurrRollgCntr1_Val" 0 DISPLAY_IDENTIFIER CDD_MotCtrlMgr.SenderPorts.MotCurrRollgCntr1.Val /end MEASUREMENT
/begin MEASUREMENT CDD_MotCtrlMgr.MotCurrRollgCntr2.Val "MICROSAR RTE" UBYTE NO_COMPU_METHOD 0 0 0 255 ECU_ADDRESS 0 SYMBOL_LINK "Rte_CDD_MotCtrlMgr_MotCurrRollgCntr2_Val" 0 DISPLAY_IDENTIFIER CDD_MotCtrlMgr.SenderPorts.MotCurrRollgCntr2.Val /end MEASUREMENT
/begin MEASUREMENT CDD_MotCtrlMgr.MotDampgDax.Val "MICROSAR RTE" FLOAT32_IEEE NO_COMPU_METHOD 0 0 0.0 45.0 ECU_ADDRESS 0 SYMBOL_LINK "Rte_MotCurrRegCfg_MotDampgDax_Val" 0 DISPLAY_IDENTIFIER CDD_MotCtrlMgr.ReceiverPorts.MotDampgDax.Val /end MEASUREMENT
/begin MEASUREMENT CDD_MotCtrlMgr.MotDampgQax.Val "MICROSAR RTE" FLOAT32_IEEE NO_COMPU_METHOD 0 0 0.0 45.0 ECU_ADDRESS 0 SYMBOL_LINK "Rte_MotCurrRegCfg_MotDampgQax_Val" 0 DISPLAY_IDENTIFIER CDD_MotCtrlMgr.ReceiverPorts.MotDampgQax.Val /end MEASUREMENT
/begin MEASUREMENT CDD_MotCtrlMgr.MotElecMeclPolarity.Val "MICROSAR RTE" SBYTE NO_COMPU_METHOD 0 0 -1.0 1.0 ECU_ADDRESS 0 SYMBOL_LINK "Rte_PolarityCfg_MotElecMeclPolarity_Val" 0 DISPLAY_IDENTIFIER CDD_MotCtrlMgr.ReceiverPorts.MotElecMeclPolarity.Val /end MEASUREMENT
/begin MEASUREMENT CDD_MotCtrlMgr.MotIntglGainDax.Val "MICROSAR RTE" FLOAT32_IEEE NO_COMPU_METHOD 0 0 0.0 3.6 ECU_ADDRESS 0 SYMBOL_LINK "Rte_MotCurrRegCfg_MotIntglGainDax_Val" 0 DISPLAY_IDENTIFIER CDD_MotCtrlMgr.ReceiverPorts.MotIntglGainDax.Val /end MEASUREMENT
/begin MEASUREMENT CDD_MotCtrlMgr.MotIntglGainQax.Val "MICROSAR RTE" FLOAT32_IEEE NO_COMPU_METHOD 0 0 0.0 3.6 ECU_ADDRESS 0 SYMBOL_LINK "Rte_MotCurrRegCfg_MotIntglGainQax_Val" 0 DISPLAY_IDENTIFIER CDD_MotCtrlMgr.ReceiverPorts.MotIntglGainQax.Val /end MEASUREMENT
/begin MEASUREMENT CDD_MotCtrlMgr.MotPropGainDax.Val "MICROSAR RTE" FLOAT32_IEEE NO_COMPU_METHOD 0 0 0.0 2.25 ECU_ADDRESS 0 SYMBOL_LINK "Rte_MotCurrRegCfg_MotPropGainDax_Val" 0 DISPLAY_IDENTIFIER CDD_MotCtrlMgr.ReceiverPorts.MotPropGainDax.Val /end MEASUREMENT
/begin MEASUREMENT CDD_MotCtrlMgr.MotPropGainQax.Val "MICROSAR RTE" FLOAT32_IEEE NO_COMPU_METHOD 0 0 0.0 2.25 ECU_ADDRESS 0 SYMBOL_LINK "Rte_MotCurrRegCfg_MotPropGainQax_Val" 0 DISPLAY_IDENTIFIER CDD_MotCtrlMgr.ReceiverPorts.MotPropGainQax.Val /end MEASUREMENT
/begin MEASUREMENT CDD_MotCtrlMgr.MotREstimd.Val "MICROSAR RTE" FLOAT32_IEEE NO_COMPU_METHOD 0 0 -3.402823466e+38 3.402823466e+38 ECU_ADDRESS 0 SYMBOL_LINK "Rte_CDD_MotCtrlMgr_MotREstimd_Val" 0 DISPLAY_IDENTIFIER CDD_MotCtrlMgr.ReceiverPorts.MotREstimd.Val /end MEASUREMENT
/begin MEASUREMENT CDD_MotCtrlMgr.MotReacncDax.Val "MICROSAR RTE" FLOAT32_IEEE NO_COMPU_METHOD 0 0 -0.5 0.5 ECU_ADDRESS 0 SYMBOL_LINK "Rte_MotRefMdl_MotReacncDax_Val" 0 DISPLAY_IDENTIFIER CDD_MotCtrlMgr.ReceiverPorts.MotReacncDax.Val /end MEASUREMENT
/begin MEASUREMENT CDD_MotCtrlMgr.MotReacncQax.Val "MICROSAR RTE" FLOAT32_IEEE NO_COMPU_METHOD 0 0 -0.5 0.5 ECU_ADDRESS 0 SYMBOL_LINK "Rte_MotRefMdl_MotReacncQax_Val" 0 DISPLAY_IDENTIFIER CDD_MotCtrlMgr.ReceiverPorts.MotReacncQax.Val /end MEASUREMENT
/begin MEASUREMENT CDD_MotCtrlMgr.MotTqRplCoggOrder1Mgn.Val "MICROSAR RTE" FLOAT32_IEEE NO_COMPU_METHOD 0 0 -3.402823466e+38 3.402823466e+38 ECU_ADDRESS 0 SYMBOL_LINK "Rte_MotRplCoggCfg_MotTqRplCoggOrder1Mgn_Val" 0 DISPLAY_IDENTIFIER CDD_MotCtrlMgr.ReceiverPorts.MotTqRplCoggOrder1Mgn.Val /end MEASUREMENT
/begin MEASUREMENT CDD_MotCtrlMgr.MotTqRplCoggOrder1Pha.Val "MICROSAR RTE" FLOAT32_IEEE NO_COMPU_METHOD 0 0 -3.402823466e+38 3.402823466e+38 ECU_ADDRESS 0 SYMBOL_LINK "Rte_MotRplCoggCfg_MotTqRplCoggOrder1Pha_Val" 0 DISPLAY_IDENTIFIER CDD_MotCtrlMgr.ReceiverPorts.MotTqRplCoggOrder1Pha.Val /end MEASUREMENT
/begin MEASUREMENT CDD_MotCtrlMgr.MotTqRplCoggOrder2Mgn.Val "MICROSAR RTE" FLOAT32_IEEE NO_COMPU_METHOD 0 0 -3.402823466e+38 3.402823466e+38 ECU_ADDRESS 0 SYMBOL_LINK "Rte_MotRplCoggCfg_MotTqRplCoggOrder2Mgn_Val" 0 DISPLAY_IDENTIFIER CDD_MotCtrlMgr.ReceiverPorts.MotTqRplCoggOrder2Mgn.Val /end MEASUREMENT
/begin MEASUREMENT CDD_MotCtrlMgr.MotTqRplCoggOrder2Pha.Val "MICROSAR RTE" FLOAT32_IEEE NO_COMPU_METHOD 0 0 -3.402823466e+38 3.402823466e+38 ECU_ADDRESS 0 SYMBOL_LINK "Rte_MotRplCoggCfg_MotTqRplCoggOrder2Pha_Val" 0 DISPLAY_IDENTIFIER CDD_MotCtrlMgr.ReceiverPorts.MotTqRplCoggOrder2Pha.Val /end MEASUREMENT
/begin MEASUREMENT CDD_MotCtrlMgr.MotTqRplCoggOrder3Mgn.Val "MICROSAR RTE" FLOAT32_IEEE NO_COMPU_METHOD 0 0 -3.402823466e+38 3.402823466e+38 ECU_ADDRESS 0 SYMBOL_LINK "Rte_MotRplCoggCfg_MotTqRplCoggOrder3Mgn_Val" 0 DISPLAY_IDENTIFIER CDD_MotCtrlMgr.ReceiverPorts.MotTqRplCoggOrder3Mgn.Val /end MEASUREMENT
/begin MEASUREMENT CDD_MotCtrlMgr.MotTqRplCoggOrder3Pha.Val "MICROSAR RTE" FLOAT32_IEEE NO_COMPU_METHOD 0 0 -3.402823466e+38 3.402823466e+38 ECU_ADDRESS 0 SYMBOL_LINK "Rte_MotRplCoggCfg_MotTqRplCoggOrder3Pha_Val" 0 DISPLAY_IDENTIFIER CDD_MotCtrlMgr.ReceiverPorts.MotTqRplCoggOrder3Pha.Val /end MEASUREMENT
/begin MEASUREMENT CDD_MotCtrlMgr.MotVelMrf.Val "MICROSAR RTE" FLOAT32_IEEE NO_COMPU_METHOD 0 0 -1350 1350.0 ECU_ADDRESS 0 SYMBOL_LINK "Rte_CDD_MotVel_MotVelMrf_Val" 0 DISPLAY_IDENTIFIER CDD_MotCtrlMgr.ReceiverPorts.MotVelMrf.Val /end MEASUREMENT
/begin MEASUREMENT CDD_MotCtrlMgr.MotVltgDaxFf.Val "MICROSAR RTE" FLOAT32_IEEE NO_COMPU_METHOD 0 0 -26.5 26.5 ECU_ADDRESS 0 SYMBOL_LINK "Rte_MotRefMdl_MotVltgDaxFf_Val" 0 DISPLAY_IDENTIFIER CDD_MotCtrlMgr.ReceiverPorts.MotVltgDaxFf.Val /end MEASUREMENT
/begin MEASUREMENT CDD_MotCtrlMgr.MotVltgDaxFild.Val "MICROSAR RTE" FLOAT32_IEEE NO_COMPU_METHOD 0 0 -3.402823466e+38 3.402823466e+38 ECU_ADDRESS 0 SYMBOL_LINK "Rte_CDD_MotCtrlMgr_MotVltgDaxFild_Val" 0 DISPLAY_IDENTIFIER CDD_MotCtrlMgr.SenderPorts.MotVltgDaxFild.Val /end MEASUREMENT
/begin MEASUREMENT CDD_MotCtrlMgr.MotVltgQaxFf.Val "MICROSAR RTE" FLOAT32_IEEE NO_COMPU_METHOD 0 0 -26.5 26.5 ECU_ADDRESS 0 SYMBOL_LINK "Rte_MotRefMdl_MotVltgQaxFf_Val" 0 DISPLAY_IDENTIFIER CDD_MotCtrlMgr.ReceiverPorts.MotVltgQaxFf.Val /end MEASUREMENT
/begin MEASUREMENT CDD_MotCtrlMgr.MotVltgQaxFild.Val "MICROSAR RTE" FLOAT32_IEEE NO_COMPU_METHOD 0 0 -3.402823466e+38 3.402823466e+38 ECU_ADDRESS 0 SYMBOL_LINK "Rte_CDD_MotCtrlMgr_MotVltgQaxFild_Val" 0 DISPLAY_IDENTIFIER CDD_MotCtrlMgr.SenderPorts.MotVltgQaxFild.Val /end MEASUREMENT
/begin MEASUREMENT CDD_MotCtrlMgr.Ntc5DErrCnt.Val "MICROSAR RTE" UWORD NO_COMPU_METHOD 0 0 0 65535 ECU_ADDRESS 0 SYMBOL_LINK "Rte_CDD_MotCtrlMgr_Ntc5DErrCnt_Val" 0 DISPLAY_IDENTIFIER CDD_MotCtrlMgr.SenderPorts.Ntc5DErrCnt.Val /end MEASUREMENT
/begin MEASUREMENT CDD_MotCtrlMgr.Ntc6DErrCnt.Val "MICROSAR RTE" UWORD NO_COMPU_METHOD 0 0 0 65535 ECU_ADDRESS 0 SYMBOL_LINK "Rte_CDD_MotCtrlMgr_Ntc6DErrCnt_Val" 0 DISPLAY_IDENTIFIER CDD_MotCtrlMgr.SenderPorts.Ntc6DErrCnt.Val /end MEASUREMENT
/begin MEASUREMENT CDD_MotCtrlMgr.PhaOnTiSumA.Val "MICROSAR RTE" ULONG NO_COMPU_METHOD 0 0 0 4294967295 ECU_ADDRESS 0 SYMBOL_LINK "Rte_CDD_MotCtrlMgr_PhaOnTiSumA_Val" 0 DISPLAY_IDENTIFIER CDD_MotCtrlMgr.SenderPorts.PhaOnTiSumA.Val /end MEASUREMENT
/begin MEASUREMENT CDD_MotCtrlMgr.PhaOnTiSumB.Val "MICROSAR RTE" ULONG NO_COMPU_METHOD 0 0 0 4294967295 ECU_ADDRESS 0 SYMBOL_LINK "Rte_CDD_MotCtrlMgr_PhaOnTiSumB_Val" 0 DISPLAY_IDENTIFIER CDD_MotCtrlMgr.SenderPorts.PhaOnTiSumB.Val /end MEASUREMENT
/begin MEASUREMENT CDD_MotCtrlMgr.PhaOnTiSumC.Val "MICROSAR RTE" ULONG NO_COMPU_METHOD 0 0 0 4294967295 ECU_ADDRESS 0 SYMBOL_LINK "Rte_CDD_MotCtrlMgr_PhaOnTiSumC_Val" 0 DISPLAY_IDENTIFIER CDD_MotCtrlMgr.SenderPorts.PhaOnTiSumC.Val /end MEASUREMENT
/begin MEASUREMENT CDD_MotCtrlMgr.SlowLoopCntr.Val "MICROSAR RTE" UWORD NO_COMPU_METHOD 0 0 0 65535 ECU_ADDRESS 0 SYMBOL_LINK "Rte_CDD_MotCtrlMgr_SlowLoopCntr_Val" 0 DISPLAY_IDENTIFIER CDD_MotCtrlMgr.SenderPorts.SlowLoopCntr.Val /end MEASUREMENT
/begin MEASUREMENT CDD_MotCtrlMgr.SysSt.Val "MICROSAR RTE" UBYTE RTE_CM_ENUM_SysSt1 0 0 0 255 ECU_ADDRESS 0 SYMBOL_LINK "Rte_SysStMod_SysSt_Val" 0 DISPLAY_IDENTIFIER CDD_MotCtrlMgr.ReceiverPorts.SysSt.Val /end MEASUREMENT
/begin MEASUREMENT CDD_MotCurrRegVltgLimr.AntiWdupCmdScaDax "MICROSAR RTE" FLOAT32_IEEE NO_COMPU_METHOD 0 0 0.0 1.0 ECU_ADDRESS 0 SYMBOL_LINK "Rte_CDD_MotCurrRegVltgLimr_AntiWdupCmdScaDax" 0 DISPLAY_IDENTIFIER CDD_MotCurrRegVltgLimr.PerInstanceMemories.AntiWdupCmdScaDax /end MEASUREMENT
/begin MEASUREMENT CDD_MotCurrRegVltgLimr.AntiWdupCmdScaQax "MICROSAR RTE" FLOAT32_IEEE NO_COMPU_METHOD 0 0 0.0 1.0 ECU_ADDRESS 0 SYMBOL_LINK "Rte_CDD_MotCurrRegVltgLimr_AntiWdupCmdScaQax" 0 DISPLAY_IDENTIFIER CDD_MotCurrRegVltgLimr.PerInstanceMemories.AntiWdupCmdScaQax /end MEASUREMENT
/begin MEASUREMENT CDD_MotCurrRegVltgLimr.CurrLoaScarPrev "MICROSAR RTE" FLOAT32_IEEE NO_COMPU_METHOD 0 0 0.0 1.0 ECU_ADDRESS 0 SYMBOL_LINK "Rte_CDD_MotCurrRegVltgLimr_CurrLoaScarPrev" 0 DISPLAY_IDENTIFIER CDD_MotCurrRegVltgLimr.PerInstanceMemories.CurrLoaScarPrev /end MEASUREMENT
/begin MEASUREMENT CDD_MotCurrRegVltgLimr.DualEcuLoaScarPrev "MICROSAR RTE" FLOAT32_IEEE NO_COMPU_METHOD 0 0 -3.402823466e+38 3.402823466e+38 ECU_ADDRESS 0 SYMBOL_LINK "Rte_CDD_MotCurrRegVltgLimr_DualEcuLoaScarPrev" 0 DISPLAY_IDENTIFIER CDD_MotCurrRegVltgLimr.PerInstanceMemories.DualEcuLoaScarPrev /end MEASUREMENT
/begin MEASUREMENT CDD_MotCurrRegVltgLimr.IvtrLoaScarPrev "MICROSAR RTE" FLOAT32_IEEE NO_COMPU_METHOD 0 0 0.0 1.0 ECU_ADDRESS 0 SYMBOL_LINK "Rte_CDD_MotCurrRegVltgLimr_IvtrLoaScarPrev" 0 DISPLAY_IDENTIFIER CDD_MotCurrRegVltgLimr.PerInstanceMemories.IvtrLoaScarPrev /end MEASUREMENT
/begin MEASUREMENT CDD_MotCurrRegVltgLimr.MotCtrlMotVltgDaxPrev "MICROSAR RTE" FLOAT32_IEEE NO_COMPU_METHOD 0 0 -3.402823466e+38 3.402823466e+38 ECU_ADDRESS 0 SYMBOL_LINK "Rte_CDD_MotCurrRegVltgLimr_MotCtrlMotVltgDaxPrev" 0 DISPLAY_IDENTIFIER CDD_MotCurrRegVltgLimr.PerInstanceMemories.MotCtrlMotVltgDaxPrev /end MEASUREMENT
/begin MEASUREMENT CDD_MotCurrRegVltgLimr.MotCtrlMotVltgQaxPrev "MICROSAR RTE" FLOAT32_IEEE NO_COMPU_METHOD 0 0 -3.402823466e+38 3.402823466e+38 ECU_ADDRESS 0 SYMBOL_LINK "Rte_CDD_MotCurrRegVltgLimr_MotCtrlMotVltgQaxPrev" 0 DISPLAY_IDENTIFIER CDD_MotCurrRegVltgLimr.PerInstanceMemories.MotCtrlMotVltgQaxPrev /end MEASUREMENT
/begin MEASUREMENT CDD_MotCurrRegVltgLimr.MotVltgBrdgLpFil.FilGain "MICROSAR RTE" FLOAT32_IEEE NO_COMPU_METHOD 0 0 -3.402823466e+38 3.402823466e+38 ECU_ADDRESS 0 SYMBOL_LINK "Rte_CDD_MotCurrRegVltgLimr_MotVltgBrdgLpFil.FilGain" 0 DISPLAY_IDENTIFIER CDD_MotCurrRegVltgLimr.PerInstanceMemories.MotVltgBrdgLpFil.FilGain /end MEASUREMENT
/begin MEASUREMENT CDD_MotCurrRegVltgLimr.MotVltgBrdgLpFil.FilSt "MICROSAR RTE" FLOAT32_IEEE NO_COMPU_METHOD 0 0 -3.402823466e+38 3.402823466e+38 ECU_ADDRESS 0 SYMBOL_LINK "Rte_CDD_MotCurrRegVltgLimr_MotVltgBrdgLpFil.FilSt" 0 DISPLAY_IDENTIFIER CDD_MotCurrRegVltgLimr.PerInstanceMemories.MotVltgBrdgLpFil.FilSt /end MEASUREMENT
/begin MEASUREMENT CDD_MotCurrRegVltgLimr.MotVltgIntglCmdDaxPrev "MICROSAR RTE" FLOAT32_IEEE NO_COMPU_METHOD 0 0 -1000 1000 ECU_ADDRESS 0 SYMBOL_LINK "Rte_CDD_MotCurrRegVltgLimr_MotVltgIntglCmdDaxPrev" 0 DISPLAY_IDENTIFIER CDD_MotCurrRegVltgLimr.PerInstanceMemories.MotVltgIntglCmdDaxPrev /end MEASUREMENT
/begin MEASUREMENT CDD_MotCurrRegVltgLimr.MotVltgIntglCmdQaxPrev "MICROSAR RTE" FLOAT32_IEEE NO_COMPU_METHOD 0 0 -1000 1000 ECU_ADDRESS 0 SYMBOL_LINK "Rte_CDD_MotCurrRegVltgLimr_MotVltgIntglCmdQaxPrev" 0 DISPLAY_IDENTIFIER CDD_MotCurrRegVltgLimr.PerInstanceMemories.MotVltgIntglCmdQaxPrev /end MEASUREMENT
/begin MEASUREMENT CDD_MotCurrRegVltgLimr.MotVltgQaxFfLpFil.FilGain "MICROSAR RTE" FLOAT32_IEEE NO_COMPU_METHOD 0 0 -3.402823466e+38 3.402823466e+38 ECU_ADDRESS 0 SYMBOL_LINK "Rte_CDD_MotCurrRegVltgLimr_MotVltgQaxFfLpFil.FilGain" 0 DISPLAY_IDENTIFIER CDD_MotCurrRegVltgLimr.PerInstanceMemories.MotVltgQaxFfLpFil.FilGain /end MEASUREMENT
/begin MEASUREMENT CDD_MotCurrRegVltgLimr.MotVltgQaxFfLpFil.FilSt "MICROSAR RTE" FLOAT32_IEEE NO_COMPU_METHOD 0 0 -3.402823466e+38 3.402823466e+38 ECU_ADDRESS 0 SYMBOL_LINK "Rte_CDD_MotCurrRegVltgLimr_MotVltgQaxFfLpFil.FilSt" 0 DISPLAY_IDENTIFIER CDD_MotCurrRegVltgLimr.PerInstanceMemories.MotVltgQaxFfLpFil.FilSt /end MEASUREMENT
/begin MEASUREMENT CDD_MotCurrRegVltgLimr.dMotCurrRegVltgLimrAntiWdupCmdScaDax "MICROSAR RTE" FLOAT32_IEEE NO_COMPU_METHOD 0 0 0.0 1.0 ECU_ADDRESS 0 SYMBOL_LINK "Rte_CDD_MotCurrRegVltgLimr_dMotCurrRegVltgLimrAntiWdupCmdScaDax" 0 DISPLAY_IDENTIFIER CDD_MotCurrRegVltgLimr.PerInstanceMemories.dMotCurrRegVltgLimrAntiWdupCmdScaDax /end MEASUREMENT
/begin MEASUREMENT CDD_MotCurrRegVltgLimr.dMotCurrRegVltgLimrAntiWdupCmdScaQax "MICROSAR RTE" FLOAT32_IEEE NO_COMPU_METHOD 0 0 0.0 1.0 ECU_ADDRESS 0 SYMBOL_LINK "Rte_CDD_MotCurrRegVltgLimr_dMotCurrRegVltgLimrAntiWdupCmdScaQax" 0 DISPLAY_IDENTIFIER CDD_MotCurrRegVltgLimr.PerInstanceMemories.dMotCurrRegVltgLimrAntiWdupCmdScaQax /end MEASUREMENT
/begin MEASUREMENT CDD_MotCurrRegVltgLimr.dMotCurrRegVltgLimrMotCurrCmdErr "MICROSAR RTE" FLOAT32_IEEE NO_COMPU_METHOD 0 0 -450 450 ECU_ADDRESS 0 SYMBOL_LINK "Rte_CDD_MotCurrRegVltgLimr_dMotCurrRegVltgLimrMotCurrCmdErr" 0 DISPLAY_IDENTIFIER CDD_MotCurrRegVltgLimr.PerInstanceMemories.dMotCurrRegVltgLimrMotCurrCmdErr /end MEASUREMENT
/begin MEASUREMENT CDD_MotCurrRegVltgLimr.dMotCurrRegVltgLimrMotCurrCmdErrDax "MICROSAR RTE" FLOAT32_IEEE NO_COMPU_METHOD 0 0 -450 450 ECU_ADDRESS 0 SYMBOL_LINK "Rte_CDD_MotCurrRegVltgLimr_dMotCurrRegVltgLimrMotCurrCmdErrDax" 0 DISPLAY_IDENTIFIER CDD_MotCurrRegVltgLimr.PerInstanceMemories.dMotCurrRegVltgLimrMotCurrCmdErrDax /end MEASUREMENT
/begin MEASUREMENT CDD_MotCurrRegVltgLimr.dMotCurrRegVltgLimrMotCurrCmdErrQax "MICROSAR RTE" FLOAT32_IEEE NO_COMPU_METHOD 0 0 -450 450 ECU_ADDRESS 0 SYMBOL_LINK "Rte_CDD_MotCurrRegVltgLimr_dMotCurrRegVltgLimrMotCurrCmdErrQax" 0 DISPLAY_IDENTIFIER CDD_MotCurrRegVltgLimr.PerInstanceMemories.dMotCurrRegVltgLimrMotCurrCmdErrQax /end MEASUREMENT
/begin MEASUREMENT CDD_MotCurrRegVltgLimr.dMotCurrRegVltgLimrMotCurrCmdScaDax "MICROSAR RTE" FLOAT32_IEEE NO_COMPU_METHOD 0 0 -200 200 ECU_ADDRESS 0 SYMBOL_LINK "Rte_CDD_MotCurrRegVltgLimr_dMotCurrRegVltgLimrMotCurrCmdScaDax" 0 DISPLAY_IDENTIFIER CDD_MotCurrRegVltgLimr.PerInstanceMemories.dMotCurrRegVltgLimrMotCurrCmdScaDax /end MEASUREMENT
/begin MEASUREMENT CDD_MotCurrRegVltgLimr.dMotCurrRegVltgLimrMotCurrCmdScaQax "MICROSAR RTE" FLOAT32_IEEE NO_COMPU_METHOD 0 0 -200 200 ECU_ADDRESS 0 SYMBOL_LINK "Rte_CDD_MotCurrRegVltgLimr_dMotCurrRegVltgLimrMotCurrCmdScaQax" 0 DISPLAY_IDENTIFIER CDD_MotCurrRegVltgLimr.PerInstanceMemories.dMotCurrRegVltgLimrMotCurrCmdScaQax /end MEASUREMENT
/begin MEASUREMENT CDD_MotCurrRegVltgLimr.dMotCurrRegVltgLimrMotVltgBrdgFild "MICROSAR RTE" FLOAT32_IEEE NO_COMPU_METHOD 0 0 -3.402823466e+38 3.402823466e+38 ECU_ADDRESS 0 SYMBOL_LINK "Rte_CDD_MotCurrRegVltgLimr_dMotCurrRegVltgLimrMotVltgBrdgFild" 0 DISPLAY_IDENTIFIER CDD_MotCurrRegVltgLimr.PerInstanceMemories.dMotCurrRegVltgLimrMotVltgBrdgFild /end MEASUREMENT
/begin MEASUREMENT CDD_MotCurrRegVltgLimr.dMotCurrRegVltgLimrMotVltgCmdFinal "MICROSAR RTE" FLOAT32_IEEE NO_COMPU_METHOD 0 0 -26.5 26.5 ECU_ADDRESS 0 SYMBOL_LINK "Rte_CDD_MotCurrRegVltgLimr_dMotCurrRegVltgLimrMotVltgCmdFinal" 0 DISPLAY_IDENTIFIER CDD_MotCurrRegVltgLimr.PerInstanceMemories.dMotCurrRegVltgLimrMotVltgCmdFinal /end MEASUREMENT
/begin MEASUREMENT CDD_MotCurrRegVltgLimr.dMotCurrRegVltgLimrMotVltgCmdPreLim "MICROSAR RTE" FLOAT32_IEEE NO_COMPU_METHOD 0 0 -26.5 26.5 ECU_ADDRESS 0 SYMBOL_LINK "Rte_CDD_MotCurrRegVltgLimr_dMotCurrRegVltgLimrMotVltgCmdPreLim" 0 DISPLAY_IDENTIFIER CDD_MotCurrRegVltgLimr.PerInstanceMemories.dMotCurrRegVltgLimrMotVltgCmdPreLim /end MEASUREMENT
/begin MEASUREMENT CDD_MotCurrRegVltgLimr.dMotCurrRegVltgLimrMotVltgDampgDax "MICROSAR RTE" FLOAT32_IEEE NO_COMPU_METHOD 0 0 -26.5 26.5 ECU_ADDRESS 0 SYMBOL_LINK "Rte_CDD_MotCurrRegVltgLimr_dMotCurrRegVltgLimrMotVltgDampgDax" 0 DISPLAY_IDENTIFIER CDD_MotCurrRegVltgLimr.PerInstanceMemories.dMotCurrRegVltgLimrMotVltgDampgDax /end MEASUREMENT
/begin MEASUREMENT CDD_MotCurrRegVltgLimr.dMotCurrRegVltgLimrMotVltgDampgQax "MICROSAR RTE" FLOAT32_IEEE NO_COMPU_METHOD 0 0 -26.5 26.5 ECU_ADDRESS 0 SYMBOL_LINK "Rte_CDD_MotCurrRegVltgLimr_dMotCurrRegVltgLimrMotVltgDampgQax" 0 DISPLAY_IDENTIFIER CDD_MotCurrRegVltgLimr.PerInstanceMemories.dMotCurrRegVltgLimrMotVltgDampgQax /end MEASUREMENT
/begin MEASUREMENT CDD_MotCurrRegVltgLimr.dMotCurrRegVltgLimrMotVltgDaxFb "MICROSAR RTE" FLOAT32_IEEE NO_COMPU_METHOD 0 0 -3.402823466e+38 3.402823466e+38 ECU_ADDRESS 0 SYMBOL_LINK "Rte_CDD_MotCurrRegVltgLimr_dMotCurrRegVltgLimrMotVltgDaxFb" 0 DISPLAY_IDENTIFIER CDD_MotCurrRegVltgLimr.PerInstanceMemories.dMotCurrRegVltgLimrMotVltgDaxFb /end MEASUREMENT
/begin MEASUREMENT CDD_MotCurrRegVltgLimr.dMotCurrRegVltgLimrMotVltgDaxIntglPreLim "MICROSAR RTE" FLOAT32_IEEE NO_COMPU_METHOD 0 0 -3.402823466e+38 3.402823466e+38 ECU_ADDRESS 0 SYMBOL_LINK "Rte_CDD_MotCurrRegVltgLimr_dMotCurrRegVltgLimrMotVltgDaxIntglPreLim" 0 DISPLAY_IDENTIFIER CDD_MotCurrRegVltgLimr.PerInstanceMemories.dMotCurrRegVltgLimrMotVltgDaxIntglPreLim /end MEASUREMENT
/begin MEASUREMENT CDD_MotCurrRegVltgLimr.dMotCurrRegVltgLimrMotVltgDecouplFbDax "MICROSAR RTE" FLOAT32_IEEE NO_COMPU_METHOD 0 0 -26.5 26.5 ECU_ADDRESS 0 SYMBOL_LINK "Rte_CDD_MotCurrRegVltgLimr_dMotCurrRegVltgLimrMotVltgDecouplFbDax" 0 DISPLAY_IDENTIFIER CDD_MotCurrRegVltgLimr.PerInstanceMemories.dMotCurrRegVltgLimrMotVltgDecouplFbDax /end MEASUREMENT
/begin MEASUREMENT CDD_MotCurrRegVltgLimr.dMotCurrRegVltgLimrMotVltgDecouplFbQax "MICROSAR RTE" FLOAT32_IEEE NO_COMPU_METHOD 0 0 -26.5 26.5 ECU_ADDRESS 0 SYMBOL_LINK "Rte_CDD_MotCurrRegVltgLimr_dMotCurrRegVltgLimrMotVltgDecouplFbQax" 0 DISPLAY_IDENTIFIER CDD_MotCurrRegVltgLimr.PerInstanceMemories.dMotCurrRegVltgLimrMotVltgDecouplFbQax /end MEASUREMENT
/begin MEASUREMENT CDD_MotCurrRegVltgLimr.dMotCurrRegVltgLimrMotVltgDircFbDax "MICROSAR RTE" FLOAT32_IEEE NO_COMPU_METHOD 0 0 -26.5 26.5 ECU_ADDRESS 0 SYMBOL_LINK "Rte_CDD_MotCurrRegVltgLimr_dMotCurrRegVltgLimrMotVltgDircFbDax" 0 DISPLAY_IDENTIFIER CDD_MotCurrRegVltgLimr.PerInstanceMemories.dMotCurrRegVltgLimrMotVltgDircFbDax /end MEASUREMENT
/begin MEASUREMENT CDD_MotCurrRegVltgLimr.dMotCurrRegVltgLimrMotVltgDircFbQax "MICROSAR RTE" FLOAT32_IEEE NO_COMPU_METHOD 0 0 -26.5 26.5 ECU_ADDRESS 0 SYMBOL_LINK "Rte_CDD_MotCurrRegVltgLimr_dMotCurrRegVltgLimrMotVltgDircFbQax" 0 DISPLAY_IDENTIFIER CDD_MotCurrRegVltgLimr.PerInstanceMemories.dMotCurrRegVltgLimrMotVltgDircFbQax /end MEASUREMENT
/begin MEASUREMENT CDD_MotCurrRegVltgLimr.dMotCurrRegVltgLimrMotVltgPreLimDax "MICROSAR RTE" FLOAT32_IEEE NO_COMPU_METHOD 0 0 -26.5 26.5 ECU_ADDRESS 0 SYMBOL_LINK "Rte_CDD_MotCurrRegVltgLimr_dMotCurrRegVltgLimrMotVltgPreLimDax" 0 DISPLAY_IDENTIFIER CDD_MotCurrRegVltgLimr.PerInstanceMemories.dMotCurrRegVltgLimrMotVltgPreLimDax /end MEASUREMENT
/begin MEASUREMENT CDD_MotCurrRegVltgLimr.dMotCurrRegVltgLimrMotVltgPreLimQax "MICROSAR RTE" FLOAT32_IEEE NO_COMPU_METHOD 0 0 -26.5 26.5 ECU_ADDRESS 0 SYMBOL_LINK "Rte_CDD_MotCurrRegVltgLimr_dMotCurrRegVltgLimrMotVltgPreLimQax" 0 DISPLAY_IDENTIFIER CDD_MotCurrRegVltgLimr.PerInstanceMemories.dMotCurrRegVltgLimrMotVltgPreLimQax /end MEASUREMENT
/begin MEASUREMENT CDD_MotCurrRegVltgLimr.dMotCurrRegVltgLimrMotVltgPropCmdDax "MICROSAR RTE" FLOAT32_IEEE NO_COMPU_METHOD 0 0 -26.5 26.5 ECU_ADDRESS 0 SYMBOL_LINK "Rte_CDD_MotCurrRegVltgLimr_dMotCurrRegVltgLimrMotVltgPropCmdDax" 0 DISPLAY_IDENTIFIER CDD_MotCurrRegVltgLimr.PerInstanceMemories.dMotCurrRegVltgLimrMotVltgPropCmdDax /end MEASUREMENT
/begin MEASUREMENT CDD_MotCurrRegVltgLimr.dMotCurrRegVltgLimrMotVltgPropCmdQax "MICROSAR RTE" FLOAT32_IEEE NO_COMPU_METHOD 0 0 -26.5 26.5 ECU_ADDRESS 0 SYMBOL_LINK "Rte_CDD_MotCurrRegVltgLimr_dMotCurrRegVltgLimrMotVltgPropCmdQax" 0 DISPLAY_IDENTIFIER CDD_MotCurrRegVltgLimr.PerInstanceMemories.dMotCurrRegVltgLimrMotVltgPropCmdQax /end MEASUREMENT
/begin MEASUREMENT CDD_MotCurrRegVltgLimr.dMotCurrRegVltgLimrMotVltgQaxFb "MICROSAR RTE" FLOAT32_IEEE NO_COMPU_METHOD 0 0 -3.402823466e+38 3.402823466e+38 ECU_ADDRESS 0 SYMBOL_LINK "Rte_CDD_MotCurrRegVltgLimr_dMotCurrRegVltgLimrMotVltgQaxFb" 0 DISPLAY_IDENTIFIER CDD_MotCurrRegVltgLimr.PerInstanceMemories.dMotCurrRegVltgLimrMotVltgQaxFb /end MEASUREMENT
/begin MEASUREMENT CDD_MotCurrRegVltgLimr.dMotCurrRegVltgLimrMotVltgQaxFfFild "MICROSAR RTE" FLOAT32_IEEE NO_COMPU_METHOD 0 0 -3.402823466e+38 3.402823466e+38 ECU_ADDRESS 0 SYMBOL_LINK "Rte_CDD_MotCurrRegVltgLimr_dMotCurrRegVltgLimrMotVltgQaxFfFild" 0 DISPLAY_IDENTIFIER CDD_MotCurrRegVltgLimr.PerInstanceMemories.dMotCurrRegVltgLimrMotVltgQaxFfFild /end MEASUREMENT
/begin MEASUREMENT CDD_MotCurrRegVltgLimr.dMotCurrRegVltgLimrMotVltgQaxIntglPreLim "MICROSAR RTE" FLOAT32_IEEE NO_COMPU_METHOD 0 0 -3.402823466e+38 3.402823466e+38 ECU_ADDRESS 0 SYMBOL_LINK "Rte_CDD_MotCurrRegVltgLimr_dMotCurrRegVltgLimrMotVltgQaxIntglPreLim" 0 DISPLAY_IDENTIFIER CDD_MotCurrRegVltgLimr.PerInstanceMemories.dMotCurrRegVltgLimrMotVltgQaxIntglPreLim /end MEASUREMENT
/begin MEASUREMENT CDD_MotCurrRegVltgLimr.dMotCurrRegVltgLimrMotVltgSatnIvsRat "MICROSAR RTE" FLOAT32_IEEE NO_COMPU_METHOD 0 0 0.0 1.0 ECU_ADDRESS 0 SYMBOL_LINK "Rte_CDD_MotCurrRegVltgLimr_dMotCurrRegVltgLimrMotVltgSatnIvsRat" 0 DISPLAY_IDENTIFIER CDD_MotCurrRegVltgLimr.PerInstanceMemories.dMotCurrRegVltgLimrMotVltgSatnIvsRat /end MEASUREMENT
/begin MEASUREMENT CDD_MotCurrRegVltgLimr.dMotCurrRegVltgLimrMotVltgSatnRat "MICROSAR RTE" FLOAT32_IEEE NO_COMPU_METHOD 0 0 0.0 1.0 ECU_ADDRESS 0 SYMBOL_LINK "Rte_CDD_MotCurrRegVltgLimr_dMotCurrRegVltgLimrMotVltgSatnRat" 0 DISPLAY_IDENTIFIER CDD_MotCurrRegVltgLimr.PerInstanceMemories.dMotCurrRegVltgLimrMotVltgSatnRat /end MEASUREMENT
/begin MEASUREMENT CDD_MotCurrRegVltgLimr.dMotCurrRegVltgLimrPhaAdvPreDly "MICROSAR RTE" FLOAT32_IEEE NO_COMPU_METHOD 0 0 0 6.2832 ECU_ADDRESS 0 SYMBOL_LINK "Rte_CDD_MotCurrRegVltgLimr_dMotCurrRegVltgLimrPhaAdvPreDly" 0 DISPLAY_IDENTIFIER CDD_MotCurrRegVltgLimr.PerInstanceMemories.dMotCurrRegVltgLimrPhaAdvPreDly /end MEASUREMENT
/begin MEASUREMENT CDD_MotRplCoggCmd.MotCoggCmdY "MICROSAR RTE" SWORD NO_COMPU_METHOD 0 0 -32768 32767 MATRIX_DIM 512 1 1 ECU_ADDRESS 0 SYMBOL_LINK "Rte_CDD_MotRplCoggCmd_MotCoggCmdY" 0 DISPLAY_IDENTIFIER CDD_MotRplCoggCmd.PerInstanceMemories.MotCoggCmdY /end MEASUREMENT
/begin MEASUREMENT CDD_MotRplCoggCmd.dMotRplCoggCmdCoggIdx "MICROSAR RTE" UWORD NO_COMPU_METHOD 0 0 0 65535 ECU_ADDRESS 0 SYMBOL_LINK "Rte_CDD_MotRplCoggCmd_dMotRplCoggCmdCoggIdx" 0 DISPLAY_IDENTIFIER CDD_MotRplCoggCmd.PerInstanceMemories.dMotRplCoggCmdCoggIdx /end MEASUREMENT
/begin MEASUREMENT CDD_MotRplCoggCmd.dMotRplCoggCmdMotCoggCmd "MICROSAR RTE" FLOAT32_IEEE NO_COMPU_METHOD 0 0 -3.402823466e+38 3.402823466e+38 ECU_ADDRESS 0 SYMBOL_LINK "Rte_CDD_MotRplCoggCmd_dMotRplCoggCmdMotCoggCmd" 0 DISPLAY_IDENTIFIER CDD_MotRplCoggCmd.PerInstanceMemories.dMotRplCoggCmdMotCoggCmd /end MEASUREMENT
/begin MEASUREMENT CDD_MotRplCoggCmd.dMotRplCoggCmdMotCurrQaxCoggCmdPreLim "MICROSAR RTE" FLOAT32_IEEE NO_COMPU_METHOD 0 0 -3.402823466e+38 3.402823466e+38 ECU_ADDRESS 0 SYMBOL_LINK "Rte_CDD_MotRplCoggCmd_dMotRplCoggCmdMotCurrQaxCoggCmdPreLim" 0 DISPLAY_IDENTIFIER CDD_MotRplCoggCmd.PerInstanceMemories.dMotRplCoggCmdMotCurrQaxCoggCmdPreLim /end MEASUREMENT
/begin MEASUREMENT CDD_MotRplCoggCmd.dMotRplCoggCmdMotRplCmdPreLim "MICROSAR RTE" FLOAT32_IEEE NO_COMPU_METHOD 0 0 -3.402823466e+38 3.402823466e+38 ECU_ADDRESS 0 SYMBOL_LINK "Rte_CDD_MotRplCoggCmd_dMotRplCoggCmdMotRplCmdPreLim" 0 DISPLAY_IDENTIFIER CDD_MotRplCoggCmd.PerInstanceMemories.dMotRplCoggCmdMotRplCmdPreLim /end MEASUREMENT
/begin MEASUREMENT CDD_MotVel.AssiMechPolarity.Val "MICROSAR RTE" SBYTE NO_COMPU_METHOD 0 0 -1.0 1.0 ECU_ADDRESS 0 SYMBOL_LINK "Rte_PolarityCfg_AssiMechPolarity_Val" 0 DISPLAY_IDENTIFIER CDD_MotVel.ReceiverPorts.AssiMechPolarity.Val /end MEASUREMENT
/begin MEASUREMENT CDD_MotVel.HwVel.Val "MICROSAR RTE" FLOAT32_IEEE NO_COMPU_METHOD 0 0 -42 42 ECU_ADDRESS 0 SYMBOL_LINK "Rte_CDD_MotVel_HwVel_Val" 0 DISPLAY_IDENTIFIER CDD_MotVel.SenderPorts.HwVel.Val /end MEASUREMENT
/begin MEASUREMENT CDD_MotVel.MotAgBuf.Ary1D "MICROSAR RTE" UWORD RTE_CM_Ag5 0 0 0 0 MATRIX_DIM 8 1 1 ECU_ADDRESS 0 SYMBOL_LINK "Rte_CDD_MotCtrlMgr_MotAgBuf_Ary1D" 0 DISPLAY_IDENTIFIER CDD_MotVel.ReceiverPorts.MotAgBuf.Ary1D /end MEASUREMENT
/begin MEASUREMENT CDD_MotVel.MotAgBufIdx "MICROSAR RTE" UBYTE NO_COMPU_METHOD 0 0 0 7 ECU_ADDRESS 0 SYMBOL_LINK "Rte_CDD_MotVel_MotAgBufIdx" 0 DISPLAY_IDENTIFIER CDD_MotVel.PerInstanceMemories.MotAgBufIdx /end MEASUREMENT
/begin MEASUREMENT CDD_MotVel.MotAgBufIdx.Val "MICROSAR RTE" UBYTE NO_COMPU_METHOD 0 0 0 7 ECU_ADDRESS 0 SYMBOL_LINK "Rte_CDD_MotCtrlMgr_MotAgBufIdx_Val" 0 DISPLAY_IDENTIFIER CDD_MotVel.ReceiverPorts.MotAgBufIdx.Val /end MEASUREMENT
/begin MEASUREMENT CDD_MotVel.MotAgBufIdxPrev "MICROSAR RTE" UBYTE NO_COMPU_METHOD 0 0 0 255 ECU_ADDRESS 0 SYMBOL_LINK "Rte_CDD_MotVel_MotAgBufIdxPrev" 0 DISPLAY_IDENTIFIER CDD_MotVel.PerInstanceMemories.MotAgBufIdxPrev /end MEASUREMENT
/begin MEASUREMENT CDD_MotVel.MotAgBufPrev "MICROSAR RTE" UWORD RTE_CM_Ag5 0 0 0 0 MATRIX_DIM 8 1 1 ECU_ADDRESS 0 SYMBOL_LINK "Rte_CDD_MotVel_MotAgBufPrev" 0 DISPLAY_IDENTIFIER CDD_MotVel.PerInstanceMemories.MotAgBufPrev /end MEASUREMENT
/begin MEASUREMENT CDD_MotVel.MotAgTiBuf.Ary1D "MICROSAR RTE" ULONG NO_COMPU_METHOD 0 0 0 4294967295 MATRIX_DIM 8 1 1 ECU_ADDRESS 0 SYMBOL_LINK "Rte_CDD_MotCtrlMgr_MotAgTiBuf_Ary1D" 0 DISPLAY_IDENTIFIER CDD_MotVel.ReceiverPorts.MotAgTiBuf.Ary1D /end MEASUREMENT
/begin MEASUREMENT CDD_MotVel.MotAgTiBufPrev "MICROSAR RTE" ULONG NO_COMPU_METHOD 0 0 0 4294967295 MATRIX_DIM 8 1 1 ECU_ADDRESS 0 SYMBOL_LINK "Rte_CDD_MotVel_MotAgTiBufPrev" 0 DISPLAY_IDENTIFIER CDD_MotVel.PerInstanceMemories.MotAgTiBufPrev /end MEASUREMENT
/begin MEASUREMENT CDD_MotVel.MotVelCrf.Val "MICROSAR RTE" FLOAT32_IEEE NO_COMPU_METHOD 0 0 -1350 1350.0 ECU_ADDRESS 0 SYMBOL_LINK "Rte_CDD_MotVel_MotVelCrf_Val" 0 DISPLAY_IDENTIFIER CDD_MotVel.SenderPorts.MotVelCrf.Val /end MEASUREMENT
/begin MEASUREMENT CDD_MotVel.MotVelIninCntr "MICROSAR RTE" UBYTE NO_COMPU_METHOD 0 0 0.0 31.0 ECU_ADDRESS 0 SYMBOL_LINK "Rte_CDD_MotVel_MotVelIninCntr" 0 DISPLAY_IDENTIFIER CDD_MotVel.PerInstanceMemories.MotVelIninCntr /end MEASUREMENT
/begin MEASUREMENT CDD_MotVel.MotVelMrf.Val "MICROSAR RTE" FLOAT32_IEEE NO_COMPU_METHOD 0 0 -1350 1350.0 ECU_ADDRESS 0 SYMBOL_LINK "Rte_CDD_MotVel_MotVelMrf_Val" 0 DISPLAY_IDENTIFIER CDD_MotVel.SenderPorts.MotVelMrf.Val /end MEASUREMENT
/begin MEASUREMENT CDD_MotVel.dMotVelAvrgTi "MICROSAR RTE" FLOAT32_IEEE NO_COMPU_METHOD 0 0 0 4295 ECU_ADDRESS 0 SYMBOL_LINK "Rte_CDD_MotVel_dMotVelAvrgTi" 0 DISPLAY_IDENTIFIER CDD_MotVel.PerInstanceMemories.dMotVelAvrgTi /end MEASUREMENT
/begin MEASUREMENT CDD_MotVel.dMotVelMotAgRef "MICROSAR RTE" UWORD NO_COMPU_METHOD 0 0 0 65535 ECU_ADDRESS 0 SYMBOL_LINK "Rte_CDD_MotVel_dMotVelMotAgRef" 0 DISPLAY_IDENTIFIER CDD_MotVel.PerInstanceMemories.dMotVelMotAgRef /end MEASUREMENT
/begin MEASUREMENT CDD_MotVel.dMotVelTiStampRef "MICROSAR RTE" FLOAT32_IEEE NO_COMPU_METHOD 0 0 0 4295 ECU_ADDRESS 0 SYMBOL_LINK "Rte_CDD_MotVel_dMotVelTiStampRef" 0 DISPLAY_IDENTIFIER CDD_MotVel.PerInstanceMemories.dMotVelTiStampRef /end MEASUREMENT
/begin MEASUREMENT CDD_NvMProxy.BlkFltTbl[0].Prm "MICROSAR RTE" UBYTE NO_COMPU_METHOD 0 0 0 255 ECU_ADDRESS 0 SYMBOL_LINK "Rte_CDD_NvMProxy_BlkFltTbl[0].Prm" 0 DISPLAY_IDENTIFIER CDD_NvMProxy.PerInstanceMemories.BlkFltTbl[0].Prm /end MEASUREMENT
/begin MEASUREMENT CDD_NvMProxy.BlkFltTbl[0].Sts "MICROSAR RTE" UBYTE RTE_CM_ENUM_NtcSts1 0 0 0 255 ECU_ADDRESS 0 SYMBOL_LINK "Rte_CDD_NvMProxy_BlkFltTbl[0].Sts" 0 DISPLAY_IDENTIFIER CDD_NvMProxy.PerInstanceMemories.BlkFltTbl[0].Sts /end MEASUREMENT
/begin MEASUREMENT CDD_NvMProxy.BlkFltTbl[1].Prm "MICROSAR RTE" UBYTE NO_COMPU_METHOD 0 0 0 255 ECU_ADDRESS 0 SYMBOL_LINK "Rte_CDD_NvMProxy_BlkFltTbl[1].Prm" 0 DISPLAY_IDENTIFIER CDD_NvMProxy.PerInstanceMemories.BlkFltTbl[1].Prm /end MEASUREMENT
/begin MEASUREMENT CDD_NvMProxy.BlkFltTbl[1].Sts "MICROSAR RTE" UBYTE RTE_CM_ENUM_NtcSts1 0 0 0 255 ECU_ADDRESS 0 SYMBOL_LINK "Rte_CDD_NvMProxy_BlkFltTbl[1].Sts" 0 DISPLAY_IDENTIFIER CDD_NvMProxy.PerInstanceMemories.BlkFltTbl[1].Sts /end MEASUREMENT
/begin MEASUREMENT CDD_NvMProxy.BlkFltTbl[2].Prm "MICROSAR RTE" UBYTE NO_COMPU_METHOD 0 0 0 255 ECU_ADDRESS 0 SYMBOL_LINK "Rte_CDD_NvMProxy_BlkFltTbl[2].Prm" 0 DISPLAY_IDENTIFIER CDD_NvMProxy.PerInstanceMemories.BlkFltTbl[2].Prm /end MEASUREMENT
/begin MEASUREMENT CDD_NvMProxy.BlkFltTbl[2].Sts "MICROSAR RTE" UBYTE RTE_CM_ENUM_NtcSts1 0 0 0 255 ECU_ADDRESS 0 SYMBOL_LINK "Rte_CDD_NvMProxy_BlkFltTbl[2].Sts" 0 DISPLAY_IDENTIFIER CDD_NvMProxy.PerInstanceMemories.BlkFltTbl[2].Sts /end MEASUREMENT
/begin MEASUREMENT CDD_NvMProxy.BlkFltTbl[3].Prm "MICROSAR RTE" UBYTE NO_COMPU_METHOD 0 0 0 255 ECU_ADDRESS 0 SYMBOL_LINK "Rte_CDD_NvMProxy_BlkFltTbl[3].Prm" 0 DISPLAY_IDENTIFIER CDD_NvMProxy.PerInstanceMemories.BlkFltTbl[3].Prm /end MEASUREMENT
/begin MEASUREMENT CDD_NvMProxy.BlkFltTbl[3].Sts "MICROSAR RTE" UBYTE RTE_CM_ENUM_NtcSts1 0 0 0 255 ECU_ADDRESS 0 SYMBOL_LINK "Rte_CDD_NvMProxy_BlkFltTbl[3].Sts" 0 DISPLAY_IDENTIFIER CDD_NvMProxy.PerInstanceMemories.BlkFltTbl[3].Sts /end MEASUREMENT
/begin MEASUREMENT CDD_NvMProxy.BlkFltTbl[4].Prm "MICROSAR RTE" UBYTE NO_COMPU_METHOD 0 0 0 255 ECU_ADDRESS 0 SYMBOL_LINK "Rte_CDD_NvMProxy_BlkFltTbl[4].Prm" 0 DISPLAY_IDENTIFIER CDD_NvMProxy.PerInstanceMemories.BlkFltTbl[4].Prm /end MEASUREMENT
/begin MEASUREMENT CDD_NvMProxy.BlkFltTbl[4].Sts "MICROSAR RTE" UBYTE RTE_CM_ENUM_NtcSts1 0 0 0 255 ECU_ADDRESS 0 SYMBOL_LINK "Rte_CDD_NvMProxy_BlkFltTbl[4].Sts" 0 DISPLAY_IDENTIFIER CDD_NvMProxy.PerInstanceMemories.BlkFltTbl[4].Sts /end MEASUREMENT
/begin MEASUREMENT CDD_NvMProxy.NvmBlkActv "MICROSAR RTE" UBYTE RTE_CM_BOOLEAN 0 0 0 255 MATRIX_DIM 65535 1 1 ECU_ADDRESS 0 SYMBOL_LINK "Rte_CDD_NvMProxy_NvmBlkActv" 0 DISPLAY_IDENTIFIER CDD_NvMProxy.PerInstanceMemories.NvmBlkActv /end MEASUREMENT
/begin MEASUREMENT CDD_NvMProxy.NvmStsCollctd "MICROSAR RTE" UBYTE RTE_CM_BOOLEAN 0 0 0 255 ECU_ADDRESS 0 SYMBOL_LINK "Rte_CDD_NvMProxy_NvmStsCollctd" 0 DISPLAY_IDENTIFIER CDD_NvMProxy.PerInstanceMemories.NvmStsCollctd /end MEASUREMENT
/begin MEASUREMENT CDD_NvMProxy.ShtdwnClsChk "MICROSAR RTE" ULONG NO_COMPU_METHOD 0 0 0 4294967295 ECU_ADDRESS 0 SYMBOL_LINK "Rte_CDD_NvMProxy_ShtdwnClsChk" 0 DISPLAY_IDENTIFIER CDD_NvMProxy.PerInstanceMemories.ShtdwnClsChk /end MEASUREMENT
/begin MEASUREMENT CDD_RamMem.LclRamEccSngBitCntr "MICROSAR RTE" UBYTE NO_COMPU_METHOD 0 0 0 255 ECU_ADDRESS 0 SYMBOL_LINK "Rte_CDD_RamMem_LclRamEccSngBitCntr" 0 DISPLAY_IDENTIFIER CDD_RamMem.PerInstanceMemories.LclRamEccSngBitCntr /end MEASUREMENT
/begin MEASUREMENT CDD_RamMem.LclRamEccSngBitCntrOutp.Val "MICROSAR RTE" UBYTE NO_COMPU_METHOD 0 0 0 255 ECU_ADDRESS 0 SYMBOL_LINK "Rte_CDD_RamMem_LclRamEccSngBitCntrOutp_Val" 0 DISPLAY_IDENTIFIER CDD_RamMem.SenderPorts.LclRamEccSngBitCntrOutp.Val /end MEASUREMENT
/begin MEASUREMENT CDD_RamMem.LclRamEccSngBitSoftFailr "MICROSAR RTE" UBYTE RTE_CM_BOOLEAN 0 0 0 255 ECU_ADDRESS 0 SYMBOL_LINK "Rte_CDD_RamMem_LclRamEccSngBitSoftFailr" 0 DISPLAY_IDENTIFIER CDD_RamMem.PerInstanceMemories.LclRamEccSngBitSoftFailr /end MEASUREMENT
/begin MEASUREMENT CDD_RamMem.LclRamFailrAdr "MICROSAR RTE" ULONG NO_COMPU_METHOD 0 0 0 4294967295 ECU_ADDRESS 0 SYMBOL_LINK "Rte_CDD_RamMem_LclRamFailrAdr" 0 DISPLAY_IDENTIFIER CDD_RamMem.PerInstanceMemories.LclRamFailrAdr /end MEASUREMENT
/begin MEASUREMENT CDD_RamMem.LclRamWordLineRead "MICROSAR RTE" ULONG NO_COMPU_METHOD 0 0 0 4294967295 ECU_ADDRESS 0 SYMBOL_LINK "Rte_CDD_RamMem_LclRamWordLineRead" 0 DISPLAY_IDENTIFIER CDD_RamMem.PerInstanceMemories.LclRamWordLineRead /end MEASUREMENT
/begin MEASUREMENT CDD_RamMem.dRamMemCanRamDblBitEccErrAdr "MICROSAR RTE" ULONG NO_COMPU_METHOD 0 0 0 4294967295 ECU_ADDRESS 0 SYMBOL_LINK "Rte_CDD_RamMem_dRamMemCanRamDblBitEccErrAdr" 0 DISPLAY_IDENTIFIER CDD_RamMem.PerInstanceMemories.dRamMemCanRamDblBitEccErrAdr /end MEASUREMENT
/begin MEASUREMENT CDD_RamMem.dRamMemCanRamSngBitEccErrAdr "MICROSAR RTE" ULONG NO_COMPU_METHOD 0 0 0 4294967295 ECU_ADDRESS 0 SYMBOL_LINK "Rte_CDD_RamMem_dRamMemCanRamSngBitEccErrAdr" 0 DISPLAY_IDENTIFIER CDD_RamMem.PerInstanceMemories.dRamMemCanRamSngBitEccErrAdr /end MEASUREMENT
/begin MEASUREMENT CDD_RamMem.dRamMemDtsRamEccErrAdr "MICROSAR RTE" ULONG NO_COMPU_METHOD 0 0 0 4294967295 ECU_ADDRESS 0 SYMBOL_LINK "Rte_CDD_RamMem_dRamMemDtsRamEccErrAdr" 0 DISPLAY_IDENTIFIER CDD_RamMem.PerInstanceMemories.dRamMemDtsRamEccErrAdr /end MEASUREMENT
/begin MEASUREMENT CDD_RamMem.dRamMemFrRamDblBitEccErrAdr "MICROSAR RTE" ULONG NO_COMPU_METHOD 0 0 0 4294967295 ECU_ADDRESS 0 SYMBOL_LINK "Rte_CDD_RamMem_dRamMemFrRamDblBitEccErrAdr" 0 DISPLAY_IDENTIFIER CDD_RamMem.PerInstanceMemories.dRamMemFrRamDblBitEccErrAdr /end MEASUREMENT
/begin MEASUREMENT CDD_RamMem.dRamMemFrRamSngBitEccErrAdr "MICROSAR RTE" ULONG NO_COMPU_METHOD 0 0 0 4294967295 ECU_ADDRESS 0 SYMBOL_LINK "Rte_CDD_RamMem_dRamMemFrRamSngBitEccErrAdr" 0 DISPLAY_IDENTIFIER CDD_RamMem.PerInstanceMemories.dRamMemFrRamSngBitEccErrAdr /end MEASUREMENT
/begin MEASUREMENT CDD_RamMem.dRamMemFrRamTmpBufADblBitEccErrAdr "MICROSAR RTE" ULONG NO_COMPU_METHOD 0 0 0 4294967295 ECU_ADDRESS 0 SYMBOL_LINK "Rte_CDD_RamMem_dRamMemFrRamTmpBufADblBitEccErrAdr" 0 DISPLAY_IDENTIFIER CDD_RamMem.PerInstanceMemories.dRamMemFrRamTmpBufADblBitEccErrAdr /end MEASUREMENT
/begin MEASUREMENT CDD_RamMem.dRamMemFrRamTmpBufBDblBitEccErrAdr "MICROSAR RTE" ULONG NO_COMPU_METHOD 0 0 0 4294967295 ECU_ADDRESS 0 SYMBOL_LINK "Rte_CDD_RamMem_dRamMemFrRamTmpBufBDblBitEccErrAdr" 0 DISPLAY_IDENTIFIER CDD_RamMem.PerInstanceMemories.dRamMemFrRamTmpBufBDblBitEccErrAdr /end MEASUREMENT
/begin MEASUREMENT CDD_RamMem.dRamMemSpi0RamEccErrAdr "MICROSAR RTE" ULONG NO_COMPU_METHOD 0 0 0 4294967295 ECU_ADDRESS 0 SYMBOL_LINK "Rte_CDD_RamMem_dRamMemSpi0RamEccErrAdr" 0 DISPLAY_IDENTIFIER CDD_RamMem.PerInstanceMemories.dRamMemSpi0RamEccErrAdr /end MEASUREMENT
/begin MEASUREMENT CDD_RamMem.dRamMemSpi1RamEccErrAdr "MICROSAR RTE" ULONG NO_COMPU_METHOD 0 0 0 4294967295 ECU_ADDRESS 0 SYMBOL_LINK "Rte_CDD_RamMem_dRamMemSpi1RamEccErrAdr" 0 DISPLAY_IDENTIFIER CDD_RamMem.PerInstanceMemories.dRamMemSpi1RamEccErrAdr /end MEASUREMENT
/begin MEASUREMENT CDD_RamMem.dRamMemSpi2RamEccErrAdr "MICROSAR RTE" ULONG NO_COMPU_METHOD 0 0 0 4294967295 ECU_ADDRESS 0 SYMBOL_LINK "Rte_CDD_RamMem_dRamMemSpi2RamEccErrAdr" 0 DISPLAY_IDENTIFIER CDD_RamMem.PerInstanceMemories.dRamMemSpi2RamEccErrAdr /end MEASUREMENT
/begin MEASUREMENT CDD_RamMem.dRamMemSpi3RamEccErrAdr "MICROSAR RTE" ULONG NO_COMPU_METHOD 0 0 0 4294967295 ECU_ADDRESS 0 SYMBOL_LINK "Rte_CDD_RamMem_dRamMemSpi3RamEccErrAdr" 0 DISPLAY_IDENTIFIER CDD_RamMem.PerInstanceMemories.dRamMemSpi3RamEccErrAdr /end MEASUREMENT
/begin MEASUREMENT CDD_RamMem.dRamMemSpiRamEccErrAdr "MICROSAR RTE" ULONG NO_COMPU_METHOD 0 0 0 4294967295 ECU_ADDRESS 0 SYMBOL_LINK "Rte_CDD_RamMem_dRamMemSpiRamEccErrAdr" 0 DISPLAY_IDENTIFIER CDD_RamMem.PerInstanceMemories.dRamMemSpiRamEccErrAdr /end MEASUREMENT
/begin MEASUREMENT CDD_Sci30CfgAndUse.Sci100MilliSecBufCnt "MICROSAR RTE" UBYTE NO_COMPU_METHOD 0 0 0 255 MATRIX_DIM 8 65535 1 ECU_ADDRESS 0 SYMBOL_LINK "Rte_CDD_Sci30CfgAndUse_Sci100MilliSecBufCnt" 0 DISPLAY_IDENTIFIER CDD_Sci30CfgAndUse.PerInstanceMemories.Sci100MilliSecBufCnt /end MEASUREMENT
/begin MEASUREMENT CDD_Sci30CfgAndUse.Sci100MilliSecReadCmpl "MICROSAR RTE" UBYTE RTE_CM_BOOLEAN 0 0 0 255 ECU_ADDRESS 0 SYMBOL_LINK "Rte_CDD_Sci30CfgAndUse_Sci100MilliSecReadCmpl" 0 DISPLAY_IDENTIFIER CDD_Sci30CfgAndUse.PerInstanceMemories.Sci100MilliSecReadCmpl /end MEASUREMENT
/begin MEASUREMENT CDD_Sci30CfgAndUse.Sci10MilliSecBufCnt "MICROSAR RTE" UBYTE NO_COMPU_METHOD 0 0 0 255 MATRIX_DIM 8 65535 1 ECU_ADDRESS 0 SYMBOL_LINK "Rte_CDD_Sci30CfgAndUse_Sci10MilliSecBufCnt" 0 DISPLAY_IDENTIFIER CDD_Sci30CfgAndUse.PerInstanceMemories.Sci10MilliSecBufCnt /end MEASUREMENT
/begin MEASUREMENT CDD_Sci30CfgAndUse.Sci10MilliSecReadCmpl "MICROSAR RTE" UBYTE RTE_CM_BOOLEAN 0 0 0 255 ECU_ADDRESS 0 SYMBOL_LINK "Rte_CDD_Sci30CfgAndUse_Sci10MilliSecReadCmpl" 0 DISPLAY_IDENTIFIER CDD_Sci30CfgAndUse.PerInstanceMemories.Sci10MilliSecReadCmpl /end MEASUREMENT
/begin MEASUREMENT CDD_Sci30CfgAndUse.Sci2MilliSecBufCnt "MICROSAR RTE" UBYTE NO_COMPU_METHOD 0 0 0 255 MATRIX_DIM 8 65535 1 ECU_ADDRESS 0 SYMBOL_LINK "Rte_CDD_Sci30CfgAndUse_Sci2MilliSecBufCnt" 0 DISPLAY_IDENTIFIER CDD_Sci30CfgAndUse.PerInstanceMemories.Sci2MilliSecBufCnt /end MEASUREMENT
/begin MEASUREMENT CDD_Sci30CfgAndUse.SciDiagcFrmErrCntr "MICROSAR RTE" ULONG NO_COMPU_METHOD 0 0 0 4294967295 ECU_ADDRESS 0 SYMBOL_LINK "Rte_CDD_Sci30CfgAndUse_SciDiagcFrmErrCntr" 0 DISPLAY_IDENTIFIER CDD_Sci30CfgAndUse.PerInstanceMemories.SciDiagcFrmErrCntr /end MEASUREMENT
/begin MEASUREMENT CDD_Sci30CfgAndUse.SciDiagcOvrrunErrCntr "MICROSAR RTE" ULONG NO_COMPU_METHOD 0 0 0 4294967295 ECU_ADDRESS 0 SYMBOL_LINK "Rte_CDD_Sci30CfgAndUse_SciDiagcOvrrunErrCntr" 0 DISPLAY_IDENTIFIER CDD_Sci30CfgAndUse.PerInstanceMemories.SciDiagcOvrrunErrCntr /end MEASUREMENT
/begin MEASUREMENT CDD_Sci30CfgAndUse.SciDiagcParErrCntr "MICROSAR RTE" ULONG NO_COMPU_METHOD 0 0 0 4294967295 ECU_ADDRESS 0 SYMBOL_LINK "Rte_CDD_Sci30CfgAndUse_SciDiagcParErrCntr" 0 DISPLAY_IDENTIFIER CDD_Sci30CfgAndUse.PerInstanceMemories.SciDiagcParErrCntr /end MEASUREMENT
/begin MEASUREMENT CDD_Sci30CfgAndUse.SciDiagcRxMaxDataErrCntr "MICROSAR RTE" ULONG NO_COMPU_METHOD 0 0 0 4294967295 ECU_ADDRESS 0 SYMBOL_LINK "Rte_CDD_Sci30CfgAndUse_SciDiagcRxMaxDataErrCntr" 0 DISPLAY_IDENTIFIER CDD_Sci30CfgAndUse.PerInstanceMemories.SciDiagcRxMaxDataErrCntr /end MEASUREMENT
/begin MEASUREMENT CDD_Sci30CfgAndUse.SciNrOfPnd100MilliSecFrmCnt "MICROSAR RTE" UBYTE NO_COMPU_METHOD 0 0 0 255 ECU_ADDRESS 0 SYMBOL_LINK "Rte_CDD_Sci30CfgAndUse_SciNrOfPnd100MilliSecFrmCnt" 0 DISPLAY_IDENTIFIER CDD_Sci30CfgAndUse.PerInstanceMemories.SciNrOfPnd100MilliSecFrmCnt /end MEASUREMENT
/begin MEASUREMENT CDD_Sci30CfgAndUse.SciNrOfPnd10MilliSecFrmCnt "MICROSAR RTE" UBYTE NO_COMPU_METHOD 0 0 0 255 ECU_ADDRESS 0 SYMBOL_LINK "Rte_CDD_Sci30CfgAndUse_SciNrOfPnd10MilliSecFrmCnt" 0 DISPLAY_IDENTIFIER CDD_Sci30CfgAndUse.PerInstanceMemories.SciNrOfPnd10MilliSecFrmCnt /end MEASUREMENT
/begin MEASUREMENT CDD_Sci30CfgAndUse.SciRxPrevLoopDataUnread "MICROSAR RTE" UBYTE NO_COMPU_METHOD 0 0 0 255 ECU_ADDRESS 0 SYMBOL_LINK "Rte_CDD_Sci30CfgAndUse_SciRxPrevLoopDataUnread" 0 DISPLAY_IDENTIFIER CDD_Sci30CfgAndUse.PerInstanceMemories.SciRxPrevLoopDataUnread /end MEASUREMENT
/begin MEASUREMENT CDD_Sci30CfgAndUse.SciRxProcIdx "MICROSAR RTE" UBYTE NO_COMPU_METHOD 0 0 0 255 ECU_ADDRESS 0 SYMBOL_LINK "Rte_CDD_Sci30CfgAndUse_SciRxProcIdx" 0 DISPLAY_IDENTIFIER CDD_Sci30CfgAndUse.PerInstanceMemories.SciRxProcIdx /end MEASUREMENT
/begin MEASUREMENT CDD_SinVltgGenn.Fil1OutpPrev "MICROSAR RTE" FLOAT32_IEEE NO_COMPU_METHOD 0 0 0 71429 ECU_ADDRESS 0 SYMBOL_LINK "Rte_CDD_SinVltgGenn_Fil1OutpPrev" 0 DISPLAY_IDENTIFIER CDD_SinVltgGenn.PerInstanceMemories.Fil1OutpPrev /end MEASUREMENT
/begin MEASUREMENT CDD_SinVltgGenn.Fil2OutpPrev "MICROSAR RTE" FLOAT32_IEEE NO_COMPU_METHOD 0 0 0 71429 ECU_ADDRESS 0 SYMBOL_LINK "Rte_CDD_SinVltgGenn_Fil2OutpPrev" 0 DISPLAY_IDENTIFIER CDD_SinVltgGenn.PerInstanceMemories.Fil2OutpPrev /end MEASUREMENT
/begin MEASUREMENT CDD_SinVltgGenn.MotElecMeclPolarity.Val "MICROSAR RTE" SBYTE NO_COMPU_METHOD 0 0 -1.0 1.0 ECU_ADDRESS 0 SYMBOL_LINK "Rte_PolarityCfg_MotElecMeclPolarity_Val" 0 DISPLAY_IDENTIFIER CDD_SinVltgGenn.ReceiverPorts.MotElecMeclPolarity.Val /end MEASUREMENT
/begin MEASUREMENT CDD_SinVltgGenn.PhaDptOffsA "MICROSAR RTE" FLOAT32_IEEE NO_COMPU_METHOD 0 0 0.0 0.999 ECU_ADDRESS 0 SYMBOL_LINK "Rte_CDD_SinVltgGenn_PhaDptOffsA" 0 DISPLAY_IDENTIFIER CDD_SinVltgGenn.PerInstanceMemories.PhaDptOffsA /end MEASUREMENT
/begin MEASUREMENT CDD_SinVltgGenn.PhaDptOffsB "MICROSAR RTE" FLOAT32_IEEE NO_COMPU_METHOD 0 0 0.0 0.999 ECU_ADDRESS 0 SYMBOL_LINK "Rte_CDD_SinVltgGenn_PhaDptOffsB" 0 DISPLAY_IDENTIFIER CDD_SinVltgGenn.PerInstanceMemories.PhaDptOffsB /end MEASUREMENT
/begin MEASUREMENT CDD_SinVltgGenn.PhaDptOffsC "MICROSAR RTE" FLOAT32_IEEE NO_COMPU_METHOD 0 0 0.0 0.999 ECU_ADDRESS 0 SYMBOL_LINK "Rte_CDD_SinVltgGenn_PhaDptOffsC" 0 DISPLAY_IDENTIFIER CDD_SinVltgGenn.PerInstanceMemories.PhaDptOffsC /end MEASUREMENT
/begin MEASUREMENT CDD_SinVltgGenn.PhaOnTiSumAPrev "MICROSAR RTE" ULONG NO_COMPU_METHOD 0 0 0 4294967295 ECU_ADDRESS 0 SYMBOL_LINK "Rte_CDD_SinVltgGenn_PhaOnTiSumAPrev" 0 DISPLAY_IDENTIFIER CDD_SinVltgGenn.PerInstanceMemories.PhaOnTiSumAPrev /end MEASUREMENT
/begin MEASUREMENT CDD_SinVltgGenn.PhaOnTiSumBPrev "MICROSAR RTE" ULONG NO_COMPU_METHOD 0 0 0 4294967295 ECU_ADDRESS 0 SYMBOL_LINK "Rte_CDD_SinVltgGenn_PhaOnTiSumBPrev" 0 DISPLAY_IDENTIFIER CDD_SinVltgGenn.PerInstanceMemories.PhaOnTiSumBPrev /end MEASUREMENT
/begin MEASUREMENT CDD_SinVltgGenn.PhaOnTiSumCPrev "MICROSAR RTE" ULONG NO_COMPU_METHOD 0 0 0 4294967295 ECU_ADDRESS 0 SYMBOL_LINK "Rte_CDD_SinVltgGenn_PhaOnTiSumCPrev" 0 DISPLAY_IDENTIFIER CDD_SinVltgGenn.PerInstanceMemories.PhaOnTiSumCPrev /end MEASUREMENT
/begin MEASUREMENT CDD_SinVltgGenn.PwmPerdRng "MICROSAR RTE" ULONG NO_COMPU_METHOD 0 0 0 71429 ECU_ADDRESS 0 SYMBOL_LINK "Rte_CDD_SinVltgGenn_PwmPerdRng" 0 DISPLAY_IDENTIFIER CDD_SinVltgGenn.PerInstanceMemories.PwmPerdRng /end MEASUREMENT
/begin MEASUREMENT CDD_SinVltgGenn.RndNrPrev "MICROSAR RTE" FLOAT32_IEEE NO_COMPU_METHOD 0 0 0.0 1.0 ECU_ADDRESS 0 SYMBOL_LINK "Rte_CDD_SinVltgGenn_RndNrPrev" 0 DISPLAY_IDENTIFIER CDD_SinVltgGenn.PerInstanceMemories.RndNrPrev /end MEASUREMENT
/begin MEASUREMENT CDD_SnsrMeasStrt.TqMsgTrigCnt "Captures how many timer trigger happen" ULONG NO_COMPU_METHOD 0 0 0 4294967295 ECU_ADDRESS 0 SYMBOL_LINK "Rte_CDD_SnsrMeasStrt_TqMsgTrigCnt" 0 DISPLAY_IDENTIFIER CDD_SnsrMeasStrt.PerInstanceMemories.TqMsgTrigCnt /end MEASUREMENT
/begin MEASUREMENT CDD_SyncCrc.CrcHwSts[0].CrcHwSts "MICROSAR RTE" UBYTE RTE_CM_ENUM_CrcHwSts1 0 0 0 255 ECU_ADDRESS 0 SYMBOL_LINK "Rte_CDD_SyncCrc_CrcHwSts[0].CrcHwSts" 0 DISPLAY_IDENTIFIER CDD_SyncCrc.PerInstanceMemories.CrcHwSts[0].CrcHwSts /end MEASUREMENT
/begin MEASUREMENT CDD_SyncCrc.CrcHwSts[0].TaskId "MICROSAR RTE" UWORD NO_COMPU_METHOD 0 0 0 65535 ECU_ADDRESS 0 SYMBOL_LINK "Rte_CDD_SyncCrc_CrcHwSts[0].TaskId" 0 DISPLAY_IDENTIFIER CDD_SyncCrc.PerInstanceMemories.CrcHwSts[0].TaskId /end MEASUREMENT
/begin MEASUREMENT CDD_SyncCrc.CrcHwSts[1].CrcHwSts "MICROSAR RTE" UBYTE RTE_CM_ENUM_CrcHwSts1 0 0 0 255 ECU_ADDRESS 0 SYMBOL_LINK "Rte_CDD_SyncCrc_CrcHwSts[1].CrcHwSts" 0 DISPLAY_IDENTIFIER CDD_SyncCrc.PerInstanceMemories.CrcHwSts[1].CrcHwSts /end MEASUREMENT
/begin MEASUREMENT CDD_SyncCrc.CrcHwSts[1].TaskId "MICROSAR RTE" UWORD NO_COMPU_METHOD 0 0 0 65535 ECU_ADDRESS 0 SYMBOL_LINK "Rte_CDD_SyncCrc_CrcHwSts[1].TaskId" 0 DISPLAY_IDENTIFIER CDD_SyncCrc.PerInstanceMemories.CrcHwSts[1].TaskId /end MEASUREMENT
/begin MEASUREMENT CDD_SyncCrc.CrcHwSts[2].CrcHwSts "MICROSAR RTE" UBYTE RTE_CM_ENUM_CrcHwSts1 0 0 0 255 ECU_ADDRESS 0 SYMBOL_LINK "Rte_CDD_SyncCrc_CrcHwSts[2].CrcHwSts" 0 DISPLAY_IDENTIFIER CDD_SyncCrc.PerInstanceMemories.CrcHwSts[2].CrcHwSts /end MEASUREMENT
/begin MEASUREMENT CDD_SyncCrc.CrcHwSts[2].TaskId "MICROSAR RTE" UWORD NO_COMPU_METHOD 0 0 0 65535 ECU_ADDRESS 0 SYMBOL_LINK "Rte_CDD_SyncCrc_CrcHwSts[2].TaskId" 0 DISPLAY_IDENTIFIER CDD_SyncCrc.PerInstanceMemories.CrcHwSts[2].TaskId /end MEASUREMENT
/begin MEASUREMENT CDD_SyncCrc.CrcHwSts[3].CrcHwSts "MICROSAR RTE" UBYTE RTE_CM_ENUM_CrcHwSts1 0 0 0 255 ECU_ADDRESS 0 SYMBOL_LINK "Rte_CDD_SyncCrc_CrcHwSts[3].CrcHwSts" 0 DISPLAY_IDENTIFIER CDD_SyncCrc.PerInstanceMemories.CrcHwSts[3].CrcHwSts /end MEASUREMENT
/begin MEASUREMENT CDD_SyncCrc.CrcHwSts[3].TaskId "MICROSAR RTE" UWORD NO_COMPU_METHOD 0 0 0 65535 ECU_ADDRESS 0 SYMBOL_LINK "Rte_CDD_SyncCrc_CrcHwSts[3].TaskId" 0 DISPLAY_IDENTIFIER CDD_SyncCrc.PerInstanceMemories.CrcHwSts[3].TaskId /end MEASUREMENT
/begin MEASUREMENT CDD_TSG31CfgAndUse.MotCurrEolCalSt.Val "MICROSAR RTE" UBYTE RTE_CM_ENUM_MotCurrEolCalSt2 0 0 0 255 ECU_ADDRESS 0 SYMBOL_LINK "Rte_CDD_CurrMeas_MotCurrEolCalSt_Val" 0 DISPLAY_IDENTIFIER CDD_TSG31CfgAndUse.ReceiverPorts.MotCurrEolCalSt.Val /end MEASUREMENT
/begin MEASUREMENT CDD_TSG31CfgAndUse.SysSt.Val "MICROSAR RTE" UBYTE RTE_CM_ENUM_SysSt1 0 0 0 255 ECU_ADDRESS 0 SYMBOL_LINK "Rte_SysStMod_SysSt_Val" 0 DISPLAY_IDENTIFIER CDD_TSG31CfgAndUse.ReceiverPorts.SysSt.Val /end MEASUREMENT
/begin MEASUREMENT CDD_TSG31CfgAndUse.TSG31CfgAndUseAdcStrtOfCnvnPeak "MICROSAR RTE" ULONG NO_COMPU_METHOD 0 0 0 1800 ECU_ADDRESS 0 SYMBOL_LINK "Rte_CDD_TSG31CfgAndUse_TSG31CfgAndUseAdcStrtOfCnvnPeak" 0 DISPLAY_IDENTIFIER CDD_TSG31CfgAndUse.PerInstanceMemories.TSG31CfgAndUseAdcStrtOfCnvnPeak /end MEASUREMENT
/begin MEASUREMENT CDD_TSG31CfgAndUse.TSG31CfgAndUseMotAg0SPIStart "MICROSAR RTE" ULONG NO_COMPU_METHOD 0 0 0 1800 ECU_ADDRESS 0 SYMBOL_LINK "Rte_CDD_TSG31CfgAndUse_TSG31CfgAndUseMotAg0SPIStart" 0 DISPLAY_IDENTIFIER CDD_TSG31CfgAndUse.PerInstanceMemories.TSG31CfgAndUseMotAg0SPIStart /end MEASUREMENT
/begin MEASUREMENT CDD_TSG31CfgAndUse.TSG31CfgAndUseSysStEnaPrev "MICROSAR RTE" UBYTE RTE_CM_BOOLEAN 0 0 0 255 ECU_ADDRESS 0 SYMBOL_LINK "Rte_CDD_TSG31CfgAndUse_TSG31CfgAndUseSysStEnaPrev" 0 DISPLAY_IDENTIFIER CDD_TSG31CfgAndUse.PerInstanceMemories.TSG31CfgAndUseSysStEnaPrev /end MEASUREMENT
/begin MEASUREMENT CDD_Tauj0CfgAndUse.PhaOnTiCntrAPrev "MICROSAR RTE" ULONG NO_COMPU_METHOD 0 0 0 4294967295 ECU_ADDRESS 0 SYMBOL_LINK "Rte_CDD_Tauj0CfgAndUse_PhaOnTiCntrAPrev" 0 DISPLAY_IDENTIFIER CDD_Tauj0CfgAndUse.PerInstanceMemories.PhaOnTiCntrAPrev /end MEASUREMENT
/begin MEASUREMENT CDD_Tauj0CfgAndUse.PhaOnTiCntrBPrev "MICROSAR RTE" ULONG NO_COMPU_METHOD 0 0 0 4294967295 ECU_ADDRESS 0 SYMBOL_LINK "Rte_CDD_Tauj0CfgAndUse_PhaOnTiCntrBPrev" 0 DISPLAY_IDENTIFIER CDD_Tauj0CfgAndUse.PerInstanceMemories.PhaOnTiCntrBPrev /end MEASUREMENT
/begin MEASUREMENT CDD_Tauj0CfgAndUse.PhaOnTiCntrCPrev "MICROSAR RTE" ULONG NO_COMPU_METHOD 0 0 0 4294967295 ECU_ADDRESS 0 SYMBOL_LINK "Rte_CDD_Tauj0CfgAndUse_PhaOnTiCntrCPrev" 0 DISPLAY_IDENTIFIER CDD_Tauj0CfgAndUse.PerInstanceMemories.PhaOnTiCntrCPrev /end MEASUREMENT
/begin MEASUREMENT CDD_Tauj0CfgAndUse.PhaOnTiMeasdA.Val "MICROSAR RTE" ULONG NO_COMPU_METHOD 0 0 0 4294967295 ECU_ADDRESS 0 SYMBOL_LINK "Rte_CDD_Tauj0CfgAndUse_PhaOnTiMeasdA_Val" 0 DISPLAY_IDENTIFIER CDD_Tauj0CfgAndUse.SenderPorts.PhaOnTiMeasdA.Val /end MEASUREMENT
/begin MEASUREMENT CDD_Tauj0CfgAndUse.PhaOnTiMeasdB.Val "MICROSAR RTE" ULONG NO_COMPU_METHOD 0 0 0 4294967295 ECU_ADDRESS 0 SYMBOL_LINK "Rte_CDD_Tauj0CfgAndUse_PhaOnTiMeasdB_Val" 0 DISPLAY_IDENTIFIER CDD_Tauj0CfgAndUse.SenderPorts.PhaOnTiMeasdB.Val /end MEASUREMENT
/begin MEASUREMENT CDD_Tauj0CfgAndUse.PhaOnTiMeasdC.Val "MICROSAR RTE" ULONG NO_COMPU_METHOD 0 0 0 4294967295 ECU_ADDRESS 0 SYMBOL_LINK "Rte_CDD_Tauj0CfgAndUse_PhaOnTiMeasdC_Val" 0 DISPLAY_IDENTIFIER CDD_Tauj0CfgAndUse.SenderPorts.PhaOnTiMeasdC.Val /end MEASUREMENT
/begin MEASUREMENT CDD_Tauj1CfgAndUse.PhaOnTiCntrDPrev "MICROSAR RTE" ULONG NO_COMPU_METHOD 0 0 0 4294967295 ECU_ADDRESS 0 SYMBOL_LINK "Rte_CDD_Tauj1CfgAndUse_PhaOnTiCntrDPrev" 0 DISPLAY_IDENTIFIER CDD_Tauj1CfgAndUse.PerInstanceMemories.PhaOnTiCntrDPrev /end MEASUREMENT
/begin MEASUREMENT CDD_Tauj1CfgAndUse.PhaOnTiCntrEPrev "MICROSAR RTE" ULONG NO_COMPU_METHOD 0 0 0 4294967295 ECU_ADDRESS 0 SYMBOL_LINK "Rte_CDD_Tauj1CfgAndUse_PhaOnTiCntrEPrev" 0 DISPLAY_IDENTIFIER CDD_Tauj1CfgAndUse.PerInstanceMemories.PhaOnTiCntrEPrev /end MEASUREMENT
/begin MEASUREMENT CDD_Tauj1CfgAndUse.PhaOnTiCntrFPrev "MICROSAR RTE" ULONG NO_COMPU_METHOD 0 0 0 4294967295 ECU_ADDRESS 0 SYMBOL_LINK "Rte_CDD_Tauj1CfgAndUse_PhaOnTiCntrFPrev" 0 DISPLAY_IDENTIFIER CDD_Tauj1CfgAndUse.PerInstanceMemories.PhaOnTiCntrFPrev /end MEASUREMENT
/begin MEASUREMENT CDD_Tauj1CfgAndUse.PhaOnTiMeasdD.Val "MICROSAR RTE" ULONG NO_COMPU_METHOD 0 0 0 4294967295 ECU_ADDRESS 0 SYMBOL_LINK "Rte_CDD_Tauj1CfgAndUse_PhaOnTiMeasdD_Val" 0 DISPLAY_IDENTIFIER CDD_Tauj1CfgAndUse.SenderPorts.PhaOnTiMeasdD.Val /end MEASUREMENT
/begin MEASUREMENT CDD_Tauj1CfgAndUse.PhaOnTiMeasdE.Val "MICROSAR RTE" ULONG NO_COMPU_METHOD 0 0 0 4294967295 ECU_ADDRESS 0 SYMBOL_LINK "Rte_CDD_Tauj1CfgAndUse_PhaOnTiMeasdE_Val" 0 DISPLAY_IDENTIFIER CDD_Tauj1CfgAndUse.SenderPorts.PhaOnTiMeasdE.Val /end MEASUREMENT
/begin MEASUREMENT CDD_Tauj1CfgAndUse.PhaOnTiMeasdF.Val "MICROSAR RTE" ULONG NO_COMPU_METHOD 0 0 0 4294967295 ECU_ADDRESS 0 SYMBOL_LINK "Rte_CDD_Tauj1CfgAndUse_PhaOnTiMeasdF_Val" 0 DISPLAY_IDENTIFIER CDD_Tauj1CfgAndUse.SenderPorts.PhaOnTiMeasdF.Val /end MEASUREMENT
/begin MEASUREMENT CDD_VrfyCritReg.dVrfyCritRegCritRegActVal "MICROSAR RTE" ULONG NO_COMPU_METHOD 0 0 0 4294967295 ECU_ADDRESS 0 SYMBOL_LINK "Rte_CDD_VrfyCritReg_dVrfyCritRegCritRegActVal" 0 DISPLAY_IDENTIFIER CDD_VrfyCritReg.PerInstanceMemories.dVrfyCritRegCritRegActVal /end MEASUREMENT
/begin MEASUREMENT CDD_VrfyCritReg.dVrfyCritRegCritRegAdr "MICROSAR RTE" ULONG NO_COMPU_METHOD 0 0 0 4294967295 ECU_ADDRESS 0 SYMBOL_LINK "Rte_CDD_VrfyCritReg_dVrfyCritRegCritRegAdr" 0 DISPLAY_IDENTIFIER CDD_VrfyCritReg.PerInstanceMemories.dVrfyCritRegCritRegAdr /end MEASUREMENT
/begin MEASUREMENT CDD_VrfyCritReg.dVrfyCritRegCritRegDesVal "MICROSAR RTE" ULONG NO_COMPU_METHOD 0 0 0 4294967295 ECU_ADDRESS 0 SYMBOL_LINK "Rte_CDD_VrfyCritReg_dVrfyCritRegCritRegDesVal" 0 DISPLAY_IDENTIFIER CDD_VrfyCritReg.PerInstanceMemories.dVrfyCritRegCritRegDesVal /end MEASUREMENT
/begin MEASUREMENT CDD_VrfyCritReg.dVrfyCritRegSysCritRegActVal "MICROSAR RTE" ULONG NO_COMPU_METHOD 0 0 0 4294967295 ECU_ADDRESS 0 SYMBOL_LINK "Rte_CDD_VrfyCritReg_dVrfyCritRegSysCritRegActVal" 0 DISPLAY_IDENTIFIER CDD_VrfyCritReg.PerInstanceMemories.dVrfyCritRegSysCritRegActVal /end MEASUREMENT
/begin MEASUREMENT CDD_VrfyCritReg.dVrfyCritRegSysCritRegAdr "MICROSAR RTE" ULONG NO_COMPU_METHOD 0 0 0 4294967295 ECU_ADDRESS 0 SYMBOL_LINK "Rte_CDD_VrfyCritReg_dVrfyCritRegSysCritRegAdr" 0 DISPLAY_IDENTIFIER CDD_VrfyCritReg.PerInstanceMemories.dVrfyCritRegSysCritRegAdr /end MEASUREMENT
/begin MEASUREMENT CDD_VrfyCritReg.dVrfyCritRegSysCritRegDesVal "MICROSAR RTE" ULONG NO_COMPU_METHOD 0 0 0 4294967295 ECU_ADDRESS 0 SYMBOL_LINK "Rte_CDD_VrfyCritReg_dVrfyCritRegSysCritRegDesVal" 0 DISPLAY_IDENTIFIER CDD_VrfyCritReg.PerInstanceMemories.dVrfyCritRegSysCritRegDesVal /end MEASUREMENT
/begin MEASUREMENT CDD_XcpIf.ActvIninIdx.Val "MICROSAR RTE" UBYTE NO_COMPU_METHOD 0 0 0 255 ECU_ADDRESS 0 SYMBOL_LINK "Rte_TunSelnMngt_ActvIninIdx_Val" 0 DISPLAY_IDENTIFIER CDD_XcpIf.ReceiverPorts.ActvIninIdx.Val /end MEASUREMENT
/begin MEASUREMENT CDD_XcpIf.ActvRtIdx.Val "MICROSAR RTE" UBYTE NO_COMPU_METHOD 0 0 0 255 ECU_ADDRESS 0 SYMBOL_LINK "Rte_TunSelnMngt_ActvRtIdx_Val" 0 DISPLAY_IDENTIFIER CDD_XcpIf.ReceiverPorts.ActvRtIdx.Val /end MEASUREMENT
/begin GROUP CDD_MotCtrlMgr.IvtrLoaMtgtnEna.Logl "MICROSAR RTE" /begin SUB_GROUP /end SUB_GROUP /begin FUNCTION_LIST /end FUNCTION_LIST /begin REF_CHARACTERISTIC /end REF_CHARACTERISTIC /begin REF_MEASUREMENT CDD_MotCtrlMgr.IvtrLoaMtgtnEna.Logl /end REF_MEASUREMENT /end GROUP
/begin GROUP CDD_MotCtrlMgr.LoopCntr2MilliSec.Val "MICROSAR RTE" /begin SUB_GROUP /end SUB_GROUP /begin FUNCTION_LIST /end FUNCTION_LIST /begin REF_CHARACTERISTIC /end REF_CHARACTERISTIC /begin REF_MEASUREMENT CDD_MotCtrlMgr.LoopCntr2MilliSec.Val /end REF_MEASUREMENT /end GROUP
/begin GROUP CDD_MotCtrlMgr.MotAg0Mecl.Val "MICROSAR RTE" /begin SUB_GROUP /end SUB_GROUP /begin FUNCTION_LIST /end FUNCTION_LIST /begin REF_CHARACTERISTIC /end REF_CHARACTERISTIC /begin REF_MEASUREMENT CDD_MotCtrlMgr.MotAg0Mecl.Val /end REF_MEASUREMENT /end GROUP
/begin GROUP CDD_MotCtrlMgr.MotAg0MeclQlfr.Val "MICROSAR RTE" /begin SUB_GROUP /end SUB_GROUP /begin FUNCTION_LIST /end FUNCTION_LIST /begin REF_CHARACTERISTIC /end REF_CHARACTERISTIC /begin REF_MEASUREMENT CDD_MotCtrlMgr.MotAg0MeclQlfr.Val /end REF_MEASUREMENT /end GROUP
/begin GROUP CDD_MotCtrlMgr.MotAg0MeclRollgCntr.Val "MICROSAR RTE" /begin SUB_GROUP /end SUB_GROUP /begin FUNCTION_LIST /end FUNCTION_LIST /begin REF_CHARACTERISTIC /end REF_CHARACTERISTIC /begin REF_MEASUREMENT CDD_MotCtrlMgr.MotAg0MeclRollgCntr.Val /end REF_MEASUREMENT /end GROUP
/begin GROUP CDD_MotCtrlMgr.MotAg0Offs.Val "MICROSAR RTE" /begin SUB_GROUP /end SUB_GROUP /begin FUNCTION_LIST /end FUNCTION_LIST /begin REF_CHARACTERISTIC /end REF_CHARACTERISTIC /begin REF_MEASUREMENT CDD_MotCtrlMgr.MotAg0Offs.Val /end REF_MEASUREMENT /end GROUP
/begin GROUP CDD_MotCtrlMgr.MotAg1Mecl.Val "MICROSAR RTE" /begin SUB_GROUP /end SUB_GROUP /begin FUNCTION_LIST /end FUNCTION_LIST /begin REF_CHARACTERISTIC /end REF_CHARACTERISTIC /begin REF_MEASUREMENT CDD_MotCtrlMgr.MotAg1Mecl.Val /end REF_MEASUREMENT /end GROUP
/begin GROUP CDD_MotCtrlMgr.MotAg1MeclQlfr.Val "MICROSAR RTE" /begin SUB_GROUP /end SUB_GROUP /begin FUNCTION_LIST /end FUNCTION_LIST /begin REF_CHARACTERISTIC /end REF_CHARACTERISTIC /begin REF_MEASUREMENT CDD_MotCtrlMgr.MotAg1MeclQlfr.Val /end REF_MEASUREMENT /end GROUP
/begin GROUP CDD_MotCtrlMgr.MotAg1MeclRollgCntr.Val "MICROSAR RTE" /begin SUB_GROUP /end SUB_GROUP /begin FUNCTION_LIST /end FUNCTION_LIST /begin REF_CHARACTERISTIC /end REF_CHARACTERISTIC /begin REF_MEASUREMENT CDD_MotCtrlMgr.MotAg1MeclRollgCntr.Val /end REF_MEASUREMENT /end GROUP
/begin GROUP CDD_MotCtrlMgr.MotAg1Offs.Val "MICROSAR RTE" /begin SUB_GROUP /end SUB_GROUP /begin FUNCTION_LIST /end FUNCTION_LIST /begin REF_CHARACTERISTIC /end REF_CHARACTERISTIC /begin REF_MEASUREMENT CDD_MotCtrlMgr.MotAg1Offs.Val /end REF_MEASUREMENT /end GROUP
/begin GROUP CDD_MotCtrlMgr.MotAgBuf.Ary1D "MICROSAR RTE" /begin SUB_GROUP /end SUB_GROUP /begin FUNCTION_LIST /end FUNCTION_LIST /begin REF_CHARACTERISTIC /end REF_CHARACTERISTIC /begin REF_MEASUREMENT CDD_MotCtrlMgr.MotAgBuf.Ary1D /end REF_MEASUREMENT /end GROUP
/begin GROUP CDD_MotCtrlMgr.MotAgBufIdx.Val "MICROSAR RTE" /begin SUB_GROUP /end SUB_GROUP /begin FUNCTION_LIST /end FUNCTION_LIST /begin REF_CHARACTERISTIC /end REF_CHARACTERISTIC /begin REF_MEASUREMENT CDD_MotCtrlMgr.MotAgBufIdx.Val /end REF_MEASUREMENT /end GROUP
/begin GROUP CDD_MotCtrlMgr.MotAgCumvAlgndMrfRev.Val "MICROSAR RTE" /begin SUB_GROUP /end SUB_GROUP /begin FUNCTION_LIST /end FUNCTION_LIST /begin REF_CHARACTERISTIC /end REF_CHARACTERISTIC /begin REF_MEASUREMENT CDD_MotCtrlMgr.MotAgCumvAlgndMrfRev.Val /end REF_MEASUREMENT /end GROUP
/begin GROUP CDD_MotCtrlMgr.MotAgElecDly.Val "MICROSAR RTE" /begin SUB_GROUP /end SUB_GROUP /begin FUNCTION_LIST /end FUNCTION_LIST /begin REF_CHARACTERISTIC /end REF_CHARACTERISTIC /begin REF_MEASUREMENT CDD_MotCtrlMgr.MotAgElecDly.Val /end REF_MEASUREMENT /end GROUP
/begin GROUP CDD_MotCtrlMgr.MotAgElecDlyRpl.Val "MICROSAR RTE" /begin SUB_GROUP /end SUB_GROUP /begin FUNCTION_LIST /end FUNCTION_LIST /begin REF_CHARACTERISTIC /end REF_CHARACTERISTIC /begin REF_MEASUREMENT CDD_MotCtrlMgr.MotAgElecDlyRpl.Val /end REF_MEASUREMENT /end GROUP
/begin GROUP CDD_MotCtrlMgr.MotAgMecl0Polarity.Val "MICROSAR RTE" /begin SUB_GROUP /end SUB_GROUP /begin FUNCTION_LIST /end FUNCTION_LIST /begin REF_CHARACTERISTIC /end REF_CHARACTERISTIC /begin REF_MEASUREMENT CDD_MotCtrlMgr.MotAgMecl0Polarity.Val /end REF_MEASUREMENT /end GROUP
/begin GROUP CDD_MotCtrlMgr.MotAgMecl1Polarity.Val "MICROSAR RTE" /begin SUB_GROUP /end SUB_GROUP /begin FUNCTION_LIST /end FUNCTION_LIST /begin REF_CHARACTERISTIC /end REF_CHARACTERISTIC /begin REF_MEASUREMENT CDD_MotCtrlMgr.MotAgMecl1Polarity.Val /end REF_MEASUREMENT /end GROUP
/begin GROUP CDD_MotCtrlMgr.MotAgMeclCorrlnSt.Val "MICROSAR RTE" /begin SUB_GROUP /end SUB_GROUP /begin FUNCTION_LIST /end FUNCTION_LIST /begin REF_CHARACTERISTIC /end REF_CHARACTERISTIC /begin REF_MEASUREMENT CDD_MotCtrlMgr.MotAgMeclCorrlnSt.Val /end REF_MEASUREMENT /end GROUP
/begin GROUP CDD_MotCtrlMgr.MotAgTiBuf.Ary1D "MICROSAR RTE" /begin SUB_GROUP /end SUB_GROUP /begin FUNCTION_LIST /end FUNCTION_LIST /begin REF_CHARACTERISTIC /end REF_CHARACTERISTIC /begin REF_MEASUREMENT CDD_MotCtrlMgr.MotAgTiBuf.Ary1D /end REF_MEASUREMENT /end GROUP
/begin GROUP CDD_MotCtrlMgr.MotCurrAdcVlyA.Val "MICROSAR RTE" /begin SUB_GROUP /end SUB_GROUP /begin FUNCTION_LIST /end FUNCTION_LIST /begin REF_CHARACTERISTIC /end REF_CHARACTERISTIC /begin REF_MEASUREMENT CDD_MotCtrlMgr.MotCurrAdcVlyA.Val /end REF_MEASUREMENT /end GROUP
/begin GROUP CDD_MotCtrlMgr.MotCurrAdcVlyAAdcFaild.Logl "MICROSAR RTE" /begin SUB_GROUP /end SUB_GROUP /begin FUNCTION_LIST /end FUNCTION_LIST /begin REF_CHARACTERISTIC /end REF_CHARACTERISTIC /begin REF_MEASUREMENT CDD_MotCtrlMgr.MotCurrAdcVlyAAdcFaild.Logl /end REF_MEASUREMENT /end GROUP
/begin GROUP CDD_MotCtrlMgr.MotCurrAdcVlyB.Val "MICROSAR RTE" /begin SUB_GROUP /end SUB_GROUP /begin FUNCTION_LIST /end FUNCTION_LIST /begin REF_CHARACTERISTIC /end REF_CHARACTERISTIC /begin REF_MEASUREMENT CDD_MotCtrlMgr.MotCurrAdcVlyB.Val /end REF_MEASUREMENT /end GROUP
/begin GROUP CDD_MotCtrlMgr.MotCurrAdcVlyBAdcFaild.Logl "MICROSAR RTE" /begin SUB_GROUP /end SUB_GROUP /begin FUNCTION_LIST /end FUNCTION_LIST /begin REF_CHARACTERISTIC /end REF_CHARACTERISTIC /begin REF_MEASUREMENT CDD_MotCtrlMgr.MotCurrAdcVlyBAdcFaild.Logl /end REF_MEASUREMENT /end GROUP
/begin GROUP CDD_MotCtrlMgr.MotCurrAdcVlyC.Val "MICROSAR RTE" /begin SUB_GROUP /end SUB_GROUP /begin FUNCTION_LIST /end FUNCTION_LIST /begin REF_CHARACTERISTIC /end REF_CHARACTERISTIC /begin REF_MEASUREMENT CDD_MotCtrlMgr.MotCurrAdcVlyC.Val /end REF_MEASUREMENT /end GROUP
/begin GROUP CDD_MotCtrlMgr.MotCurrAdcVlyCAdcFaild.Logl "MICROSAR RTE" /begin SUB_GROUP /end SUB_GROUP /begin FUNCTION_LIST /end FUNCTION_LIST /begin REF_CHARACTERISTIC /end REF_CHARACTERISTIC /begin REF_MEASUREMENT CDD_MotCtrlMgr.MotCurrAdcVlyCAdcFaild.Logl /end REF_MEASUREMENT /end GROUP
/begin GROUP CDD_MotCtrlMgr.MotCurrAdcVlyD.Val "MICROSAR RTE" /begin SUB_GROUP /end SUB_GROUP /begin FUNCTION_LIST /end FUNCTION_LIST /begin REF_CHARACTERISTIC /end REF_CHARACTERISTIC /begin REF_MEASUREMENT CDD_MotCtrlMgr.MotCurrAdcVlyD.Val /end REF_MEASUREMENT /end GROUP
/begin GROUP CDD_MotCtrlMgr.MotCurrAdcVlyDAdcFaild.Logl "MICROSAR RTE" /begin SUB_GROUP /end SUB_GROUP /begin FUNCTION_LIST /end FUNCTION_LIST /begin REF_CHARACTERISTIC /end REF_CHARACTERISTIC /begin REF_MEASUREMENT CDD_MotCtrlMgr.MotCurrAdcVlyDAdcFaild.Logl /end REF_MEASUREMENT /end GROUP
/begin GROUP CDD_MotCtrlMgr.MotCurrAdcVlyE.Val "MICROSAR RTE" /begin SUB_GROUP /end SUB_GROUP /begin FUNCTION_LIST /end FUNCTION_LIST /begin REF_CHARACTERISTIC /end REF_CHARACTERISTIC /begin REF_MEASUREMENT CDD_MotCtrlMgr.MotCurrAdcVlyE.Val /end REF_MEASUREMENT /end GROUP
/begin GROUP CDD_MotCtrlMgr.MotCurrAdcVlyEAdcFaild.Logl "MICROSAR RTE" /begin SUB_GROUP /end SUB_GROUP /begin FUNCTION_LIST /end FUNCTION_LIST /begin REF_CHARACTERISTIC /end REF_CHARACTERISTIC /begin REF_MEASUREMENT CDD_MotCtrlMgr.MotCurrAdcVlyEAdcFaild.Logl /end REF_MEASUREMENT /end GROUP
/begin GROUP CDD_MotCtrlMgr.MotCurrAdcVlyF.Val "MICROSAR RTE" /begin SUB_GROUP /end SUB_GROUP /begin FUNCTION_LIST /end FUNCTION_LIST /begin REF_CHARACTERISTIC /end REF_CHARACTERISTIC /begin REF_MEASUREMENT CDD_MotCtrlMgr.MotCurrAdcVlyF.Val /end REF_MEASUREMENT /end GROUP
/begin GROUP CDD_MotCtrlMgr.MotCurrAdcVlyFAdcFaild.Logl "MICROSAR RTE" /begin SUB_GROUP /end SUB_GROUP /begin FUNCTION_LIST /end FUNCTION_LIST /begin REF_CHARACTERISTIC /end REF_CHARACTERISTIC /begin REF_MEASUREMENT CDD_MotCtrlMgr.MotCurrAdcVlyFAdcFaild.Logl /end REF_MEASUREMENT /end GROUP
/begin GROUP CDD_MotCtrlMgr.MotCurrCorrdA.Val "MICROSAR RTE" /begin SUB_GROUP /end SUB_GROUP /begin FUNCTION_LIST /end FUNCTION_LIST /begin REF_CHARACTERISTIC /end REF_CHARACTERISTIC /begin REF_MEASUREMENT CDD_MotCtrlMgr.MotCurrCorrdA.Val /end REF_MEASUREMENT /end GROUP
/begin GROUP CDD_MotCtrlMgr.MotCurrCorrdB.Val "MICROSAR RTE" /begin SUB_GROUP /end SUB_GROUP /begin FUNCTION_LIST /end FUNCTION_LIST /begin REF_CHARACTERISTIC /end REF_CHARACTERISTIC /begin REF_MEASUREMENT CDD_MotCtrlMgr.MotCurrCorrdB.Val /end REF_MEASUREMENT /end GROUP
/begin GROUP CDD_MotCtrlMgr.MotCurrCorrdC.Val "MICROSAR RTE" /begin SUB_GROUP /end SUB_GROUP /begin FUNCTION_LIST /end FUNCTION_LIST /begin REF_CHARACTERISTIC /end REF_CHARACTERISTIC /begin REF_MEASUREMENT CDD_MotCtrlMgr.MotCurrCorrdC.Val /end REF_MEASUREMENT /end GROUP
/begin GROUP CDD_MotCtrlMgr.MotCurrCorrdD.Val "MICROSAR RTE" /begin SUB_GROUP /end SUB_GROUP /begin FUNCTION_LIST /end FUNCTION_LIST /begin REF_CHARACTERISTIC /end REF_CHARACTERISTIC /begin REF_MEASUREMENT CDD_MotCtrlMgr.MotCurrCorrdD.Val /end REF_MEASUREMENT /end GROUP
/begin GROUP CDD_MotCtrlMgr.MotCurrCorrdE.Val "MICROSAR RTE" /begin SUB_GROUP /end SUB_GROUP /begin FUNCTION_LIST /end FUNCTION_LIST /begin REF_CHARACTERISTIC /end REF_CHARACTERISTIC /begin REF_MEASUREMENT CDD_MotCtrlMgr.MotCurrCorrdE.Val /end REF_MEASUREMENT /end GROUP
/begin GROUP CDD_MotCtrlMgr.MotCurrCorrdF.Val "MICROSAR RTE" /begin SUB_GROUP /end SUB_GROUP /begin FUNCTION_LIST /end FUNCTION_LIST /begin REF_CHARACTERISTIC /end REF_CHARACTERISTIC /begin REF_MEASUREMENT CDD_MotCtrlMgr.MotCurrCorrdF.Val /end REF_MEASUREMENT /end GROUP
/begin GROUP CDD_MotCtrlMgr.MotCurrDax.Val "MICROSAR RTE" /begin SUB_GROUP /end SUB_GROUP /begin FUNCTION_LIST /end FUNCTION_LIST /begin REF_CHARACTERISTIC /end REF_CHARACTERISTIC /begin REF_MEASUREMENT CDD_MotCtrlMgr.MotCurrDax.Val /end REF_MEASUREMENT /end GROUP
/begin GROUP CDD_MotCtrlMgr.MotCurrDaxCmd.Val "MICROSAR RTE" /begin SUB_GROUP /end SUB_GROUP /begin FUNCTION_LIST /end FUNCTION_LIST /begin REF_CHARACTERISTIC /end REF_CHARACTERISTIC /begin REF_MEASUREMENT CDD_MotCtrlMgr.MotCurrDaxCmd.Val /end REF_MEASUREMENT /end GROUP
/begin GROUP CDD_MotCtrlMgr.MotCurrDaxMax.Val "MICROSAR RTE" /begin SUB_GROUP /end SUB_GROUP /begin FUNCTION_LIST /end FUNCTION_LIST /begin REF_CHARACTERISTIC /end REF_CHARACTERISTIC /begin REF_MEASUREMENT CDD_MotCtrlMgr.MotCurrDaxMax.Val /end REF_MEASUREMENT /end GROUP
/begin GROUP CDD_MotCtrlMgr.MotCurrEolCalSt.Val "MICROSAR RTE" /begin SUB_GROUP /end SUB_GROUP /begin FUNCTION_LIST /end FUNCTION_LIST /begin REF_CHARACTERISTIC /end REF_CHARACTERISTIC /begin REF_MEASUREMENT CDD_MotCtrlMgr.MotCurrEolCalSt.Val /end REF_MEASUREMENT /end GROUP
/begin GROUP CDD_MotCtrlMgr.MotCurrQax.Val "MICROSAR RTE" /begin SUB_GROUP /end SUB_GROUP /begin FUNCTION_LIST /end FUNCTION_LIST /begin REF_CHARACTERISTIC /end REF_CHARACTERISTIC /begin REF_MEASUREMENT CDD_MotCtrlMgr.MotCurrQax.Val /end REF_MEASUREMENT /end GROUP
/begin GROUP CDD_MotCtrlMgr.MotCurrQaxCmd.Val "MICROSAR RTE" /begin SUB_GROUP /end SUB_GROUP /begin FUNCTION_LIST /end FUNCTION_LIST /begin REF_CHARACTERISTIC /end REF_CHARACTERISTIC /begin REF_MEASUREMENT CDD_MotCtrlMgr.MotCurrQaxCmd.Val /end REF_MEASUREMENT /end GROUP
/begin GROUP CDD_MotCtrlMgr.MotCurrQaxToMotTqGain.Val "MICROSAR RTE" /begin SUB_GROUP /end SUB_GROUP /begin FUNCTION_LIST /end FUNCTION_LIST /begin REF_CHARACTERISTIC /end REF_CHARACTERISTIC /begin REF_MEASUREMENT CDD_MotCtrlMgr.MotCurrQaxToMotTqGain.Val /end REF_MEASUREMENT /end GROUP
/begin GROUP CDD_MotCtrlMgr.MotCurrQlfr1.Val "MICROSAR RTE" /begin SUB_GROUP /end SUB_GROUP /begin FUNCTION_LIST /end FUNCTION_LIST /begin REF_CHARACTERISTIC /end REF_CHARACTERISTIC /begin REF_MEASUREMENT CDD_MotCtrlMgr.MotCurrQlfr1.Val /end REF_MEASUREMENT /end GROUP
/begin GROUP CDD_MotCtrlMgr.MotCurrQlfr2.Val "MICROSAR RTE" /begin SUB_GROUP /end SUB_GROUP /begin FUNCTION_LIST /end FUNCTION_LIST /begin REF_CHARACTERISTIC /end REF_CHARACTERISTIC /begin REF_MEASUREMENT CDD_MotCtrlMgr.MotCurrQlfr2.Val /end REF_MEASUREMENT /end GROUP
/begin GROUP CDD_MotCtrlMgr.MotCurrRollgCntr1.Val "MICROSAR RTE" /begin SUB_GROUP /end SUB_GROUP /begin FUNCTION_LIST /end FUNCTION_LIST /begin REF_CHARACTERISTIC /end REF_CHARACTERISTIC /begin REF_MEASUREMENT CDD_MotCtrlMgr.MotCurrRollgCntr1.Val /end REF_MEASUREMENT /end GROUP
/begin GROUP CDD_MotCtrlMgr.MotCurrRollgCntr2.Val "MICROSAR RTE" /begin SUB_GROUP /end SUB_GROUP /begin FUNCTION_LIST /end FUNCTION_LIST /begin REF_CHARACTERISTIC /end REF_CHARACTERISTIC /begin REF_MEASUREMENT CDD_MotCtrlMgr.MotCurrRollgCntr2.Val /end REF_MEASUREMENT /end GROUP
/begin GROUP CDD_MotCtrlMgr.MotDampgDax.Val "MICROSAR RTE" /begin SUB_GROUP /end SUB_GROUP /begin FUNCTION_LIST /end FUNCTION_LIST /begin REF_CHARACTERISTIC /end REF_CHARACTERISTIC /begin REF_MEASUREMENT CDD_MotCtrlMgr.MotDampgDax.Val /end REF_MEASUREMENT /end GROUP
/begin GROUP CDD_MotCtrlMgr.MotDampgQax.Val "MICROSAR RTE" /begin SUB_GROUP /end SUB_GROUP /begin FUNCTION_LIST /end FUNCTION_LIST /begin REF_CHARACTERISTIC /end REF_CHARACTERISTIC /begin REF_MEASUREMENT CDD_MotCtrlMgr.MotDampgQax.Val /end REF_MEASUREMENT /end GROUP
/begin GROUP CDD_MotCtrlMgr.MotElecMeclPolarity.Val "MICROSAR RTE" /begin SUB_GROUP /end SUB_GROUP /begin FUNCTION_LIST /end FUNCTION_LIST /begin REF_CHARACTERISTIC /end REF_CHARACTERISTIC /begin REF_MEASUREMENT CDD_MotCtrlMgr.MotElecMeclPolarity.Val /end REF_MEASUREMENT /end GROUP
/begin GROUP CDD_MotCtrlMgr.MotIntglGainDax.Val "MICROSAR RTE" /begin SUB_GROUP /end SUB_GROUP /begin FUNCTION_LIST /end FUNCTION_LIST /begin REF_CHARACTERISTIC /end REF_CHARACTERISTIC /begin REF_MEASUREMENT CDD_MotCtrlMgr.MotIntglGainDax.Val /end REF_MEASUREMENT /end GROUP
/begin GROUP CDD_MotCtrlMgr.MotIntglGainQax.Val "MICROSAR RTE" /begin SUB_GROUP /end SUB_GROUP /begin FUNCTION_LIST /end FUNCTION_LIST /begin REF_CHARACTERISTIC /end REF_CHARACTERISTIC /begin REF_MEASUREMENT CDD_MotCtrlMgr.MotIntglGainQax.Val /end REF_MEASUREMENT /end GROUP
/begin GROUP CDD_MotCtrlMgr.MotPropGainDax.Val "MICROSAR RTE" /begin SUB_GROUP /end SUB_GROUP /begin FUNCTION_LIST /end FUNCTION_LIST /begin REF_CHARACTERISTIC /end REF_CHARACTERISTIC /begin REF_MEASUREMENT CDD_MotCtrlMgr.MotPropGainDax.Val /end REF_MEASUREMENT /end GROUP
/begin GROUP CDD_MotCtrlMgr.MotPropGainQax.Val "MICROSAR RTE" /begin SUB_GROUP /end SUB_GROUP /begin FUNCTION_LIST /end FUNCTION_LIST /begin REF_CHARACTERISTIC /end REF_CHARACTERISTIC /begin REF_MEASUREMENT CDD_MotCtrlMgr.MotPropGainQax.Val /end REF_MEASUREMENT /end GROUP
/begin GROUP CDD_MotCtrlMgr.MotREstimd.Val "MICROSAR RTE" /begin SUB_GROUP /end SUB_GROUP /begin FUNCTION_LIST /end FUNCTION_LIST /begin REF_CHARACTERISTIC /end REF_CHARACTERISTIC /begin REF_MEASUREMENT CDD_MotCtrlMgr.MotREstimd.Val /end REF_MEASUREMENT /end GROUP
/begin GROUP CDD_MotCtrlMgr.MotReacncDax.Val "MICROSAR RTE" /begin SUB_GROUP /end SUB_GROUP /begin FUNCTION_LIST /end FUNCTION_LIST /begin REF_CHARACTERISTIC /end REF_CHARACTERISTIC /begin REF_MEASUREMENT CDD_MotCtrlMgr.MotReacncDax.Val /end REF_MEASUREMENT /end GROUP
/begin GROUP CDD_MotCtrlMgr.MotReacncQax.Val "MICROSAR RTE" /begin SUB_GROUP /end SUB_GROUP /begin FUNCTION_LIST /end FUNCTION_LIST /begin REF_CHARACTERISTIC /end REF_CHARACTERISTIC /begin REF_MEASUREMENT CDD_MotCtrlMgr.MotReacncQax.Val /end REF_MEASUREMENT /end GROUP
/begin GROUP CDD_MotCtrlMgr.MotTqRplCoggOrder1Mgn.Val "MICROSAR RTE" /begin SUB_GROUP /end SUB_GROUP /begin FUNCTION_LIST /end FUNCTION_LIST /begin REF_CHARACTERISTIC /end REF_CHARACTERISTIC /begin REF_MEASUREMENT CDD_MotCtrlMgr.MotTqRplCoggOrder1Mgn.Val /end REF_MEASUREMENT /end GROUP
/begin GROUP CDD_MotCtrlMgr.MotTqRplCoggOrder1Pha.Val "MICROSAR RTE" /begin SUB_GROUP /end SUB_GROUP /begin FUNCTION_LIST /end FUNCTION_LIST /begin REF_CHARACTERISTIC /end REF_CHARACTERISTIC /begin REF_MEASUREMENT CDD_MotCtrlMgr.MotTqRplCoggOrder1Pha.Val /end REF_MEASUREMENT /end GROUP
/begin GROUP CDD_MotCtrlMgr.MotTqRplCoggOrder2Mgn.Val "MICROSAR RTE" /begin SUB_GROUP /end SUB_GROUP /begin FUNCTION_LIST /end FUNCTION_LIST /begin REF_CHARACTERISTIC /end REF_CHARACTERISTIC /begin REF_MEASUREMENT CDD_MotCtrlMgr.MotTqRplCoggOrder2Mgn.Val /end REF_MEASUREMENT /end GROUP
/begin GROUP CDD_MotCtrlMgr.MotTqRplCoggOrder2Pha.Val "MICROSAR RTE" /begin SUB_GROUP /end SUB_GROUP /begin FUNCTION_LIST /end FUNCTION_LIST /begin REF_CHARACTERISTIC /end REF_CHARACTERISTIC /begin REF_MEASUREMENT CDD_MotCtrlMgr.MotTqRplCoggOrder2Pha.Val /end REF_MEASUREMENT /end GROUP
/begin GROUP CDD_MotCtrlMgr.MotTqRplCoggOrder3Mgn.Val "MICROSAR RTE" /begin SUB_GROUP /end SUB_GROUP /begin FUNCTION_LIST /end FUNCTION_LIST /begin REF_CHARACTERISTIC /end REF_CHARACTERISTIC /begin REF_MEASUREMENT CDD_MotCtrlMgr.MotTqRplCoggOrder3Mgn.Val /end REF_MEASUREMENT /end GROUP
/begin GROUP CDD_MotCtrlMgr.MotTqRplCoggOrder3Pha.Val "MICROSAR RTE" /begin SUB_GROUP /end SUB_GROUP /begin FUNCTION_LIST /end FUNCTION_LIST /begin REF_CHARACTERISTIC /end REF_CHARACTERISTIC /begin REF_MEASUREMENT CDD_MotCtrlMgr.MotTqRplCoggOrder3Pha.Val /end REF_MEASUREMENT /end GROUP
/begin GROUP CDD_MotCtrlMgr.MotVelMrf.Val "MICROSAR RTE" /begin SUB_GROUP /end SUB_GROUP /begin FUNCTION_LIST /end FUNCTION_LIST /begin REF_CHARACTERISTIC /end REF_CHARACTERISTIC /begin REF_MEASUREMENT CDD_MotCtrlMgr.MotVelMrf.Val /end REF_MEASUREMENT /end GROUP
/begin GROUP CDD_MotCtrlMgr.MotVltgDaxFf.Val "MICROSAR RTE" /begin SUB_GROUP /end SUB_GROUP /begin FUNCTION_LIST /end FUNCTION_LIST /begin REF_CHARACTERISTIC /end REF_CHARACTERISTIC /begin REF_MEASUREMENT CDD_MotCtrlMgr.MotVltgDaxFf.Val /end REF_MEASUREMENT /end GROUP
/begin GROUP CDD_MotCtrlMgr.MotVltgDaxFild.Val "MICROSAR RTE" /begin SUB_GROUP /end SUB_GROUP /begin FUNCTION_LIST /end FUNCTION_LIST /begin REF_CHARACTERISTIC /end REF_CHARACTERISTIC /begin REF_MEASUREMENT CDD_MotCtrlMgr.MotVltgDaxFild.Val /end REF_MEASUREMENT /end GROUP
/begin GROUP CDD_MotCtrlMgr.MotVltgQaxFf.Val "MICROSAR RTE" /begin SUB_GROUP /end SUB_GROUP /begin FUNCTION_LIST /end FUNCTION_LIST /begin REF_CHARACTERISTIC /end REF_CHARACTERISTIC /begin REF_MEASUREMENT CDD_MotCtrlMgr.MotVltgQaxFf.Val /end REF_MEASUREMENT /end GROUP
/begin GROUP CDD_MotCtrlMgr.MotVltgQaxFild.Val "MICROSAR RTE" /begin SUB_GROUP /end SUB_GROUP /begin FUNCTION_LIST /end FUNCTION_LIST /begin REF_CHARACTERISTIC /end REF_CHARACTERISTIC /begin REF_MEASUREMENT CDD_MotCtrlMgr.MotVltgQaxFild.Val /end REF_MEASUREMENT /end GROUP
/begin GROUP CDD_MotCtrlMgr.Ntc5DErrCnt.Val "MICROSAR RTE" /begin SUB_GROUP /end SUB_GROUP /begin FUNCTION_LIST /end FUNCTION_LIST /begin REF_CHARACTERISTIC /end REF_CHARACTERISTIC /begin REF_MEASUREMENT CDD_MotCtrlMgr.Ntc5DErrCnt.Val /end REF_MEASUREMENT /end GROUP
/begin GROUP CDD_MotCtrlMgr.Ntc6DErrCnt.Val "MICROSAR RTE" /begin SUB_GROUP /end SUB_GROUP /begin FUNCTION_LIST /end FUNCTION_LIST /begin REF_CHARACTERISTIC /end REF_CHARACTERISTIC /begin REF_MEASUREMENT CDD_MotCtrlMgr.Ntc6DErrCnt.Val /end REF_MEASUREMENT /end GROUP
/begin GROUP CDD_MotCtrlMgr.PhaOnTiSumA.Val "MICROSAR RTE" /begin SUB_GROUP /end SUB_GROUP /begin FUNCTION_LIST /end FUNCTION_LIST /begin REF_CHARACTERISTIC /end REF_CHARACTERISTIC /begin REF_MEASUREMENT CDD_MotCtrlMgr.PhaOnTiSumA.Val /end REF_MEASUREMENT /end GROUP
/begin GROUP CDD_MotCtrlMgr.PhaOnTiSumB.Val "MICROSAR RTE" /begin SUB_GROUP /end SUB_GROUP /begin FUNCTION_LIST /end FUNCTION_LIST /begin REF_CHARACTERISTIC /end REF_CHARACTERISTIC /begin REF_MEASUREMENT CDD_MotCtrlMgr.PhaOnTiSumB.Val /end REF_MEASUREMENT /end GROUP
/begin GROUP CDD_MotCtrlMgr.PhaOnTiSumC.Val "MICROSAR RTE" /begin SUB_GROUP /end SUB_GROUP /begin FUNCTION_LIST /end FUNCTION_LIST /begin REF_CHARACTERISTIC /end REF_CHARACTERISTIC /begin REF_MEASUREMENT CDD_MotCtrlMgr.PhaOnTiSumC.Val /end REF_MEASUREMENT /end GROUP
/begin GROUP CDD_MotCtrlMgr.ReceiverPorts "MICROSAR RTE"
 /begin SUB_GROUP CDD_MotCtrlMgr.AdcDiagcEndPtrOutp.Val CDD_MotCtrlMgr.AdcDiagcStrtPtrOutp.Val CDD_MotCtrlMgr.BrdgVltg.Val CDD_MotCtrlMgr.CurrMeasCorrlnSts.Val CDD_MotCtrlMgr.CurrMeasLoaMtgtnEna.Logl CDD_MotCtrlMgr.CurrMeasWrmIninTestCmpl.Logl CDD_MotCtrlMgr.DiagcStsIvtr1Inactv.Logl CDD_MotCtrlMgr.DiagcStsIvtr2Inactv.Logl CDD_MotCtrlMgr.EcuTFild.Val CDD_MotCtrlMgr.IvtrLoaMtgtnEna.Logl CDD_MotCtrlMgr.LoopCntr2MilliSec.Val CDD_MotCtrlMgr.MotAg0MeclQlfr.Val CDD_MotCtrlMgr.MotAg0MeclRollgCntr.Val CDD_MotCtrlMgr.MotAg0Offs.Val CDD_MotCtrlMgr.MotAg1MeclQlfr.Val CDD_MotCtrlMgr.MotAg1MeclRollgCntr.Val CDD_MotCtrlMgr.MotAg1Offs.Val CDD_MotCtrlMgr.MotAgElecDly.Val CDD_MotCtrlMgr.MotAgElecDlyRpl.Val CDD_MotCtrlMgr.MotAgMecl0Polarity.Val CDD_MotCtrlMgr.MotAgMecl1Polarity.Val CDD_MotCtrlMgr.MotAgMeclCorrlnSt.Val CDD_MotCtrlMgr.MotCurrAdcVlyAAdcFaild.Logl CDD_MotCtrlMgr.MotCurrAdcVlyBAdcFaild.Logl CDD_MotCtrlMgr.MotCurrAdcVlyCAdcFaild.Logl CDD_MotCtrlMgr.MotCurrAdcVlyDAdcFaild.Logl CDD_MotCtrlMgr.MotCurrAdcVlyEAdcFaild.Logl CDD_MotCtrlMgr.MotCurrAdcVlyFAdcFaild.Logl CDD_MotCtrlMgr.MotCurrDaxCmd.Val CDD_MotCtrlMgr.MotCurrDaxMax.Val CDD_MotCtrlMgr.MotCurrEolCalSt.Val CDD_MotCtrlMgr.MotCurrQaxCmd.Val CDD_MotCtrlMgr.MotCurrQaxToMotTqGain.Val CDD_MotCtrlMgr.MotCurrQlfr1.Val CDD_MotCtrlMgr.MotCurrQlfr2.Val CDD_MotCtrlMgr.MotDampgDax.Val CDD_MotCtrlMgr.MotDampgQax.Val CDD_MotCtrlMgr.MotElecMeclPolarity.Val CDD_MotCtrlMgr.MotIntglGainDax.Val CDD_MotCtrlMgr.MotIntglGainQax.Val CDD_MotCtrlMgr.MotPropGainDax.Val CDD_MotCtrlMgr.MotPropGainQax.Val CDD_MotCtrlMgr.MotREstimd.Val CDD_MotCtrlMgr.MotReacncDax.Val CDD_MotCtrlMgr.MotReacncQax.Val CDD_MotCtrlMgr.MotTqRplCoggOrder1Mgn.Val CDD_MotCtrlMgr.MotTqRplCoggOrder1Pha.Val CDD_MotCtrlMgr.MotTqRplCoggOrder2Mgn.Val CDD_MotCtrlMgr.MotTqRplCoggOrder2Pha.Val CDD_MotCtrlMgr.MotTqRplCoggOrder3Mgn.Val CDD_MotCtrlMgr.MotTqRplCoggOrder3Pha.Val CDD_MotCtrlMgr.MotVelMrf.Val CDD_MotCtrlMgr.MotVltgDaxFf.Val CDD_MotCtrlMgr.MotVltgQaxFf.Val CDD_MotCtrlMgr.SysSt.Val /end SUB_GROUP
 /begin FUNCTION_LIST /end FUNCTION_LIST
 /begin REF_CHARACTERISTIC /end REF_CHARACTERISTIC
 /begin REF_MEASUREMENT /end REF_MEASUREMENT
/end GROUP
/begin GROUP CDD_MotCtrlMgr.SenderPorts "MICROSAR RTE"
 /begin SUB_GROUP CDD_MotCtrlMgr.Adc0ScanGroup2Ref0.Val CDD_MotCtrlMgr.Adc0ScanGroup2Ref1.Val CDD_MotCtrlMgr.Adc0ScanGroup3Ref0.Val CDD_MotCtrlMgr.Adc0ScanGroup3Ref1.Val CDD_MotCtrlMgr.Adc0SelfDiag0.Val CDD_MotCtrlMgr.Adc0SelfDiag2.Val CDD_MotCtrlMgr.Adc0SelfDiag4.Val CDD_MotCtrlMgr.FastLoopCntr.Val CDD_MotCtrlMgr.MotAg0Mecl.Val CDD_MotCtrlMgr.MotAg1Mecl.Val CDD_MotCtrlMgr.MotAgBuf.Ary1D CDD_MotCtrlMgr.MotAgBufIdx.Val CDD_MotCtrlMgr.MotAgCumvAlgndMrfRev.Val CDD_MotCtrlMgr.MotAgTiBuf.Ary1D CDD_MotCtrlMgr.MotCurrAdcVlyA.Val CDD_MotCtrlMgr.MotCurrAdcVlyB.Val CDD_MotCtrlMgr.MotCurrAdcVlyC.Val CDD_MotCtrlMgr.MotCurrAdcVlyD.Val CDD_MotCtrlMgr.MotCurrAdcVlyE.Val CDD_MotCtrlMgr.MotCurrAdcVlyF.Val CDD_MotCtrlMgr.MotCurrCorrdA.Val CDD_MotCtrlMgr.MotCurrCorrdB.Val CDD_MotCtrlMgr.MotCurrCorrdC.Val CDD_MotCtrlMgr.MotCurrCorrdD.Val CDD_MotCtrlMgr.MotCurrCorrdE.Val CDD_MotCtrlMgr.MotCurrCorrdF.Val CDD_MotCtrlMgr.MotCurrDax.Val CDD_MotCtrlMgr.MotCurrQax.Val CDD_MotCtrlMgr.MotCurrRollgCntr1.Val CDD_MotCtrlMgr.MotCurrRollgCntr2.Val CDD_MotCtrlMgr.MotVltgDaxFild.Val CDD_MotCtrlMgr.MotVltgQaxFild.Val CDD_MotCtrlMgr.Ntc5DErrCnt.Val CDD_MotCtrlMgr.Ntc6DErrCnt.Val CDD_MotCtrlMgr.PhaOnTiSumA.Val CDD_MotCtrlMgr.PhaOnTiSumB.Val CDD_MotCtrlMgr.PhaOnTiSumC.Val CDD_MotCtrlMgr.SlowLoopCntr.Val /end SUB_GROUP
 /begin FUNCTION_LIST /end FUNCTION_LIST
 /begin REF_CHARACTERISTIC /end REF_CHARACTERISTIC
 /begin REF_MEASUREMENT /end REF_MEASUREMENT
/end GROUP
/begin GROUP CDD_MotCtrlMgr.SlowLoopCntr.Val "MICROSAR RTE" /begin SUB_GROUP /end SUB_GROUP /begin FUNCTION_LIST /end FUNCTION_LIST /begin REF_CHARACTERISTIC /end REF_CHARACTERISTIC /begin REF_MEASUREMENT CDD_MotCtrlMgr.SlowLoopCntr.Val /end REF_MEASUREMENT /end GROUP
/begin GROUP CDD_MotCtrlMgr.SysSt.Val "MICROSAR RTE" /begin SUB_GROUP /end SUB_GROUP /begin FUNCTION_LIST /end FUNCTION_LIST /begin REF_CHARACTERISTIC /end REF_CHARACTERISTIC /begin REF_MEASUREMENT CDD_MotCtrlMgr.SysSt.Val /end REF_MEASUREMENT /end GROUP
/begin GROUP CDD_MotCurrRegVltgLimr "MICROSAR RTE"
 /begin SUB_GROUP CDD_MotCurrRegVltgLimr.CalibrationPorts CDD_MotCurrRegVltgLimr.PerInstanceMemories /end SUB_GROUP
 /begin FUNCTION_LIST /end FUNCTION_LIST
 /begin REF_CHARACTERISTIC /end REF_CHARACTERISTIC
 /begin REF_MEASUREMENT /end REF_MEASUREMENT
/end GROUP
/begin GROUP CDD_MotCurrRegVltgLimr.AntiWdupCmdScaDax "MICROSAR RTE" /begin SUB_GROUP /end SUB_GROUP /begin FUNCTION_LIST /end FUNCTION_LIST /begin REF_CHARACTERISTIC /end REF_CHARACTERISTIC /begin REF_MEASUREMENT CDD_MotCurrRegVltgLimr.AntiWdupCmdScaDax /end REF_MEASUREMENT /end GROUP
/begin GROUP CDD_MotCurrRegVltgLimr.AntiWdupCmdScaQax "MICROSAR RTE" /begin SUB_GROUP /end SUB_GROUP /begin FUNCTION_LIST /end FUNCTION_LIST /begin REF_CHARACTERISTIC /end REF_CHARACTERISTIC /begin REF_MEASUREMENT CDD_MotCurrRegVltgLimr.AntiWdupCmdScaQax /end REF_MEASUREMENT /end GROUP
/begin GROUP CDD_MotCurrRegVltgLimr.CalibrationPorts "MICROSAR RTE"
 /begin SUB_GROUP CDD_MotCurrRegVltgLimr.MotCurrRegCfgCurrLoopSecOrderTrfFcnEn.Logl CDD_MotCurrRegVltgLimr.MotCurrRegCfgMotRVirtDax.Val CDD_MotCurrRegVltgLimr.MotCurrRegCfgMotRVirtQax.Val CDD_MotCurrRegVltgLimr.MotCurrRegVltgLimrCurrLoaScarSlewRate.Val CDD_MotCurrRegVltgLimr.MotCurrRegVltgLimrDaxAntiWdupCoeff.Val CDD_MotCurrRegVltgLimr.MotCurrRegVltgLimrDualEcuLoaScarSlewRate.Val CDD_MotCurrRegVltgLimr.MotCurrRegVltgLimrIvtrLoaScarSlewRate.Val CDD_MotCurrRegVltgLimr.MotCurrRegVltgLimrMotCurrPredEna.Logl CDD_MotCurrRegVltgLimr.MotCurrRegVltgLimrMotCurrPredTi.Val CDD_MotCurrRegVltgLimr.MotCurrRegVltgLimrMotCurrQaxRefMdfnRplEna.Logl CDD_MotCurrRegVltgLimr.MotCurrRegVltgLimrMotVltgBrdgFilEna.Logl CDD_MotCurrRegVltgLimr.MotCurrRegVltgLimrMotVltgBrdgLpFilFrq.Val CDD_MotCurrRegVltgLimr.MotCurrRegVltgLimrMotVltgDaxIntglHiLim.Val CDD_MotCurrRegVltgLimr.MotCurrRegVltgLimrMotVltgDaxIntglLoLim.Val CDD_MotCurrRegVltgLimr.MotCurrRegVltgLimrMotVltgQaxFfFilEna.Logl CDD_MotCurrRegVltgLimr.MotCurrRegVltgLimrMotVltgQaxFfLpFilFrq.Val CDD_MotCurrRegVltgLimr.MotCurrRegVltgLimrMotVltgQaxIntglHiLim.Val CDD_MotCurrRegVltgLimr.MotCurrRegVltgLimrMotVltgQaxIntglLoLim.Val CDD_MotCurrRegVltgLimr.MotCurrRegVltgLimrQaxAntiWdupCoeff.Val CDD_MotCurrRegVltgLimr.MotCurrRegVltgLimrQaxAntiWdupScagDi.Logl CDD_MotCurrRegVltgLimr.MotRefMdlFbCtrlDi.Logl CDD_MotCurrRegVltgLimr.MotRefMdlIvtrDeadTiBrdgVltgSca.Val /end SUB_GROUP
 /begin FUNCTION_LIST /end FUNCTION_LIST
 /begin REF_CHARACTERISTIC /end REF_CHARACTERISTIC
 /begin REF_MEASUREMENT /end REF_MEASUREMENT
/end GROUP
/begin GROUP CDD_MotCurrRegVltgLimr.CurrLoaScarPrev "MICROSAR RTE" /begin SUB_GROUP /end SUB_GROUP /begin FUNCTION_LIST /end FUNCTION_LIST /begin REF_CHARACTERISTIC /end REF_CHARACTERISTIC /begin REF_MEASUREMENT CDD_MotCurrRegVltgLimr.CurrLoaScarPrev /end REF_MEASUREMENT /end GROUP
/begin GROUP CDD_MotCurrRegVltgLimr.DualEcuLoaScarPrev "MICROSAR RTE" /begin SUB_GROUP /end SUB_GROUP /begin FUNCTION_LIST /end FUNCTION_LIST /begin REF_CHARACTERISTIC /end REF_CHARACTERISTIC /begin REF_MEASUREMENT CDD_MotCurrRegVltgLimr.DualEcuLoaScarPrev /end REF_MEASUREMENT /end GROUP
/begin GROUP CDD_MotCurrRegVltgLimr.IvtrLoaScarPrev "MICROSAR RTE" /begin SUB_GROUP /end SUB_GROUP /begin FUNCTION_LIST /end FUNCTION_LIST /begin REF_CHARACTERISTIC /end REF_CHARACTERISTIC /begin REF_MEASUREMENT CDD_MotCurrRegVltgLimr.IvtrLoaScarPrev /end REF_MEASUREMENT /end GROUP
/begin GROUP CDD_MotCurrRegVltgLimr.MotCtrlMotVltgDaxPrev "MICROSAR RTE" /begin SUB_GROUP /end SUB_GROUP /begin FUNCTION_LIST /end FUNCTION_LIST /begin REF_CHARACTERISTIC /end REF_CHARACTERISTIC /begin REF_MEASUREMENT CDD_MotCurrRegVltgLimr.MotCtrlMotVltgDaxPrev /end REF_MEASUREMENT /end GROUP
/begin GROUP CDD_MotCurrRegVltgLimr.MotCtrlMotVltgQaxPrev "MICROSAR RTE" /begin SUB_GROUP /end SUB_GROUP /begin FUNCTION_LIST /end FUNCTION_LIST /begin REF_CHARACTERISTIC /end REF_CHARACTERISTIC /begin REF_MEASUREMENT CDD_MotCurrRegVltgLimr.MotCtrlMotVltgQaxPrev /end REF_MEASUREMENT /end GROUP
/begin GROUP CDD_MotCurrRegVltgLimr.MotCurrRegCfgCurrLoopSecOrderTrfFcnEn.Logl "MICROSAR RTE" /begin SUB_GROUP /end SUB_GROUP /begin FUNCTION_LIST /end FUNCTION_LIST
 /begin REF_CHARACTERISTIC CDD_MotCurrRegVltgLimr.MotCurrRegCfgCurrLoopSecOrderTrfFcnEn.Logl /end REF_CHARACTERISTIC
 /begin REF_MEASUREMENT /end REF_MEASUREMENT
/end GROUP
/begin GROUP CDD_MotCurrRegVltgLimr.MotCurrRegCfgMotRVirtDax.Val "MICROSAR RTE" /begin SUB_GROUP /end SUB_GROUP /begin FUNCTION_LIST /end FUNCTION_LIST /begin REF_CHARACTERISTIC CDD_MotCurrRegVltgLimr.MotCurrRegCfgMotRVirtDax.Val /end REF_CHARACTERISTIC /begin REF_MEASUREMENT /end REF_MEASUREMENT /end GROUP
/begin GROUP CDD_MotCurrRegVltgLimr.MotCurrRegCfgMotRVirtQax.Val "MICROSAR RTE" /begin SUB_GROUP /end SUB_GROUP /begin FUNCTION_LIST /end FUNCTION_LIST /begin REF_CHARACTERISTIC CDD_MotCurrRegVltgLimr.MotCurrRegCfgMotRVirtQax.Val /end REF_CHARACTERISTIC /begin REF_MEASUREMENT /end REF_MEASUREMENT /end GROUP
/begin GROUP CDD_MotCurrRegVltgLimr.MotCurrRegVltgLimrCurrLoaScarSlewRate.Val "MICROSAR RTE" /begin SUB_GROUP /end SUB_GROUP /begin FUNCTION_LIST /end FUNCTION_LIST
 /begin REF_CHARACTERISTIC CDD_MotCurrRegVltgLimr.MotCurrRegVltgLimrCurrLoaScarSlewRate.Val /end REF_CHARACTERISTIC
 /begin REF_MEASUREMENT /end REF_MEASUREMENT
/end GROUP
/begin GROUP CDD_MotCurrRegVltgLimr.MotCurrRegVltgLimrDaxAntiWdupCoeff.Val "MICROSAR RTE" /begin SUB_GROUP /end SUB_GROUP /begin FUNCTION_LIST /end FUNCTION_LIST
 /begin REF_CHARACTERISTIC CDD_MotCurrRegVltgLimr.MotCurrRegVltgLimrDaxAntiWdupCoeff.Val /end REF_CHARACTERISTIC
 /begin REF_MEASUREMENT /end REF_MEASUREMENT
/end GROUP
/begin GROUP CDD_MotCurrRegVltgLimr.MotCurrRegVltgLimrDualEcuLoaScarSlewRate.Val "MICROSAR RTE" /begin SUB_GROUP /end SUB_GROUP /begin FUNCTION_LIST /end FUNCTION_LIST
 /begin REF_CHARACTERISTIC CDD_MotCurrRegVltgLimr.MotCurrRegVltgLimrDualEcuLoaScarSlewRate.Val /end REF_CHARACTERISTIC
 /begin REF_MEASUREMENT /end REF_MEASUREMENT
/end GROUP
/begin GROUP CDD_MotCurrRegVltgLimr.MotCurrRegVltgLimrIvtrLoaScarSlewRate.Val "MICROSAR RTE" /begin SUB_GROUP /end SUB_GROUP /begin FUNCTION_LIST /end FUNCTION_LIST
 /begin REF_CHARACTERISTIC CDD_MotCurrRegVltgLimr.MotCurrRegVltgLimrIvtrLoaScarSlewRate.Val /end REF_CHARACTERISTIC
 /begin REF_MEASUREMENT /end REF_MEASUREMENT
/end GROUP
/begin GROUP CDD_MotCurrRegVltgLimr.MotCurrRegVltgLimrMotCurrPredEna.Logl "MICROSAR RTE" /begin SUB_GROUP /end SUB_GROUP /begin FUNCTION_LIST /end FUNCTION_LIST
 /begin REF_CHARACTERISTIC CDD_MotCurrRegVltgLimr.MotCurrRegVltgLimrMotCurrPredEna.Logl /end REF_CHARACTERISTIC
 /begin REF_MEASUREMENT /end REF_MEASUREMENT
/end GROUP
/begin GROUP CDD_MotCurrRegVltgLimr.MotCurrRegVltgLimrMotCurrPredTi.Val "MICROSAR RTE" /begin SUB_GROUP /end SUB_GROUP /begin FUNCTION_LIST /end FUNCTION_LIST /begin REF_CHARACTERISTIC CDD_MotCurrRegVltgLimr.MotCurrRegVltgLimrMotCurrPredTi.Val /end REF_CHARACTERISTIC /begin REF_MEASUREMENT /end REF_MEASUREMENT /end GROUP
/begin GROUP CDD_MotCurrRegVltgLimr.MotCurrRegVltgLimrMotCurrQaxRefMdfnRplEna.Logl "MICROSAR RTE" /begin SUB_GROUP /end SUB_GROUP /begin FUNCTION_LIST /end FUNCTION_LIST
 /begin REF_CHARACTERISTIC CDD_MotCurrRegVltgLimr.MotCurrRegVltgLimrMotCurrQaxRefMdfnRplEna.Logl /end REF_CHARACTERISTIC
 /begin REF_MEASUREMENT /end REF_MEASUREMENT
/end GROUP
/begin GROUP CDD_MotCurrRegVltgLimr.MotCurrRegVltgLimrMotVltgBrdgFilEna.Logl "MICROSAR RTE" /begin SUB_GROUP /end SUB_GROUP /begin FUNCTION_LIST /end FUNCTION_LIST
 /begin REF_CHARACTERISTIC CDD_MotCurrRegVltgLimr.MotCurrRegVltgLimrMotVltgBrdgFilEna.Logl /end REF_CHARACTERISTIC
 /begin REF_MEASUREMENT /end REF_MEASUREMENT
/end GROUP
/begin GROUP CDD_MotCurrRegVltgLimr.MotCurrRegVltgLimrMotVltgBrdgLpFilFrq.Val "MICROSAR RTE" /begin SUB_GROUP /end SUB_GROUP /begin FUNCTION_LIST /end FUNCTION_LIST
 /begin REF_CHARACTERISTIC CDD_MotCurrRegVltgLimr.MotCurrRegVltgLimrMotVltgBrdgLpFilFrq.Val /end REF_CHARACTERISTIC
 /begin REF_MEASUREMENT /end REF_MEASUREMENT
/end GROUP
/begin GROUP CDD_MotCurrRegVltgLimr.MotCurrRegVltgLimrMotVltgDaxIntglHiLim.Val "MICROSAR RTE" /begin SUB_GROUP /end SUB_GROUP /begin FUNCTION_LIST /end FUNCTION_LIST
 /begin REF_CHARACTERISTIC CDD_MotCurrRegVltgLimr.MotCurrRegVltgLimrMotVltgDaxIntglHiLim.Val /end REF_CHARACTERISTIC
 /begin REF_MEASUREMENT /end REF_MEASUREMENT
/end GROUP
/begin GROUP CDD_MotCurrRegVltgLimr.MotCurrRegVltgLimrMotVltgDaxIntglLoLim.Val "MICROSAR RTE" /begin SUB_GROUP /end SUB_GROUP /begin FUNCTION_LIST /end FUNCTION_LIST
 /begin REF_CHARACTERISTIC CDD_MotCurrRegVltgLimr.MotCurrRegVltgLimrMotVltgDaxIntglLoLim.Val /end REF_CHARACTERISTIC
 /begin REF_MEASUREMENT /end REF_MEASUREMENT
/end GROUP
/begin GROUP CDD_MotCurrRegVltgLimr.MotCurrRegVltgLimrMotVltgQaxFfFilEna.Logl "MICROSAR RTE" /begin SUB_GROUP /end SUB_GROUP /begin FUNCTION_LIST /end FUNCTION_LIST
 /begin REF_CHARACTERISTIC CDD_MotCurrRegVltgLimr.MotCurrRegVltgLimrMotVltgQaxFfFilEna.Logl /end REF_CHARACTERISTIC
 /begin REF_MEASUREMENT /end REF_MEASUREMENT
/end GROUP
/begin GROUP CDD_MotCurrRegVltgLimr.MotCurrRegVltgLimrMotVltgQaxFfLpFilFrq.Val "MICROSAR RTE" /begin SUB_GROUP /end SUB_GROUP /begin FUNCTION_LIST /end FUNCTION_LIST
 /begin REF_CHARACTERISTIC CDD_MotCurrRegVltgLimr.MotCurrRegVltgLimrMotVltgQaxFfLpFilFrq.Val /end REF_CHARACTERISTIC
 /begin REF_MEASUREMENT /end REF_MEASUREMENT
/end GROUP
/begin GROUP CDD_MotCurrRegVltgLimr.MotCurrRegVltgLimrMotVltgQaxIntglHiLim.Val "MICROSAR RTE" /begin SUB_GROUP /end SUB_GROUP /begin FUNCTION_LIST /end FUNCTION_LIST
 /begin REF_CHARACTERISTIC CDD_MotCurrRegVltgLimr.MotCurrRegVltgLimrMotVltgQaxIntglHiLim.Val /end REF_CHARACTERISTIC
 /begin REF_MEASUREMENT /end REF_MEASUREMENT
/end GROUP
/begin GROUP CDD_MotCurrRegVltgLimr.MotCurrRegVltgLimrMotVltgQaxIntglLoLim.Val "MICROSAR RTE" /begin SUB_GROUP /end SUB_GROUP /begin FUNCTION_LIST /end FUNCTION_LIST
 /begin REF_CHARACTERISTIC CDD_MotCurrRegVltgLimr.MotCurrRegVltgLimrMotVltgQaxIntglLoLim.Val /end REF_CHARACTERISTIC
 /begin REF_MEASUREMENT /end REF_MEASUREMENT
/end GROUP
/begin GROUP CDD_MotCurrRegVltgLimr.MotCurrRegVltgLimrQaxAntiWdupCoeff.Val "MICROSAR RTE" /begin SUB_GROUP /end SUB_GROUP /begin FUNCTION_LIST /end FUNCTION_LIST
 /begin REF_CHARACTERISTIC CDD_MotCurrRegVltgLimr.MotCurrRegVltgLimrQaxAntiWdupCoeff.Val /end REF_CHARACTERISTIC
 /begin REF_MEASUREMENT /end REF_MEASUREMENT
/end GROUP
/begin GROUP CDD_MotCurrRegVltgLimr.MotCurrRegVltgLimrQaxAntiWdupScagDi.Logl "MICROSAR RTE" /begin SUB_GROUP /end SUB_GROUP /begin FUNCTION_LIST /end FUNCTION_LIST
 /begin REF_CHARACTERISTIC CDD_MotCurrRegVltgLimr.MotCurrRegVltgLimrQaxAntiWdupScagDi.Logl /end REF_CHARACTERISTIC
 /begin REF_MEASUREMENT /end REF_MEASUREMENT
/end GROUP
/begin GROUP CDD_MotCurrRegVltgLimr.MotRefMdlFbCtrlDi.Logl "MICROSAR RTE" /begin SUB_GROUP /end SUB_GROUP /begin FUNCTION_LIST /end FUNCTION_LIST /begin REF_CHARACTERISTIC CDD_MotCurrRegVltgLimr.MotRefMdlFbCtrlDi.Logl /end REF_CHARACTERISTIC /begin REF_MEASUREMENT /end REF_MEASUREMENT /end GROUP
/begin GROUP CDD_MotCurrRegVltgLimr.MotRefMdlIvtrDeadTiBrdgVltgSca.Val "MICROSAR RTE" /begin SUB_GROUP /end SUB_GROUP /begin FUNCTION_LIST /end FUNCTION_LIST /begin REF_CHARACTERISTIC CDD_MotCurrRegVltgLimr.MotRefMdlIvtrDeadTiBrdgVltgSca.Val /end REF_CHARACTERISTIC /begin REF_MEASUREMENT /end REF_MEASUREMENT /end GROUP
/begin GROUP CDD_MotCurrRegVltgLimr.MotVltgBrdgLpFil "MICROSAR RTE" /begin SUB_GROUP /end SUB_GROUP /begin FUNCTION_LIST /end FUNCTION_LIST /begin REF_CHARACTERISTIC /end REF_CHARACTERISTIC
 /begin REF_MEASUREMENT CDD_MotCurrRegVltgLimr.MotVltgBrdgLpFil.FilGain CDD_MotCurrRegVltgLimr.MotVltgBrdgLpFil.FilSt /end REF_MEASUREMENT
/end GROUP
/begin GROUP CDD_MotCurrRegVltgLimr.MotVltgIntglCmdDaxPrev "MICROSAR RTE" /begin SUB_GROUP /end SUB_GROUP /begin FUNCTION_LIST /end FUNCTION_LIST /begin REF_CHARACTERISTIC /end REF_CHARACTERISTIC /begin REF_MEASUREMENT CDD_MotCurrRegVltgLimr.MotVltgIntglCmdDaxPrev /end REF_MEASUREMENT /end GROUP
/begin GROUP CDD_MotCurrRegVltgLimr.MotVltgIntglCmdQaxPrev "MICROSAR RTE" /begin SUB_GROUP /end SUB_GROUP /begin FUNCTION_LIST /end FUNCTION_LIST /begin REF_CHARACTERISTIC /end REF_CHARACTERISTIC /begin REF_MEASUREMENT CDD_MotCurrRegVltgLimr.MotVltgIntglCmdQaxPrev /end REF_MEASUREMENT /end GROUP
/begin GROUP CDD_MotCurrRegVltgLimr.MotVltgQaxFfLpFil "MICROSAR RTE" /begin SUB_GROUP /end SUB_GROUP /begin FUNCTION_LIST /end FUNCTION_LIST /begin REF_CHARACTERISTIC /end REF_CHARACTERISTIC
 /begin REF_MEASUREMENT CDD_MotCurrRegVltgLimr.MotVltgQaxFfLpFil.FilGain CDD_MotCurrRegVltgLimr.MotVltgQaxFfLpFil.FilSt /end REF_MEASUREMENT
/end GROUP
/begin GROUP CDD_MotCurrRegVltgLimr.PerInstanceMemories "MICROSAR RTE"
 /begin SUB_GROUP CDD_MotCurrRegVltgLimr.AntiWdupCmdScaDax CDD_MotCurrRegVltgLimr.AntiWdupCmdScaQax CDD_MotCurrRegVltgLimr.CurrLoaScarPrev CDD_MotCurrRegVltgLimr.DualEcuLoaScarPrev CDD_MotCurrRegVltgLimr.IvtrLoaScarPrev CDD_MotCurrRegVltgLimr.MotCtrlMotVltgDaxPrev CDD_MotCurrRegVltgLimr.MotCtrlMotVltgQaxPrev CDD_MotCurrRegVltgLimr.MotVltgBrdgLpFil CDD_MotCurrRegVltgLimr.MotVltgIntglCmdDaxPrev CDD_MotCurrRegVltgLimr.MotVltgIntglCmdQaxPrev CDD_MotCurrRegVltgLimr.MotVltgQaxFfLpFil CDD_MotCurrRegVltgLimr.dMotCurrRegVltgLimrAntiWdupCmdScaDax CDD_MotCurrRegVltgLimr.dMotCurrRegVltgLimrAntiWdupCmdScaQax CDD_MotCurrRegVltgLimr.dMotCurrRegVltgLimrMotCurrCmdErr CDD_MotCurrRegVltgLimr.dMotCurrRegVltgLimrMotCurrCmdErrDax CDD_MotCurrRegVltgLimr.dMotCurrRegVltgLimrMotCurrCmdErrQax CDD_MotCurrRegVltgLimr.dMotCurrRegVltgLimrMotCurrCmdScaDax CDD_MotCurrRegVltgLimr.dMotCurrRegVltgLimrMotCurrCmdScaQax CDD_MotCurrRegVltgLimr.dMotCurrRegVltgLimrMotVltgBrdgFild CDD_MotCurrRegVltgLimr.dMotCurrRegVltgLimrMotVltgCmdFinal CDD_MotCurrRegVltgLimr.dMotCurrRegVltgLimrMotVltgCmdPreLim CDD_MotCurrRegVltgLimr.dMotCurrRegVltgLimrMotVltgDampgDax CDD_MotCurrRegVltgLimr.dMotCurrRegVltgLimrMotVltgDampgQax CDD_MotCurrRegVltgLimr.dMotCurrRegVltgLimrMotVltgDaxFb CDD_MotCurrRegVltgLimr.dMotCurrRegVltgLimrMotVltgDaxIntglPreLim CDD_MotCurrRegVltgLimr.dMotCurrRegVltgLimrMotVltgDecouplFbDax CDD_MotCurrRegVltgLimr.dMotCurrRegVltgLimrMotVltgDecouplFbQax CDD_MotCurrRegVltgLimr.dMotCurrRegVltgLimrMotVltgDircFbDax CDD_MotCurrRegVltgLimr.dMotCurrRegVltgLimrMotVltgDircFbQax CDD_MotCurrRegVltgLimr.dMotCurrRegVltgLimrMotVltgPreLimDax CDD_MotCurrRegVltgLimr.dMotCurrRegVltgLimrMotVltgPreLimQax CDD_MotCurrRegVltgLimr.dMotCurrRegVltgLimrMotVltgPropCmdDax CDD_MotCurrRegVltgLimr.dMotCurrRegVltgLimrMotVltgPropCmdQax CDD_MotCurrRegVltgLimr.dMotCurrRegVltgLimrMotVltgQaxFb CDD_MotCurrRegVltgLimr.dMotCurrRegVltgLimrMotVltgQaxFfFild CDD_MotCurrRegVltgLimr.dMotCurrRegVltgLimrMotVltgQaxIntglPreLim CDD_MotCurrRegVltgLimr.dMotCurrRegVltgLimrMotVltgSatnIvsRat CDD_MotCurrRegVltgLimr.dMotCurrRegVltgLimrMotVltgSatnRat CDD_MotCurrRegVltgLimr.dMotCurrRegVltgLimrPhaAdvPreDly /end SUB_GROUP
 /begin FUNCTION_LIST /end FUNCTION_LIST
 /begin REF_CHARACTERISTIC /end REF_CHARACTERISTIC
 /begin REF_MEASUREMENT /end REF_MEASUREMENT
/end GROUP
/begin GROUP CDD_MotCurrRegVltgLimr.dMotCurrRegVltgLimrAntiWdupCmdScaDax "MICROSAR RTE" /begin SUB_GROUP /end SUB_GROUP /begin FUNCTION_LIST /end FUNCTION_LIST /begin REF_CHARACTERISTIC /end REF_CHARACTERISTIC
 /begin REF_MEASUREMENT CDD_MotCurrRegVltgLimr.dMotCurrRegVltgLimrAntiWdupCmdScaDax /end REF_MEASUREMENT
/end GROUP
/begin GROUP CDD_MotCurrRegVltgLimr.dMotCurrRegVltgLimrAntiWdupCmdScaQax "MICROSAR RTE" /begin SUB_GROUP /end SUB_GROUP /begin FUNCTION_LIST /end FUNCTION_LIST /begin REF_CHARACTERISTIC /end REF_CHARACTERISTIC
 /begin REF_MEASUREMENT CDD_MotCurrRegVltgLimr.dMotCurrRegVltgLimrAntiWdupCmdScaQax /end REF_MEASUREMENT
/end GROUP
/begin GROUP CDD_MotCurrRegVltgLimr.dMotCurrRegVltgLimrMotCurrCmdErr "MICROSAR RTE" /begin SUB_GROUP /end SUB_GROUP /begin FUNCTION_LIST /end FUNCTION_LIST /begin REF_CHARACTERISTIC /end REF_CHARACTERISTIC /begin REF_MEASUREMENT CDD_MotCurrRegVltgLimr.dMotCurrRegVltgLimrMotCurrCmdErr /end REF_MEASUREMENT /end GROUP
/begin GROUP CDD_MotCurrRegVltgLimr.dMotCurrRegVltgLimrMotCurrCmdErrDax "MICROSAR RTE" /begin SUB_GROUP /end SUB_GROUP /begin FUNCTION_LIST /end FUNCTION_LIST /begin REF_CHARACTERISTIC /end REF_CHARACTERISTIC /begin REF_MEASUREMENT CDD_MotCurrRegVltgLimr.dMotCurrRegVltgLimrMotCurrCmdErrDax /end REF_MEASUREMENT /end GROUP
/begin GROUP CDD_MotCurrRegVltgLimr.dMotCurrRegVltgLimrMotCurrCmdErrQax "MICROSAR RTE" /begin SUB_GROUP /end SUB_GROUP /begin FUNCTION_LIST /end FUNCTION_LIST /begin REF_CHARACTERISTIC /end REF_CHARACTERISTIC /begin REF_MEASUREMENT CDD_MotCurrRegVltgLimr.dMotCurrRegVltgLimrMotCurrCmdErrQax /end REF_MEASUREMENT /end GROUP
/begin GROUP CDD_MotCurrRegVltgLimr.dMotCurrRegVltgLimrMotCurrCmdScaDax "MICROSAR RTE" /begin SUB_GROUP /end SUB_GROUP /begin FUNCTION_LIST /end FUNCTION_LIST /begin REF_CHARACTERISTIC /end REF_CHARACTERISTIC /begin REF_MEASUREMENT CDD_MotCurrRegVltgLimr.dMotCurrRegVltgLimrMotCurrCmdScaDax /end REF_MEASUREMENT /end GROUP
/begin GROUP CDD_MotCurrRegVltgLimr.dMotCurrRegVltgLimrMotCurrCmdScaQax "MICROSAR RTE" /begin SUB_GROUP /end SUB_GROUP /begin FUNCTION_LIST /end FUNCTION_LIST /begin REF_CHARACTERISTIC /end REF_CHARACTERISTIC /begin REF_MEASUREMENT CDD_MotCurrRegVltgLimr.dMotCurrRegVltgLimrMotCurrCmdScaQax /end REF_MEASUREMENT /end GROUP
/begin GROUP CDD_MotCurrRegVltgLimr.dMotCurrRegVltgLimrMotVltgBrdgFild "MICROSAR RTE" /begin SUB_GROUP /end SUB_GROUP /begin FUNCTION_LIST /end FUNCTION_LIST /begin REF_CHARACTERISTIC /end REF_CHARACTERISTIC /begin REF_MEASUREMENT CDD_MotCurrRegVltgLimr.dMotCurrRegVltgLimrMotVltgBrdgFild /end REF_MEASUREMENT /end GROUP
/begin GROUP CDD_MotCurrRegVltgLimr.dMotCurrRegVltgLimrMotVltgCmdFinal "MICROSAR RTE" /begin SUB_GROUP /end SUB_GROUP /begin FUNCTION_LIST /end FUNCTION_LIST /begin REF_CHARACTERISTIC /end REF_CHARACTERISTIC /begin REF_MEASUREMENT CDD_MotCurrRegVltgLimr.dMotCurrRegVltgLimrMotVltgCmdFinal /end REF_MEASUREMENT /end GROUP
/begin GROUP CDD_MotCurrRegVltgLimr.dMotCurrRegVltgLimrMotVltgCmdPreLim "MICROSAR RTE" /begin SUB_GROUP /end SUB_GROUP /begin FUNCTION_LIST /end FUNCTION_LIST /begin REF_CHARACTERISTIC /end REF_CHARACTERISTIC /begin REF_MEASUREMENT CDD_MotCurrRegVltgLimr.dMotCurrRegVltgLimrMotVltgCmdPreLim /end REF_MEASUREMENT /end GROUP
/begin GROUP CDD_MotCurrRegVltgLimr.dMotCurrRegVltgLimrMotVltgDampgDax "MICROSAR RTE" /begin SUB_GROUP /end SUB_GROUP /begin FUNCTION_LIST /end FUNCTION_LIST /begin REF_CHARACTERISTIC /end REF_CHARACTERISTIC /begin REF_MEASUREMENT CDD_MotCurrRegVltgLimr.dMotCurrRegVltgLimrMotVltgDampgDax /end REF_MEASUREMENT /end GROUP
/begin GROUP CDD_MotCurrRegVltgLimr.dMotCurrRegVltgLimrMotVltgDampgQax "MICROSAR RTE" /begin SUB_GROUP /end SUB_GROUP /begin FUNCTION_LIST /end FUNCTION_LIST /begin REF_CHARACTERISTIC /end REF_CHARACTERISTIC /begin REF_MEASUREMENT CDD_MotCurrRegVltgLimr.dMotCurrRegVltgLimrMotVltgDampgQax /end REF_MEASUREMENT /end GROUP
/begin GROUP CDD_MotCurrRegVltgLimr.dMotCurrRegVltgLimrMotVltgDaxFb "MICROSAR RTE" /begin SUB_GROUP /end SUB_GROUP /begin FUNCTION_LIST /end FUNCTION_LIST /begin REF_CHARACTERISTIC /end REF_CHARACTERISTIC /begin REF_MEASUREMENT CDD_MotCurrRegVltgLimr.dMotCurrRegVltgLimrMotVltgDaxFb /end REF_MEASUREMENT /end GROUP
/begin GROUP CDD_MotCurrRegVltgLimr.dMotCurrRegVltgLimrMotVltgDaxIntglPreLim "MICROSAR RTE" /begin SUB_GROUP /end SUB_GROUP /begin FUNCTION_LIST /end FUNCTION_LIST /begin REF_CHARACTERISTIC /end REF_CHARACTERISTIC
 /begin REF_MEASUREMENT CDD_MotCurrRegVltgLimr.dMotCurrRegVltgLimrMotVltgDaxIntglPreLim /end REF_MEASUREMENT
/end GROUP
/begin GROUP CDD_MotCurrRegVltgLimr.dMotCurrRegVltgLimrMotVltgDecouplFbDax "MICROSAR RTE" /begin SUB_GROUP /end SUB_GROUP /begin FUNCTION_LIST /end FUNCTION_LIST /begin REF_CHARACTERISTIC /end REF_CHARACTERISTIC
 /begin REF_MEASUREMENT CDD_MotCurrRegVltgLimr.dMotCurrRegVltgLimrMotVltgDecouplFbDax /end REF_MEASUREMENT
/end GROUP
/begin GROUP CDD_MotCurrRegVltgLimr.dMotCurrRegVltgLimrMotVltgDecouplFbQax "MICROSAR RTE" /begin SUB_GROUP /end SUB_GROUP /begin FUNCTION_LIST /end FUNCTION_LIST /begin REF_CHARACTERISTIC /end REF_CHARACTERISTIC
 /begin REF_MEASUREMENT CDD_MotCurrRegVltgLimr.dMotCurrRegVltgLimrMotVltgDecouplFbQax /end REF_MEASUREMENT
/end GROUP
/begin GROUP CDD_MotCurrRegVltgLimr.dMotCurrRegVltgLimrMotVltgDircFbDax "MICROSAR RTE" /begin SUB_GROUP /end SUB_GROUP /begin FUNCTION_LIST /end FUNCTION_LIST /begin REF_CHARACTERISTIC /end REF_CHARACTERISTIC /begin REF_MEASUREMENT CDD_MotCurrRegVltgLimr.dMotCurrRegVltgLimrMotVltgDircFbDax /end REF_MEASUREMENT /end GROUP
/begin GROUP CDD_MotCurrRegVltgLimr.dMotCurrRegVltgLimrMotVltgDircFbQax "MICROSAR RTE" /begin SUB_GROUP /end SUB_GROUP /begin FUNCTION_LIST /end FUNCTION_LIST /begin REF_CHARACTERISTIC /end REF_CHARACTERISTIC /begin REF_MEASUREMENT CDD_MotCurrRegVltgLimr.dMotCurrRegVltgLimrMotVltgDircFbQax /end REF_MEASUREMENT /end GROUP
/begin GROUP CDD_MotCurrRegVltgLimr.dMotCurrRegVltgLimrMotVltgPreLimDax "MICROSAR RTE" /begin SUB_GROUP /end SUB_GROUP /begin FUNCTION_LIST /end FUNCTION_LIST /begin REF_CHARACTERISTIC /end REF_CHARACTERISTIC /begin REF_MEASUREMENT CDD_MotCurrRegVltgLimr.dMotCurrRegVltgLimrMotVltgPreLimDax /end REF_MEASUREMENT /end GROUP
/begin GROUP CDD_MotCurrRegVltgLimr.dMotCurrRegVltgLimrMotVltgPreLimQax "MICROSAR RTE" /begin SUB_GROUP /end SUB_GROUP /begin FUNCTION_LIST /end FUNCTION_LIST /begin REF_CHARACTERISTIC /end REF_CHARACTERISTIC /begin REF_MEASUREMENT CDD_MotCurrRegVltgLimr.dMotCurrRegVltgLimrMotVltgPreLimQax /end REF_MEASUREMENT /end GROUP
/begin GROUP CDD_MotCurrRegVltgLimr.dMotCurrRegVltgLimrMotVltgPropCmdDax "MICROSAR RTE" /begin SUB_GROUP /end SUB_GROUP /begin FUNCTION_LIST /end FUNCTION_LIST /begin REF_CHARACTERISTIC /end REF_CHARACTERISTIC
 /begin REF_MEASUREMENT CDD_MotCurrRegVltgLimr.dMotCurrRegVltgLimrMotVltgPropCmdDax /end REF_MEASUREMENT
/end GROUP
/begin GROUP CDD_MotCurrRegVltgLimr.dMotCurrRegVltgLimrMotVltgPropCmdQax "MICROSAR RTE" /begin SUB_GROUP /end SUB_GROUP /begin FUNCTION_LIST /end FUNCTION_LIST /begin REF_CHARACTERISTIC /end REF_CHARACTERISTIC
 /begin REF_MEASUREMENT CDD_MotCurrRegVltgLimr.dMotCurrRegVltgLimrMotVltgPropCmdQax /end REF_MEASUREMENT
/end GROUP
/begin GROUP CDD_MotCurrRegVltgLimr.dMotCurrRegVltgLimrMotVltgQaxFb "MICROSAR RTE" /begin SUB_GROUP /end SUB_GROUP /begin FUNCTION_LIST /end FUNCTION_LIST /begin REF_CHARACTERISTIC /end REF_CHARACTERISTIC /begin REF_MEASUREMENT CDD_MotCurrRegVltgLimr.dMotCurrRegVltgLimrMotVltgQaxFb /end REF_MEASUREMENT /end GROUP
/begin GROUP CDD_MotCurrRegVltgLimr.dMotCurrRegVltgLimrMotVltgQaxFfFild "MICROSAR RTE" /begin SUB_GROUP /end SUB_GROUP /begin FUNCTION_LIST /end FUNCTION_LIST /begin REF_CHARACTERISTIC /end REF_CHARACTERISTIC /begin REF_MEASUREMENT CDD_MotCurrRegVltgLimr.dMotCurrRegVltgLimrMotVltgQaxFfFild /end REF_MEASUREMENT /end GROUP
/begin GROUP CDD_MotCurrRegVltgLimr.dMotCurrRegVltgLimrMotVltgQaxIntglPreLim "MICROSAR RTE" /begin SUB_GROUP /end SUB_GROUP /begin FUNCTION_LIST /end FUNCTION_LIST /begin REF_CHARACTERISTIC /end REF_CHARACTERISTIC
 /begin REF_MEASUREMENT CDD_MotCurrRegVltgLimr.dMotCurrRegVltgLimrMotVltgQaxIntglPreLim /end REF_MEASUREMENT
/end GROUP
/begin GROUP CDD_MotCurrRegVltgLimr.dMotCurrRegVltgLimrMotVltgSatnIvsRat "MICROSAR RTE" /begin SUB_GROUP /end SUB_GROUP /begin FUNCTION_LIST /end FUNCTION_LIST /begin REF_CHARACTERISTIC /end REF_CHARACTERISTIC
 /begin REF_MEASUREMENT CDD_MotCurrRegVltgLimr.dMotCurrRegVltgLimrMotVltgSatnIvsRat /end REF_MEASUREMENT
/end GROUP
/begin GROUP CDD_MotCurrRegVltgLimr.dMotCurrRegVltgLimrMotVltgSatnRat "MICROSAR RTE" /begin SUB_GROUP /end SUB_GROUP /begin FUNCTION_LIST /end FUNCTION_LIST /begin REF_CHARACTERISTIC /end REF_CHARACTERISTIC /begin REF_MEASUREMENT CDD_MotCurrRegVltgLimr.dMotCurrRegVltgLimrMotVltgSatnRat /end REF_MEASUREMENT /end GROUP
/begin GROUP CDD_MotCurrRegVltgLimr.dMotCurrRegVltgLimrPhaAdvPreDly "MICROSAR RTE" /begin SUB_GROUP /end SUB_GROUP /begin FUNCTION_LIST /end FUNCTION_LIST /begin REF_CHARACTERISTIC /end REF_CHARACTERISTIC /begin REF_MEASUREMENT CDD_MotCurrRegVltgLimr.dMotCurrRegVltgLimrPhaAdvPreDly /end REF_MEASUREMENT /end GROUP
/begin GROUP CDD_MotRplCoggCmd "MICROSAR RTE"
 /begin SUB_GROUP CDD_MotRplCoggCmd.CalibrationPorts CDD_MotRplCoggCmd.PerInstanceMemories /end SUB_GROUP
 /begin FUNCTION_LIST /end FUNCTION_LIST
 /begin REF_CHARACTERISTIC /end REF_CHARACTERISTIC
 /begin REF_MEASUREMENT /end REF_MEASUREMENT
/end GROUP
/begin GROUP CDD_MotRplCoggCmd.CalibrationPorts "MICROSAR RTE"
 /begin SUB_GROUP CDD_MotRplCoggCmd.MotRplCoggCmdHrmncOrder1Elec.Val CDD_MotRplCoggCmd.MotRplCoggCmdHrmncOrder2Elec.Val CDD_MotRplCoggCmd.MotRplCoggCmdHrmncOrder3Elec.Val /end SUB_GROUP
 /begin FUNCTION_LIST /end FUNCTION_LIST
 /begin REF_CHARACTERISTIC /end REF_CHARACTERISTIC
 /begin REF_MEASUREMENT /end REF_MEASUREMENT
/end GROUP
/begin GROUP CDD_MotRplCoggCmd.MotCoggCmdY "MICROSAR RTE" /begin SUB_GROUP /end SUB_GROUP /begin FUNCTION_LIST /end FUNCTION_LIST /begin REF_CHARACTERISTIC /end REF_CHARACTERISTIC /begin REF_MEASUREMENT CDD_MotRplCoggCmd.MotCoggCmdY /end REF_MEASUREMENT /end GROUP
/begin GROUP CDD_MotRplCoggCmd.MotRplCoggCmdHrmncOrder1Elec.Val "MICROSAR RTE" /begin SUB_GROUP /end SUB_GROUP /begin FUNCTION_LIST /end FUNCTION_LIST /begin REF_CHARACTERISTIC CDD_MotRplCoggCmd.MotRplCoggCmdHrmncOrder1Elec.Val /end REF_CHARACTERISTIC /begin REF_MEASUREMENT /end REF_MEASUREMENT /end GROUP
/begin GROUP CDD_MotRplCoggCmd.MotRplCoggCmdHrmncOrder2Elec.Val "MICROSAR RTE" /begin SUB_GROUP /end SUB_GROUP /begin FUNCTION_LIST /end FUNCTION_LIST /begin REF_CHARACTERISTIC CDD_MotRplCoggCmd.MotRplCoggCmdHrmncOrder2Elec.Val /end REF_CHARACTERISTIC /begin REF_MEASUREMENT /end REF_MEASUREMENT /end GROUP
/begin GROUP CDD_MotRplCoggCmd.MotRplCoggCmdHrmncOrder3Elec.Val "MICROSAR RTE" /begin SUB_GROUP /end SUB_GROUP /begin FUNCTION_LIST /end FUNCTION_LIST /begin REF_CHARACTERISTIC CDD_MotRplCoggCmd.MotRplCoggCmdHrmncOrder3Elec.Val /end REF_CHARACTERISTIC /begin REF_MEASUREMENT /end REF_MEASUREMENT /end GROUP
/begin GROUP CDD_MotRplCoggCmd.PerInstanceMemories "MICROSAR RTE"
 /begin SUB_GROUP CDD_MotRplCoggCmd.MotCoggCmdY CDD_MotRplCoggCmd.dMotRplCoggCmdCoggIdx CDD_MotRplCoggCmd.dMotRplCoggCmdMotCoggCmd CDD_MotRplCoggCmd.dMotRplCoggCmdMotCurrQaxCoggCmdPreLim CDD_MotRplCoggCmd.dMotRplCoggCmdMotRplCmdPreLim /end SUB_GROUP
 /begin FUNCTION_LIST /end FUNCTION_LIST
 /begin REF_CHARACTERISTIC /end REF_CHARACTERISTIC
 /begin REF_MEASUREMENT /end REF_MEASUREMENT
/end GROUP
/begin GROUP CDD_MotRplCoggCmd.dMotRplCoggCmdCoggIdx "MICROSAR RTE" /begin SUB_GROUP /end SUB_GROUP /begin FUNCTION_LIST /end FUNCTION_LIST /begin REF_CHARACTERISTIC /end REF_CHARACTERISTIC /begin REF_MEASUREMENT CDD_MotRplCoggCmd.dMotRplCoggCmdCoggIdx /end REF_MEASUREMENT /end GROUP
/begin GROUP CDD_MotRplCoggCmd.dMotRplCoggCmdMotCoggCmd "MICROSAR RTE" /begin SUB_GROUP /end SUB_GROUP /begin FUNCTION_LIST /end FUNCTION_LIST /begin REF_CHARACTERISTIC /end REF_CHARACTERISTIC /begin REF_MEASUREMENT CDD_MotRplCoggCmd.dMotRplCoggCmdMotCoggCmd /end REF_MEASUREMENT /end GROUP
/begin GROUP CDD_MotRplCoggCmd.dMotRplCoggCmdMotCurrQaxCoggCmdPreLim "MICROSAR RTE" /begin SUB_GROUP /end SUB_GROUP /begin FUNCTION_LIST /end FUNCTION_LIST /begin REF_CHARACTERISTIC /end REF_CHARACTERISTIC /begin REF_MEASUREMENT CDD_MotRplCoggCmd.dMotRplCoggCmdMotCurrQaxCoggCmdPreLim /end REF_MEASUREMENT /end GROUP
/begin GROUP CDD_MotRplCoggCmd.dMotRplCoggCmdMotRplCmdPreLim "MICROSAR RTE" /begin SUB_GROUP /end SUB_GROUP /begin FUNCTION_LIST /end FUNCTION_LIST /begin REF_CHARACTERISTIC /end REF_CHARACTERISTIC /begin REF_MEASUREMENT CDD_MotRplCoggCmd.dMotRplCoggCmdMotRplCmdPreLim /end REF_MEASUREMENT /end GROUP
/begin GROUP CDD_MotVel "MICROSAR RTE"
 /begin SUB_GROUP CDD_MotVel.CalibrationPorts CDD_MotVel.PerInstanceMemories CDD_MotVel.ReceiverPorts CDD_MotVel.SenderPorts /end SUB_GROUP
 /begin FUNCTION_LIST /end FUNCTION_LIST
 /begin REF_CHARACTERISTIC /end REF_CHARACTERISTIC
 /begin REF_MEASUREMENT /end REF_MEASUREMENT
/end GROUP
/begin GROUP CDD_MotVel.AssiMechPolarity.Val "MICROSAR RTE" /begin SUB_GROUP /end SUB_GROUP /begin FUNCTION_LIST /end FUNCTION_LIST /begin REF_CHARACTERISTIC /end REF_CHARACTERISTIC /begin REF_MEASUREMENT CDD_MotVel.AssiMechPolarity.Val /end REF_MEASUREMENT /end GROUP
/begin GROUP CDD_MotVel.CalibrationPorts "MICROSAR RTE" /begin SUB_GROUP CDD_MotVel.SysGlbPrmSysKineRat.Val /end SUB_GROUP /begin FUNCTION_LIST /end FUNCTION_LIST /begin REF_CHARACTERISTIC /end REF_CHARACTERISTIC /begin REF_MEASUREMENT /end REF_MEASUREMENT /end GROUP
/begin GROUP CDD_MotVel.HwVel.Val "MICROSAR RTE" /begin SUB_GROUP /end SUB_GROUP /begin FUNCTION_LIST /end FUNCTION_LIST /begin REF_CHARACTERISTIC /end REF_CHARACTERISTIC /begin REF_MEASUREMENT CDD_MotVel.HwVel.Val /end REF_MEASUREMENT /end GROUP
/begin GROUP CDD_MotVel.MotAgBuf.Ary1D "MICROSAR RTE" /begin SUB_GROUP /end SUB_GROUP /begin FUNCTION_LIST /end FUNCTION_LIST /begin REF_CHARACTERISTIC /end REF_CHARACTERISTIC /begin REF_MEASUREMENT CDD_MotVel.MotAgBuf.Ary1D /end REF_MEASUREMENT /end GROUP
/begin GROUP CDD_MotVel.MotAgBufIdx "MICROSAR RTE" /begin SUB_GROUP /end SUB_GROUP /begin FUNCTION_LIST /end FUNCTION_LIST /begin REF_CHARACTERISTIC /end REF_CHARACTERISTIC /begin REF_MEASUREMENT CDD_MotVel.MotAgBufIdx /end REF_MEASUREMENT /end GROUP
/begin GROUP CDD_MotVel.MotAgBufIdx.Val "MICROSAR RTE" /begin SUB_GROUP /end SUB_GROUP /begin FUNCTION_LIST /end FUNCTION_LIST /begin REF_CHARACTERISTIC /end REF_CHARACTERISTIC /begin REF_MEASUREMENT CDD_MotVel.MotAgBufIdx.Val /end REF_MEASUREMENT /end GROUP
/begin GROUP CDD_MotVel.MotAgBufIdxPrev "MICROSAR RTE" /begin SUB_GROUP /end SUB_GROUP /begin FUNCTION_LIST /end FUNCTION_LIST /begin REF_CHARACTERISTIC /end REF_CHARACTERISTIC /begin REF_MEASUREMENT CDD_MotVel.MotAgBufIdxPrev /end REF_MEASUREMENT /end GROUP
/begin GROUP CDD_MotVel.MotAgBufPrev "MICROSAR RTE" /begin SUB_GROUP /end SUB_GROUP /begin FUNCTION_LIST /end FUNCTION_LIST /begin REF_CHARACTERISTIC /end REF_CHARACTERISTIC /begin REF_MEASUREMENT CDD_MotVel.MotAgBufPrev /end REF_MEASUREMENT /end GROUP
/begin GROUP CDD_MotVel.MotAgTiBuf.Ary1D "MICROSAR RTE" /begin SUB_GROUP /end SUB_GROUP /begin FUNCTION_LIST /end FUNCTION_LIST /begin REF_CHARACTERISTIC /end REF_CHARACTERISTIC /begin REF_MEASUREMENT CDD_MotVel.MotAgTiBuf.Ary1D /end REF_MEASUREMENT /end GROUP
/begin GROUP CDD_MotVel.MotAgTiBufPrev "MICROSAR RTE" /begin SUB_GROUP /end SUB_GROUP /begin FUNCTION_LIST /end FUNCTION_LIST /begin REF_CHARACTERISTIC /end REF_CHARACTERISTIC /begin REF_MEASUREMENT CDD_MotVel.MotAgTiBufPrev /end REF_MEASUREMENT /end GROUP
/begin GROUP CDD_MotVel.MotVelCrf.Val "MICROSAR RTE" /begin SUB_GROUP /end SUB_GROUP /begin FUNCTION_LIST /end FUNCTION_LIST /begin REF_CHARACTERISTIC /end REF_CHARACTERISTIC /begin REF_MEASUREMENT CDD_MotVel.MotVelCrf.Val /end REF_MEASUREMENT /end GROUP
/begin GROUP CDD_MotVel.MotVelIninCntr "MICROSAR RTE" /begin SUB_GROUP /end SUB_GROUP /begin FUNCTION_LIST /end FUNCTION_LIST /begin REF_CHARACTERISTIC /end REF_CHARACTERISTIC /begin REF_MEASUREMENT CDD_MotVel.MotVelIninCntr /end REF_MEASUREMENT /end GROUP
/begin GROUP CDD_MotVel.MotVelMrf.Val "MICROSAR RTE" /begin SUB_GROUP /end SUB_GROUP /begin FUNCTION_LIST /end FUNCTION_LIST /begin REF_CHARACTERISTIC /end REF_CHARACTERISTIC /begin REF_MEASUREMENT CDD_MotVel.MotVelMrf.Val /end REF_MEASUREMENT /end GROUP
/begin GROUP CDD_MotVel.PerInstanceMemories "MICROSAR RTE"
 /begin SUB_GROUP CDD_MotVel.MotAgBufIdx CDD_MotVel.MotAgBufIdxPrev CDD_MotVel.MotAgBufPrev CDD_MotVel.MotAgTiBufPrev CDD_MotVel.MotVelIninCntr CDD_MotVel.dMotVelAvrgTi CDD_MotVel.dMotVelMotAgRef CDD_MotVel.dMotVelTiStampRef /end SUB_GROUP
 /begin FUNCTION_LIST /end FUNCTION_LIST
 /begin REF_CHARACTERISTIC /end REF_CHARACTERISTIC
 /begin REF_MEASUREMENT /end REF_MEASUREMENT
/end GROUP
/begin GROUP CDD_MotVel.ReceiverPorts "MICROSAR RTE"
 /begin SUB_GROUP CDD_MotVel.AssiMechPolarity.Val CDD_MotVel.MotAgBuf.Ary1D CDD_MotVel.MotAgBufIdx.Val CDD_MotVel.MotAgTiBuf.Ary1D /end SUB_GROUP
 /begin FUNCTION_LIST /end FUNCTION_LIST
 /begin REF_CHARACTERISTIC /end REF_CHARACTERISTIC
 /begin REF_MEASUREMENT /end REF_MEASUREMENT
/end GROUP
/begin GROUP CDD_MotVel.SenderPorts "MICROSAR RTE"
 /begin SUB_GROUP CDD_MotVel.HwVel.Val CDD_MotVel.MotVelCrf.Val CDD_MotVel.MotVelMrf.Val /end SUB_GROUP
 /begin FUNCTION_LIST /end FUNCTION_LIST
 /begin REF_CHARACTERISTIC /end REF_CHARACTERISTIC
 /begin REF_MEASUREMENT /end REF_MEASUREMENT
/end GROUP
/begin GROUP CDD_MotVel.SysGlbPrmSysKineRat.Val "MICROSAR RTE" /begin SUB_GROUP /end SUB_GROUP /begin FUNCTION_LIST /end FUNCTION_LIST /begin REF_CHARACTERISTIC CDD_MotVel.SysGlbPrmSysKineRat.Val /end REF_CHARACTERISTIC /begin REF_MEASUREMENT /end REF_MEASUREMENT /end GROUP
/begin GROUP CDD_MotVel.dMotVelAvrgTi "MICROSAR RTE" /begin SUB_GROUP /end SUB_GROUP /begin FUNCTION_LIST /end FUNCTION_LIST /begin REF_CHARACTERISTIC /end REF_CHARACTERISTIC /begin REF_MEASUREMENT CDD_MotVel.dMotVelAvrgTi /end REF_MEASUREMENT /end GROUP
/begin GROUP CDD_MotVel.dMotVelMotAgRef "MICROSAR RTE" /begin SUB_GROUP /end SUB_GROUP /begin FUNCTION_LIST /end FUNCTION_LIST /begin REF_CHARACTERISTIC /end REF_CHARACTERISTIC /begin REF_MEASUREMENT CDD_MotVel.dMotVelMotAgRef /end REF_MEASUREMENT /end GROUP
/begin GROUP CDD_MotVel.dMotVelTiStampRef "MICROSAR RTE" /begin SUB_GROUP /end SUB_GROUP /begin FUNCTION_LIST /end FUNCTION_LIST /begin REF_CHARACTERISTIC /end REF_CHARACTERISTIC /begin REF_MEASUREMENT CDD_MotVel.dMotVelTiStampRef /end REF_MEASUREMENT /end GROUP
/begin GROUP CDD_NvMProxy "MICROSAR RTE" /begin SUB_GROUP CDD_NvMProxy.PerInstanceMemories /end SUB_GROUP /begin FUNCTION_LIST /end FUNCTION_LIST /begin REF_CHARACTERISTIC /end REF_CHARACTERISTIC /begin REF_MEASUREMENT /end REF_MEASUREMENT /end GROUP
/begin GROUP CDD_NvMProxy.BlkFltTbl "MICROSAR RTE" /begin SUB_GROUP /end SUB_GROUP /begin FUNCTION_LIST /end FUNCTION_LIST /begin REF_CHARACTERISTIC /end REF_CHARACTERISTIC
 /begin REF_MEASUREMENT CDD_NvMProxy.BlkFltTbl[0].Prm CDD_NvMProxy.BlkFltTbl[0].Sts CDD_NvMProxy.BlkFltTbl[1].Prm CDD_NvMProxy.BlkFltTbl[1].Sts CDD_NvMProxy.BlkFltTbl[2].Prm CDD_NvMProxy.BlkFltTbl[2].Sts CDD_NvMProxy.BlkFltTbl[3].Prm CDD_NvMProxy.BlkFltTbl[3].Sts CDD_NvMProxy.BlkFltTbl[4].Prm CDD_NvMProxy.BlkFltTbl[4].Sts /end REF_MEASUREMENT
/end GROUP
/begin GROUP CDD_NvMProxy.NvmBlkActv "MICROSAR RTE" /begin SUB_GROUP /end SUB_GROUP /begin FUNCTION_LIST /end FUNCTION_LIST /begin REF_CHARACTERISTIC /end REF_CHARACTERISTIC /begin REF_MEASUREMENT CDD_NvMProxy.NvmBlkActv /end REF_MEASUREMENT /end GROUP
/begin GROUP CDD_NvMProxy.NvmStsCollctd "MICROSAR RTE" /begin SUB_GROUP /end SUB_GROUP /begin FUNCTION_LIST /end FUNCTION_LIST /begin REF_CHARACTERISTIC /end REF_CHARACTERISTIC /begin REF_MEASUREMENT CDD_NvMProxy.NvmStsCollctd /end REF_MEASUREMENT /end GROUP
/begin GROUP CDD_NvMProxy.PerInstanceMemories "MICROSAR RTE"
 /begin SUB_GROUP CDD_NvMProxy.BlkFltTbl CDD_NvMProxy.NvmBlkActv CDD_NvMProxy.NvmStsCollctd CDD_NvMProxy.ShtdwnClsChk /end SUB_GROUP
 /begin FUNCTION_LIST /end FUNCTION_LIST
 /begin REF_CHARACTERISTIC /end REF_CHARACTERISTIC
 /begin REF_MEASUREMENT /end REF_MEASUREMENT
/end GROUP
/begin GROUP CDD_NvMProxy.ShtdwnClsChk "MICROSAR RTE" /begin SUB_GROUP /end SUB_GROUP /begin FUNCTION_LIST /end FUNCTION_LIST /begin REF_CHARACTERISTIC /end REF_CHARACTERISTIC /begin REF_MEASUREMENT CDD_NvMProxy.ShtdwnClsChk /end REF_MEASUREMENT /end GROUP
/begin GROUP CDD_RamMem "MICROSAR RTE" /begin SUB_GROUP CDD_RamMem.PerInstanceMemories CDD_RamMem.SenderPorts /end SUB_GROUP /begin FUNCTION_LIST /end FUNCTION_LIST /begin REF_CHARACTERISTIC /end REF_CHARACTERISTIC /begin REF_MEASUREMENT /end REF_MEASUREMENT /end GROUP
/begin GROUP CDD_RamMem.LclRamEccSngBitCntr "MICROSAR RTE" /begin SUB_GROUP /end SUB_GROUP /begin FUNCTION_LIST /end FUNCTION_LIST /begin REF_CHARACTERISTIC /end REF_CHARACTERISTIC /begin REF_MEASUREMENT CDD_RamMem.LclRamEccSngBitCntr /end REF_MEASUREMENT /end GROUP
/begin GROUP CDD_RamMem.LclRamEccSngBitCntrOutp.Val "MICROSAR RTE" /begin SUB_GROUP /end SUB_GROUP /begin FUNCTION_LIST /end FUNCTION_LIST /begin REF_CHARACTERISTIC /end REF_CHARACTERISTIC /begin REF_MEASUREMENT CDD_RamMem.LclRamEccSngBitCntrOutp.Val /end REF_MEASUREMENT /end GROUP
/begin GROUP CDD_RamMem.LclRamEccSngBitSoftFailr "MICROSAR RTE" /begin SUB_GROUP /end SUB_GROUP /begin FUNCTION_LIST /end FUNCTION_LIST /begin REF_CHARACTERISTIC /end REF_CHARACTERISTIC /begin REF_MEASUREMENT CDD_RamMem.LclRamEccSngBitSoftFailr /end REF_MEASUREMENT /end GROUP
/begin GROUP CDD_RamMem.LclRamFailrAdr "MICROSAR RTE" /begin SUB_GROUP /end SUB_GROUP /begin FUNCTION_LIST /end FUNCTION_LIST /begin REF_CHARACTERISTIC /end REF_CHARACTERISTIC /begin REF_MEASUREMENT CDD_RamMem.LclRamFailrAdr /end REF_MEASUREMENT /end GROUP
/begin GROUP CDD_RamMem.LclRamWordLineRead "MICROSAR RTE" /begin SUB_GROUP /end SUB_GROUP /begin FUNCTION_LIST /end FUNCTION_LIST /begin REF_CHARACTERISTIC /end REF_CHARACTERISTIC /begin REF_MEASUREMENT CDD_RamMem.LclRamWordLineRead /end REF_MEASUREMENT /end GROUP
/begin GROUP CDD_RamMem.PerInstanceMemories "MICROSAR RTE"
 /begin SUB_GROUP CDD_RamMem.LclRamEccSngBitCntr CDD_RamMem.LclRamEccSngBitSoftFailr CDD_RamMem.LclRamFailrAdr CDD_RamMem.LclRamWordLineRead CDD_RamMem.dRamMemCanRamDblBitEccErrAdr CDD_RamMem.dRamMemCanRamSngBitEccErrAdr CDD_RamMem.dRamMemDtsRamEccErrAdr CDD_RamMem.dRamMemFrRamDblBitEccErrAdr CDD_RamMem.dRamMemFrRamSngBitEccErrAdr CDD_RamMem.dRamMemFrRamTmpBufADblBitEccErrAdr CDD_RamMem.dRamMemFrRamTmpBufBDblBitEccErrAdr CDD_RamMem.dRamMemSpi0RamEccErrAdr CDD_RamMem.dRamMemSpi1RamEccErrAdr CDD_RamMem.dRamMemSpi2RamEccErrAdr CDD_RamMem.dRamMemSpi3RamEccErrAdr CDD_RamMem.dRamMemSpiRamEccErrAdr /end SUB_GROUP
 /begin FUNCTION_LIST /end FUNCTION_LIST
 /begin REF_CHARACTERISTIC /end REF_CHARACTERISTIC
 /begin REF_MEASUREMENT /end REF_MEASUREMENT
/end GROUP
/begin GROUP CDD_RamMem.SenderPorts "MICROSAR RTE" /begin SUB_GROUP CDD_RamMem.LclRamEccSngBitCntrOutp.Val /end SUB_GROUP /begin FUNCTION_LIST /end FUNCTION_LIST /begin REF_CHARACTERISTIC /end REF_CHARACTERISTIC /begin REF_MEASUREMENT /end REF_MEASUREMENT /end GROUP
/begin GROUP CDD_RamMem.dRamMemCanRamDblBitEccErrAdr "MICROSAR RTE" /begin SUB_GROUP /end SUB_GROUP /begin FUNCTION_LIST /end FUNCTION_LIST /begin REF_CHARACTERISTIC /end REF_CHARACTERISTIC /begin REF_MEASUREMENT CDD_RamMem.dRamMemCanRamDblBitEccErrAdr /end REF_MEASUREMENT /end GROUP
/begin GROUP CDD_RamMem.dRamMemCanRamSngBitEccErrAdr "MICROSAR RTE" /begin SUB_GROUP /end SUB_GROUP /begin FUNCTION_LIST /end FUNCTION_LIST /begin REF_CHARACTERISTIC /end REF_CHARACTERISTIC /begin REF_MEASUREMENT CDD_RamMem.dRamMemCanRamSngBitEccErrAdr /end REF_MEASUREMENT /end GROUP
/begin GROUP CDD_RamMem.dRamMemDtsRamEccErrAdr "MICROSAR RTE" /begin SUB_GROUP /end SUB_GROUP /begin FUNCTION_LIST /end FUNCTION_LIST /begin REF_CHARACTERISTIC /end REF_CHARACTERISTIC /begin REF_MEASUREMENT CDD_RamMem.dRamMemDtsRamEccErrAdr /end REF_MEASUREMENT /end GROUP
/begin GROUP CDD_RamMem.dRamMemFrRamDblBitEccErrAdr "MICROSAR RTE" /begin SUB_GROUP /end SUB_GROUP /begin FUNCTION_LIST /end FUNCTION_LIST /begin REF_CHARACTERISTIC /end REF_CHARACTERISTIC /begin REF_MEASUREMENT CDD_RamMem.dRamMemFrRamDblBitEccErrAdr /end REF_MEASUREMENT /end GROUP
/begin GROUP CDD_RamMem.dRamMemFrRamSngBitEccErrAdr "MICROSAR RTE" /begin SUB_GROUP /end SUB_GROUP /begin FUNCTION_LIST /end FUNCTION_LIST /begin REF_CHARACTERISTIC /end REF_CHARACTERISTIC /begin REF_MEASUREMENT CDD_RamMem.dRamMemFrRamSngBitEccErrAdr /end REF_MEASUREMENT /end GROUP
/begin GROUP CDD_RamMem.dRamMemFrRamTmpBufADblBitEccErrAdr "MICROSAR RTE" /begin SUB_GROUP /end SUB_GROUP /begin FUNCTION_LIST /end FUNCTION_LIST /begin REF_CHARACTERISTIC /end REF_CHARACTERISTIC /begin REF_MEASUREMENT CDD_RamMem.dRamMemFrRamTmpBufADblBitEccErrAdr /end REF_MEASUREMENT /end GROUP
/begin GROUP CDD_RamMem.dRamMemFrRamTmpBufBDblBitEccErrAdr "MICROSAR RTE" /begin SUB_GROUP /end SUB_GROUP /begin FUNCTION_LIST /end FUNCTION_LIST /begin REF_CHARACTERISTIC /end REF_CHARACTERISTIC /begin REF_MEASUREMENT CDD_RamMem.dRamMemFrRamTmpBufBDblBitEccErrAdr /end REF_MEASUREMENT /end GROUP
/begin GROUP CDD_RamMem.dRamMemSpi0RamEccErrAdr "MICROSAR RTE" /begin SUB_GROUP /end SUB_GROUP /begin FUNCTION_LIST /end FUNCTION_LIST /begin REF_CHARACTERISTIC /end REF_CHARACTERISTIC /begin REF_MEASUREMENT CDD_RamMem.dRamMemSpi0RamEccErrAdr /end REF_MEASUREMENT /end GROUP
/begin GROUP CDD_RamMem.dRamMemSpi1RamEccErrAdr "MICROSAR RTE" /begin SUB_GROUP /end SUB_GROUP /begin FUNCTION_LIST /end FUNCTION_LIST /begin REF_CHARACTERISTIC /end REF_CHARACTERISTIC /begin REF_MEASUREMENT CDD_RamMem.dRamMemSpi1RamEccErrAdr /end REF_MEASUREMENT /end GROUP
/begin GROUP CDD_RamMem.dRamMemSpi2RamEccErrAdr "MICROSAR RTE" /begin SUB_GROUP /end SUB_GROUP /begin FUNCTION_LIST /end FUNCTION_LIST /begin REF_CHARACTERISTIC /end REF_CHARACTERISTIC /begin REF_MEASUREMENT CDD_RamMem.dRamMemSpi2RamEccErrAdr /end REF_MEASUREMENT /end GROUP
/begin GROUP CDD_RamMem.dRamMemSpi3RamEccErrAdr "MICROSAR RTE" /begin SUB_GROUP /end SUB_GROUP /begin FUNCTION_LIST /end FUNCTION_LIST /begin REF_CHARACTERISTIC /end REF_CHARACTERISTIC /begin REF_MEASUREMENT CDD_RamMem.dRamMemSpi3RamEccErrAdr /end REF_MEASUREMENT /end GROUP
/begin GROUP CDD_RamMem.dRamMemSpiRamEccErrAdr "MICROSAR RTE" /begin SUB_GROUP /end SUB_GROUP /begin FUNCTION_LIST /end FUNCTION_LIST /begin REF_CHARACTERISTIC /end REF_CHARACTERISTIC /begin REF_MEASUREMENT CDD_RamMem.dRamMemSpiRamEccErrAdr /end REF_MEASUREMENT /end GROUP
/begin GROUP CDD_Sci30CfgAndUse "MICROSAR RTE" /begin SUB_GROUP CDD_Sci30CfgAndUse.PerInstanceMemories /end SUB_GROUP /begin FUNCTION_LIST /end FUNCTION_LIST /begin REF_CHARACTERISTIC /end REF_CHARACTERISTIC /begin REF_MEASUREMENT /end REF_MEASUREMENT /end GROUP
/begin GROUP CDD_Sci30CfgAndUse.PerInstanceMemories "MICROSAR RTE"
 /begin SUB_GROUP CDD_Sci30CfgAndUse.Sci100MilliSecBufCnt CDD_Sci30CfgAndUse.Sci100MilliSecReadCmpl CDD_Sci30CfgAndUse.Sci10MilliSecBufCnt CDD_Sci30CfgAndUse.Sci10MilliSecReadCmpl CDD_Sci30CfgAndUse.Sci2MilliSecBufCnt CDD_Sci30CfgAndUse.SciDiagcFrmErrCntr CDD_Sci30CfgAndUse.SciDiagcOvrrunErrCntr CDD_Sci30CfgAndUse.SciDiagcParErrCntr CDD_Sci30CfgAndUse.SciDiagcRxMaxDataErrCntr CDD_Sci30CfgAndUse.SciNrOfPnd100MilliSecFrmCnt CDD_Sci30CfgAndUse.SciNrOfPnd10MilliSecFrmCnt CDD_Sci30CfgAndUse.SciRxPrevLoopDataUnread CDD_Sci30CfgAndUse.SciRxProcIdx /end SUB_GROUP
 /begin FUNCTION_LIST /end FUNCTION_LIST
 /begin REF_CHARACTERISTIC /end REF_CHARACTERISTIC
 /begin REF_MEASUREMENT /end REF_MEASUREMENT
/end GROUP
/begin GROUP CDD_Sci30CfgAndUse.Sci100MilliSecBufCnt "MICROSAR RTE" /begin SUB_GROUP /end SUB_GROUP /begin FUNCTION_LIST /end FUNCTION_LIST /begin REF_CHARACTERISTIC /end REF_CHARACTERISTIC /begin REF_MEASUREMENT CDD_Sci30CfgAndUse.Sci100MilliSecBufCnt /end REF_MEASUREMENT /end GROUP
/begin GROUP CDD_Sci30CfgAndUse.Sci100MilliSecReadCmpl "MICROSAR RTE" /begin SUB_GROUP /end SUB_GROUP /begin FUNCTION_LIST /end FUNCTION_LIST /begin REF_CHARACTERISTIC /end REF_CHARACTERISTIC /begin REF_MEASUREMENT CDD_Sci30CfgAndUse.Sci100MilliSecReadCmpl /end REF_MEASUREMENT /end GROUP
/begin GROUP CDD_Sci30CfgAndUse.Sci10MilliSecBufCnt "MICROSAR RTE" /begin SUB_GROUP /end SUB_GROUP /begin FUNCTION_LIST /end FUNCTION_LIST /begin REF_CHARACTERISTIC /end REF_CHARACTERISTIC /begin REF_MEASUREMENT CDD_Sci30CfgAndUse.Sci10MilliSecBufCnt /end REF_MEASUREMENT /end GROUP
/begin GROUP CDD_Sci30CfgAndUse.Sci10MilliSecReadCmpl "MICROSAR RTE" /begin SUB_GROUP /end SUB_GROUP /begin FUNCTION_LIST /end FUNCTION_LIST /begin REF_CHARACTERISTIC /end REF_CHARACTERISTIC /begin REF_MEASUREMENT CDD_Sci30CfgAndUse.Sci10MilliSecReadCmpl /end REF_MEASUREMENT /end GROUP
/begin GROUP CDD_Sci30CfgAndUse.Sci2MilliSecBufCnt "MICROSAR RTE" /begin SUB_GROUP /end SUB_GROUP /begin FUNCTION_LIST /end FUNCTION_LIST /begin REF_CHARACTERISTIC /end REF_CHARACTERISTIC /begin REF_MEASUREMENT CDD_Sci30CfgAndUse.Sci2MilliSecBufCnt /end REF_MEASUREMENT /end GROUP
/begin GROUP CDD_Sci30CfgAndUse.SciDiagcFrmErrCntr "MICROSAR RTE" /begin SUB_GROUP /end SUB_GROUP /begin FUNCTION_LIST /end FUNCTION_LIST /begin REF_CHARACTERISTIC /end REF_CHARACTERISTIC /begin REF_MEASUREMENT CDD_Sci30CfgAndUse.SciDiagcFrmErrCntr /end REF_MEASUREMENT /end GROUP
/begin GROUP CDD_Sci30CfgAndUse.SciDiagcOvrrunErrCntr "MICROSAR RTE" /begin SUB_GROUP /end SUB_GROUP /begin FUNCTION_LIST /end FUNCTION_LIST /begin REF_CHARACTERISTIC /end REF_CHARACTERISTIC /begin REF_MEASUREMENT CDD_Sci30CfgAndUse.SciDiagcOvrrunErrCntr /end REF_MEASUREMENT /end GROUP
/begin GROUP CDD_Sci30CfgAndUse.SciDiagcParErrCntr "MICROSAR RTE" /begin SUB_GROUP /end SUB_GROUP /begin FUNCTION_LIST /end FUNCTION_LIST /begin REF_CHARACTERISTIC /end REF_CHARACTERISTIC /begin REF_MEASUREMENT CDD_Sci30CfgAndUse.SciDiagcParErrCntr /end REF_MEASUREMENT /end GROUP
/begin GROUP CDD_Sci30CfgAndUse.SciDiagcRxMaxDataErrCntr "MICROSAR RTE" /begin SUB_GROUP /end SUB_GROUP /begin FUNCTION_LIST /end FUNCTION_LIST /begin REF_CHARACTERISTIC /end REF_CHARACTERISTIC /begin REF_MEASUREMENT CDD_Sci30CfgAndUse.SciDiagcRxMaxDataErrCntr /end REF_MEASUREMENT /end GROUP
/begin GROUP CDD_Sci30CfgAndUse.SciNrOfPnd100MilliSecFrmCnt "MICROSAR RTE" /begin SUB_GROUP /end SUB_GROUP /begin FUNCTION_LIST /end FUNCTION_LIST /begin REF_CHARACTERISTIC /end REF_CHARACTERISTIC /begin REF_MEASUREMENT CDD_Sci30CfgAndUse.SciNrOfPnd100MilliSecFrmCnt /end REF_MEASUREMENT /end GROUP
/begin GROUP CDD_Sci30CfgAndUse.SciNrOfPnd10MilliSecFrmCnt "MICROSAR RTE" /begin SUB_GROUP /end SUB_GROUP /begin FUNCTION_LIST /end FUNCTION_LIST /begin REF_CHARACTERISTIC /end REF_CHARACTERISTIC /begin REF_MEASUREMENT CDD_Sci30CfgAndUse.SciNrOfPnd10MilliSecFrmCnt /end REF_MEASUREMENT /end GROUP
/begin GROUP CDD_Sci30CfgAndUse.SciRxPrevLoopDataUnread "MICROSAR RTE" /begin SUB_GROUP /end SUB_GROUP /begin FUNCTION_LIST /end FUNCTION_LIST /begin REF_CHARACTERISTIC /end REF_CHARACTERISTIC /begin REF_MEASUREMENT CDD_Sci30CfgAndUse.SciRxPrevLoopDataUnread /end REF_MEASUREMENT /end GROUP
/begin GROUP CDD_Sci30CfgAndUse.SciRxProcIdx "MICROSAR RTE" /begin SUB_GROUP /end SUB_GROUP /begin FUNCTION_LIST /end FUNCTION_LIST /begin REF_CHARACTERISTIC /end REF_CHARACTERISTIC /begin REF_MEASUREMENT CDD_Sci30CfgAndUse.SciRxProcIdx /end REF_MEASUREMENT /end GROUP
/begin GROUP CDD_SinVltgGenn "MICROSAR RTE"
 /begin SUB_GROUP CDD_SinVltgGenn.CalibrationPorts CDD_SinVltgGenn.PerInstanceMemories CDD_SinVltgGenn.ReceiverPorts /end SUB_GROUP
 /begin FUNCTION_LIST /end FUNCTION_LIST
 /begin REF_CHARACTERISTIC /end REF_CHARACTERISTIC
 /begin REF_MEASUREMENT /end REF_MEASUREMENT
/end GROUP
/begin GROUP CDD_SinVltgGenn.CalibrationPorts "MICROSAR RTE" /begin SUB_GROUP CDD_SinVltgGenn.SinVltgGennDthrLpFilCoeff.Val /end SUB_GROUP /begin FUNCTION_LIST /end FUNCTION_LIST /begin REF_CHARACTERISTIC /end REF_CHARACTERISTIC /begin REF_MEASUREMENT /end REF_MEASUREMENT /end GROUP
/begin GROUP CDD_SinVltgGenn.Fil1OutpPrev "MICROSAR RTE" /begin SUB_GROUP /end SUB_GROUP /begin FUNCTION_LIST /end FUNCTION_LIST /begin REF_CHARACTERISTIC /end REF_CHARACTERISTIC /begin REF_MEASUREMENT CDD_SinVltgGenn.Fil1OutpPrev /end REF_MEASUREMENT /end GROUP
/begin GROUP CDD_SinVltgGenn.Fil2OutpPrev "MICROSAR RTE" /begin SUB_GROUP /end SUB_GROUP /begin FUNCTION_LIST /end FUNCTION_LIST /begin REF_CHARACTERISTIC /end REF_CHARACTERISTIC /begin REF_MEASUREMENT CDD_SinVltgGenn.Fil2OutpPrev /end REF_MEASUREMENT /end GROUP
/begin GROUP CDD_SinVltgGenn.MotElecMeclPolarity.Val "MICROSAR RTE" /begin SUB_GROUP /end SUB_GROUP /begin FUNCTION_LIST /end FUNCTION_LIST /begin REF_CHARACTERISTIC /end REF_CHARACTERISTIC /begin REF_MEASUREMENT CDD_SinVltgGenn.MotElecMeclPolarity.Val /end REF_MEASUREMENT /end GROUP
/begin GROUP CDD_SinVltgGenn.PerInstanceMemories "MICROSAR RTE"
 /begin SUB_GROUP CDD_SinVltgGenn.Fil1OutpPrev CDD_SinVltgGenn.Fil2OutpPrev CDD_SinVltgGenn.PhaDptOffsA CDD_SinVltgGenn.PhaDptOffsB CDD_SinVltgGenn.PhaDptOffsC CDD_SinVltgGenn.PhaOnTiSumAPrev CDD_SinVltgGenn.PhaOnTiSumBPrev CDD_SinVltgGenn.PhaOnTiSumCPrev CDD_SinVltgGenn.PwmPerdRng CDD_SinVltgGenn.RndNrPrev /end SUB_GROUP
 /begin FUNCTION_LIST /end FUNCTION_LIST
 /begin REF_CHARACTERISTIC /end REF_CHARACTERISTIC
 /begin REF_MEASUREMENT /end REF_MEASUREMENT
/end GROUP
/begin GROUP CDD_SinVltgGenn.PhaDptOffsA "MICROSAR RTE" /begin SUB_GROUP /end SUB_GROUP /begin FUNCTION_LIST /end FUNCTION_LIST /begin REF_CHARACTERISTIC /end REF_CHARACTERISTIC /begin REF_MEASUREMENT CDD_SinVltgGenn.PhaDptOffsA /end REF_MEASUREMENT /end GROUP
/begin GROUP CDD_SinVltgGenn.PhaDptOffsB "MICROSAR RTE" /begin SUB_GROUP /end SUB_GROUP /begin FUNCTION_LIST /end FUNCTION_LIST /begin REF_CHARACTERISTIC /end REF_CHARACTERISTIC /begin REF_MEASUREMENT CDD_SinVltgGenn.PhaDptOffsB /end REF_MEASUREMENT /end GROUP
/begin GROUP CDD_SinVltgGenn.PhaDptOffsC "MICROSAR RTE" /begin SUB_GROUP /end SUB_GROUP /begin FUNCTION_LIST /end FUNCTION_LIST /begin REF_CHARACTERISTIC /end REF_CHARACTERISTIC /begin REF_MEASUREMENT CDD_SinVltgGenn.PhaDptOffsC /end REF_MEASUREMENT /end GROUP
/begin GROUP CDD_SinVltgGenn.PhaOnTiSumAPrev "MICROSAR RTE" /begin SUB_GROUP /end SUB_GROUP /begin FUNCTION_LIST /end FUNCTION_LIST /begin REF_CHARACTERISTIC /end REF_CHARACTERISTIC /begin REF_MEASUREMENT CDD_SinVltgGenn.PhaOnTiSumAPrev /end REF_MEASUREMENT /end GROUP
/begin GROUP CDD_SinVltgGenn.PhaOnTiSumBPrev "MICROSAR RTE" /begin SUB_GROUP /end SUB_GROUP /begin FUNCTION_LIST /end FUNCTION_LIST /begin REF_CHARACTERISTIC /end REF_CHARACTERISTIC /begin REF_MEASUREMENT CDD_SinVltgGenn.PhaOnTiSumBPrev /end REF_MEASUREMENT /end GROUP
/begin GROUP CDD_SinVltgGenn.PhaOnTiSumCPrev "MICROSAR RTE" /begin SUB_GROUP /end SUB_GROUP /begin FUNCTION_LIST /end FUNCTION_LIST /begin REF_CHARACTERISTIC /end REF_CHARACTERISTIC /begin REF_MEASUREMENT CDD_SinVltgGenn.PhaOnTiSumCPrev /end REF_MEASUREMENT /end GROUP
/begin GROUP CDD_SinVltgGenn.PwmPerdRng "MICROSAR RTE" /begin SUB_GROUP /end SUB_GROUP /begin FUNCTION_LIST /end FUNCTION_LIST /begin REF_CHARACTERISTIC /end REF_CHARACTERISTIC /begin REF_MEASUREMENT CDD_SinVltgGenn.PwmPerdRng /end REF_MEASUREMENT /end GROUP
/begin GROUP CDD_SinVltgGenn.ReceiverPorts "MICROSAR RTE" /begin SUB_GROUP CDD_SinVltgGenn.MotElecMeclPolarity.Val /end SUB_GROUP /begin FUNCTION_LIST /end FUNCTION_LIST /begin REF_CHARACTERISTIC /end REF_CHARACTERISTIC /begin REF_MEASUREMENT /end REF_MEASUREMENT /end GROUP
/begin GROUP CDD_SinVltgGenn.RndNrPrev "MICROSAR RTE" /begin SUB_GROUP /end SUB_GROUP /begin FUNCTION_LIST /end FUNCTION_LIST /begin REF_CHARACTERISTIC /end REF_CHARACTERISTIC /begin REF_MEASUREMENT CDD_SinVltgGenn.RndNrPrev /end REF_MEASUREMENT /end GROUP
/begin GROUP CDD_SinVltgGenn.SinVltgGennDthrLpFilCoeff.Val "MICROSAR RTE" /begin SUB_GROUP /end SUB_GROUP /begin FUNCTION_LIST /end FUNCTION_LIST /begin REF_CHARACTERISTIC CDD_SinVltgGenn.SinVltgGennDthrLpFilCoeff.Val /end REF_CHARACTERISTIC /begin REF_MEASUREMENT /end REF_MEASUREMENT /end GROUP
/begin GROUP CDD_SnsrMeasStrt "MICROSAR RTE"
 /begin SUB_GROUP CDD_SnsrMeasStrt.CalibrationPorts CDD_SnsrMeasStrt.PerInstanceMemories /end SUB_GROUP
 /begin FUNCTION_LIST /end FUNCTION_LIST
 /begin REF_CHARACTERISTIC /end REF_CHARACTERISTIC
 /begin REF_MEASUREMENT /end REF_MEASUREMENT
/end GROUP
/begin GROUP CDD_SnsrMeasStrt.CalibrationPorts "MICROSAR RTE" /begin SUB_GROUP CDD_SnsrMeasStrt.SnsrMeasStrtTrigDly.Val /end SUB_GROUP /begin FUNCTION_LIST /end FUNCTION_LIST /begin REF_CHARACTERISTIC /end REF_CHARACTERISTIC /begin REF_MEASUREMENT /end REF_MEASUREMENT /end GROUP
/begin GROUP CDD_SnsrMeasStrt.PerInstanceMemories "MICROSAR RTE" /begin SUB_GROUP CDD_SnsrMeasStrt.TqMsgTrigCnt /end SUB_GROUP /begin FUNCTION_LIST /end FUNCTION_LIST /begin REF_CHARACTERISTIC /end REF_CHARACTERISTIC /begin REF_MEASUREMENT /end REF_MEASUREMENT /end GROUP
/begin GROUP CDD_SnsrMeasStrt.SnsrMeasStrtTrigDly.Val "MICROSAR RTE" /begin SUB_GROUP /end SUB_GROUP /begin FUNCTION_LIST /end FUNCTION_LIST /begin REF_CHARACTERISTIC CDD_SnsrMeasStrt.SnsrMeasStrtTrigDly.Val /end REF_CHARACTERISTIC /begin REF_MEASUREMENT /end REF_MEASUREMENT /end GROUP
/begin GROUP CDD_SnsrMeasStrt.TqMsgTrigCnt "MICROSAR RTE" /begin SUB_GROUP /end SUB_GROUP /begin FUNCTION_LIST /end FUNCTION_LIST /begin REF_CHARACTERISTIC /end REF_CHARACTERISTIC /begin REF_MEASUREMENT CDD_SnsrMeasStrt.TqMsgTrigCnt /end REF_MEASUREMENT /end GROUP
/begin GROUP CDD_SyncCrc "MICROSAR RTE" /begin SUB_GROUP CDD_SyncCrc.PerInstanceMemories /end SUB_GROUP /begin FUNCTION_LIST /end FUNCTION_LIST /begin REF_CHARACTERISTIC /end REF_CHARACTERISTIC /begin REF_MEASUREMENT /end REF_MEASUREMENT /end GROUP
/begin GROUP CDD_SyncCrc.CrcHwSts "MICROSAR RTE" /begin SUB_GROUP /end SUB_GROUP /begin FUNCTION_LIST /end FUNCTION_LIST /begin REF_CHARACTERISTIC /end REF_CHARACTERISTIC
 /begin REF_MEASUREMENT CDD_SyncCrc.CrcHwSts[0].CrcHwSts CDD_SyncCrc.CrcHwSts[0].TaskId CDD_SyncCrc.CrcHwSts[1].CrcHwSts CDD_SyncCrc.CrcHwSts[1].TaskId CDD_SyncCrc.CrcHwSts[2].CrcHwSts CDD_SyncCrc.CrcHwSts[2].TaskId CDD_SyncCrc.CrcHwSts[3].CrcHwSts CDD_SyncCrc.CrcHwSts[3].TaskId /end REF_MEASUREMENT
/end GROUP
/begin GROUP CDD_SyncCrc.PerInstanceMemories "MICROSAR RTE" /begin SUB_GROUP CDD_SyncCrc.CrcHwSts /end SUB_GROUP /begin FUNCTION_LIST /end FUNCTION_LIST /begin REF_CHARACTERISTIC /end REF_CHARACTERISTIC /begin REF_MEASUREMENT /end REF_MEASUREMENT /end GROUP
/begin GROUP CDD_TSG31CfgAndUse "MICROSAR RTE"
 /begin SUB_GROUP CDD_TSG31CfgAndUse.CalibrationPorts CDD_TSG31CfgAndUse.PerInstanceMemories CDD_TSG31CfgAndUse.ReceiverPorts /end SUB_GROUP
 /begin FUNCTION_LIST /end FUNCTION_LIST
 /begin REF_CHARACTERISTIC /end REF_CHARACTERISTIC
 /begin REF_MEASUREMENT /end REF_MEASUREMENT
/end GROUP
/begin GROUP CDD_TSG31CfgAndUse.CalibrationPorts "MICROSAR RTE"
 /begin SUB_GROUP CDD_TSG31CfgAndUse.CurrMeasEolFixdPwmPerd.Val CDD_TSG31CfgAndUse.CurrMeasEolOffsHiCmuOffs.Val CDD_TSG31CfgAndUse.CurrMeasEolOffsLoCmuOffs.Val CDD_TSG31CfgAndUse.TSG31CfgAndUseAdcStrtOfCnvn2Offs.Val CDD_TSG31CfgAndUse.TSG31CfgAndUseAdcStrtOfCnvnMotCtrlPeakOffs.Val CDD_TSG31CfgAndUse.TSG31CfgAndUseAdcStrtOfCnvnMotCtrlVlyOffs.Val CDD_TSG31CfgAndUse.TSG31CfgAndUseMtrAg0SPIStart.Val CDD_TSG31CfgAndUse.TSG31CfgAndUsePwmDbnd.Val /end SUB_GROUP
 /begin FUNCTION_LIST /end FUNCTION_LIST
 /begin REF_CHARACTERISTIC /end REF_CHARACTERISTIC
 /begin REF_MEASUREMENT /end REF_MEASUREMENT
/end GROUP
/begin GROUP CDD_TSG31CfgAndUse.CurrMeasEolFixdPwmPerd.Val "MICROSAR RTE" /begin SUB_GROUP /end SUB_GROUP /begin FUNCTION_LIST /end FUNCTION_LIST /begin REF_CHARACTERISTIC CDD_TSG31CfgAndUse.CurrMeasEolFixdPwmPerd.Val /end REF_CHARACTERISTIC /begin REF_MEASUREMENT /end REF_MEASUREMENT /end GROUP
/begin GROUP CDD_TSG31CfgAndUse.CurrMeasEolOffsHiCmuOffs.Val "MICROSAR RTE" /begin SUB_GROUP /end SUB_GROUP /begin FUNCTION_LIST /end FUNCTION_LIST /begin REF_CHARACTERISTIC CDD_TSG31CfgAndUse.CurrMeasEolOffsHiCmuOffs.Val /end REF_CHARACTERISTIC /begin REF_MEASUREMENT /end REF_MEASUREMENT /end GROUP
/begin GROUP CDD_TSG31CfgAndUse.CurrMeasEolOffsLoCmuOffs.Val "MICROSAR RTE" /begin SUB_GROUP /end SUB_GROUP /begin FUNCTION_LIST /end FUNCTION_LIST /begin REF_CHARACTERISTIC CDD_TSG31CfgAndUse.CurrMeasEolOffsLoCmuOffs.Val /end REF_CHARACTERISTIC /begin REF_MEASUREMENT /end REF_MEASUREMENT /end GROUP
/begin GROUP CDD_TSG31CfgAndUse.MotCurrEolCalSt.Val "MICROSAR RTE" /begin SUB_GROUP /end SUB_GROUP /begin FUNCTION_LIST /end FUNCTION_LIST /begin REF_CHARACTERISTIC /end REF_CHARACTERISTIC /begin REF_MEASUREMENT CDD_TSG31CfgAndUse.MotCurrEolCalSt.Val /end REF_MEASUREMENT /end GROUP
/begin GROUP CDD_TSG31CfgAndUse.PerInstanceMemories "MICROSAR RTE"
 /begin SUB_GROUP CDD_TSG31CfgAndUse.TSG31CfgAndUseAdcStrtOfCnvnPeak CDD_TSG31CfgAndUse.TSG31CfgAndUseMotAg0SPIStart CDD_TSG31CfgAndUse.TSG31CfgAndUseSysStEnaPrev /end SUB_GROUP
 /begin FUNCTION_LIST /end FUNCTION_LIST
 /begin REF_CHARACTERISTIC /end REF_CHARACTERISTIC
 /begin REF_MEASUREMENT /end REF_MEASUREMENT
/end GROUP
/begin GROUP CDD_TSG31CfgAndUse.ReceiverPorts "MICROSAR RTE"
 /begin SUB_GROUP CDD_TSG31CfgAndUse.MotCurrEolCalSt.Val CDD_TSG31CfgAndUse.SysSt.Val /end SUB_GROUP
 /begin FUNCTION_LIST /end FUNCTION_LIST
 /begin REF_CHARACTERISTIC /end REF_CHARACTERISTIC
 /begin REF_MEASUREMENT /end REF_MEASUREMENT
/end GROUP
/begin GROUP CDD_TSG31CfgAndUse.SysSt.Val "MICROSAR RTE" /begin SUB_GROUP /end SUB_GROUP /begin FUNCTION_LIST /end FUNCTION_LIST /begin REF_CHARACTERISTIC /end REF_CHARACTERISTIC /begin REF_MEASUREMENT CDD_TSG31CfgAndUse.SysSt.Val /end REF_MEASUREMENT /end GROUP
/begin GROUP CDD_TSG31CfgAndUse.TSG31CfgAndUseAdcStrtOfCnvn2Offs.Val "MICROSAR RTE" /begin SUB_GROUP /end SUB_GROUP /begin FUNCTION_LIST /end FUNCTION_LIST /begin REF_CHARACTERISTIC CDD_TSG31CfgAndUse.TSG31CfgAndUseAdcStrtOfCnvn2Offs.Val /end REF_CHARACTERISTIC /begin REF_MEASUREMENT /end REF_MEASUREMENT /end GROUP
/begin GROUP CDD_TSG31CfgAndUse.TSG31CfgAndUseAdcStrtOfCnvnMotCtrlPeakOffs.Val "MICROSAR RTE" /begin SUB_GROUP /end SUB_GROUP /begin FUNCTION_LIST /end FUNCTION_LIST
 /begin REF_CHARACTERISTIC CDD_TSG31CfgAndUse.TSG31CfgAndUseAdcStrtOfCnvnMotCtrlPeakOffs.Val /end REF_CHARACTERISTIC
 /begin REF_MEASUREMENT /end REF_MEASUREMENT
/end GROUP
/begin GROUP CDD_TSG31CfgAndUse.TSG31CfgAndUseAdcStrtOfCnvnMotCtrlVlyOffs.Val "MICROSAR RTE" /begin SUB_GROUP /end SUB_GROUP /begin FUNCTION_LIST /end FUNCTION_LIST
 /begin REF_CHARACTERISTIC CDD_TSG31CfgAndUse.TSG31CfgAndUseAdcStrtOfCnvnMotCtrlVlyOffs.Val /end REF_CHARACTERISTIC
 /begin REF_MEASUREMENT /end REF_MEASUREMENT
/end GROUP
/begin GROUP CDD_TSG31CfgAndUse.TSG31CfgAndUseAdcStrtOfCnvnPeak "MICROSAR RTE" /begin SUB_GROUP /end SUB_GROUP /begin FUNCTION_LIST /end FUNCTION_LIST /begin REF_CHARACTERISTIC /end REF_CHARACTERISTIC /begin REF_MEASUREMENT CDD_TSG31CfgAndUse.TSG31CfgAndUseAdcStrtOfCnvnPeak /end REF_MEASUREMENT /end GROUP
/begin GROUP CDD_TSG31CfgAndUse.TSG31CfgAndUseMotAg0SPIStart "MICROSAR RTE" /begin SUB_GROUP /end SUB_GROUP /begin FUNCTION_LIST /end FUNCTION_LIST /begin REF_CHARACTERISTIC /end REF_CHARACTERISTIC /begin REF_MEASUREMENT CDD_TSG31CfgAndUse.TSG31CfgAndUseMotAg0SPIStart /end REF_MEASUREMENT /end GROUP
/begin GROUP CDD_TSG31CfgAndUse.TSG31CfgAndUseMtrAg0SPIStart.Val "MICROSAR RTE" /begin SUB_GROUP /end SUB_GROUP /begin FUNCTION_LIST /end FUNCTION_LIST /begin REF_CHARACTERISTIC CDD_TSG31CfgAndUse.TSG31CfgAndUseMtrAg0SPIStart.Val /end REF_CHARACTERISTIC /begin REF_MEASUREMENT /end REF_MEASUREMENT /end GROUP
/begin GROUP CDD_TSG31CfgAndUse.TSG31CfgAndUsePwmDbnd.Val "MICROSAR RTE" /begin SUB_GROUP /end SUB_GROUP /begin FUNCTION_LIST /end FUNCTION_LIST /begin REF_CHARACTERISTIC CDD_TSG31CfgAndUse.TSG31CfgAndUsePwmDbnd.Val /end REF_CHARACTERISTIC /begin REF_MEASUREMENT /end REF_MEASUREMENT /end GROUP
/begin GROUP CDD_TSG31CfgAndUse.TSG31CfgAndUseSysStEnaPrev "MICROSAR RTE" /begin SUB_GROUP /end SUB_GROUP /begin FUNCTION_LIST /end FUNCTION_LIST /begin REF_CHARACTERISTIC /end REF_CHARACTERISTIC /begin REF_MEASUREMENT CDD_TSG31CfgAndUse.TSG31CfgAndUseSysStEnaPrev /end REF_MEASUREMENT /end GROUP
/begin GROUP CDD_Tauj0CfgAndUse "MICROSAR RTE"
 /begin SUB_GROUP CDD_Tauj0CfgAndUse.PerInstanceMemories CDD_Tauj0CfgAndUse.SenderPorts /end SUB_GROUP
 /begin FUNCTION_LIST /end FUNCTION_LIST
 /begin REF_CHARACTERISTIC /end REF_CHARACTERISTIC
 /begin REF_MEASUREMENT /end REF_MEASUREMENT
/end GROUP
/begin GROUP CDD_Tauj0CfgAndUse.PerInstanceMemories "MICROSAR RTE"
 /begin SUB_GROUP CDD_Tauj0CfgAndUse.PhaOnTiCntrAPrev CDD_Tauj0CfgAndUse.PhaOnTiCntrBPrev CDD_Tauj0CfgAndUse.PhaOnTiCntrCPrev /end SUB_GROUP
 /begin FUNCTION_LIST /end FUNCTION_LIST
 /begin REF_CHARACTERISTIC /end REF_CHARACTERISTIC
 /begin REF_MEASUREMENT /end REF_MEASUREMENT
/end GROUP
/begin GROUP CDD_Tauj0CfgAndUse.PhaOnTiCntrAPrev "MICROSAR RTE" /begin SUB_GROUP /end SUB_GROUP /begin FUNCTION_LIST /end FUNCTION_LIST /begin REF_CHARACTERISTIC /end REF_CHARACTERISTIC /begin REF_MEASUREMENT CDD_Tauj0CfgAndUse.PhaOnTiCntrAPrev /end REF_MEASUREMENT /end GROUP
/begin GROUP CDD_Tauj0CfgAndUse.PhaOnTiCntrBPrev "MICROSAR RTE" /begin SUB_GROUP /end SUB_GROUP /begin FUNCTION_LIST /end FUNCTION_LIST /begin REF_CHARACTERISTIC /end REF_CHARACTERISTIC /begin REF_MEASUREMENT CDD_Tauj0CfgAndUse.PhaOnTiCntrBPrev /end REF_MEASUREMENT /end GROUP
/begin GROUP CDD_Tauj0CfgAndUse.PhaOnTiCntrCPrev "MICROSAR RTE" /begin SUB_GROUP /end SUB_GROUP /begin FUNCTION_LIST /end FUNCTION_LIST /begin REF_CHARACTERISTIC /end REF_CHARACTERISTIC /begin REF_MEASUREMENT CDD_Tauj0CfgAndUse.PhaOnTiCntrCPrev /end REF_MEASUREMENT /end GROUP
/begin GROUP CDD_Tauj0CfgAndUse.PhaOnTiMeasdA.Val "MICROSAR RTE" /begin SUB_GROUP /end SUB_GROUP /begin FUNCTION_LIST /end FUNCTION_LIST /begin REF_CHARACTERISTIC /end REF_CHARACTERISTIC /begin REF_MEASUREMENT CDD_Tauj0CfgAndUse.PhaOnTiMeasdA.Val /end REF_MEASUREMENT /end GROUP
/begin GROUP CDD_Tauj0CfgAndUse.PhaOnTiMeasdB.Val "MICROSAR RTE" /begin SUB_GROUP /end SUB_GROUP /begin FUNCTION_LIST /end FUNCTION_LIST /begin REF_CHARACTERISTIC /end REF_CHARACTERISTIC /begin REF_MEASUREMENT CDD_Tauj0CfgAndUse.PhaOnTiMeasdB.Val /end REF_MEASUREMENT /end GROUP
/begin GROUP CDD_Tauj0CfgAndUse.PhaOnTiMeasdC.Val "MICROSAR RTE" /begin SUB_GROUP /end SUB_GROUP /begin FUNCTION_LIST /end FUNCTION_LIST /begin REF_CHARACTERISTIC /end REF_CHARACTERISTIC /begin REF_MEASUREMENT CDD_Tauj0CfgAndUse.PhaOnTiMeasdC.Val /end REF_MEASUREMENT /end GROUP
/begin GROUP CDD_Tauj0CfgAndUse.SenderPorts "MICROSAR RTE"
 /begin SUB_GROUP CDD_Tauj0CfgAndUse.PhaOnTiMeasdA.Val CDD_Tauj0CfgAndUse.PhaOnTiMeasdB.Val CDD_Tauj0CfgAndUse.PhaOnTiMeasdC.Val /end SUB_GROUP
 /begin FUNCTION_LIST /end FUNCTION_LIST
 /begin REF_CHARACTERISTIC /end REF_CHARACTERISTIC
 /begin REF_MEASUREMENT /end REF_MEASUREMENT
/end GROUP
/begin GROUP CDD_Tauj1CfgAndUse "MICROSAR RTE"
 /begin SUB_GROUP CDD_Tauj1CfgAndUse.PerInstanceMemories CDD_Tauj1CfgAndUse.SenderPorts /end SUB_GROUP
 /begin FUNCTION_LIST /end FUNCTION_LIST
 /begin REF_CHARACTERISTIC /end REF_CHARACTERISTIC
 /begin REF_MEASUREMENT /end REF_MEASUREMENT
/end GROUP
/begin GROUP CDD_Tauj1CfgAndUse.PerInstanceMemories "MICROSAR RTE"
 /begin SUB_GROUP CDD_Tauj1CfgAndUse.PhaOnTiCntrDPrev CDD_Tauj1CfgAndUse.PhaOnTiCntrEPrev CDD_Tauj1CfgAndUse.PhaOnTiCntrFPrev /end SUB_GROUP
 /begin FUNCTION_LIST /end FUNCTION_LIST
 /begin REF_CHARACTERISTIC /end REF_CHARACTERISTIC
 /begin REF_MEASUREMENT /end REF_MEASUREMENT
/end GROUP
/begin GROUP CDD_Tauj1CfgAndUse.PhaOnTiCntrDPrev "MICROSAR RTE" /begin SUB_GROUP /end SUB_GROUP /begin FUNCTION_LIST /end FUNCTION_LIST /begin REF_CHARACTERISTIC /end REF_CHARACTERISTIC /begin REF_MEASUREMENT CDD_Tauj1CfgAndUse.PhaOnTiCntrDPrev /end REF_MEASUREMENT /end GROUP
/begin GROUP CDD_Tauj1CfgAndUse.PhaOnTiCntrEPrev "MICROSAR RTE" /begin SUB_GROUP /end SUB_GROUP /begin FUNCTION_LIST /end FUNCTION_LIST /begin REF_CHARACTERISTIC /end REF_CHARACTERISTIC /begin REF_MEASUREMENT CDD_Tauj1CfgAndUse.PhaOnTiCntrEPrev /end REF_MEASUREMENT /end GROUP
/begin GROUP CDD_Tauj1CfgAndUse.PhaOnTiCntrFPrev "MICROSAR RTE" /begin SUB_GROUP /end SUB_GROUP /begin FUNCTION_LIST /end FUNCTION_LIST /begin REF_CHARACTERISTIC /end REF_CHARACTERISTIC /begin REF_MEASUREMENT CDD_Tauj1CfgAndUse.PhaOnTiCntrFPrev /end REF_MEASUREMENT /end GROUP
/begin GROUP CDD_Tauj1CfgAndUse.PhaOnTiMeasdD.Val "MICROSAR RTE" /begin SUB_GROUP /end SUB_GROUP /begin FUNCTION_LIST /end FUNCTION_LIST /begin REF_CHARACTERISTIC /end REF_CHARACTERISTIC /begin REF_MEASUREMENT CDD_Tauj1CfgAndUse.PhaOnTiMeasdD.Val /end REF_MEASUREMENT /end GROUP
/begin GROUP CDD_Tauj1CfgAndUse.PhaOnTiMeasdE.Val "MICROSAR RTE" /begin SUB_GROUP /end SUB_GROUP /begin FUNCTION_LIST /end FUNCTION_LIST /begin REF_CHARACTERISTIC /end REF_CHARACTERISTIC /begin REF_MEASUREMENT CDD_Tauj1CfgAndUse.PhaOnTiMeasdE.Val /end REF_MEASUREMENT /end GROUP
/begin GROUP CDD_Tauj1CfgAndUse.PhaOnTiMeasdF.Val "MICROSAR RTE" /begin SUB_GROUP /end SUB_GROUP /begin FUNCTION_LIST /end FUNCTION_LIST /begin REF_CHARACTERISTIC /end REF_CHARACTERISTIC /begin REF_MEASUREMENT CDD_Tauj1CfgAndUse.PhaOnTiMeasdF.Val /end REF_MEASUREMENT /end GROUP
/begin GROUP CDD_Tauj1CfgAndUse.SenderPorts "MICROSAR RTE"
 /begin SUB_GROUP CDD_Tauj1CfgAndUse.PhaOnTiMeasdD.Val CDD_Tauj1CfgAndUse.PhaOnTiMeasdE.Val CDD_Tauj1CfgAndUse.PhaOnTiMeasdF.Val /end SUB_GROUP
 /begin FUNCTION_LIST /end FUNCTION_LIST
 /begin REF_CHARACTERISTIC /end REF_CHARACTERISTIC
 /begin REF_MEASUREMENT /end REF_MEASUREMENT
/end GROUP
/begin GROUP CDD_VrfyCritReg "MICROSAR RTE" /begin SUB_GROUP CDD_VrfyCritReg.PerInstanceMemories /end SUB_GROUP /begin FUNCTION_LIST /end FUNCTION_LIST /begin REF_CHARACTERISTIC /end REF_CHARACTERISTIC /begin REF_MEASUREMENT /end REF_MEASUREMENT /end GROUP
/begin GROUP CDD_VrfyCritReg.PerInstanceMemories "MICROSAR RTE"
 /begin SUB_GROUP CDD_VrfyCritReg.dVrfyCritRegCritRegActVal CDD_VrfyCritReg.dVrfyCritRegCritRegAdr CDD_VrfyCritReg.dVrfyCritRegCritRegDesVal CDD_VrfyCritReg.dVrfyCritRegSysCritRegActVal CDD_VrfyCritReg.dVrfyCritRegSysCritRegAdr CDD_VrfyCritReg.dVrfyCritRegSysCritRegDesVal /end SUB_GROUP
 /begin FUNCTION_LIST /end FUNCTION_LIST
 /begin REF_CHARACTERISTIC /end REF_CHARACTERISTIC
 /begin REF_MEASUREMENT /end REF_MEASUREMENT
/end GROUP
/begin GROUP CDD_VrfyCritReg.dVrfyCritRegCritRegActVal "MICROSAR RTE" /begin SUB_GROUP /end SUB_GROUP /begin FUNCTION_LIST /end FUNCTION_LIST /begin REF_CHARACTERISTIC /end REF_CHARACTERISTIC /begin REF_MEASUREMENT CDD_VrfyCritReg.dVrfyCritRegCritRegActVal /end REF_MEASUREMENT /end GROUP
/begin GROUP CDD_VrfyCritReg.dVrfyCritRegCritRegAdr "MICROSAR RTE" /begin SUB_GROUP /end SUB_GROUP /begin FUNCTION_LIST /end FUNCTION_LIST /begin REF_CHARACTERISTIC /end REF_CHARACTERISTIC /begin REF_MEASUREMENT CDD_VrfyCritReg.dVrfyCritRegCritRegAdr /end REF_MEASUREMENT /end GROUP
/begin GROUP CDD_VrfyCritReg.dVrfyCritRegCritRegDesVal "MICROSAR RTE" /begin SUB_GROUP /end SUB_GROUP /begin FUNCTION_LIST /end FUNCTION_LIST /begin REF_CHARACTERISTIC /end REF_CHARACTERISTIC /begin REF_MEASUREMENT CDD_VrfyCritReg.dVrfyCritRegCritRegDesVal /end REF_MEASUREMENT /end GROUP
/begin GROUP CDD_VrfyCritReg.dVrfyCritRegSysCritRegActVal "MICROSAR RTE" /begin SUB_GROUP /end SUB_GROUP /begin FUNCTION_LIST /end FUNCTION_LIST /begin REF_CHARACTERISTIC /end REF_CHARACTERISTIC /begin REF_MEASUREMENT CDD_VrfyCritReg.dVrfyCritRegSysCritRegActVal /end REF_MEASUREMENT /end GROUP
/begin GROUP CDD_VrfyCritReg.dVrfyCritRegSysCritRegAdr "MICROSAR RTE" /begin SUB_GROUP /end SUB_GROUP /begin FUNCTION_LIST /end FUNCTION_LIST /begin REF_CHARACTERISTIC /end REF_CHARACTERISTIC /begin REF_MEASUREMENT CDD_VrfyCritReg.dVrfyCritRegSysCritRegAdr /end REF_MEASUREMENT /end GROUP
/begin GROUP CDD_VrfyCritReg.dVrfyCritRegSysCritRegDesVal "MICROSAR RTE" /begin SUB_GROUP /end SUB_GROUP /begin FUNCTION_LIST /end FUNCTION_LIST /begin REF_CHARACTERISTIC /end REF_CHARACTERISTIC /begin REF_MEASUREMENT CDD_VrfyCritReg.dVrfyCritRegSysCritRegDesVal /end REF_MEASUREMENT /end GROUP
/begin GROUP CDD_XcpIf "MICROSAR RTE" /begin SUB_GROUP CDD_XcpIf.ReceiverPorts /end SUB_GROUP /begin FUNCTION_LIST /end FUNCTION_LIST /begin REF_CHARACTERISTIC /end REF_CHARACTERISTIC /begin REF_MEASUREMENT /end REF_MEASUREMENT /end GROUP
/begin GROUP CDD_XcpIf.ActvIninIdx.Val "MICROSAR RTE" /begin SUB_GROUP /end SUB_GROUP /begin FUNCTION_LIST /end FUNCTION_LIST /begin REF_CHARACTERISTIC /end REF_CHARACTERISTIC /begin REF_MEASUREMENT CDD_XcpIf.ActvIninIdx.Val /end REF_MEASUREMENT /end GROUP
/begin GROUP CDD_XcpIf.ActvRtIdx.Val "MICROSAR RTE" /begin SUB_GROUP /end SUB_GROUP /begin FUNCTION_LIST /end FUNCTION_LIST /begin REF_CHARACTERISTIC /end REF_CHARACTERISTIC /begin REF_MEASUREMENT CDD_XcpIf.ActvRtIdx.Val /end REF_MEASUREMENT /end GROUP
/begin GROUP CDD_XcpIf.ReceiverPorts "MICROSAR RTE" /begin SUB_GROUP CDD_XcpIf.ActvIninIdx.Val CDD_XcpIf.ActvRtIdx.Val /end SUB_GROUP /begin FUNCTION_LIST /end FUNCTION_LIST /begin REF_CHARACTERISTIC /end REF_CHARACTERISTIC /begin REF_MEASUREMENT /end REF_MEASUREMENT /end GROUP
/begin GROUP CalRegn01Cmn "MICROSAR RTE" /begin SUB_GROUP CalRegn01Cmn.CalibrationPorts /end SUB_GROUP /begin FUNCTION_LIST /end FUNCTION_LIST /begin REF_CHARACTERISTIC /end REF_CHARACTERISTIC /begin REF_MEASUREMENT /end REF_MEASUREMENT /end GROUP
/begin GROUP CalRegn01Cmn.AdcDiagcNtc0x032FailStep.Val "MICROSAR RTE" /begin SUB_GROUP /end SUB_GROUP /begin FUNCTION_LIST /end FUNCTION_LIST /begin REF_CHARACTERISTIC CalRegn01Cmn.AdcDiagcNtc0x032FailStep.Val /end REF_CHARACTERISTIC /begin REF_MEASUREMENT /end REF_MEASUREMENT /end GROUP
/begin GROUP CalRegn01Cmn.AdcDiagcNtc0x032PassStep.Val "MICROSAR RTE" /begin SUB_GROUP /end SUB_GROUP /begin FUNCTION_LIST /end FUNCTION_LIST /begin REF_CHARACTERISTIC CalRegn01Cmn.AdcDiagcNtc0x032PassStep.Val /end REF_CHARACTERISTIC /begin REF_MEASUREMENT /end REF_MEASUREMENT /end GROUP
/begin GROUP CalRegn01Cmn.AdcDiagcNtc0x033FailStep.Val "MICROSAR RTE" /begin SUB_GROUP /end SUB_GROUP /begin FUNCTION_LIST /end FUNCTION_LIST /begin REF_CHARACTERISTIC CalRegn01Cmn.AdcDiagcNtc0x033FailStep.Val /end REF_CHARACTERISTIC /begin REF_MEASUREMENT /end REF_MEASUREMENT /end GROUP
/begin GROUP CalRegn01Cmn.AdcDiagcNtc0x033PassStep.Val "MICROSAR RTE" /begin SUB_GROUP /end SUB_GROUP /begin FUNCTION_LIST /end FUNCTION_LIST /begin REF_CHARACTERISTIC CalRegn01Cmn.AdcDiagcNtc0x033PassStep.Val /end REF_CHARACTERISTIC /begin REF_MEASUREMENT /end REF_MEASUREMENT /end GROUP
/begin GROUP CalRegn01Cmn.AssiPahFwlDiRcvr.Logl "MICROSAR RTE" /begin SUB_GROUP /end SUB_GROUP /begin FUNCTION_LIST /end FUNCTION_LIST /begin REF_CHARACTERISTIC CalRegn01Cmn.AssiPahFwlDiRcvr.Logl /end REF_CHARACTERISTIC /begin REF_MEASUREMENT /end REF_MEASUREMENT /end GROUP
/begin GROUP CalRegn01Cmn.AssiPahFwlVehSpd.Ary1D "MICROSAR RTE" /begin SUB_GROUP /end SUB_GROUP /begin FUNCTION_LIST /end FUNCTION_LIST /begin REF_CHARACTERISTIC CalRegn01Cmn.AssiPahFwlVehSpd.Ary1D /end REF_CHARACTERISTIC /begin REF_MEASUREMENT /end REF_MEASUREMENT /end GROUP
/begin GROUP CalRegn01Cmn.AssiSumLimNtc0x0C4FailStep.Val "MICROSAR RTE" /begin SUB_GROUP /end SUB_GROUP /begin FUNCTION_LIST /end FUNCTION_LIST /begin REF_CHARACTERISTIC CalRegn01Cmn.AssiSumLimNtc0x0C4FailStep.Val /end REF_CHARACTERISTIC /begin REF_MEASUREMENT /end REF_MEASUREMENT /end GROUP
/begin GROUP CalRegn01Cmn.AssiSumLimNtc0x0C4PassStep.Val "MICROSAR RTE" /begin SUB_GROUP /end SUB_GROUP /begin FUNCTION_LIST /end FUNCTION_LIST /begin REF_CHARACTERISTIC CalRegn01Cmn.AssiSumLimNtc0x0C4PassStep.Val /end REF_CHARACTERISTIC /begin REF_MEASUREMENT /end REF_MEASUREMENT /end GROUP
/begin GROUP CalRegn01Cmn.AssiSumLimPullCmpLim.Val "MICROSAR RTE" /begin SUB_GROUP /end SUB_GROUP /begin FUNCTION_LIST /end FUNCTION_LIST /begin REF_CHARACTERISTIC CalRegn01Cmn.AssiSumLimPullCmpLim.Val /end REF_CHARACTERISTIC /begin REF_MEASUREMENT /end REF_MEASUREMENT /end GROUP
/begin GROUP CalRegn01Cmn.BasAssiPahFwlOverLimDiagcFailStep.Val "MICROSAR RTE" /begin SUB_GROUP /end SUB_GROUP /begin FUNCTION_LIST /end FUNCTION_LIST /begin REF_CHARACTERISTIC CalRegn01Cmn.BasAssiPahFwlOverLimDiagcFailStep.Val /end REF_CHARACTERISTIC /begin REF_MEASUREMENT /end REF_MEASUREMENT /end GROUP
/begin GROUP CalRegn01Cmn.BasAssiPahFwlOverLimDiagcPassStep.Val "MICROSAR RTE" /begin SUB_GROUP /end SUB_GROUP /begin FUNCTION_LIST /end FUNCTION_LIST /begin REF_CHARACTERISTIC CalRegn01Cmn.BasAssiPahFwlOverLimDiagcPassStep.Val /end REF_CHARACTERISTIC /begin REF_MEASUREMENT /end REF_MEASUREMENT /end GROUP
/begin GROUP CalRegn01Cmn.BattVltgCorrlnAllwdVltgDif.Val "MICROSAR RTE" /begin SUB_GROUP /end SUB_GROUP /begin FUNCTION_LIST /end FUNCTION_LIST /begin REF_CHARACTERISTIC CalRegn01Cmn.BattVltgCorrlnAllwdVltgDif.Val /end REF_CHARACTERISTIC /begin REF_MEASUREMENT /end REF_MEASUREMENT /end GROUP
/begin GROUP CalRegn01Cmn.BattVltgCorrlnBattLoVltg.Val "MICROSAR RTE" /begin SUB_GROUP /end SUB_GROUP /begin FUNCTION_LIST /end FUNCTION_LIST /begin REF_CHARACTERISTIC CalRegn01Cmn.BattVltgCorrlnBattLoVltg.Val /end REF_CHARACTERISTIC /begin REF_MEASUREMENT /end REF_MEASUREMENT /end GROUP
/begin GROUP CalRegn01Cmn.BattVltgCorrlnBattOverVltg.Val "MICROSAR RTE" /begin SUB_GROUP /end SUB_GROUP /begin FUNCTION_LIST /end FUNCTION_LIST /begin REF_CHARACTERISTIC CalRegn01Cmn.BattVltgCorrlnBattOverVltg.Val /end REF_CHARACTERISTIC /begin REF_MEASUREMENT /end REF_MEASUREMENT /end GROUP
/begin GROUP CalRegn01Cmn.BattVltgCorrlnBattUnderVltg.Val "MICROSAR RTE" /begin SUB_GROUP /end SUB_GROUP /begin FUNCTION_LIST /end FUNCTION_LIST /begin REF_CHARACTERISTIC CalRegn01Cmn.BattVltgCorrlnBattUnderVltg.Val /end REF_CHARACTERISTIC /begin REF_MEASUREMENT /end REF_MEASUREMENT /end GROUP
/begin GROUP CalRegn01Cmn.BattVltgCorrlnNtc0x03C0x0440x04CFailStep.Val "MICROSAR RTE" /begin SUB_GROUP /end SUB_GROUP /begin FUNCTION_LIST /end FUNCTION_LIST /begin REF_CHARACTERISTIC CalRegn01Cmn.BattVltgCorrlnNtc0x03C0x0440x04CFailStep.Val /end REF_CHARACTERISTIC /begin REF_MEASUREMENT /end REF_MEASUREMENT /end GROUP
/begin GROUP CalRegn01Cmn.BattVltgCorrlnNtc0x03C0x0440x04CPassStep.Val "MICROSAR RTE" /begin SUB_GROUP /end SUB_GROUP /begin FUNCTION_LIST /end FUNCTION_LIST /begin REF_CHARACTERISTIC CalRegn01Cmn.BattVltgCorrlnNtc0x03C0x0440x04CPassStep.Val /end REF_CHARACTERISTIC /begin REF_MEASUREMENT /end REF_MEASUREMENT /end GROUP
/begin GROUP CalRegn01Cmn.BattVltgCorrlnNtc0x03DFailStep.Val "MICROSAR RTE" /begin SUB_GROUP /end SUB_GROUP /begin FUNCTION_LIST /end FUNCTION_LIST /begin REF_CHARACTERISTIC CalRegn01Cmn.BattVltgCorrlnNtc0x03DFailStep.Val /end REF_CHARACTERISTIC /begin REF_MEASUREMENT /end REF_MEASUREMENT /end GROUP
/begin GROUP CalRegn01Cmn.BattVltgCorrlnNtc0x03DPassStep.Val "MICROSAR RTE" /begin SUB_GROUP /end SUB_GROUP /begin FUNCTION_LIST /end FUNCTION_LIST /begin REF_CHARACTERISTIC CalRegn01Cmn.BattVltgCorrlnNtc0x03DPassStep.Val /end REF_CHARACTERISTIC /begin REF_MEASUREMENT /end REF_MEASUREMENT /end GROUP
/begin GROUP CalRegn01Cmn.BattVltgCorrlnNtc0x0B0FailStep.Val "MICROSAR RTE" /begin SUB_GROUP /end SUB_GROUP /begin FUNCTION_LIST /end FUNCTION_LIST /begin REF_CHARACTERISTIC CalRegn01Cmn.BattVltgCorrlnNtc0x0B0FailStep.Val /end REF_CHARACTERISTIC /begin REF_MEASUREMENT /end REF_MEASUREMENT /end GROUP
/begin GROUP CalRegn01Cmn.BattVltgCorrlnNtc0x0B0PassStep.Val "MICROSAR RTE" /begin SUB_GROUP /end SUB_GROUP /begin FUNCTION_LIST /end FUNCTION_LIST /begin REF_CHARACTERISTIC CalRegn01Cmn.BattVltgCorrlnNtc0x0B0PassStep.Val /end REF_CHARACTERISTIC /begin REF_MEASUREMENT /end REF_MEASUREMENT /end GROUP
/**********************************************************************************************************************
* RECORD_LAYOUT
*********************************************************************************************************************/
/begin RECORD_LAYOUT RTE_RL_UBYTE FNC_VALUES 1 UBYTE ROW_DIR DIRECT /end RECORD_LAYOUT
/begin RECORD_LAYOUT RTE_RL_UWORD FNC_VALUES 1 UWORD ROW_DIR DIRECT /end RECORD_LAYOUT
/begin RECORD_LAYOUT RTE_RL_ULONG FNC_VALUES 1 ULONG ROW_DIR DIRECT /end RECORD_LAYOUT
/begin RECORD_LAYOUT RTE_RL_FLOAT32_IEEE FNC_VALUES 1 FLOAT32_IEEE ROW_DIR DIRECT /end RECORD_LAYOUT
/begin RECORD_LAYOUT RTE_RL_BOOLEAN FNC_VALUES 1 UBYTE ROW_DIR DIRECT /end RECORD_LAYOUT
/**********************************************************************************************************************
* COMPU_METHOD / COMPU_VTAB_RANGE
*********************************************************************************************************************/
/begin COMPU_METHOD RTE_CM_BOOLEAN "" TAB_VERB "%3.1" "" COMPU_TAB_REF RTE_CM_BOOLEAN /end COMPU_METHOD
/begin COMPU_VTAB_RANGE RTE_CM_BOOLEAN "" 2 0 0 "false" 1 255 "true" /end COMPU_VTAB_RANGE
/begin COMPU_METHOD RTE_CM_ENUM_SysSt1 "" TAB_VERB "%.1" "" COMPU_TAB_REF RTE_CM_ENUM_SysSt1 /end COMPU_METHOD
/begin COMPU_VTAB_RANGE RTE_CM_ENUM_SysSt1 "" 4 0 0 "SYSST_DI" 1 1 "SYSST_OFF" 2 2 "SYSST_ENA" 3 3 "SYSST_WRMININ" /end COMPU_VTAB_RANGE
/begin COMPU_METHOD RTE_CM_ENUM_SigQlfr1 "" TAB_VERB "%.1" "" COMPU_TAB_REF RTE_CM_ENUM_SigQlfr1 /end COMPU_METHOD
/begin COMPU_VTAB_RANGE RTE_CM_ENUM_SigQlfr1 "" 3 0 0 "SIGQLFR_NORES" 1 1 "SIGQLFR_PASSD" 2 2 "SIGQLFR_FAILD" /end COMPU_VTAB_RANGE
/begin COMPU_METHOD RTE_CM_ENUM_MotCurrEolCalSt2 "" TAB_VERB "%.1" "" COMPU_TAB_REF RTE_CM_ENUM_MotCurrEolCalSt2 /end COMPU_METHOD
/begin COMPU_VTAB_RANGE RTE_CM_ENUM_MotCurrEolCalSt2 "" 9 0 0 "MCECS_OFFSCMDSTRT" 1 1 "MCECS_OFFSCMDHI" 2 2 "MCECS_OFFSCMDLO" 3 3 "MCECS_OFFSCMDZERO" 4 4 "MCECS_OFFSCMDEND" 5 5 "MCECS_GAINCMDAD" 6 6 "MCECS_GAINCMDBE" 7 7 "MCECS_GAINCMDCF" 8 8 "MCECS_CMDSAFEST" /end COMPU_VTAB_RANGE
/begin COMPU_METHOD RTE_CM_Ag8 "" RAT_FUNC "%.1" "MotRev" COEFFS 0 65536 0 0 0 1 /end COMPU_METHOD
/begin COMPU_METHOD RTE_CM_Ag5 "" RAT_FUNC "%.1" "MotRev" COEFFS 0 65536 0 0 0 1 /end COMPU_METHOD
/begin COMPU_METHOD RTE_CM_ENUM_NtcSts1 "" TAB_VERB "%.1" "" COMPU_TAB_REF RTE_CM_ENUM_NtcSts1 /end COMPU_METHOD
/begin COMPU_VTAB_RANGE RTE_CM_ENUM_NtcSts1 "" 4 0 0 "NTCSTS_PASSD" 1 1 "NTCSTS_FAILD" 2 2 "NTCSTS_PREPASSD" 3 3 "NTCSTS_PREFAILD" /end COMPU_VTAB_RANGE
/begin COMPU_METHOD RTE_CM_ENUM_CrcHwSts1 "" TAB_VERB "%.1" "" COMPU_TAB_REF RTE_CM_ENUM_CrcHwSts1 /end COMPU_METHOD
/begin COMPU_VTAB_RANGE RTE_CM_ENUM_CrcHwSts1 "" 6 0 0 "CRCHWSTS_NOTAVL" 1 1 "CRCHWSTS_AVL" 2 2 "CRCHWSTS_BUSY" 3 3 "CRCHWSTS_NOTENAD" 4 4 "CRCHWSTS_RESV" 255 255 "CRCHWSTS_IDXINVLD" /end COMPU_VTAB_RANGE
