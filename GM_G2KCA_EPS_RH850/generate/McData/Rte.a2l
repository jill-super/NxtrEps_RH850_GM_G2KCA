/begin CHARACTERISTIC PwrSply.PwrSplyNtc0x07BFailStep.Val "MICROSAR RTE" VALUE 0x0 RTE_RL_UWORD 0 NO_COMPU_METHOD 0 65535 SYMBOL_LINK "Rte_CalprmRom_CalRegn01Cmn_DEFAULT_RTE_CALPRM_GROUP.PwrSplyNtc0x07BFailStep_Val" 0 DISPLAY_IDENTIFIER PwrSply.CalibrationPorts.PwrSplyNtc0x07BFailStep.Val /end CHARACTERISTIC
/begin CHARACTERISTIC PwrSply.PwrSplyNtc0x07BPassStep.Val "MICROSAR RTE" VALUE 0x0 RTE_RL_UWORD 0 NO_COMPU_METHOD 0 65535 SYMBOL_LINK "Rte_CalprmRom_CalRegn01Cmn_DEFAULT_RTE_CALPRM_GROUP.PwrSplyNtc0x07BPassStep_Val" 0 DISPLAY_IDENTIFIER PwrSply.CalibrationPorts.PwrSplyNtc0x07BPassStep.Val /end CHARACTERISTIC
/begin CHARACTERISTIC PwrSply.PwrSplyNtc0x07CFailStep.Val "MICROSAR RTE" VALUE 0x0 RTE_RL_UWORD 0 NO_COMPU_METHOD 0 65535 SYMBOL_LINK "Rte_CalprmRom_CalRegn01Cmn_DEFAULT_RTE_CALPRM_GROUP.PwrSplyNtc0x07CFailStep_Val" 0 DISPLAY_IDENTIFIER PwrSply.CalibrationPorts.PwrSplyNtc0x07CFailStep.Val /end CHARACTERISTIC
/begin CHARACTERISTIC PwrSply.PwrSplyNtc0x07CPassStep.Val "MICROSAR RTE" VALUE 0x0 RTE_RL_UWORD 0 NO_COMPU_METHOD 0 65535 SYMBOL_LINK "Rte_CalprmRom_CalRegn01Cmn_DEFAULT_RTE_CALPRM_GROUP.PwrSplyNtc0x07CPassStep_Val" 0 DISPLAY_IDENTIFIER PwrSply.CalibrationPorts.PwrSplyNtc0x07CPassStep.Val /end CHARACTERISTIC
/begin CHARACTERISTIC PwrSply.PwrSplyNtc0x07DFailStep.Val "MICROSAR RTE" VALUE 0x0 RTE_RL_UWORD 0 NO_COMPU_METHOD 0 65535 SYMBOL_LINK "Rte_CalprmRom_CalRegn01Cmn_DEFAULT_RTE_CALPRM_GROUP.PwrSplyNtc0x07DFailStep_Val" 0 DISPLAY_IDENTIFIER PwrSply.CalibrationPorts.PwrSplyNtc0x07DFailStep.Val /end CHARACTERISTIC
/begin CHARACTERISTIC PwrSply.PwrSplyNtc0x07DPassStep.Val "MICROSAR RTE" VALUE 0x0 RTE_RL_UWORD 0 NO_COMPU_METHOD 0 65535 SYMBOL_LINK "Rte_CalprmRom_CalRegn01Cmn_DEFAULT_RTE_CALPRM_GROUP.PwrSplyNtc0x07DPassStep_Val" 0 DISPLAY_IDENTIFIER PwrSply.CalibrationPorts.PwrSplyNtc0x07DPassStep.Val /end CHARACTERISTIC
/begin CHARACTERISTIC PwrpkCmpbltyChk.PwrpkCmpbltyChkGearId.Val "MICROSAR RTE" VALUE 0x0 RTE_RL_UBYTE 0 NO_COMPU_METHOD 0 255 SYMBOL_LINK "Rte_CalprmRom_CalRegn03Inin00_DEFAULT_RTE_CALPRM_GROUP.PwrpkCmpbltyChkGearId_Val" 0 DISPLAY_IDENTIFIER PwrpkCmpbltyChk.CalibrationPorts.PwrpkCmpbltyChkGearId.Val /end CHARACTERISTIC
/begin CHARACTERISTIC Rtn.RtnHwAgOffsCalcdX.Ary2D "MICROSAR RTE" VAL_BLK 0x0 RTE_RL_UWORD 0 RTE_CM_Ag18 0 0 MATRIX_DIM 16 9 1 SYMBOL_LINK "Rte_CalprmRom_CalRegn03Rt00GroupA_DEFAULT_RTE_CALPRM_GROUP.RtnHwAgOffsCalcdX_Ary2D" 0 DISPLAY_IDENTIFIER Rtn.CalibrationPorts.RtnHwAgOffsCalcdX.Ary2D /end CHARACTERISTIC
/begin CHARACTERISTIC Rtn.RtnHwAgOffsCalcdY.Ary2D "MICROSAR RTE" VAL_BLK 0x0 RTE_RL_UWORD 0 RTE_CM_Tq14 0 0 MATRIX_DIM 16 9 1 SYMBOL_LINK "Rte_CalprmRom_CalRegn03Rt00GroupA_DEFAULT_RTE_CALPRM_GROUP.RtnHwAgOffsCalcdY_Ary2D" 0 DISPLAY_IDENTIFIER Rtn.CalibrationPorts.RtnHwAgOffsCalcdY.Ary2D /end CHARACTERISTIC
/begin CHARACTERISTIC Rtn.RtnHwAuthyScaX.Ary1D "MICROSAR RTE" VAL_BLK 0x0 RTE_RL_UWORD 0 RTE_CM_Uls17 0 0 MATRIX_DIM 4 1 1 SYMBOL_LINK "Rte_CalprmRom_CalRegn03Inin00_DEFAULT_RTE_CALPRM_GROUP.RtnHwAuthyScaX_Ary1D" 0 DISPLAY_IDENTIFIER Rtn.CalibrationPorts.RtnHwAuthyScaX.Ary1D /end CHARACTERISTIC
/begin CHARACTERISTIC Rtn.RtnHwAuthyScaY.Ary1D "MICROSAR RTE" VAL_BLK 0x0 RTE_RL_UWORD 0 RTE_CM_Uls18 0 0 MATRIX_DIM 4 1 1 SYMBOL_LINK "Rte_CalprmRom_CalRegn03Inin00_DEFAULT_RTE_CALPRM_GROUP.RtnHwAuthyScaY_Ary1D" 0 DISPLAY_IDENTIFIER Rtn.CalibrationPorts.RtnHwAuthyScaY.Ary1D /end CHARACTERISTIC
/begin CHARACTERISTIC Rtn.RtnHwAuthySlew.Val "MICROSAR RTE" VALUE 0x0 RTE_RL_FLOAT32_IEEE 0 NO_COMPU_METHOD 0.1 10.0 SYMBOL_LINK "Rte_CalprmRom_CalRegn03Inin00_DEFAULT_RTE_CALPRM_GROUP.RtnHwAuthySlew_Val" 0 DISPLAY_IDENTIFIER Rtn.CalibrationPorts.RtnHwAuthySlew.Val /end CHARACTERISTIC
/begin CHARACTERISTIC Rtn.RtnOffsRng.Val "MICROSAR RTE" VALUE 0x0 RTE_RL_FLOAT32_IEEE 0 NO_COMPU_METHOD 0.0 20.0 SYMBOL_LINK "Rte_CalprmRom_CalRegn03Inin00_DEFAULT_RTE_CALPRM_GROUP.RtnOffsRng_Val" 0 DISPLAY_IDENTIFIER Rtn.CalibrationPorts.RtnOffsRng.Val /end CHARACTERISTIC
/begin CHARACTERISTIC Rtn.RtnOffsSlew.Val "MICROSAR RTE" VALUE 0x0 RTE_RL_FLOAT32_IEEE 0 NO_COMPU_METHOD 0.0 0.5 SYMBOL_LINK "Rte_CalprmRom_CalRegn03Inin00_DEFAULT_RTE_CALPRM_GROUP.RtnOffsSlew_Val" 0 DISPLAY_IDENTIFIER Rtn.CalibrationPorts.RtnOffsSlew.Val /end CHARACTERISTIC
/begin CHARACTERISTIC Rtn.RtnScaTqX.Ary2D "MICROSAR RTE" VAL_BLK 0x0 RTE_RL_UWORD 0 RTE_CM_Tq6 0 0 MATRIX_DIM 8 9 1 SYMBOL_LINK "Rte_CalprmRom_CalRegn03Rt00GroupA_DEFAULT_RTE_CALPRM_GROUP.RtnScaTqX_Ary2D" 0 DISPLAY_IDENTIFIER Rtn.CalibrationPorts.RtnScaTqX.Ary2D /end CHARACTERISTIC
/begin CHARACTERISTIC Rtn.RtnScaTqY.Ary2D "MICROSAR RTE" VAL_BLK 0x0 RTE_RL_UWORD 0 RTE_CM_Uls17 0 0 MATRIX_DIM 8 9 1 SYMBOL_LINK "Rte_CalprmRom_CalRegn03Rt00GroupA_DEFAULT_RTE_CALPRM_GROUP.RtnScaTqY_Ary2D" 0 DISPLAY_IDENTIFIER Rtn.CalibrationPorts.RtnScaTqY.Ary2D /end CHARACTERISTIC
/begin CHARACTERISTIC Rtn.RtnScaVelX.Ary2D "MICROSAR RTE" VAL_BLK 0x0 RTE_RL_UWORD 0 RTE_CM_Vel6 0 0 MATRIX_DIM 4 9 1 SYMBOL_LINK "Rte_CalprmRom_CalRegn03Rt00GroupA_DEFAULT_RTE_CALPRM_GROUP.RtnScaVelX_Ary2D" 0 DISPLAY_IDENTIFIER Rtn.CalibrationPorts.RtnScaVelX.Ary2D /end CHARACTERISTIC
/begin CHARACTERISTIC Rtn.RtnScaVelY.Ary2D "MICROSAR RTE" VAL_BLK 0x0 RTE_RL_UWORD 0 RTE_CM_Uls19 0 0 MATRIX_DIM 4 9 1 SYMBOL_LINK "Rte_CalprmRom_CalRegn03Rt00GroupA_DEFAULT_RTE_CALPRM_GROUP.RtnScaVelY_Ary2D" 0 DISPLAY_IDENTIFIER Rtn.CalibrationPorts.RtnScaVelY.Ary2D /end CHARACTERISTIC
/begin CHARACTERISTIC Rtn.RtnTScaX.Ary1D "MICROSAR RTE" VAL_BLK 0x0 RTE_RL_SWORD 0 RTE_CM_T6 0 0 MATRIX_DIM 14 1 1 SYMBOL_LINK "Rte_CalprmRom_CalRegn03Inin00GroupA_DEFAULT_RTE_CALPRM_GROUP.RtnTScaX_Ary1D" 0 DISPLAY_IDENTIFIER Rtn.CalibrationPorts.RtnTScaX.Ary1D /end CHARACTERISTIC
/begin CHARACTERISTIC Rtn.RtnTScaY.Ary1D "MICROSAR RTE" VAL_BLK 0x0 RTE_RL_UWORD 0 RTE_CM_Uls23 0 0 MATRIX_DIM 14 1 1 SYMBOL_LINK "Rte_CalprmRom_CalRegn03Inin00GroupA_DEFAULT_RTE_CALPRM_GROUP.RtnTScaY_Ary1D" 0 DISPLAY_IDENTIFIER Rtn.CalibrationPorts.RtnTScaY.Ary1D /end CHARACTERISTIC
/begin CHARACTERISTIC Rtn.RtnVehSpdSeln.Ary1D "MICROSAR RTE" VAL_BLK 0x0 RTE_RL_UWORD 0 RTE_CM_Spd2 0 0 MATRIX_DIM 9 1 1 SYMBOL_LINK "Rte_CalprmRom_CalRegn03CmnGroupA_DEFAULT_RTE_CALPRM_GROUP.RtnVehSpdSeln_Ary1D" 0 DISPLAY_IDENTIFIER Rtn.CalibrationPorts.RtnVehSpdSeln.Ary1D /end CHARACTERISTIC
/begin CHARACTERISTIC RtnPahFwl.RtnPahFwlUpprBndTblX.Ary1D "MICROSAR RTE" VAL_BLK 0x0 RTE_RL_SWORD 0 NO_COMPU_METHOD -32768 32767 MATRIX_DIM 11 1 1 SYMBOL_LINK "Rte_CalprmRom_CalRegn01Inin00_DEFAULT_RTE_CALPRM_GROUP.RtnPahFwlUpprBndTblX_Ary1D" 0 DISPLAY_IDENTIFIER RtnPahFwl.CalibrationPorts.RtnPahFwlUpprBndTblX.Ary1D /end CHARACTERISTIC
/begin CHARACTERISTIC RtnPahFwl.RtnPahFwlUpprBndTblY.Ary2D "MICROSAR RTE" VAL_BLK 0x0 RTE_RL_SWORD 0 NO_COMPU_METHOD -32768 32767 MATRIX_DIM 11 8 1 SYMBOL_LINK "Rte_CalprmRom_CalRegn01Inin00_DEFAULT_RTE_CALPRM_GROUP.RtnPahFwlUpprBndTblY_Ary2D" 0 DISPLAY_IDENTIFIER RtnPahFwl.CalibrationPorts.RtnPahFwlUpprBndTblY.Ary2D /end CHARACTERISTIC
/begin CHARACTERISTIC RtnPahFwl.RtnPahFwlVehSpd.Ary1D "MICROSAR RTE" VAL_BLK 0x0 RTE_RL_UWORD 0 NO_COMPU_METHOD 0 65535 MATRIX_DIM 8 1 1 SYMBOL_LINK "Rte_CalprmRom_CalRegn01Inin00_DEFAULT_RTE_CALPRM_GROUP.RtnPahFwlVehSpd_Ary1D" 0 DISPLAY_IDENTIFIER RtnPahFwl.CalibrationPorts.RtnPahFwlVehSpd.Ary1D /end CHARACTERISTIC
/begin CHARACTERISTIC SerlComOutpProxy.GmOvrlStMgrApaMfgEna.Logl "MICROSAR RTE" VALUE 0x0 RTE_RL_BOOLEAN 0 RTE_CM_BOOLEAN 0 255 SYMBOL_LINK "Rte_CalprmRom_CalRegn02CmnGroupA_DEFAULT_RTE_CALPRM_GROUP.GmOvrlStMgrApaMfgEna_Logl" 0 DISPLAY_IDENTIFIER SerlComOutpProxy.CalibrationPorts.GmOvrlStMgrApaMfgEna.Logl /end CHARACTERISTIC
/begin CHARACTERISTIC SerlComOutpProxy.GmOvrlStMgrEscMfgEna.Logl "MICROSAR RTE" VALUE 0x0 RTE_RL_BOOLEAN 0 RTE_CM_BOOLEAN 0 255 SYMBOL_LINK "Rte_CalprmRom_CalRegn02CmnGroupA_DEFAULT_RTE_CALPRM_GROUP.GmOvrlStMgrEscMfgEna_Logl" 0 DISPLAY_IDENTIFIER SerlComOutpProxy.CalibrationPorts.GmOvrlStMgrEscMfgEna.Logl /end CHARACTERISTIC
/begin CHARACTERISTIC SerlComOutpProxy.GmOvrlStMgrLkaMfgEna.Logl "MICROSAR RTE" VALUE 0x0 RTE_RL_BOOLEAN 0 RTE_CM_BOOLEAN 0 255 SYMBOL_LINK "Rte_CalprmRom_CalRegn02CmnGroupA_DEFAULT_RTE_CALPRM_GROUP.GmOvrlStMgrLkaMfgEna_Logl" 0 DISPLAY_IDENTIFIER SerlComOutpProxy.CalibrationPorts.GmOvrlStMgrLkaMfgEna.Logl /end CHARACTERISTIC
/begin CHARACTERISTIC SnsrOffsCorrn.SnsrOffsCorrnHwAgLrndOffsLim.Val "MICROSAR RTE" VALUE 0x0 RTE_RL_FLOAT32_IEEE 0 NO_COMPU_METHOD -3.402823466e+38 3.402823466e+38 SYMBOL_LINK "Rte_CalprmRom_CalRegn02Cmn_DEFAULT_RTE_CALPRM_GROUP.SnsrOffsCorrnHwAgLrndOffsLim_Val" 0 DISPLAY_IDENTIFIER SnsrOffsCorrn.CalibrationPorts.SnsrOffsCorrnHwAgLrndOffsLim.Val /end CHARACTERISTIC
/begin CHARACTERISTIC SnsrOffsCorrn.SnsrOffsCorrnHwTqLrndOffsLim.Val "MICROSAR RTE" VALUE 0x0 RTE_RL_FLOAT32_IEEE 0 NO_COMPU_METHOD -3.402823466e+38 3.402823466e+38 SYMBOL_LINK "Rte_CalprmRom_CalRegn02Cmn_DEFAULT_RTE_CALPRM_GROUP.SnsrOffsCorrnHwTqLrndOffsLim_Val" 0 DISPLAY_IDENTIFIER SnsrOffsCorrn.CalibrationPorts.SnsrOffsCorrnHwTqLrndOffsLim.Val /end CHARACTERISTIC
/begin CHARACTERISTIC SnsrOffsCorrn.SnsrOffsCorrnOffsEna.Logl "MICROSAR RTE" VALUE 0x0 RTE_RL_BOOLEAN 0 RTE_CM_BOOLEAN 0 255 SYMBOL_LINK "Rte_CalprmRom_CalRegn02Cmn_DEFAULT_RTE_CALPRM_GROUP.SnsrOffsCorrnOffsEna_Logl" 0 DISPLAY_IDENTIFIER SnsrOffsCorrn.CalibrationPorts.SnsrOffsCorrnOffsEna.Logl /end CHARACTERISTIC
/begin CHARACTERISTIC SnsrOffsCorrn.SnsrOffsCorrnVehYawRateLrndOffsLim.Val "MICROSAR RTE" VALUE 0x0 RTE_RL_FLOAT32_IEEE 0 NO_COMPU_METHOD -3.402823466e+38 3.402823466e+38 SYMBOL_LINK "Rte_CalprmRom_CalRegn02Cmn_DEFAULT_RTE_CALPRM_GROUP.SnsrOffsCorrnVehYawRateLrndOffsLim_Val" 0 DISPLAY_IDENTIFIER SnsrOffsCorrn.CalibrationPorts.SnsrOffsCorrnVehYawRateLrndOffsLim.Val /end CHARACTERISTIC
/begin MEASUREMENT PwrLimr.SpdAdjSlewStVari "MICROSAR RTE" FLOAT32_IEEE NO_COMPU_METHOD 0 0 -3.402823466e+38 3.402823466e+38 ECU_ADDRESS 0 SYMBOL_LINK "Rte_PwrLimr_SpdAdjSlewStVari" 0 DISPLAY_IDENTIFIER PwrLimr.PerInstanceMemories.SpdAdjSlewStVari /end MEASUREMENT
/begin MEASUREMENT PwrLimr.TqLimAssiRednLpFil.FilGain "MICROSAR RTE" FLOAT32_IEEE NO_COMPU_METHOD 0 0 -3.402823466e+38 3.402823466e+38 ECU_ADDRESS 0 SYMBOL_LINK "Rte_PwrLimr_TqLimAssiRednLpFil.FilGain" 0 DISPLAY_IDENTIFIER PwrLimr.PerInstanceMemories.TqLimAssiRednLpFil.FilGain /end MEASUREMENT
/begin MEASUREMENT PwrLimr.TqLimAssiRednLpFil.FilSt "MICROSAR RTE" FLOAT32_IEEE NO_COMPU_METHOD 0 0 -3.402823466e+38 3.402823466e+38 ECU_ADDRESS 0 SYMBOL_LINK "Rte_PwrLimr_TqLimAssiRednLpFil.FilSt" 0 DISPLAY_IDENTIFIER PwrLimr.PerInstanceMemories.TqLimAssiRednLpFil.FilSt /end MEASUREMENT
/begin MEASUREMENT PwrLimr.dPwrLimrFildMotVel "MICROSAR RTE" FLOAT32_IEEE NO_COMPU_METHOD 0 0 -3.402823466e+38 3.402823466e+38 ECU_ADDRESS 0 SYMBOL_LINK "Rte_PwrLimr_dPwrLimrFildMotVel" 0 DISPLAY_IDENTIFIER PwrLimr.PerInstanceMemories.dPwrLimrFildMotVel /end MEASUREMENT
/begin MEASUREMENT PwrLimr.dPwrLimrLimDif "MICROSAR RTE" FLOAT32_IEEE NO_COMPU_METHOD 0 0 -3.402823466e+38 3.402823466e+38 ECU_ADDRESS 0 SYMBOL_LINK "Rte_PwrLimr_dPwrLimrLimDif" 0 DISPLAY_IDENTIFIER PwrLimr.PerInstanceMemories.dPwrLimrLimDif /end MEASUREMENT
/begin MEASUREMENT PwrLimr.dPwrLimrMinStdOperLim "MICROSAR RTE" FLOAT32_IEEE NO_COMPU_METHOD 0 0 -3.402823466e+38 3.402823466e+38 ECU_ADDRESS 0 SYMBOL_LINK "Rte_PwrLimr_dPwrLimrMinStdOperLim" 0 DISPLAY_IDENTIFIER PwrLimr.PerInstanceMemories.dPwrLimrMinStdOperLim /end MEASUREMENT
/begin MEASUREMENT PwrLimr.dPwrLimrMotEnvlpSpd "MICROSAR RTE" FLOAT32_IEEE NO_COMPU_METHOD 0 0 -3.402823466e+38 3.402823466e+38 ECU_ADDRESS 0 SYMBOL_LINK "Rte_PwrLimr_dPwrLimrMotEnvlpSpd" 0 DISPLAY_IDENTIFIER PwrLimr.PerInstanceMemories.dPwrLimrMotEnvlpSpd /end MEASUREMENT
/begin MEASUREMENT PwrLimr.dPwrLimrMotTqCmdIvtrLoaSca "MICROSAR RTE" FLOAT32_IEEE NO_COMPU_METHOD 0 0 -3.402823466e+38 3.402823466e+38 ECU_ADDRESS 0 SYMBOL_LINK "Rte_PwrLimr_dPwrLimrMotTqCmdIvtrLoaSca" 0 DISPLAY_IDENTIFIER PwrLimr.PerInstanceMemories.dPwrLimrMotTqCmdIvtrLoaSca /end MEASUREMENT
/begin MEASUREMENT PwrLimr.dPwrLimrOutpVelOffs "MICROSAR RTE" FLOAT32_IEEE NO_COMPU_METHOD 0 0 -3.402823466e+38 3.402823466e+38 ECU_ADDRESS 0 SYMBOL_LINK "Rte_PwrLimr_dPwrLimrOutpVelOffs" 0 DISPLAY_IDENTIFIER PwrLimr.PerInstanceMemories.dPwrLimrOutpVelOffs /end MEASUREMENT
/begin MEASUREMENT PwrLimr.dPwrLimrSpdAdj "MICROSAR RTE" FLOAT32_IEEE NO_COMPU_METHOD 0 0 -3.402823466e+38 3.402823466e+38 ECU_ADDRESS 0 SYMBOL_LINK "Rte_PwrLimr_dPwrLimrSpdAdj" 0 DISPLAY_IDENTIFIER PwrLimr.PerInstanceMemories.dPwrLimrSpdAdj /end MEASUREMENT
/begin MEASUREMENT PwrLimr.dPwrLimrTLimMaxCurr "MICROSAR RTE" FLOAT32_IEEE NO_COMPU_METHOD 0 0 -3.402823466e+38 3.402823466e+38 ECU_ADDRESS 0 SYMBOL_LINK "Rte_PwrLimr_dPwrLimrTLimMaxCurr" 0 DISPLAY_IDENTIFIER PwrLimr.PerInstanceMemories.dPwrLimrTLimMaxCurr /end MEASUREMENT
/begin MEASUREMENT PwrLimr.dPwrLimrTqEnvlpLim1 "MICROSAR RTE" FLOAT32_IEEE NO_COMPU_METHOD 0 0 -3.402823466e+38 3.402823466e+38 ECU_ADDRESS 0 SYMBOL_LINK "Rte_PwrLimr_dPwrLimrTqEnvlpLim1" 0 DISPLAY_IDENTIFIER PwrLimr.PerInstanceMemories.dPwrLimrTqEnvlpLim1 /end MEASUREMENT
/begin MEASUREMENT PwrLimr.dPwrLimrTqEnvlpLim4 "MICROSAR RTE" FLOAT32_IEEE NO_COMPU_METHOD 0 0 -3.402823466e+38 3.402823466e+38 ECU_ADDRESS 0 SYMBOL_LINK "Rte_PwrLimr_dPwrLimrTqEnvlpLim4" 0 DISPLAY_IDENTIFIER PwrLimr.PerInstanceMemories.dPwrLimrTqEnvlpLim4 /end MEASUREMENT
/begin MEASUREMENT PwrLimr.dPwrLimrTqLim "MICROSAR RTE" FLOAT32_IEEE NO_COMPU_METHOD 0 0 -3.402823466e+38 3.402823466e+38 ECU_ADDRESS 0 SYMBOL_LINK "Rte_PwrLimr_dPwrLimrTqLim" 0 DISPLAY_IDENTIFIER PwrLimr.PerInstanceMemories.dPwrLimrTqLim /end MEASUREMENT
/begin MEASUREMENT PwrLimr.dPwrLimrTqLim1 "MICROSAR RTE" FLOAT32_IEEE NO_COMPU_METHOD 0 0 -3.402823466e+38 3.402823466e+38 ECU_ADDRESS 0 SYMBOL_LINK "Rte_PwrLimr_dPwrLimrTqLim1" 0 DISPLAY_IDENTIFIER PwrLimr.PerInstanceMemories.dPwrLimrTqLim1 /end MEASUREMENT
/begin MEASUREMENT PwrLimr.dPwrLimrTqLim4 "MICROSAR RTE" FLOAT32_IEEE NO_COMPU_METHOD 0 0 -3.402823466e+38 3.402823466e+38 ECU_ADDRESS 0 SYMBOL_LINK "Rte_PwrLimr_dPwrLimrTqLim4" 0 DISPLAY_IDENTIFIER PwrLimr.PerInstanceMemories.dPwrLimrTqLim4 /end MEASUREMENT
/begin MEASUREMENT PwrSply.PwrSplyReadWrOrderFlg1 "MICROSAR RTE" UBYTE RTE_CM_BOOLEAN 0 0 0 255 ECU_ADDRESS 0 SYMBOL_LINK "Rte_PwrSply_PwrSplyReadWrOrderFlg1" 0 DISPLAY_IDENTIFIER PwrSply.PerInstanceMemories.PwrSplyReadWrOrderFlg1 /end MEASUREMENT
/begin MEASUREMENT PwrSply.PwrSplyReadWrOrderFlg2 "MICROSAR RTE" UBYTE RTE_CM_BOOLEAN 0 0 0 255 ECU_ADDRESS 0 SYMBOL_LINK "Rte_PwrSply_PwrSplyReadWrOrderFlg2" 0 DISPLAY_IDENTIFIER PwrSply.PerInstanceMemories.PwrSplyReadWrOrderFlg2 /end MEASUREMENT
/begin MEASUREMENT PwrSply.PwrSplyStrtUpSelfTestCmpl "MICROSAR RTE" UBYTE RTE_CM_BOOLEAN 0 0 0 255 ECU_ADDRESS 0 SYMBOL_LINK "Rte_PwrSply_PwrSplyStrtUpSelfTestCmpl" 0 DISPLAY_IDENTIFIER PwrSply.PerInstanceMemories.PwrSplyStrtUpSelfTestCmpl /end MEASUREMENT
/begin MEASUREMENT PwrSply.SysSt.Val "MICROSAR RTE" UBYTE RTE_CM_ENUM_SysSt1 0 0 0 255 ECU_ADDRESS 0 SYMBOL_LINK "Rte_SysStMod_SysSt_Val" 0 DISPLAY_IDENTIFIER PwrSply.ReceiverPorts.SysSt.Val /end MEASUREMENT
/begin MEASUREMENT PwrUpSeq.CodFlsCrcChkCmpl.Logl "MICROSAR RTE" UBYTE RTE_CM_BOOLEAN 0 0 0 255 ECU_ADDRESS 0 SYMBOL_LINK "Rte_CDD_FlsMem_CodFlsCrcChkCmpl_Logl" 0 DISPLAY_IDENTIFIER PwrUpSeq.ReceiverPorts.CodFlsCrcChkCmpl.Logl /end MEASUREMENT
/begin MEASUREMENT PwrUpSeq.CurrMeasWrmIninTestCmpl.Logl "MICROSAR RTE" UBYTE RTE_CM_BOOLEAN 0 0 0 255 ECU_ADDRESS 0 SYMBOL_LINK "Rte_CDD_CurrMeas_CurrMeasWrmIninTestCmpl_Logl" 0 DISPLAY_IDENTIFIER PwrUpSeq.ReceiverPorts.CurrMeasWrmIninTestCmpl.Logl /end MEASUREMENT
/begin MEASUREMENT PwrUpSeq.MotDrvr0IninTestCmpl.Logl "MICROSAR RTE" UBYTE RTE_CM_BOOLEAN 0 0 0 255 ECU_ADDRESS 0 SYMBOL_LINK "Rte_GateDrv0Ctrl_MotDrvr0IninTestCmpl_Logl" 0 DISPLAY_IDENTIFIER PwrUpSeq.ReceiverPorts.MotDrvr0IninTestCmpl.Logl /end MEASUREMENT
/begin MEASUREMENT PwrUpSeq.MotDrvr1IninTestCmpl.Logl "MICROSAR RTE" UBYTE RTE_CM_BOOLEAN 0 0 0 255 ECU_ADDRESS 0 SYMBOL_LINK "Rte_PwrUpSeq_MotDrvr1IninTestCmpl_Logl" 0 DISPLAY_IDENTIFIER PwrUpSeq.ReceiverPorts.MotDrvr1IninTestCmpl.Logl /end MEASUREMENT
/begin MEASUREMENT PwrUpSeq.PwrDiscnctATestCmpl.Logl "MICROSAR RTE" UBYTE RTE_CM_BOOLEAN 0 0 0 255 ECU_ADDRESS 0 SYMBOL_LINK "Rte_PwrDiscnct_PwrDiscnctATestCmpl_Logl" 0 DISPLAY_IDENTIFIER PwrUpSeq.ReceiverPorts.PwrDiscnctATestCmpl.Logl /end MEASUREMENT
/begin MEASUREMENT PwrUpSeq.PwrDiscnctBTestCmpl.Logl "MICROSAR RTE" UBYTE RTE_CM_BOOLEAN 0 0 0 255 ECU_ADDRESS 0 SYMBOL_LINK "Rte_PwrDiscnct_PwrDiscnctBTestCmpl_Logl" 0 DISPLAY_IDENTIFIER PwrUpSeq.ReceiverPorts.PwrDiscnctBTestCmpl.Logl /end MEASUREMENT
/begin MEASUREMENT PwrUpSeq.StrtUpSt.Val "MICROSAR RTE" UBYTE NO_COMPU_METHOD 0 0 0 255 ECU_ADDRESS 0 SYMBOL_LINK "Rte_PwrUpSeq_StrtUpSt_Val" 0 DISPLAY_IDENTIFIER PwrUpSeq.SenderPorts.StrtUpSt.Val /end MEASUREMENT
/begin MEASUREMENT PwrUpSeq.SysSt.Val "MICROSAR RTE" UBYTE RTE_CM_ENUM_SysSt1 0 0 0 255 ECU_ADDRESS 0 SYMBOL_LINK "Rte_SysStMod_SysSt_Val" 0 DISPLAY_IDENTIFIER PwrUpSeq.ReceiverPorts.SysSt.Val /end MEASUREMENT
/begin MEASUREMENT PwrUpSeq.SysStWrmIninCmpl.Logl "MICROSAR RTE" UBYTE RTE_CM_BOOLEAN 0 0 0 255 ECU_ADDRESS 0 SYMBOL_LINK "Rte_PwrUpSeq_SysStWrmIninCmpl_Logl" 0 DISPLAY_IDENTIFIER PwrUpSeq.SenderPorts.SysStWrmIninCmpl.Logl /end MEASUREMENT
/begin MEASUREMENT PwrUpSeq.TmplMonIninTestCmpl.Logl "MICROSAR RTE" UBYTE RTE_CM_BOOLEAN 0 0 0 255 ECU_ADDRESS 0 SYMBOL_LINK "Rte_TmplMonr_TmplMonrIninTestCmpl_Logl" 0 DISPLAY_IDENTIFIER PwrUpSeq.ReceiverPorts.TmplMonIninTestCmpl.Logl /end MEASUREMENT
/begin MEASUREMENT PwrpkCmpbltyChk.GearIdn1.Val "MICROSAR RTE" UBYTE NO_COMPU_METHOD 0 0 0 255 ECU_ADDRESS 0 SYMBOL_LINK "Rte_CDD_HwTq2Meas_GearIdn1_Val" 0 DISPLAY_IDENTIFIER PwrpkCmpbltyChk.ReceiverPorts.GearIdn1.Val /end MEASUREMENT
/begin MEASUREMENT PwrpkCmpbltyChk.GearIdn1Vld.Logl "MICROSAR RTE" UBYTE RTE_CM_BOOLEAN 0 0 0 255 ECU_ADDRESS 0 SYMBOL_LINK "Rte_CDD_HwTq2Meas_GearIdn1Vld_Logl" 0 DISPLAY_IDENTIFIER PwrpkCmpbltyChk.ReceiverPorts.GearIdn1Vld.Logl /end MEASUREMENT
/begin MEASUREMENT PwrpkCmpbltyChk.GearIdn2.Val "MICROSAR RTE" UBYTE NO_COMPU_METHOD 0 0 0 255 ECU_ADDRESS 0 SYMBOL_LINK "Rte_CDD_HwTq3Meas_GearIdn2_Val" 0 DISPLAY_IDENTIFIER PwrpkCmpbltyChk.ReceiverPorts.GearIdn2.Val /end MEASUREMENT
/begin MEASUREMENT PwrpkCmpbltyChk.GearIdn2Vld.Logl "MICROSAR RTE" UBYTE RTE_CM_BOOLEAN 0 0 0 255 ECU_ADDRESS 0 SYMBOL_LINK "Rte_CDD_HwTq3Meas_GearIdn2Vld_Logl" 0 DISPLAY_IDENTIFIER PwrpkCmpbltyChk.ReceiverPorts.GearIdn2Vld.Logl /end MEASUREMENT
/begin MEASUREMENT PwrpkCmpbltyChk.GearIdnRefTmr "MICROSAR RTE" ULONG NO_COMPU_METHOD 0 0 0 4294967295 ECU_ADDRESS 0 SYMBOL_LINK "Rte_PwrpkCmpbltyChk_GearIdnRefTmr" 0 DISPLAY_IDENTIFIER PwrpkCmpbltyChk.PerInstanceMemories.GearIdnRefTmr /end MEASUREMENT
/begin MEASUREMENT Rtn.AssiMechT.Val "MICROSAR RTE" FLOAT32_IEEE NO_COMPU_METHOD 0 0 -50.0 150.0 ECU_ADDRESS 0 SYMBOL_LINK "Rte_TEstimn_AssiMechT_Val" 0 DISPLAY_IDENTIFIER Rtn.ReceiverPorts.AssiMechT.Val /end MEASUREMENT
/begin MEASUREMENT Rtn.HwAg.Val "MICROSAR RTE" FLOAT32_IEEE NO_COMPU_METHOD 0 0 -1440.0 1440.0 ECU_ADDRESS 0 SYMBOL_LINK "Rte_HwAgSysArbn_PinionAg_Val" 0 DISPLAY_IDENTIFIER Rtn.ReceiverPorts.HwAg.Val /end MEASUREMENT
/begin MEASUREMENT Rtn.HwAgAuthySca.Val "MICROSAR RTE" FLOAT32_IEEE NO_COMPU_METHOD 0 0 0.0 1.0 ECU_ADDRESS 0 SYMBOL_LINK "Rte_HwAgSysArbn_PinionAgConf_Val" 0 DISPLAY_IDENTIFIER Rtn.ReceiverPorts.HwAgAuthySca.Val /end MEASUREMENT
/begin MEASUREMENT Rtn.HwAgRtnOffs.Val "MICROSAR RTE" FLOAT32_IEEE NO_COMPU_METHOD 0 0 0.0 20.0 ECU_ADDRESS 0 SYMBOL_LINK "Rte_Rtn_HwAgRtnOffs_Val" 0 DISPLAY_IDENTIFIER Rtn.ReceiverPorts.HwAgRtnOffs.Val /end MEASUREMENT
/begin MEASUREMENT Rtn.HwTq.Val "MICROSAR RTE" FLOAT32_IEEE NO_COMPU_METHOD 0 0 -10.0 10.0 ECU_ADDRESS 0 SYMBOL_LINK "Rte_Swp_HwTqSwp_Val" 0 DISPLAY_IDENTIFIER Rtn.ReceiverPorts.HwTq.Val /end MEASUREMENT
/begin MEASUREMENT Rtn.HwVel.Val "MICROSAR RTE" FLOAT32_IEEE NO_COMPU_METHOD 0 0 -42 42 ECU_ADDRESS 0 SYMBOL_LINK "Rte_CDD_MotVel_HwVel_Val" 0 DISPLAY_IDENTIFIER Rtn.ReceiverPorts.HwVel.Val /end MEASUREMENT
/begin MEASUREMENT Rtn.PrevHwAgAuthy "MICROSAR RTE" FLOAT32_IEEE NO_COMPU_METHOD 0 0 0.1 10.0 ECU_ADDRESS 0 SYMBOL_LINK "Rte_Rtn_PrevHwAgAuthy" 0 DISPLAY_IDENTIFIER Rtn.PerInstanceMemories.PrevHwAgAuthy /end MEASUREMENT
/begin MEASUREMENT Rtn.PrevHwAgOffsLimd "MICROSAR RTE" FLOAT32_IEEE NO_COMPU_METHOD 0 0 0.0 20.0 ECU_ADDRESS 0 SYMBOL_LINK "Rte_Rtn_PrevHwAgOffsLimd" 0 DISPLAY_IDENTIFIER Rtn.PerInstanceMemories.PrevHwAgOffsLimd /end MEASUREMENT
/begin MEASUREMENT Rtn.RtnCmd.Val "MICROSAR RTE" FLOAT32_IEEE NO_COMPU_METHOD 0 0 -8.8 8.8 ECU_ADDRESS 0 SYMBOL_LINK "Rte_Rtn_RtnCmd_Val" 0 DISPLAY_IDENTIFIER Rtn.SenderPorts.RtnCmd.Val /end MEASUREMENT
/begin MEASUREMENT Rtn.RtnCmdDi.Logl "MICROSAR RTE" UBYTE RTE_CM_BOOLEAN 0 0 0 255 ECU_ADDRESS 0 SYMBOL_LINK "Rte_CmnMfgSrv_RtnCmdDi_Logl" 0 DISPLAY_IDENTIFIER Rtn.ReceiverPorts.RtnCmdDi.Logl /end MEASUREMENT
/begin MEASUREMENT Rtn.RtnCmdDiagcDi.Logl "MICROSAR RTE" UBYTE RTE_CM_BOOLEAN 0 0 0 255 ECU_ADDRESS 0 SYMBOL_LINK "Rte_Rtn_RtnCmdDiagcDi_Logl" 0 DISPLAY_IDENTIFIER Rtn.ReceiverPorts.RtnCmdDiagcDi.Logl /end MEASUREMENT
/begin MEASUREMENT Rtn.RtnCmdSca.Val "MICROSAR RTE" FLOAT32_IEEE NO_COMPU_METHOD 0 0 0.0 1.0 ECU_ADDRESS 0 SYMBOL_LINK "Rte_GmTqArbn_RtnCmdSca_Val" 0 DISPLAY_IDENTIFIER Rtn.ReceiverPorts.RtnCmdSca.Val /end MEASUREMENT
/begin MEASUREMENT Rtn.RtnCmdScaServo.Val "MICROSAR RTE" FLOAT32_IEEE NO_COMPU_METHOD 0 0 0.0 1.0 ECU_ADDRESS 0 SYMBOL_LINK "Rte_Rtn_RtnCmdScaServo_Val" 0 DISPLAY_IDENTIFIER Rtn.ReceiverPorts.RtnCmdScaServo.Val /end MEASUREMENT
/begin MEASUREMENT Rtn.VehSpd.Val "MICROSAR RTE" FLOAT32_IEEE NO_COMPU_METHOD 0 0 0.0 511.0 ECU_ADDRESS 0 SYMBOL_LINK "Rte_VehSigCdng_VehSpd_Val" 0 DISPLAY_IDENTIFIER Rtn.ReceiverPorts.VehSpd.Val /end MEASUREMENT
/begin MEASUREMENT Rtn.dRtnAbsltHwAgOffsCalcd "MICROSAR RTE" FLOAT32_IEEE NO_COMPU_METHOD 0 0 0.0 1440.0 ECU_ADDRESS 0 SYMBOL_LINK "Rte_Rtn_dRtnAbsltHwAgOffsCalcd" 0 DISPLAY_IDENTIFIER Rtn.PerInstanceMemories.dRtnAbsltHwAgOffsCalcd /end MEASUREMENT
/begin MEASUREMENT Rtn.dRtnAssiMechTRtnSca "MICROSAR RTE" FLOAT32_IEEE NO_COMPU_METHOD 0 0 0.0 1.0 ECU_ADDRESS 0 SYMBOL_LINK "Rte_Rtn_dRtnAssiMechTRtnSca" 0 DISPLAY_IDENTIFIER Rtn.PerInstanceMemories.dRtnAssiMechTRtnSca /end MEASUREMENT
/begin MEASUREMENT Rtn.dRtnBascRtn "MICROSAR RTE" FLOAT32_IEEE NO_COMPU_METHOD 0 0 -8.8 8.8 ECU_ADDRESS 0 SYMBOL_LINK "Rte_Rtn_dRtnBascRtn" 0 DISPLAY_IDENTIFIER Rtn.PerInstanceMemories.dRtnBascRtn /end MEASUREMENT
/begin MEASUREMENT Rtn.dRtnHwAgAuthySca "MICROSAR RTE" FLOAT32_IEEE NO_COMPU_METHOD 0 0 0.0 1.0 ECU_ADDRESS 0 SYMBOL_LINK "Rte_Rtn_dRtnHwAgAuthySca" 0 DISPLAY_IDENTIFIER Rtn.PerInstanceMemories.dRtnHwAgAuthySca /end MEASUREMENT
/begin MEASUREMENT Rtn.dRtnHwAgRtnCmd "MICROSAR RTE" FLOAT32_IEEE NO_COMPU_METHOD 0 0 -8.8 8.8 ECU_ADDRESS 0 SYMBOL_LINK "Rte_Rtn_dRtnHwAgRtnCmd" 0 DISPLAY_IDENTIFIER Rtn.PerInstanceMemories.dRtnHwAgRtnCmd /end MEASUREMENT
/begin MEASUREMENT Rtn.dRtnHwTqRtnSca "MICROSAR RTE" FLOAT32_IEEE NO_COMPU_METHOD 0 0 0.0 1.0 ECU_ADDRESS 0 SYMBOL_LINK "Rte_Rtn_dRtnHwTqRtnSca" 0 DISPLAY_IDENTIFIER Rtn.PerInstanceMemories.dRtnHwTqRtnSca /end MEASUREMENT
/begin MEASUREMENT Rtn.dRtnHwVelRtnSca "MICROSAR RTE" FLOAT32_IEEE NO_COMPU_METHOD 0 0 0.0 1.0 ECU_ADDRESS 0 SYMBOL_LINK "Rte_Rtn_dRtnHwVelRtnSca" 0 DISPLAY_IDENTIFIER Rtn.PerInstanceMemories.dRtnHwVelRtnSca /end MEASUREMENT
/begin MEASUREMENT RtnPahFwl.HwAg.Val "MICROSAR RTE" FLOAT32_IEEE NO_COMPU_METHOD 0 0 -3.402823466e+38 3.402823466e+38 ECU_ADDRESS 0 SYMBOL_LINK "Rte_HwAgSysArbn_PinionAg_Val" 0 DISPLAY_IDENTIFIER RtnPahFwl.ReceiverPorts.HwAg.Val /end MEASUREMENT
/begin MEASUREMENT RtnPahFwl.RtnCmd.Val "MICROSAR RTE" FLOAT32_IEEE NO_COMPU_METHOD 0 0 -3.402823466e+38 3.402823466e+38 ECU_ADDRESS 0 SYMBOL_LINK "Rte_Rtn_RtnCmd_Val" 0 DISPLAY_IDENTIFIER RtnPahFwl.ReceiverPorts.RtnCmd.Val /end MEASUREMENT
/begin MEASUREMENT RtnPahFwl.RtnCmdDi.Logl "MICROSAR RTE" UBYTE RTE_CM_BOOLEAN 0 0 0 255 ECU_ADDRESS 0 SYMBOL_LINK "Rte_CmnMfgSrv_RtnCmdDi_Logl" 0 DISPLAY_IDENTIFIER RtnPahFwl.ReceiverPorts.RtnCmdDi.Logl /end MEASUREMENT
/begin MEASUREMENT RtnPahFwl.RtnCmdLimd.Val "MICROSAR RTE" FLOAT32_IEEE NO_COMPU_METHOD 0 0 -3.402823466e+38 3.402823466e+38 ECU_ADDRESS 0 SYMBOL_LINK "Rte_RtnPahFwl_RtnCmdLimd_Val" 0 DISPLAY_IDENTIFIER RtnPahFwl.SenderPorts.RtnCmdLimd.Val /end MEASUREMENT
/begin MEASUREMENT RtnPahFwl.VehSpd.Val "MICROSAR RTE" FLOAT32_IEEE NO_COMPU_METHOD 0 0 -3.402823466e+38 3.402823466e+38 ECU_ADDRESS 0 SYMBOL_LINK "Rte_VehSigCdng_VehSpd_Val" 0 DISPLAY_IDENTIFIER RtnPahFwl.ReceiverPorts.VehSpd.Val /end MEASUREMENT
/begin MEASUREMENT RtnPahFwl.dRtnPahFwlLowrBnd "MICROSAR RTE" FLOAT32_IEEE NO_COMPU_METHOD 0 0 -3.402823466e+38 3.402823466e+38 ECU_ADDRESS 0 SYMBOL_LINK "Rte_RtnPahFwl_dRtnPahFwlLowrBnd" 0 DISPLAY_IDENTIFIER RtnPahFwl.PerInstanceMemories.dRtnPahFwlLowrBnd /end MEASUREMENT
/begin MEASUREMENT RtnPahFwl.dRtnPahFwlOverBnd "MICROSAR RTE" UBYTE RTE_CM_BOOLEAN 0 0 0 255 ECU_ADDRESS 0 SYMBOL_LINK "Rte_RtnPahFwl_dRtnPahFwlOverBnd" 0 DISPLAY_IDENTIFIER RtnPahFwl.PerInstanceMemories.dRtnPahFwlOverBnd /end MEASUREMENT
/begin MEASUREMENT RtnPahFwl.dRtnPahFwlUpprBnd "MICROSAR RTE" FLOAT32_IEEE NO_COMPU_METHOD 0 0 -3.402823466e+38 3.402823466e+38 ECU_ADDRESS 0 SYMBOL_LINK "Rte_RtnPahFwl_dRtnPahFwlUpprBnd" 0 DISPLAY_IDENTIFIER RtnPahFwl.PerInstanceMemories.dRtnPahFwlUpprBnd /end MEASUREMENT
/begin MEASUREMENT SerlComInpProxy.AbsActvProtdProtnValRaw.Val "MICROSAR RTE" UBYTE NO_COMPU_METHOD 0 0 0 255 ECU_ADDRESS 0 SYMBOL_LINK "Rte_SerlComInpProxy_AbsActvProtdProtnValRaw_Val" 0 DISPLAY_IDENTIFIER SerlComInpProxy.SenderPorts.AbsActvProtdProtnValRaw.Val /end MEASUREMENT
/begin MEASUREMENT SerlComInpProxy.AbsActvProtdRaw.Val "MICROSAR RTE" UBYTE NO_COMPU_METHOD 0 0 0 255 ECU_ADDRESS 0 SYMBOL_LINK "Rte_SerlComInpProxy_AbsActvProtdRaw_Val" 0 DISPLAY_IDENTIFIER SerlComInpProxy.SenderPorts.AbsActvProtdRaw.Val /end MEASUREMENT
/begin MEASUREMENT SerlComInpProxy.AbsActvProtdRollgCntrRaw.Val "MICROSAR RTE" UBYTE NO_COMPU_METHOD 0 0 0 255 ECU_ADDRESS 0 SYMBOL_LINK "Rte_SerlComInpProxy_AbsActvProtdRollgCntrRaw_Val" 0 DISPLAY_IDENTIFIER SerlComInpProxy.SenderPorts.AbsActvProtdRollgCntrRaw.Val /end MEASUREMENT
/begin MEASUREMENT SerlComInpProxy.AbsActvRaw.Val "MICROSAR RTE" UBYTE NO_COMPU_METHOD 0 0 0 255 ECU_ADDRESS 0 SYMBOL_LINK "Rte_SerlComInpProxy_AbsActvRaw_Val" 0 DISPLAY_IDENTIFIER SerlComInpProxy.SenderPorts.AbsActvRaw.Val /end MEASUREMENT
/begin MEASUREMENT SerlComInpProxy.AbsFaildRaw.Val "MICROSAR RTE" UBYTE NO_COMPU_METHOD 0 0 0 255 ECU_ADDRESS 0 SYMBOL_LINK "Rte_SerlComInpProxy_AbsFaildRaw_Val" 0 DISPLAY_IDENTIFIER SerlComInpProxy.SenderPorts.AbsFaildRaw.Val /end MEASUREMENT
/begin MEASUREMENT SerlComInpProxy.BackUpPwrModMstVirtDevAuthyRaw.Val "MICROSAR RTE" UBYTE NO_COMPU_METHOD 0 0 0 255 ECU_ADDRESS 0 SYMBOL_LINK "Rte_SerlComInpProxy_BackUpPwrModMstVirtDevAuthyRaw_Val" 0 DISPLAY_IDENTIFIER SerlComInpProxy.SenderPorts.BackUpPwrModMstVirtDevAuthyRaw.Val /end MEASUREMENT
/begin MEASUREMENT SerlComInpProxy.BusOffChassisExp.Logl "MICROSAR RTE" UBYTE RTE_CM_BOOLEAN 0 0 0 255 ECU_ADDRESS 0 SYMBOL_LINK "Rte_SerlComInpProxy_BusOffChassisExp_Logl" 0 DISPLAY_IDENTIFIER SerlComInpProxy.SenderPorts.BusOffChassisExp.Logl /end MEASUREMENT
/begin MEASUREMENT SerlComInpProxy.BusOffHiSpd.Logl "MICROSAR RTE" UBYTE RTE_CM_BOOLEAN 0 0 0 255 ECU_ADDRESS 0 SYMBOL_LINK "Rte_SerlComInpProxy_BusOffHiSpd_Logl" 0 DISPLAY_IDENTIFIER SerlComInpProxy.SenderPorts.BusOffHiSpd.Logl /end MEASUREMENT
/begin MEASUREMENT SerlComInpProxy.EngOilTRaw.Val "MICROSAR RTE" UBYTE NO_COMPU_METHOD 0 0 0 255 ECU_ADDRESS 0 SYMBOL_LINK "Rte_SerlComInpProxy_EngOilTRaw_Val" 0 DISPLAY_IDENTIFIER SerlComInpProxy.SenderPorts.EngOilTRaw.Val /end MEASUREMENT
/begin MEASUREMENT SerlComInpProxy.EngOilVldRaw.Val "MICROSAR RTE" UBYTE NO_COMPU_METHOD 0 0 0 255 ECU_ADDRESS 0 SYMBOL_LINK "Rte_SerlComInpProxy_EngOilVldRaw_Val" 0 DISPLAY_IDENTIFIER SerlComInpProxy.SenderPorts.EngOilVldRaw.Val /end MEASUREMENT
/begin MEASUREMENT SerlComInpProxy.EngRunActvRaw.Val "MICROSAR RTE" UBYTE NO_COMPU_METHOD 0 0 0 255 ECU_ADDRESS 0 SYMBOL_LINK "Rte_SerlComInpProxy_EngRunActvRaw_Val" 0 DISPLAY_IDENTIFIER SerlComInpProxy.SenderPorts.EngRunActvRaw.Val /end MEASUREMENT
/begin MEASUREMENT SerlComInpProxy.EngSpdRaw.Val "MICROSAR RTE" UWORD NO_COMPU_METHOD 0 0 0 65535 ECU_ADDRESS 0 SYMBOL_LINK "Rte_SerlComInpProxy_EngSpdRaw_Val" 0 DISPLAY_IDENTIFIER SerlComInpProxy.SenderPorts.EngSpdRaw.Val /end MEASUREMENT
/begin MEASUREMENT SerlComInpProxy.EngSpdStsRaw.Val "MICROSAR RTE" UBYTE NO_COMPU_METHOD 0 0 0 255 ECU_ADDRESS 0 SYMBOL_LINK "Rte_SerlComInpProxy_EngSpdStsRaw_Val" 0 DISPLAY_IDENTIFIER SerlComInpProxy.SenderPorts.EngSpdStsRaw.Val /end MEASUREMENT
/begin MEASUREMENT SerlComInpProxy.LeWhlDstPlsCntrRaw.Val "MICROSAR RTE" UWORD NO_COMPU_METHOD 0 0 0 65535 ECU_ADDRESS 0 SYMBOL_LINK "Rte_SerlComInpProxy_LeWhlDstPlsCntrRaw_Val" 0 DISPLAY_IDENTIFIER SerlComInpProxy.SenderPorts.LeWhlDstPlsCntrRaw.Val /end MEASUREMENT
/begin MEASUREMENT SerlComInpProxy.LeWhlDstTiStampRaw.Val "MICROSAR RTE" UWORD NO_COMPU_METHOD 0 0 0 65535 ECU_ADDRESS 0 SYMBOL_LINK "Rte_SerlComInpProxy_LeWhlDstTiStampRaw_Val" 0 DISPLAY_IDENTIFIER SerlComInpProxy.SenderPorts.LeWhlDstTiStampRaw.Val /end MEASUREMENT
/begin MEASUREMENT SerlComInpProxy.LeWhlDstVldRaw.Val "MICROSAR RTE" UBYTE NO_COMPU_METHOD 0 0 0 255 ECU_ADDRESS 0 SYMBOL_LINK "Rte_SerlComInpProxy_LeWhlDstVldRaw_Val" 0 DISPLAY_IDENTIFIER SerlComInpProxy.SenderPorts.LeWhlDstVldRaw.Val /end MEASUREMENT
/begin MEASUREMENT SerlComInpProxy.LeWhlRotlStsRstRaw.Val "MICROSAR RTE" UBYTE NO_COMPU_METHOD 0 0 0 255 ECU_ADDRESS 0 SYMBOL_LINK "Rte_SerlComInpProxy_LeWhlRotlStsRstRaw_Val" 0 DISPLAY_IDENTIFIER SerlComInpProxy.SenderPorts.LeWhlRotlStsRstRaw.Val /end MEASUREMENT
/begin MEASUREMENT SerlComInpProxy.LeWhlSeqNrRaw.Val "MICROSAR RTE" UBYTE NO_COMPU_METHOD 0 0 0 255 ECU_ADDRESS 0 SYMBOL_LINK "Rte_SerlComInpProxy_LeWhlSeqNrRaw_Val" 0 DISPLAY_IDENTIFIER SerlComInpProxy.SenderPorts.LeWhlSeqNrRaw.Val /end MEASUREMENT
/begin MEASUREMENT SerlComInpProxy.LkaCmdProtnValRaw.Val "MICROSAR RTE" UWORD NO_COMPU_METHOD 0 0 0 65535 ECU_ADDRESS 0 SYMBOL_LINK "Rte_SerlComInpProxy_LkaCmdProtnValRaw_Val" 0 DISPLAY_IDENTIFIER SerlComInpProxy.SenderPorts.LkaCmdProtnValRaw.Val /end MEASUREMENT
/begin MEASUREMENT SerlComInpProxy.LkaCmdRollgCntrRaw.Val "MICROSAR RTE" UBYTE NO_COMPU_METHOD 0 0 0 255 ECU_ADDRESS 0 SYMBOL_LINK "Rte_SerlComInpProxy_LkaCmdRollgCntrRaw_Val" 0 DISPLAY_IDENTIFIER SerlComInpProxy.SenderPorts.LkaCmdRollgCntrRaw.Val /end MEASUREMENT
/begin MEASUREMENT SerlComInpProxy.LkaCmdTqReqActvRaw.Val "MICROSAR RTE" UBYTE NO_COMPU_METHOD 0 0 0 255 ECU_ADDRESS 0 SYMBOL_LINK "Rte_SerlComInpProxy_LkaCmdTqReqActvRaw_Val" 0 DISPLAY_IDENTIFIER SerlComInpProxy.SenderPorts.LkaCmdTqReqActvRaw.Val /end MEASUREMENT
/begin MEASUREMENT SerlComInpProxy.LkaCmdTqValRaw.Val "MICROSAR RTE" UWORD NO_COMPU_METHOD 0 0 0 65535 ECU_ADDRESS 0 SYMBOL_LINK "Rte_SerlComInpProxy_LkaCmdTqValRaw_Val" 0 DISPLAY_IDENTIFIER SerlComInpProxy.SenderPorts.LkaCmdTqValRaw.Val /end MEASUREMENT
/begin MEASUREMENT SerlComInpProxy.LstRxnTiMsg0C5.Val "MICROSAR RTE" ULONG NO_COMPU_METHOD 0 0 0 4294967295 ECU_ADDRESS 0 SYMBOL_LINK "Rte_SerlComInpProxy_LstRxnTiMsg0C5_Val" 0 DISPLAY_IDENTIFIER SerlComInpProxy.SenderPorts.LstRxnTiMsg0C5.Val /end MEASUREMENT
/begin MEASUREMENT SerlComInpProxy.LstRxnTiMsg0C9.Val "MICROSAR RTE" ULONG NO_COMPU_METHOD 0 0 0 4294967295 ECU_ADDRESS 0 SYMBOL_LINK "Rte_SerlComInpProxy_LstRxnTiMsg0C9_Val" 0 DISPLAY_IDENTIFIER SerlComInpProxy.SenderPorts.LstRxnTiMsg0C9.Val /end MEASUREMENT
/begin MEASUREMENT SerlComInpProxy.LstRxnTiMsg17D.Val "MICROSAR RTE" ULONG NO_COMPU_METHOD 0 0 0 4294967295 ECU_ADDRESS 0 SYMBOL_LINK "Rte_SerlComInpProxy_LstRxnTiMsg17D_Val" 0 DISPLAY_IDENTIFIER SerlComInpProxy.SenderPorts.LstRxnTiMsg17D.Val /end MEASUREMENT
/begin MEASUREMENT SerlComInpProxy.LstRxnTiMsg180BusChassisExp.Val "MICROSAR RTE" ULONG NO_COMPU_METHOD 0 0 0 4294967295 ECU_ADDRESS 0 SYMBOL_LINK "Rte_SerlComInpProxy_LstRxnTiMsg180BusChassisExp_Val" 0 DISPLAY_IDENTIFIER SerlComInpProxy.SenderPorts.LstRxnTiMsg180BusChassisExp.Val /end MEASUREMENT
/begin MEASUREMENT SerlComInpProxy.LstRxnTiMsg180BusHiSpd.Val "MICROSAR RTE" ULONG NO_COMPU_METHOD 0 0 0 4294967295 ECU_ADDRESS 0 SYMBOL_LINK "Rte_SerlComInpProxy_LstRxnTiMsg180BusHiSpd_Val" 0 DISPLAY_IDENTIFIER SerlComInpProxy.SenderPorts.LstRxnTiMsg180BusHiSpd.Val /end MEASUREMENT
/begin MEASUREMENT SerlComInpProxy.LstRxnTiMsg182.Val "MICROSAR RTE" ULONG NO_COMPU_METHOD 0 0 0 4294967295 ECU_ADDRESS 0 SYMBOL_LINK "Rte_SerlComInpProxy_LstRxnTiMsg182_Val" 0 DISPLAY_IDENTIFIER SerlComInpProxy.SenderPorts.LstRxnTiMsg182.Val /end MEASUREMENT
/begin MEASUREMENT SerlComInpProxy.LstRxnTiMsg1E9.Val "MICROSAR RTE" ULONG NO_COMPU_METHOD 0 0 0 4294967295 ECU_ADDRESS 0 SYMBOL_LINK "Rte_SerlComInpProxy_LstRxnTiMsg1E9_Val" 0 DISPLAY_IDENTIFIER SerlComInpProxy.SenderPorts.LstRxnTiMsg1E9.Val /end MEASUREMENT
/begin MEASUREMENT SerlComInpProxy.LstRxnTiMsg1F1.Val "MICROSAR RTE" ULONG NO_COMPU_METHOD 0 0 0 4294967295 ECU_ADDRESS 0 SYMBOL_LINK "Rte_SerlComInpProxy_LstRxnTiMsg1F1_Val" 0 DISPLAY_IDENTIFIER SerlComInpProxy.SenderPorts.LstRxnTiMsg1F1.Val /end MEASUREMENT
/begin MEASUREMENT SerlComInpProxy.LstRxnTiMsg1F5.Val "MICROSAR RTE" ULONG NO_COMPU_METHOD 0 0 0 4294967295 ECU_ADDRESS 0 SYMBOL_LINK "Rte_SerlComInpProxy_LstRxnTiMsg1F5_Val" 0 DISPLAY_IDENTIFIER SerlComInpProxy.SenderPorts.LstRxnTiMsg1F5.Val /end MEASUREMENT
/begin MEASUREMENT SerlComInpProxy.LstRxnTiMsg214.Val "MICROSAR RTE" ULONG NO_COMPU_METHOD 0 0 0 4294967295 ECU_ADDRESS 0 SYMBOL_LINK "Rte_SerlComInpProxy_LstRxnTiMsg214_Val" 0 DISPLAY_IDENTIFIER SerlComInpProxy.SenderPorts.LstRxnTiMsg214.Val /end MEASUREMENT
/begin MEASUREMENT SerlComInpProxy.LstRxnTiMsg232.Val "MICROSAR RTE" ULONG NO_COMPU_METHOD 0 0 0 4294967295 ECU_ADDRESS 0 SYMBOL_LINK "Rte_SerlComInpProxy_LstRxnTiMsg232_Val" 0 DISPLAY_IDENTIFIER SerlComInpProxy.SenderPorts.LstRxnTiMsg232.Val /end MEASUREMENT
/begin MEASUREMENT SerlComInpProxy.LstRxnTiMsg337BusChassisExp.Val "MICROSAR RTE" ULONG NO_COMPU_METHOD 0 0 0 4294967295 ECU_ADDRESS 0 SYMBOL_LINK "Rte_SerlComInpProxy_LstRxnTiMsg337BusChassisExp_Val" 0 DISPLAY_IDENTIFIER SerlComInpProxy.SenderPorts.LstRxnTiMsg337BusChassisExp.Val /end MEASUREMENT
/begin MEASUREMENT SerlComInpProxy.LstRxnTiMsg348BusChassisExp.Val "MICROSAR RTE" ULONG NO_COMPU_METHOD 0 0 0 4294967295 ECU_ADDRESS 0 SYMBOL_LINK "Rte_SerlComInpProxy_LstRxnTiMsg348BusChassisExp_Val" 0 DISPLAY_IDENTIFIER SerlComInpProxy.SenderPorts.LstRxnTiMsg348BusChassisExp.Val /end MEASUREMENT
/begin MEASUREMENT SerlComInpProxy.LstRxnTiMsg348BusHiSpd.Val "MICROSAR RTE" ULONG NO_COMPU_METHOD 0 0 0 4294967295 ECU_ADDRESS 0 SYMBOL_LINK "Rte_SerlComInpProxy_LstRxnTiMsg348BusHiSpd_Val" 0 DISPLAY_IDENTIFIER SerlComInpProxy.SenderPorts.LstRxnTiMsg348BusHiSpd.Val /end MEASUREMENT
/begin MEASUREMENT SerlComInpProxy.LstRxnTiMsg34ABusChassisExp.Val "MICROSAR RTE" ULONG NO_COMPU_METHOD 0 0 0 4294967295 ECU_ADDRESS 0 SYMBOL_LINK "Rte_SerlComInpProxy_LstRxnTiMsg34ABusChassisExp_Val" 0 DISPLAY_IDENTIFIER SerlComInpProxy.SenderPorts.LstRxnTiMsg34ABusChassisExp.Val /end MEASUREMENT
/begin MEASUREMENT SerlComInpProxy.LstRxnTiMsg34ABusHiSpd.Val "MICROSAR RTE" ULONG NO_COMPU_METHOD 0 0 0 4294967295 ECU_ADDRESS 0 SYMBOL_LINK "Rte_SerlComInpProxy_LstRxnTiMsg34ABusHiSpd_Val" 0 DISPLAY_IDENTIFIER SerlComInpProxy.SenderPorts.LstRxnTiMsg34ABusHiSpd.Val /end MEASUREMENT
/begin MEASUREMENT SerlComInpProxy.LstRxnTiMsg3F1.Val "MICROSAR RTE" ULONG NO_COMPU_METHOD 0 0 0 4294967295 ECU_ADDRESS 0 SYMBOL_LINK "Rte_SerlComInpProxy_LstRxnTiMsg3F1_Val" 0 DISPLAY_IDENTIFIER SerlComInpProxy.SenderPorts.LstRxnTiMsg3F1.Val /end MEASUREMENT
/begin MEASUREMENT SerlComInpProxy.LstRxnTiMsg4D1.Val "MICROSAR RTE" ULONG NO_COMPU_METHOD 0 0 0 4294967295 ECU_ADDRESS 0 SYMBOL_LINK "Rte_SerlComInpProxy_LstRxnTiMsg4D1_Val" 0 DISPLAY_IDENTIFIER SerlComInpProxy.SenderPorts.LstRxnTiMsg4D1.Val /end MEASUREMENT
/begin MEASUREMENT SerlComInpProxy.LstRxnTiMsg500BusHiSpd.Val "MICROSAR RTE" ULONG NO_COMPU_METHOD 0 0 0 4294967295 ECU_ADDRESS 0 SYMBOL_LINK "Rte_SerlComInpProxy_LstRxnTiMsg500BusHiSpd_Val" 0 DISPLAY_IDENTIFIER SerlComInpProxy.SenderPorts.LstRxnTiMsg500BusHiSpd.Val /end MEASUREMENT
/begin MEASUREMENT SerlComInpProxy.OutdAirTCorrdValMaskRaw.Val "MICROSAR RTE" UBYTE NO_COMPU_METHOD 0 0 0 255 ECU_ADDRESS 0 SYMBOL_LINK "Rte_SerlComInpProxy_OutdAirTCorrdValMaskRaw_Val" 0 DISPLAY_IDENTIFIER SerlComInpProxy.SenderPorts.OutdAirTCorrdValMaskRaw.Val /end MEASUREMENT
/begin MEASUREMENT SerlComInpProxy.OutdAirTCorrdValRaw.Val "MICROSAR RTE" UBYTE NO_COMPU_METHOD 0 0 0 255 ECU_ADDRESS 0 SYMBOL_LINK "Rte_SerlComInpProxy_OutdAirTCorrdValRaw_Val" 0 DISPLAY_IDENTIFIER SerlComInpProxy.SenderPorts.OutdAirTCorrdValRaw.Val /end MEASUREMENT
/begin MEASUREMENT SerlComInpProxy.OutdAirTCorrdValVldRaw.Val "MICROSAR RTE" UBYTE NO_COMPU_METHOD 0 0 0 255 ECU_ADDRESS 0 SYMBOL_LINK "Rte_SerlComInpProxy_OutdAirTCorrdValVldRaw_Val" 0 DISPLAY_IDENTIFIER SerlComInpProxy.SenderPorts.OutdAirTCorrdValVldRaw.Val /end MEASUREMENT
/begin MEASUREMENT SerlComInpProxy.PtCrkActvRaw.Val "MICROSAR RTE" UBYTE NO_COMPU_METHOD 0 0 0 255 ECU_ADDRESS 0 SYMBOL_LINK "Rte_SerlComInpProxy_PtCrkActvRaw_Val" 0 DISPLAY_IDENTIFIER SerlComInpProxy.SenderPorts.PtCrkActvRaw.Val /end MEASUREMENT
/begin MEASUREMENT SerlComInpProxy.RdntVehStabyEnhmtSysActvRaw.Val "MICROSAR RTE" UBYTE NO_COMPU_METHOD 0 0 0 255 ECU_ADDRESS 0 SYMBOL_LINK "Rte_SerlComInpProxy_RdntVehStabyEnhmtSysActvRaw_Val" 0 DISPLAY_IDENTIFIER SerlComInpProxy.SenderPorts.RdntVehStabyEnhmtSysActvRaw.Val /end MEASUREMENT
/begin MEASUREMENT SerlComInpProxy.RdntVehStabyEnhmtSysActvRollgCntrRaw.Val "MICROSAR RTE" UBYTE NO_COMPU_METHOD 0 0 0 255 ECU_ADDRESS 0 SYMBOL_LINK "Rte_SerlComInpProxy_RdntVehStabyEnhmtSysActvRollgCntrRaw_Val" 0 DISPLAY_IDENTIFIER SerlComInpProxy.SenderPorts.RdntVehStabyEnhmtSysActvRollgCntrRaw.Val /end MEASUREMENT
/begin MEASUREMENT SerlComInpProxy.RiWhlDstPlsCntrRaw.Val "MICROSAR RTE" UWORD NO_COMPU_METHOD 0 0 0 65535 ECU_ADDRESS 0 SYMBOL_LINK "Rte_SerlComInpProxy_RiWhlDstPlsCntrRaw_Val" 0 DISPLAY_IDENTIFIER SerlComInpProxy.SenderPorts.RiWhlDstPlsCntrRaw.Val /end MEASUREMENT
/begin MEASUREMENT SerlComInpProxy.RiWhlDstTiStampRaw.Val "MICROSAR RTE" UWORD NO_COMPU_METHOD 0 0 0 65535 ECU_ADDRESS 0 SYMBOL_LINK "Rte_SerlComInpProxy_RiWhlDstTiStampRaw_Val" 0 DISPLAY_IDENTIFIER SerlComInpProxy.SenderPorts.RiWhlDstTiStampRaw.Val /end MEASUREMENT
/begin MEASUREMENT SerlComInpProxy.RiWhlDstVldRaw.Val "MICROSAR RTE" UBYTE NO_COMPU_METHOD 0 0 0 255 ECU_ADDRESS 0 SYMBOL_LINK "Rte_SerlComInpProxy_RiWhlDstVldRaw_Val" 0 DISPLAY_IDENTIFIER SerlComInpProxy.SenderPorts.RiWhlDstVldRaw.Val /end MEASUREMENT
/begin MEASUREMENT SerlComInpProxy.RiWhlRotlStsRstRaw.Val "MICROSAR RTE" UBYTE NO_COMPU_METHOD 0 0 0 255 ECU_ADDRESS 0 SYMBOL_LINK "Rte_SerlComInpProxy_RiWhlRotlStsRstRaw_Val" 0 DISPLAY_IDENTIFIER SerlComInpProxy.SenderPorts.RiWhlRotlStsRstRaw.Val /end MEASUREMENT
/begin MEASUREMENT SerlComInpProxy.RiWhlSeqNrRaw.Val "MICROSAR RTE" UBYTE NO_COMPU_METHOD 0 0 0 255 ECU_ADDRESS 0 SYMBOL_LINK "Rte_SerlComInpProxy_RiWhlSeqNrRaw_Val" 0 DISPLAY_IDENTIFIER SerlComInpProxy.SenderPorts.RiWhlSeqNrRaw.Val /end MEASUREMENT
/begin MEASUREMENT SerlComInpProxy.ShiftLvrPosnRaw.Val "MICROSAR RTE" UBYTE NO_COMPU_METHOD 0 0 0 255 ECU_ADDRESS 0 SYMBOL_LINK "Rte_SerlComInpProxy_ShiftLvrPosnRaw_Val" 0 DISPLAY_IDENTIFIER SerlComInpProxy.SenderPorts.ShiftLvrPosnRaw.Val /end MEASUREMENT
/begin MEASUREMENT SerlComInpProxy.ShiftLvrPosnVldRaw.Val "MICROSAR RTE" UBYTE NO_COMPU_METHOD 0 0 0 255 ECU_ADDRESS 0 SYMBOL_LINK "Rte_SerlComInpProxy_ShiftLvrPosnVldRaw_Val" 0 DISPLAY_IDENTIFIER SerlComInpProxy.SenderPorts.ShiftLvrPosnVldRaw.Val /end MEASUREMENT
/begin MEASUREMENT SerlComInpProxy.SteerSysPrfmncModReqRaw.Val "MICROSAR RTE" UBYTE NO_COMPU_METHOD 0 0 0 255 ECU_ADDRESS 0 SYMBOL_LINK "Rte_SerlComInpProxy_SteerSysPrfmncModReqRaw_Val" 0 DISPLAY_IDENTIFIER SerlComInpProxy.SenderPorts.SteerSysPrfmncModReqRaw.Val /end MEASUREMENT
/begin MEASUREMENT SerlComInpProxy.SteerWhlAgReqActvRaw.Val "MICROSAR RTE" UBYTE NO_COMPU_METHOD 0 0 0 255 ECU_ADDRESS 0 SYMBOL_LINK "Rte_SerlComInpProxy_SteerWhlAgReqActvRaw_Val" 0 DISPLAY_IDENTIFIER SerlComInpProxy.SenderPorts.SteerWhlAgReqActvRaw.Val /end MEASUREMENT
/begin MEASUREMENT SerlComInpProxy.SteerWhlAgReqActvVldRaw.Val "MICROSAR RTE" UBYTE NO_COMPU_METHOD 0 0 0 255 ECU_ADDRESS 0 SYMBOL_LINK "Rte_SerlComInpProxy_SteerWhlAgReqActvVldRaw_Val" 0 DISPLAY_IDENTIFIER SerlComInpProxy.SenderPorts.SteerWhlAgReqActvVldRaw.Val /end MEASUREMENT
/begin MEASUREMENT SerlComInpProxy.SteerWhlAgReqProtnValRaw.Val "MICROSAR RTE" ULONG NO_COMPU_METHOD 0 0 0 4294967295 ECU_ADDRESS 0 SYMBOL_LINK "Rte_SerlComInpProxy_SteerWhlAgReqProtnValRaw_Val" 0 DISPLAY_IDENTIFIER SerlComInpProxy.SenderPorts.SteerWhlAgReqProtnValRaw.Val /end MEASUREMENT
/begin MEASUREMENT SerlComInpProxy.SteerWhlAgReqRollgCntrRaw.Val "MICROSAR RTE" UBYTE NO_COMPU_METHOD 0 0 0 255 ECU_ADDRESS 0 SYMBOL_LINK "Rte_SerlComInpProxy_SteerWhlAgReqRollgCntrRaw_Val" 0 DISPLAY_IDENTIFIER SerlComInpProxy.SenderPorts.SteerWhlAgReqRollgCntrRaw.Val /end MEASUREMENT
/begin MEASUREMENT SerlComInpProxy.SteerWhlAgReqTarAgRaw.Val "MICROSAR RTE" UWORD NO_COMPU_METHOD 0 0 0 65535 ECU_ADDRESS 0 SYMBOL_LINK "Rte_SerlComInpProxy_SteerWhlAgReqTarAgRaw_Val" 0 DISPLAY_IDENTIFIER SerlComInpProxy.SenderPorts.SteerWhlAgReqTarAgRaw.Val /end MEASUREMENT
/begin MEASUREMENT SerlComInpProxy.SteerWhlFbReqActvProtnValRaw.Val "MICROSAR RTE" UBYTE NO_COMPU_METHOD 0 0 0 255 ECU_ADDRESS 0 SYMBOL_LINK "Rte_SerlComInpProxy_SteerWhlFbReqActvProtnValRaw_Val" 0 DISPLAY_IDENTIFIER SerlComInpProxy.SenderPorts.SteerWhlFbReqActvProtnValRaw.Val /end MEASUREMENT
/begin MEASUREMENT SerlComInpProxy.SteerWhlFbReqActvRaw.Val "MICROSAR RTE" UBYTE NO_COMPU_METHOD 0 0 0 255 ECU_ADDRESS 0 SYMBOL_LINK "Rte_SerlComInpProxy_SteerWhlFbReqActvRaw_Val" 0 DISPLAY_IDENTIFIER SerlComInpProxy.SenderPorts.SteerWhlFbReqActvRaw.Val /end MEASUREMENT
/begin MEASUREMENT SerlComInpProxy.SteerWhlFbReqActvRollgCntrRaw.Val "MICROSAR RTE" UBYTE NO_COMPU_METHOD 0 0 0 255 ECU_ADDRESS 0 SYMBOL_LINK "Rte_SerlComInpProxy_SteerWhlFbReqActvRollgCntrRaw_Val" 0 DISPLAY_IDENTIFIER SerlComInpProxy.SenderPorts.SteerWhlFbReqActvRollgCntrRaw.Val /end MEASUREMENT
/begin MEASUREMENT SerlComInpProxy.SysBackUpPwrModEnaRaw.Val "MICROSAR RTE" UBYTE NO_COMPU_METHOD 0 0 0 255 ECU_ADDRESS 0 SYMBOL_LINK "Rte_SerlComInpProxy_SysBackUpPwrModEnaRaw_Val" 0 DISPLAY_IDENTIFIER SerlComInpProxy.SenderPorts.SysBackUpPwrModEnaRaw.Val /end MEASUREMENT
/begin MEASUREMENT SerlComInpProxy.SysBackUpPwrModRaw.Val "MICROSAR RTE" UBYTE NO_COMPU_METHOD 0 0 0 255 ECU_ADDRESS 0 SYMBOL_LINK "Rte_SerlComInpProxy_SysBackUpPwrModRaw_Val" 0 DISPLAY_IDENTIFIER SerlComInpProxy.SenderPorts.SysBackUpPwrModRaw.Val /end MEASUREMENT
/begin MEASUREMENT SerlComInpProxy.SysPwrModRaw.Val "MICROSAR RTE" UBYTE NO_COMPU_METHOD 0 0 0 255 ECU_ADDRESS 0 SYMBOL_LINK "Rte_SerlComInpProxy_SysPwrModRaw_Val" 0 DISPLAY_IDENTIFIER SerlComInpProxy.SenderPorts.SysPwrModRaw.Val /end MEASUREMENT
/begin MEASUREMENT SerlComInpProxy.TqOvrlAlvRollgCntrRaw.Val "MICROSAR RTE" UBYTE NO_COMPU_METHOD 0 0 0 255 ECU_ADDRESS 0 SYMBOL_LINK "Rte_SerlComInpProxy_TqOvrlAlvRollgCntrRaw_Val" 0 DISPLAY_IDENTIFIER SerlComInpProxy.SenderPorts.TqOvrlAlvRollgCntrRaw.Val /end MEASUREMENT
/begin MEASUREMENT SerlComInpProxy.TqOvrlCmdChksRaw.Val "MICROSAR RTE" UWORD NO_COMPU_METHOD 0 0 0 65535 ECU_ADDRESS 0 SYMBOL_LINK "Rte_SerlComInpProxy_TqOvrlCmdChksRaw_Val" 0 DISPLAY_IDENTIFIER SerlComInpProxy.SenderPorts.TqOvrlCmdChksRaw.Val /end MEASUREMENT
/begin MEASUREMENT SerlComInpProxy.TqOvrlDeltaTqCmdActvRaw.Val "MICROSAR RTE" UBYTE NO_COMPU_METHOD 0 0 0 255 ECU_ADDRESS 0 SYMBOL_LINK "Rte_SerlComInpProxy_TqOvrlDeltaTqCmdActvRaw_Val" 0 DISPLAY_IDENTIFIER SerlComInpProxy.SenderPorts.TqOvrlDeltaTqCmdActvRaw.Val /end MEASUREMENT
/begin MEASUREMENT SerlComInpProxy.TqOvrlDeltaTqCmdValRaw.Val "MICROSAR RTE" UWORD NO_COMPU_METHOD 0 0 0 65535 ECU_ADDRESS 0 SYMBOL_LINK "Rte_SerlComInpProxy_TqOvrlDeltaTqCmdValRaw_Val" 0 DISPLAY_IDENTIFIER SerlComInpProxy.SenderPorts.TqOvrlDeltaTqCmdValRaw.Val /end MEASUREMENT
/begin MEASUREMENT SerlComInpProxy.TracCtrlSysActvRaw.Val "MICROSAR RTE" UBYTE NO_COMPU_METHOD 0 0 0 255 ECU_ADDRESS 0 SYMBOL_LINK "Rte_SerlComInpProxy_TracCtrlSysActvRaw_Val" 0 DISPLAY_IDENTIFIER SerlComInpProxy.SenderPorts.TracCtrlSysActvRaw.Val /end MEASUREMENT
/begin MEASUREMENT SerlComInpProxy.TracCtrlSysEnaRaw.Val "MICROSAR RTE" UBYTE NO_COMPU_METHOD 0 0 0 255 ECU_ADDRESS 0 SYMBOL_LINK "Rte_SerlComInpProxy_TracCtrlSysEnaRaw_Val" 0 DISPLAY_IDENTIFIER SerlComInpProxy.SenderPorts.TracCtrlSysEnaRaw.Val /end MEASUREMENT
/begin MEASUREMENT SerlComInpProxy.VehDynCtrlSysStRaw.Val "MICROSAR RTE" UBYTE NO_COMPU_METHOD 0 0 0 255 ECU_ADDRESS 0 SYMBOL_LINK "Rte_SerlComInpProxy_VehDynCtrlSysStRaw_Val" 0 DISPLAY_IDENTIFIER SerlComInpProxy.SenderPorts.VehDynCtrlSysStRaw.Val /end MEASUREMENT
/begin MEASUREMENT SerlComInpProxy.VehDynOverUnderSteerVldRaw.Val "MICROSAR RTE" UBYTE NO_COMPU_METHOD 0 0 0 255 ECU_ADDRESS 0 SYMBOL_LINK "Rte_SerlComInpProxy_VehDynOverUnderSteerVldRaw_Val" 0 DISPLAY_IDENTIFIER SerlComInpProxy.SenderPorts.VehDynOverUnderSteerVldRaw.Val /end MEASUREMENT
/begin MEASUREMENT SerlComInpProxy.VehDynYawRateRaw.Val "MICROSAR RTE" UWORD NO_COMPU_METHOD 0 0 0 65535 ECU_ADDRESS 0 SYMBOL_LINK "Rte_SerlComInpProxy_VehDynYawRateRaw_Val" 0 DISPLAY_IDENTIFIER SerlComInpProxy.SenderPorts.VehDynYawRateRaw.Val /end MEASUREMENT
/begin MEASUREMENT SerlComInpProxy.VehDynYawRateVldRaw.Val "MICROSAR RTE" UBYTE NO_COMPU_METHOD 0 0 0 255 ECU_ADDRESS 0 SYMBOL_LINK "Rte_SerlComInpProxy_VehDynYawRateVldRaw_Val" 0 DISPLAY_IDENTIFIER SerlComInpProxy.SenderPorts.VehDynYawRateVldRaw.Val /end MEASUREMENT
/begin MEASUREMENT SerlComInpProxy.VehStabyEnhmtActvRaw.Val "MICROSAR RTE" UBYTE NO_COMPU_METHOD 0 0 0 255 ECU_ADDRESS 0 SYMBOL_LINK "Rte_SerlComInpProxy_VehStabyEnhmtActvRaw_Val" 0 DISPLAY_IDENTIFIER SerlComInpProxy.SenderPorts.VehStabyEnhmtActvRaw.Val /end MEASUREMENT
/begin MEASUREMENT SerlComInpProxy.VehStabyEnhmtLatARaw.Val "MICROSAR RTE" UWORD NO_COMPU_METHOD 0 0 0 65535 ECU_ADDRESS 0 SYMBOL_LINK "Rte_SerlComInpProxy_VehStabyEnhmtLatARaw_Val" 0 DISPLAY_IDENTIFIER SerlComInpProxy.SenderPorts.VehStabyEnhmtLatARaw.Val /end MEASUREMENT
/begin MEASUREMENT SerlComInpProxy.VehStabyEnhmtLatAVldRaw.Val "MICROSAR RTE" UBYTE NO_COMPU_METHOD 0 0 0 255 ECU_ADDRESS 0 SYMBOL_LINK "Rte_SerlComInpProxy_VehStabyEnhmtLatAVldRaw_Val" 0 DISPLAY_IDENTIFIER SerlComInpProxy.SenderPorts.VehStabyEnhmtLatAVldRaw.Val /end MEASUREMENT
/begin MEASUREMENT SerlComInpProxy.VehStabyEnhmtLgtALoReslRaw.Val "MICROSAR RTE" UWORD NO_COMPU_METHOD 0 0 0 65535 ECU_ADDRESS 0 SYMBOL_LINK "Rte_SerlComInpProxy_VehStabyEnhmtLgtALoReslRaw_Val" 0 DISPLAY_IDENTIFIER SerlComInpProxy.SenderPorts.VehStabyEnhmtLgtALoReslRaw.Val /end MEASUREMENT
/begin MEASUREMENT SerlComInpProxy.VehStabyEnhmtLgtALoReslVldRaw.Val "MICROSAR RTE" UBYTE NO_COMPU_METHOD 0 0 0 255 ECU_ADDRESS 0 SYMBOL_LINK "Rte_SerlComInpProxy_VehStabyEnhmtLgtALoReslVldRaw_Val" 0 DISPLAY_IDENTIFIER SerlComInpProxy.SenderPorts.VehStabyEnhmtLgtALoReslVldRaw.Val /end MEASUREMENT
/begin MEASUREMENT SerlComInpProxy.VehStabyEnhmtStsRaw.Val "MICROSAR RTE" UBYTE NO_COMPU_METHOD 0 0 0 255 ECU_ADDRESS 0 SYMBOL_LINK "Rte_SerlComInpProxy_VehStabyEnhmtStsRaw_Val" 0 DISPLAY_IDENTIFIER SerlComInpProxy.SenderPorts.VehStabyEnhmtStsRaw.Val /end MEASUREMENT
/begin MEASUREMENT SerlComInpProxy.WhlGndVelLeDrvnRawBusChassisExp.Val "MICROSAR RTE" UWORD NO_COMPU_METHOD 0 0 0 65535 ECU_ADDRESS 0 SYMBOL_LINK "Rte_SerlComInpProxy_WhlGndVelLeDrvnRawBusChassisExp_Val" 0 DISPLAY_IDENTIFIER SerlComInpProxy.SenderPorts.WhlGndVelLeDrvnRawBusChassisExp.Val /end MEASUREMENT
/begin MEASUREMENT SerlComInpProxy.WhlGndVelLeDrvnRawBusHiSpd.Val "MICROSAR RTE" UWORD NO_COMPU_METHOD 0 0 0 65535 ECU_ADDRESS 0 SYMBOL_LINK "Rte_SerlComInpProxy_WhlGndVelLeDrvnRawBusHiSpd_Val" 0 DISPLAY_IDENTIFIER SerlComInpProxy.SenderPorts.WhlGndVelLeDrvnRawBusHiSpd.Val /end MEASUREMENT
/begin MEASUREMENT SerlComInpProxy.WhlGndVelLeDrvnVldRawBusChassisExp.Val "MICROSAR RTE" UBYTE NO_COMPU_METHOD 0 0 0 255 ECU_ADDRESS 0 SYMBOL_LINK "Rte_SerlComInpProxy_WhlGndVelLeDrvnVldRawBusChassisExp_Val" 0 DISPLAY_IDENTIFIER SerlComInpProxy.SenderPorts.WhlGndVelLeDrvnVldRawBusChassisExp.Val /end MEASUREMENT
/begin MEASUREMENT SerlComInpProxy.WhlGndVelLeDrvnVldRawBusHiSpd.Val "MICROSAR RTE" UBYTE NO_COMPU_METHOD 0 0 0 255 ECU_ADDRESS 0 SYMBOL_LINK "Rte_SerlComInpProxy_WhlGndVelLeDrvnVldRawBusHiSpd_Val" 0 DISPLAY_IDENTIFIER SerlComInpProxy.SenderPorts.WhlGndVelLeDrvnVldRawBusHiSpd.Val /end MEASUREMENT
/begin MEASUREMENT SerlComInpProxy.WhlGndVelLeNonDrvnRawBusChassisExp.Val "MICROSAR RTE" UWORD NO_COMPU_METHOD 0 0 0 65535 ECU_ADDRESS 0 SYMBOL_LINK "Rte_SerlComInpProxy_WhlGndVelLeNonDrvnRawBusChassisExp_Val" 0 DISPLAY_IDENTIFIER SerlComInpProxy.SenderPorts.WhlGndVelLeNonDrvnRawBusChassisExp.Val /end MEASUREMENT
/begin MEASUREMENT SerlComInpProxy.WhlGndVelLeNonDrvnRawBusHiSpd.Val "MICROSAR RTE" UWORD NO_COMPU_METHOD 0 0 0 65535 ECU_ADDRESS 0 SYMBOL_LINK "Rte_SerlComInpProxy_WhlGndVelLeNonDrvnRawBusHiSpd_Val" 0 DISPLAY_IDENTIFIER SerlComInpProxy.SenderPorts.WhlGndVelLeNonDrvnRawBusHiSpd.Val /end MEASUREMENT
/begin MEASUREMENT SerlComInpProxy.WhlGndVelLeNonDrvnVldRawBusChassisExp.Val "MICROSAR RTE" UBYTE NO_COMPU_METHOD 0 0 0 255 ECU_ADDRESS 0 SYMBOL_LINK "Rte_SerlComInpProxy_WhlGndVelLeNonDrvnVldRawBusChassisExp_Val" 0 DISPLAY_IDENTIFIER SerlComInpProxy.SenderPorts.WhlGndVelLeNonDrvnVldRawBusChassisExp.Val /end MEASUREMENT
/begin MEASUREMENT SerlComInpProxy.WhlGndVelLeNonDrvnVldRawBusHiSpd.Val "MICROSAR RTE" UBYTE NO_COMPU_METHOD 0 0 0 255 ECU_ADDRESS 0 SYMBOL_LINK "Rte_SerlComInpProxy_WhlGndVelLeNonDrvnVldRawBusHiSpd_Val" 0 DISPLAY_IDENTIFIER SerlComInpProxy.SenderPorts.WhlGndVelLeNonDrvnVldRawBusHiSpd.Val /end MEASUREMENT
/begin MEASUREMENT SerlComInpProxy.WhlGndVelRiDrvnRawBusChassisExp.Val "MICROSAR RTE" UWORD NO_COMPU_METHOD 0 0 0 65535 ECU_ADDRESS 0 SYMBOL_LINK "Rte_SerlComInpProxy_WhlGndVelRiDrvnRawBusChassisExp_Val" 0 DISPLAY_IDENTIFIER SerlComInpProxy.SenderPorts.WhlGndVelRiDrvnRawBusChassisExp.Val /end MEASUREMENT
/begin MEASUREMENT SerlComInpProxy.WhlGndVelRiDrvnRawBusHiSpd.Val "MICROSAR RTE" UWORD NO_COMPU_METHOD 0 0 0 65535 ECU_ADDRESS 0 SYMBOL_LINK "Rte_SerlComInpProxy_WhlGndVelRiDrvnRawBusHiSpd_Val" 0 DISPLAY_IDENTIFIER SerlComInpProxy.SenderPorts.WhlGndVelRiDrvnRawBusHiSpd.Val /end MEASUREMENT
/begin MEASUREMENT SerlComInpProxy.WhlGndVelRiDrvnVldRawBusChassisExp.Val "MICROSAR RTE" UBYTE NO_COMPU_METHOD 0 0 0 255 ECU_ADDRESS 0 SYMBOL_LINK "Rte_SerlComInpProxy_WhlGndVelRiDrvnVldRawBusChassisExp_Val" 0 DISPLAY_IDENTIFIER SerlComInpProxy.SenderPorts.WhlGndVelRiDrvnVldRawBusChassisExp.Val /end MEASUREMENT
/begin MEASUREMENT SerlComInpProxy.WhlGndVelRiDrvnVldRawBusHiSpd.Val "MICROSAR RTE" UBYTE NO_COMPU_METHOD 0 0 0 255 ECU_ADDRESS 0 SYMBOL_LINK "Rte_SerlComInpProxy_WhlGndVelRiDrvnVldRawBusHiSpd_Val" 0 DISPLAY_IDENTIFIER SerlComInpProxy.SenderPorts.WhlGndVelRiDrvnVldRawBusHiSpd.Val /end MEASUREMENT
/begin MEASUREMENT SerlComInpProxy.WhlGndVelRiNonDrvnRawBusChassisExp.Val "MICROSAR RTE" UWORD NO_COMPU_METHOD 0 0 0 65535 ECU_ADDRESS 0 SYMBOL_LINK "Rte_SerlComInpProxy_WhlGndVelRiNonDrvnRawBusChassisExp_Val" 0 DISPLAY_IDENTIFIER SerlComInpProxy.SenderPorts.WhlGndVelRiNonDrvnRawBusChassisExp.Val /end MEASUREMENT
/begin MEASUREMENT SerlComInpProxy.WhlGndVelRiNonDrvnRawBusHiSpd.Val "MICROSAR RTE" UWORD NO_COMPU_METHOD 0 0 0 65535 ECU_ADDRESS 0 SYMBOL_LINK "Rte_SerlComInpProxy_WhlGndVelRiNonDrvnRawBusHiSpd_Val" 0 DISPLAY_IDENTIFIER SerlComInpProxy.SenderPorts.WhlGndVelRiNonDrvnRawBusHiSpd.Val /end MEASUREMENT
/begin MEASUREMENT SerlComInpProxy.WhlGndVelRiNonDrvnVldRawBusChassisExp.Val "MICROSAR RTE" UBYTE NO_COMPU_METHOD 0 0 0 255 ECU_ADDRESS 0 SYMBOL_LINK "Rte_SerlComInpProxy_WhlGndVelRiNonDrvnVldRawBusChassisExp_Val" 0 DISPLAY_IDENTIFIER SerlComInpProxy.SenderPorts.WhlGndVelRiNonDrvnVldRawBusChassisExp.Val /end MEASUREMENT
/begin MEASUREMENT SerlComInpProxy.WhlGndVelRiNonDrvnVldRawBusHiSpd.Val "MICROSAR RTE" UBYTE NO_COMPU_METHOD 0 0 0 255 ECU_ADDRESS 0 SYMBOL_LINK "Rte_SerlComInpProxy_WhlGndVelRiNonDrvnVldRawBusHiSpd_Val" 0 DISPLAY_IDENTIFIER SerlComInpProxy.SenderPorts.WhlGndVelRiNonDrvnVldRawBusHiSpd.Val /end MEASUREMENT
/begin MEASUREMENT SerlComInpProxy.WhlPlsPerRevRaw.Val "MICROSAR RTE" UBYTE NO_COMPU_METHOD 0 0 0 255 ECU_ADDRESS 0 SYMBOL_LINK "Rte_SerlComInpProxy_WhlPlsPerRevRaw_Val" 0 DISPLAY_IDENTIFIER SerlComInpProxy.SenderPorts.WhlPlsPerRevRaw.Val /end MEASUREMENT
/begin MEASUREMENT SerlComInpProxy.WhlRotlStsTiStampReslRaw.Val "MICROSAR RTE" UWORD NO_COMPU_METHOD 0 0 0 65535 ECU_ADDRESS 0 SYMBOL_LINK "Rte_SerlComInpProxy_WhlRotlStsTiStampReslRaw_Val" 0 DISPLAY_IDENTIFIER SerlComInpProxy.SenderPorts.WhlRotlStsTiStampReslRaw.Val /end MEASUREMENT
/begin MEASUREMENT SerlComOutpProxy.BusOffChassisExp "MICROSAR RTE" UBYTE RTE_CM_BOOLEAN 0 0 0 255 ECU_ADDRESS 0 SYMBOL_LINK "Rte_SerlComOutpProxy_BusOffChassisExp" 0 DISPLAY_IDENTIFIER SerlComOutpProxy.PerInstanceMemories.BusOffChassisExp /end MEASUREMENT
/begin MEASUREMENT SerlComOutpProxy.BusOffChassisExp.Logl "MICROSAR RTE" UBYTE RTE_CM_BOOLEAN 0 0 0 255 ECU_ADDRESS 0 SYMBOL_LINK "Rte_SerlComOutpProxy_BusOffChassisExp_Logl" 0 DISPLAY_IDENTIFIER SerlComOutpProxy.SenderPorts.BusOffChassisExp.Logl /end MEASUREMENT
/begin MEASUREMENT SerlComOutpProxy.BusOffHiSpd "MICROSAR RTE" UBYTE RTE_CM_BOOLEAN 0 0 0 255 ECU_ADDRESS 0 SYMBOL_LINK "Rte_SerlComOutpProxy_BusOffHiSpd" 0 DISPLAY_IDENTIFIER SerlComOutpProxy.PerInstanceMemories.BusOffHiSpd /end MEASUREMENT
/begin MEASUREMENT SerlComOutpProxy.BusOffHiSpd.Logl "MICROSAR RTE" UBYTE RTE_CM_BOOLEAN 0 0 0 255 ECU_ADDRESS 0 SYMBOL_LINK "Rte_SerlComOutpProxy_BusOffHiSpd_Logl" 0 DISPLAY_IDENTIFIER SerlComOutpProxy.SenderPorts.BusOffHiSpd.Logl /end MEASUREMENT
/begin MEASUREMENT SerlComOutpProxy.CodSupported.Val "MICROSAR RTE" UBYTE NO_COMPU_METHOD 0 0 0 255 ECU_ADDRESS 0 SYMBOL_LINK "Rte_GmMsg778BusHiSpd_CodSupported_Val" 0 DISPLAY_IDENTIFIER SerlComOutpProxy.ReceiverPorts.CodSupported.Val /end MEASUREMENT
/begin MEASUREMENT SerlComOutpProxy.CurrSts.Val "MICROSAR RTE" UBYTE NO_COMPU_METHOD 0 0 0 255 ECU_ADDRESS 0 SYMBOL_LINK "Rte_GmMsg778BusHiSpd_CurrSts_Val" 0 DISPLAY_IDENTIFIER SerlComOutpProxy.ReceiverPorts.CurrSts.Val /end MEASUREMENT
/begin MEASUREMENT SerlComOutpProxy.DrvrSteerIntvDetd.Val "MICROSAR RTE" UBYTE NO_COMPU_METHOD 0 0 0 255 ECU_ADDRESS 0 SYMBOL_LINK "Rte_GmMsg335BusChassisExp_DrvrSteerIntvDetd_Val" 0 DISPLAY_IDENTIFIER SerlComOutpProxy.ReceiverPorts.DrvrSteerIntvDetd.Val /end MEASUREMENT
/begin MEASUREMENT SerlComOutpProxy.DrvrSteerIntvDetdProtnVal.Val "MICROSAR RTE" UBYTE NO_COMPU_METHOD 0 0 0 255 ECU_ADDRESS 0 SYMBOL_LINK "Rte_GmMsg335BusChassisExp_DrvrSteerIntvDetdProtnVal_Val" 0 DISPLAY_IDENTIFIER SerlComOutpProxy.ReceiverPorts.DrvrSteerIntvDetdProtnVal.Val /end MEASUREMENT
/begin MEASUREMENT SerlComOutpProxy.DrvrSteerIntvDetdRollgCntr.Val "MICROSAR RTE" UBYTE NO_COMPU_METHOD 0 0 0 255 ECU_ADDRESS 0 SYMBOL_LINK "Rte_GmMsg335BusChassisExp_DrvrSteerIntvDetdRollgCntr_Val" 0 DISPLAY_IDENTIFIER SerlComOutpProxy.ReceiverPorts.DrvrSteerIntvDetdRollgCntr.Val /end MEASUREMENT
/begin MEASUREMENT SerlComOutpProxy.DrvrSteerIntvDetdVld.Val "MICROSAR RTE" UBYTE NO_COMPU_METHOD 0 0 0 255 ECU_ADDRESS 0 SYMBOL_LINK "Rte_GmMsg335BusChassisExp_DrvrSteerIntvDetdVld_Val" 0 DISPLAY_IDENTIFIER SerlComOutpProxy.ReceiverPorts.DrvrSteerIntvDetdVld.Val /end MEASUREMENT
/begin MEASUREMENT SerlComOutpProxy.DtcFailrTyp.Val "MICROSAR RTE" UBYTE NO_COMPU_METHOD 0 0 0 255 ECU_ADDRESS 0 SYMBOL_LINK "Rte_GmMsg778BusHiSpd_DtcFailrTyp_Val" 0 DISPLAY_IDENTIFIER SerlComOutpProxy.ReceiverPorts.DtcFailrTyp.Val /end MEASUREMENT
/begin MEASUREMENT SerlComOutpProxy.DtcFltTyp.Val "MICROSAR RTE" UBYTE NO_COMPU_METHOD 0 0 0 255 ECU_ADDRESS 0 SYMBOL_LINK "Rte_GmMsg778BusHiSpd_DtcFltTyp_Val" 0 DISPLAY_IDENTIFIER SerlComOutpProxy.ReceiverPorts.DtcFltTyp.Val /end MEASUREMENT
/begin MEASUREMENT SerlComOutpProxy.DtcNr.Val "MICROSAR RTE" UWORD NO_COMPU_METHOD 0 0 0 65535 ECU_ADDRESS 0 SYMBOL_LINK "Rte_GmMsg778BusHiSpd_DtcNr_Val" 0 DISPLAY_IDENTIFIER SerlComOutpProxy.ReceiverPorts.DtcNr.Val /end MEASUREMENT
/begin MEASUREMENT SerlComOutpProxy.DtcSrc.Val "MICROSAR RTE" UBYTE NO_COMPU_METHOD 0 0 0 255 ECU_ADDRESS 0 SYMBOL_LINK "Rte_GmMsg778BusHiSpd_DtcSrc_Val" 0 DISPLAY_IDENTIFIER SerlComOutpProxy.ReceiverPorts.DtcSrc.Val /end MEASUREMENT
/begin MEASUREMENT SerlComOutpProxy.DtcTrig.Val "MICROSAR RTE" UBYTE NO_COMPU_METHOD 0 0 0 255 ECU_ADDRESS 0 SYMBOL_LINK "Rte_GmMsg778BusHiSpd_DtcTrig_Val" 0 DISPLAY_IDENTIFIER SerlComOutpProxy.ReceiverPorts.DtcTrig.Val /end MEASUREMENT
/begin MEASUREMENT SerlComOutpProxy.ElecPowerSteerAvlSts.Val "MICROSAR RTE" UBYTE NO_COMPU_METHOD 0 0 0 255 ECU_ADDRESS 0 SYMBOL_LINK "Rte_GmMsg335BusChassisExp_ElecPowerSteerAvlSts_Val" 0 DISPLAY_IDENTIFIER SerlComOutpProxy.ReceiverPorts.ElecPowerSteerAvlSts.Val /end MEASUREMENT
/begin MEASUREMENT SerlComOutpProxy.ElecPowerSteerAvlStsProtnVal.Val "MICROSAR RTE" UBYTE NO_COMPU_METHOD 0 0 0 255 ECU_ADDRESS 0 SYMBOL_LINK "Rte_GmMsg335BusChassisExp_ElecPowerSteerAvlStsProtnVal_Val" 0 DISPLAY_IDENTIFIER SerlComOutpProxy.ReceiverPorts.ElecPowerSteerAvlStsProtnVal.Val /end MEASUREMENT
/begin MEASUREMENT SerlComOutpProxy.ElecPowerSteerAvlStsRollgCntr.Val "MICROSAR RTE" UBYTE NO_COMPU_METHOD 0 0 0 255 ECU_ADDRESS 0 SYMBOL_LINK "Rte_GmMsg335BusChassisExp_ElecPowerSteerAvlStsRollgCntr_Val" 0 DISPLAY_IDENTIFIER SerlComOutpProxy.ReceiverPorts.ElecPowerSteerAvlStsRollgCntr.Val /end MEASUREMENT
/begin MEASUREMENT SerlComOutpProxy.ElecPwrSteerTotTqDlvd.Val "MICROSAR RTE" UWORD NO_COMPU_METHOD 0 0 0 65535 ECU_ADDRESS 0 SYMBOL_LINK "Rte_GmMsg1CABusChassisExp_ElecPwrSteerTotTqDlvd_Val" 0 DISPLAY_IDENTIFIER SerlComOutpProxy.ReceiverPorts.ElecPwrSteerTotTqDlvd.Val /end MEASUREMENT
/begin MEASUREMENT SerlComOutpProxy.HandsOffSteerWhlDetnMod.Val "MICROSAR RTE" UBYTE NO_COMPU_METHOD 0 0 0 255 ECU_ADDRESS 0 SYMBOL_LINK "Rte_GmMsg184BusHiSpd_HandsOffSteerWhlDetnMod_Val" 0 DISPLAY_IDENTIFIER SerlComOutpProxy.ReceiverPorts.HandsOffSteerWhlDetnMod.Val /end MEASUREMENT
/begin MEASUREMENT SerlComOutpProxy.HandsOffSteerWhlDetnSt.Val "MICROSAR RTE" UBYTE NO_COMPU_METHOD 0 0 0 255 ECU_ADDRESS 0 SYMBOL_LINK "Rte_GmMsg184BusHiSpd_HandsOffSteerWhlDetnSt_Val" 0 DISPLAY_IDENTIFIER SerlComOutpProxy.ReceiverPorts.HandsOffSteerWhlDetnSt.Val /end MEASUREMENT
/begin MEASUREMENT SerlComOutpProxy.HandsOffSteerWhlDetnStVld.Val "MICROSAR RTE" UBYTE NO_COMPU_METHOD 0 0 0 255 ECU_ADDRESS 0 SYMBOL_LINK "Rte_GmMsg184BusHiSpd_HandsOffSteerWhlDetnStVld_Val" 0 DISPLAY_IDENTIFIER SerlComOutpProxy.ReceiverPorts.HandsOffSteerWhlDetnStVld.Val /end MEASUREMENT
/begin MEASUREMENT SerlComOutpProxy.HistSts.Val "MICROSAR RTE" UBYTE NO_COMPU_METHOD 0 0 0 255 ECU_ADDRESS 0 SYMBOL_LINK "Rte_GmMsg778BusHiSpd_HistSts_Val" 0 DISPLAY_IDENTIFIER SerlComOutpProxy.ReceiverPorts.HistSts.Val /end MEASUREMENT
/begin MEASUREMENT SerlComOutpProxy.LkaDrvrAppldTq.Val "MICROSAR RTE" UWORD NO_COMPU_METHOD 0 0 0 65535 ECU_ADDRESS 0 SYMBOL_LINK "Rte_GmMsg184BusHiSpd_LkaDrvrAppldTq_Val" 0 DISPLAY_IDENTIFIER SerlComOutpProxy.ReceiverPorts.LkaDrvrAppldTq.Val /end MEASUREMENT
/begin MEASUREMENT SerlComOutpProxy.LkaDrvrAppldTqVld.Val "MICROSAR RTE" UBYTE NO_COMPU_METHOD 0 0 0 255 ECU_ADDRESS 0 SYMBOL_LINK "Rte_GmMsg184BusHiSpd_LkaDrvrAppldTqVld_Val" 0 DISPLAY_IDENTIFIER SerlComOutpProxy.ReceiverPorts.LkaDrvrAppldTqVld.Val /end MEASUREMENT
/begin MEASUREMENT SerlComOutpProxy.LkaElecPwrSteerTotTqDlvd.Val "MICROSAR RTE" UWORD NO_COMPU_METHOD 0 0 0 65535 ECU_ADDRESS 0 SYMBOL_LINK "Rte_GmMsg184BusHiSpd_LkaElecPwrSteerTotTqDlvd_Val" 0 DISPLAY_IDENTIFIER SerlComOutpProxy.ReceiverPorts.LkaElecPwrSteerTotTqDlvd.Val /end MEASUREMENT
/begin MEASUREMENT SerlComOutpProxy.LkaTqOvrlDeltaTqDlvd.Val "MICROSAR RTE" UWORD NO_COMPU_METHOD 0 0 0 65535 ECU_ADDRESS 0 SYMBOL_LINK "Rte_GmMsg184BusHiSpd_LkaTqOvrlDeltaTqDlvd_Val" 0 DISPLAY_IDENTIFIER SerlComOutpProxy.ReceiverPorts.LkaTqOvrlDeltaTqDlvd.Val /end MEASUREMENT
/begin MEASUREMENT SerlComOutpProxy.LkaTqOvrlDlvdRollgCntr.Val "MICROSAR RTE" UBYTE NO_COMPU_METHOD 0 0 0 255 ECU_ADDRESS 0 SYMBOL_LINK "Rte_GmMsg184BusHiSpd_LkaTqOvrlDlvdRollgCntr_Val" 0 DISPLAY_IDENTIFIER SerlComOutpProxy.ReceiverPorts.LkaTqOvrlDlvdRollgCntr.Val /end MEASUREMENT
/begin MEASUREMENT SerlComOutpProxy.LkaTqOvrlStsChks.Val "MICROSAR RTE" UWORD NO_COMPU_METHOD 0 0 0 65535 ECU_ADDRESS 0 SYMBOL_LINK "Rte_GmMsg184BusHiSpd_LkaTqOvrlStsChks_Val" 0 DISPLAY_IDENTIFIER SerlComOutpProxy.ReceiverPorts.LkaTqOvrlStsChks.Val /end MEASUREMENT
/begin MEASUREMENT SerlComOutpProxy.LkaTqOvrlTqDlvdSts.Val "MICROSAR RTE" UBYTE NO_COMPU_METHOD 0 0 0 255 ECU_ADDRESS 0 SYMBOL_LINK "Rte_GmMsg184BusHiSpd_LkaTqOvrlTqDlvdSts_Val" 0 DISPLAY_IDENTIFIER SerlComOutpProxy.ReceiverPorts.LkaTqOvrlTqDlvdSts.Val /end MEASUREMENT
/begin MEASUREMENT SerlComOutpProxy.PwrSteerIndcr.Val "MICROSAR RTE" UBYTE NO_COMPU_METHOD 0 0 0 255 ECU_ADDRESS 0 SYMBOL_LINK "Rte_GmMsg148BusHiSpd_PwrSteerIndcr_Val" 0 DISPLAY_IDENTIFIER SerlComOutpProxy.ReceiverPorts.PwrSteerIndcr.Val /end MEASUREMENT
/begin MEASUREMENT SerlComOutpProxy.SteerAssiLimd.Val "MICROSAR RTE" UBYTE NO_COMPU_METHOD 0 0 0 255 ECU_ADDRESS 0 SYMBOL_LINK "Rte_GmMsg148BusHiSpd_SteerAssiLimd_Val" 0 DISPLAY_IDENTIFIER SerlComOutpProxy.ReceiverPorts.SteerAssiLimd.Val /end MEASUREMENT
/begin MEASUREMENT SerlComOutpProxy.SteerAssiLimdLvl2.Val "MICROSAR RTE" UBYTE NO_COMPU_METHOD 0 0 0 255 ECU_ADDRESS 0 SYMBOL_LINK "Rte_GmMsg148BusHiSpd_SteerAssiLimdLvl2_Val" 0 DISPLAY_IDENTIFIER SerlComOutpProxy.ReceiverPorts.SteerAssiLimdLvl2.Val /end MEASUREMENT
/begin MEASUREMENT SerlComOutpProxy.SteerAssiLimdLvl3.Val "MICROSAR RTE" UBYTE NO_COMPU_METHOD 0 0 0 255 ECU_ADDRESS 0 SYMBOL_LINK "Rte_GmMsg148BusHiSpd_SteerAssiLimdLvl3_Val" 0 DISPLAY_IDENTIFIER SerlComOutpProxy.ReceiverPorts.SteerAssiLimdLvl3.Val /end MEASUREMENT
/begin MEASUREMENT SerlComOutpProxy.SteerWhlAgAlvRollgCntBusChassisExp.Val "MICROSAR RTE" UBYTE NO_COMPU_METHOD 0 0 0 255 ECU_ADDRESS 0 SYMBOL_LINK "Rte_GmMsg1E5BusChassisExp_SteerWhlAgAlvRollgCntBusChassisExp_Val" 0 DISPLAY_IDENTIFIER SerlComOutpProxy.ReceiverPorts.SteerWhlAgAlvRollgCntBusChassisExp.Val /end MEASUREMENT
/begin MEASUREMENT SerlComOutpProxy.SteerWhlAgAlvRollgCntBusHiSpd.Val "MICROSAR RTE" UBYTE NO_COMPU_METHOD 0 0 0 255 ECU_ADDRESS 0 SYMBOL_LINK "Rte_GmMsg1E5BusHiSpd_SteerWhlAgAlvRollgCntBusHiSpd_Val" 0 DISPLAY_IDENTIFIER SerlComOutpProxy.ReceiverPorts.SteerWhlAgAlvRollgCntBusHiSpd.Val /end MEASUREMENT
/begin MEASUREMENT SerlComOutpProxy.SteerWhlAgBusChassisExp.Val "MICROSAR RTE" UWORD NO_COMPU_METHOD 0 0 0 65535 ECU_ADDRESS 0 SYMBOL_LINK "Rte_GmMsg1E5BusChassisExp_SteerWhlAgBusChassisExp_Val" 0 DISPLAY_IDENTIFIER SerlComOutpProxy.ReceiverPorts.SteerWhlAgBusChassisExp.Val /end MEASUREMENT
/begin MEASUREMENT SerlComOutpProxy.SteerWhlAgBusHiSpd.Val "MICROSAR RTE" UWORD NO_COMPU_METHOD 0 0 0 65535 ECU_ADDRESS 0 SYMBOL_LINK "Rte_GmMsg1E5BusHiSpd_SteerWhlAgBusHiSpd_Val" 0 DISPLAY_IDENTIFIER SerlComOutpProxy.ReceiverPorts.SteerWhlAgBusHiSpd.Val /end MEASUREMENT
/begin MEASUREMENT SerlComOutpProxy.SteerWhlAgGrdtBusChassisExp.Val "MICROSAR RTE" UWORD NO_COMPU_METHOD 0 0 0 65535 ECU_ADDRESS 0 SYMBOL_LINK "Rte_GmMsg1E5BusChassisExp_SteerWhlAgGrdtBusChassisExp_Val" 0 DISPLAY_IDENTIFIER SerlComOutpProxy.ReceiverPorts.SteerWhlAgGrdtBusChassisExp.Val /end MEASUREMENT
/begin MEASUREMENT SerlComOutpProxy.SteerWhlAgGrdtBusHiSpd.Val "MICROSAR RTE" UWORD NO_COMPU_METHOD 0 0 0 65535 ECU_ADDRESS 0 SYMBOL_LINK "Rte_GmMsg1E5BusHiSpd_SteerWhlAgGrdtBusHiSpd_Val" 0 DISPLAY_IDENTIFIER SerlComOutpProxy.ReceiverPorts.SteerWhlAgGrdtBusHiSpd.Val /end MEASUREMENT
/begin MEASUREMENT SerlComOutpProxy.SteerWhlAgGrdtMaskBusChassisExp.Val "MICROSAR RTE" UBYTE NO_COMPU_METHOD 0 0 0 255 ECU_ADDRESS 0 SYMBOL_LINK "Rte_GmMsg1E5BusChassisExp_SteerWhlAgGrdtMaskBusChassisExp_Val" 0 DISPLAY_IDENTIFIER SerlComOutpProxy.ReceiverPorts.SteerWhlAgGrdtMaskBusChassisExp.Val /end MEASUREMENT
/begin MEASUREMENT SerlComOutpProxy.SteerWhlAgGrdtMaskBusHiSpd.Val "MICROSAR RTE" UBYTE NO_COMPU_METHOD 0 0 0 255 ECU_ADDRESS 0 SYMBOL_LINK "Rte_GmMsg1E5BusHiSpd_SteerWhlAgGrdtMaskBusHiSpd_Val" 0 DISPLAY_IDENTIFIER SerlComOutpProxy.ReceiverPorts.SteerWhlAgGrdtMaskBusHiSpd.Val /end MEASUREMENT
/begin MEASUREMENT SerlComOutpProxy.SteerWhlAgGrdtVldBusChassisExp.Val "MICROSAR RTE" UBYTE NO_COMPU_METHOD 0 0 0 255 ECU_ADDRESS 0 SYMBOL_LINK "Rte_GmMsg1E5BusChassisExp_SteerWhlAgGrdtVldBusChassisExp_Val" 0 DISPLAY_IDENTIFIER SerlComOutpProxy.ReceiverPorts.SteerWhlAgGrdtVldBusChassisExp.Val /end MEASUREMENT
/begin MEASUREMENT SerlComOutpProxy.SteerWhlAgGrdtVldBusHiSpd.Val "MICROSAR RTE" UBYTE NO_COMPU_METHOD 0 0 0 255 ECU_ADDRESS 0 SYMBOL_LINK "Rte_GmMsg1E5BusHiSpd_SteerWhlAgGrdtVldBusHiSpd_Val" 0 DISPLAY_IDENTIFIER SerlComOutpProxy.ReceiverPorts.SteerWhlAgGrdtVldBusHiSpd.Val /end MEASUREMENT
/begin MEASUREMENT SerlComOutpProxy.SteerWhlAgMaskBusChassisExp.Val "MICROSAR RTE" UBYTE NO_COMPU_METHOD 0 0 0 255 ECU_ADDRESS 0 SYMBOL_LINK "Rte_GmMsg1E5BusChassisExp_SteerWhlAgMaskBusChassisExp_Val" 0 DISPLAY_IDENTIFIER SerlComOutpProxy.ReceiverPorts.SteerWhlAgMaskBusChassisExp.Val /end MEASUREMENT
/begin MEASUREMENT SerlComOutpProxy.SteerWhlAgMaskBusHiSpd.Val "MICROSAR RTE" UBYTE NO_COMPU_METHOD 0 0 0 255 ECU_ADDRESS 0 SYMBOL_LINK "Rte_GmMsg1E5BusHiSpd_SteerWhlAgMaskBusHiSpd_Val" 0 DISPLAY_IDENTIFIER SerlComOutpProxy.ReceiverPorts.SteerWhlAgMaskBusHiSpd.Val /end MEASUREMENT
/begin MEASUREMENT SerlComOutpProxy.SteerWhlAgSnsrCalStsBusChassisExp.Val "MICROSAR RTE" UBYTE NO_COMPU_METHOD 0 0 0 255 ECU_ADDRESS 0 SYMBOL_LINK "Rte_GmMsg1E5BusChassisExp_SteerWhlAgSnsrCalStsBusChassisExp_Val" 0 DISPLAY_IDENTIFIER SerlComOutpProxy.ReceiverPorts.SteerWhlAgSnsrCalStsBusChassisExp.Val /end MEASUREMENT
/begin MEASUREMENT SerlComOutpProxy.SteerWhlAgSnsrCalStsBusHiSpd.Val "MICROSAR RTE" UBYTE NO_COMPU_METHOD 0 0 0 255 ECU_ADDRESS 0 SYMBOL_LINK "Rte_GmMsg1E5BusHiSpd_SteerWhlAgSnsrCalStsBusHiSpd_Val" 0 DISPLAY_IDENTIFIER SerlComOutpProxy.ReceiverPorts.SteerWhlAgSnsrCalStsBusHiSpd.Val /end MEASUREMENT
/begin MEASUREMENT SerlComOutpProxy.SteerWhlAgSnsrChksBusChassisExp.Val "MICROSAR RTE" UWORD NO_COMPU_METHOD 0 0 0 65535 ECU_ADDRESS 0 SYMBOL_LINK "Rte_GmMsg1E5BusChassisExp_SteerWhlAgSnsrChksBusChassisExp_Val" 0 DISPLAY_IDENTIFIER SerlComOutpProxy.ReceiverPorts.SteerWhlAgSnsrChksBusChassisExp.Val /end MEASUREMENT
/begin MEASUREMENT SerlComOutpProxy.SteerWhlAgSnsrChksBusHiSpd.Val "MICROSAR RTE" UWORD NO_COMPU_METHOD 0 0 0 65535 ECU_ADDRESS 0 SYMBOL_LINK "Rte_GmMsg1E5BusHiSpd_SteerWhlAgSnsrChksBusHiSpd_Val" 0 DISPLAY_IDENTIFIER SerlComOutpProxy.ReceiverPorts.SteerWhlAgSnsrChksBusHiSpd.Val /end MEASUREMENT
/begin MEASUREMENT SerlComOutpProxy.SteerWhlAgSnsrTypBusChassisExp.Val "MICROSAR RTE" UBYTE NO_COMPU_METHOD 0 0 0 255 ECU_ADDRESS 0 SYMBOL_LINK "Rte_GmMsg1E5BusChassisExp_SteerWhlAgSnsrTypBusChassisExp_Val" 0 DISPLAY_IDENTIFIER SerlComOutpProxy.ReceiverPorts.SteerWhlAgSnsrTypBusChassisExp.Val /end MEASUREMENT
/begin MEASUREMENT SerlComOutpProxy.SteerWhlAgSnsrTypBusHiSpd.Val "MICROSAR RTE" UBYTE NO_COMPU_METHOD 0 0 0 255 ECU_ADDRESS 0 SYMBOL_LINK "Rte_GmMsg1E5BusHiSpd_SteerWhlAgSnsrTypBusHiSpd_Val" 0 DISPLAY_IDENTIFIER SerlComOutpProxy.ReceiverPorts.SteerWhlAgSnsrTypBusHiSpd.Val /end MEASUREMENT
/begin MEASUREMENT SerlComOutpProxy.SteerWhlAgVldBusChassisExp.Val "MICROSAR RTE" UBYTE NO_COMPU_METHOD 0 0 0 255 ECU_ADDRESS 0 SYMBOL_LINK "Rte_GmMsg1E5BusChassisExp_SteerWhlAgVldBusChassisExp_Val" 0 DISPLAY_IDENTIFIER SerlComOutpProxy.ReceiverPorts.SteerWhlAgVldBusChassisExp.Val /end MEASUREMENT
/begin MEASUREMENT SerlComOutpProxy.SteerWhlAgVldBusHiSpd.Val "MICROSAR RTE" UBYTE NO_COMPU_METHOD 0 0 0 255 ECU_ADDRESS 0 SYMBOL_LINK "Rte_GmMsg1E5BusHiSpd_SteerWhlAgVldBusHiSpd_Val" 0 DISPLAY_IDENTIFIER SerlComOutpProxy.ReceiverPorts.SteerWhlAgVldBusHiSpd.Val /end MEASUREMENT
/begin MEASUREMENT SerlComOutpProxy.TqOvrlDeltaTqDlvd.Val "MICROSAR RTE" UWORD NO_COMPU_METHOD 0 0 0 65535 ECU_ADDRESS 0 SYMBOL_LINK "Rte_GmMsg1CABusChassisExp_TqOvrlDeltaTqDlvd_Val" 0 DISPLAY_IDENTIFIER SerlComOutpProxy.ReceiverPorts.TqOvrlDeltaTqDlvd.Val /end MEASUREMENT
/begin MEASUREMENT SerlComOutpProxy.TqOvrlDlvdChks.Val "MICROSAR RTE" UWORD NO_COMPU_METHOD 0 0 0 65535 ECU_ADDRESS 0 SYMBOL_LINK "Rte_GmMsg1CABusChassisExp_TqOvrlDlvdChks_Val" 0 DISPLAY_IDENTIFIER SerlComOutpProxy.ReceiverPorts.TqOvrlDlvdChks.Val /end MEASUREMENT
/begin MEASUREMENT SerlComOutpProxy.TqOvrlDlvdRollgCntr.Val "MICROSAR RTE" UBYTE NO_COMPU_METHOD 0 0 0 255 ECU_ADDRESS 0 SYMBOL_LINK "Rte_GmMsg1CABusChassisExp_TqOvrlDlvdRollgCntr_Val" 0 DISPLAY_IDENTIFIER SerlComOutpProxy.ReceiverPorts.TqOvrlDlvdRollgCntr.Val /end MEASUREMENT
/begin MEASUREMENT SerlComOutpProxy.TqOvrlTqDlvdSts.Val "MICROSAR RTE" UBYTE NO_COMPU_METHOD 0 0 0 255 ECU_ADDRESS 0 SYMBOL_LINK "Rte_GmMsg1CABusChassisExp_TqOvrlTqDlvdSts_Val" 0 DISPLAY_IDENTIFIER SerlComOutpProxy.ReceiverPorts.TqOvrlTqDlvdSts.Val /end MEASUREMENT
/begin MEASUREMENT SerlComOutpProxy.TstFaildCodClrdSts.Val "MICROSAR RTE" UBYTE NO_COMPU_METHOD 0 0 0 255 ECU_ADDRESS 0 SYMBOL_LINK "Rte_GmMsg778BusHiSpd_TstFaildCodClrdSts_Val" 0 DISPLAY_IDENTIFIER SerlComOutpProxy.ReceiverPorts.TstFaildCodClrdSts.Val /end MEASUREMENT
/begin MEASUREMENT SerlComOutpProxy.TstFaildPwrUpSts.Val "MICROSAR RTE" UBYTE NO_COMPU_METHOD 0 0 0 255 ECU_ADDRESS 0 SYMBOL_LINK "Rte_GmMsg778BusHiSpd_TstFaildPwrUpSts_Val" 0 DISPLAY_IDENTIFIER SerlComOutpProxy.ReceiverPorts.TstFaildPwrUpSts.Val /end MEASUREMENT
/begin MEASUREMENT SerlComOutpProxy.TstNotPassdCodClrdSts.Val "MICROSAR RTE" UBYTE NO_COMPU_METHOD 0 0 0 255 ECU_ADDRESS 0 SYMBOL_LINK "Rte_GmMsg778BusHiSpd_TstNotPassdCodClrdSts_Val" 0 DISPLAY_IDENTIFIER SerlComOutpProxy.ReceiverPorts.TstNotPassdCodClrdSts.Val /end MEASUREMENT
/begin MEASUREMENT SerlComOutpProxy.TstNotPassdPwrUpSts.Val "MICROSAR RTE" UBYTE NO_COMPU_METHOD 0 0 0 255 ECU_ADDRESS 0 SYMBOL_LINK "Rte_GmMsg778BusHiSpd_TstNotPassdPwrUpSts_Val" 0 DISPLAY_IDENTIFIER SerlComOutpProxy.ReceiverPorts.TstNotPassdPwrUpSts.Val /end MEASUREMENT
/begin MEASUREMENT SerlComOutpProxy.WarnIndcrReqdSts.Val "MICROSAR RTE" UBYTE NO_COMPU_METHOD 0 0 0 255 ECU_ADDRESS 0 SYMBOL_LINK "Rte_GmMsg778BusHiSpd_WarnIndcrReqdSts_Val" 0 DISPLAY_IDENTIFIER SerlComOutpProxy.ReceiverPorts.WarnIndcrReqdSts.Val /end MEASUREMENT
/begin MEASUREMENT SnsrOffsCorrn.HwAg.Val "MICROSAR RTE" FLOAT32_IEEE NO_COMPU_METHOD 0 0 -3.402823466e+38 3.402823466e+38 ECU_ADDRESS 0 SYMBOL_LINK "Rte_HwAgVehCentrTrim_HwAgVehTrimOffs_Val" 0 DISPLAY_IDENTIFIER SnsrOffsCorrn.ReceiverPorts.HwAg.Val /end MEASUREMENT
/begin MEASUREMENT SnsrOffsCorrn.HwAgCorrd.Val "MICROSAR RTE" FLOAT32_IEEE NO_COMPU_METHOD 0 0 -3.402823466e+38 3.402823466e+38 ECU_ADDRESS 0 SYMBOL_LINK "Rte_SnsrOffsCorrn_HwAgCorrd_Val" 0 DISPLAY_IDENTIFIER SnsrOffsCorrn.SenderPorts.HwAgCorrd.Val /end MEASUREMENT
/begin MEASUREMENT SnsrOffsCorrn.HwAgOffs.Val "MICROSAR RTE" FLOAT32_IEEE NO_COMPU_METHOD 0 0 -3.402823466e+38 3.402823466e+38 ECU_ADDRESS 0 SYMBOL_LINK "Rte_SnsrOffsLrng_HwAgOffs_Val" 0 DISPLAY_IDENTIFIER SnsrOffsCorrn.ReceiverPorts.HwAgOffs.Val /end MEASUREMENT
/begin MEASUREMENT SnsrOffsCorrn.HwTq.Val "MICROSAR RTE" FLOAT32_IEEE NO_COMPU_METHOD 0 0 -3.402823466e+38 3.402823466e+38 ECU_ADDRESS 0 SYMBOL_LINK "Rte_HwTqArbn_HwTq_Val" 0 DISPLAY_IDENTIFIER SnsrOffsCorrn.ReceiverPorts.HwTq.Val /end MEASUREMENT
/begin MEASUREMENT SnsrOffsCorrn.HwTqCorrd.Val "MICROSAR RTE" FLOAT32_IEEE NO_COMPU_METHOD 0 0 -3.402823466e+38 3.402823466e+38 ECU_ADDRESS 0 SYMBOL_LINK "Rte_SnsrOffsCorrn_HwTqCorrd_Val" 0 DISPLAY_IDENTIFIER SnsrOffsCorrn.SenderPorts.HwTqCorrd.Val /end MEASUREMENT
/begin MEASUREMENT SnsrOffsCorrn.HwTqOffs.Val "MICROSAR RTE" FLOAT32_IEEE NO_COMPU_METHOD 0 0 -3.402823466e+38 3.402823466e+38 ECU_ADDRESS 0 SYMBOL_LINK "Rte_SnsrOffsLrng_HwTqOffs_Val" 0 DISPLAY_IDENTIFIER SnsrOffsCorrn.ReceiverPorts.HwTqOffs.Val /end MEASUREMENT
/begin MEASUREMENT SnsrOffsCorrn.VehYawRate.Val "MICROSAR RTE" FLOAT32_IEEE NO_COMPU_METHOD 0 0 -3.402823466e+38 3.402823466e+38 ECU_ADDRESS 0 SYMBOL_LINK "Rte_VehSigCdng_VehYawRate_Val" 0 DISPLAY_IDENTIFIER SnsrOffsCorrn.ReceiverPorts.VehYawRate.Val /end MEASUREMENT
/begin MEASUREMENT SnsrOffsCorrn.VehYawRateCorrd.Val "MICROSAR RTE" FLOAT32_IEEE NO_COMPU_METHOD 0 0 -3.402823466e+38 3.402823466e+38 ECU_ADDRESS 0 SYMBOL_LINK "Rte_SnsrOffsCorrn_VehYawRateCorrd_Val" 0 DISPLAY_IDENTIFIER SnsrOffsCorrn.SenderPorts.VehYawRateCorrd.Val /end MEASUREMENT
/begin MEASUREMENT SnsrOffsCorrn.VehYawRateOffs.Val "MICROSAR RTE" FLOAT32_IEEE NO_COMPU_METHOD 0 0 -3.402823466e+38 3.402823466e+38 ECU_ADDRESS 0 SYMBOL_LINK "Rte_SnsrOffsLrng_VehYawRateOffs_Val" 0 DISPLAY_IDENTIFIER SnsrOffsCorrn.ReceiverPorts.VehYawRateOffs.Val /end MEASUREMENT
/begin MEASUREMENT SnsrOffsLrng.HwAg.Val "MICROSAR RTE" FLOAT32_IEEE NO_COMPU_METHOD 0 0 -3.402823466e+38 3.402823466e+38 ECU_ADDRESS 0 SYMBOL_LINK "Rte_HwAgVehCentrTrim_HwAgVehTrimOffs_Val" 0 DISPLAY_IDENTIFIER SnsrOffsLrng.ReceiverPorts.HwAg.Val /end MEASUREMENT
/begin MEASUREMENT SnsrOffsLrng.HwAgAuthy.Val "MICROSAR RTE" FLOAT32_IEEE NO_COMPU_METHOD 0 0 -3.402823466e+38 3.402823466e+38 ECU_ADDRESS 0 SYMBOL_LINK "Rte_HwAgSysArbn_PinionAgConf_Val" 0 DISPLAY_IDENTIFIER SnsrOffsLrng.ReceiverPorts.HwAgAuthy.Val /end MEASUREMENT
/begin MEASUREMENT SnsrOffsLrng.HwAgCdngFil.FilGain "MICROSAR RTE" FLOAT32_IEEE NO_COMPU_METHOD 0 0 -3.402823466e+38 3.402823466e+38 ECU_ADDRESS 0 SYMBOL_LINK "Rte_SnsrOffsLrng_HwAgCdngFil.FilGain" 0 DISPLAY_IDENTIFIER SnsrOffsLrng.PerInstanceMemories.HwAgCdngFil.FilGain /end MEASUREMENT
/begin MEASUREMENT SnsrOffsLrng.HwAgCdngFil.FilSt "MICROSAR RTE" FLOAT32_IEEE NO_COMPU_METHOD 0 0 -3.402823466e+38 3.402823466e+38 ECU_ADDRESS 0 SYMBOL_LINK "Rte_SnsrOffsLrng_HwAgCdngFil.FilSt" 0 DISPLAY_IDENTIFIER SnsrOffsLrng.PerInstanceMemories.HwAgCdngFil.FilSt /end MEASUREMENT
/begin MEASUREMENT SnsrOffsLrng.HwAgLrngDrvgDstPrev "MICROSAR RTE" FLOAT32_IEEE NO_COMPU_METHOD 0 0 -3.402823466e+38 3.402823466e+38 ECU_ADDRESS 0 SYMBOL_LINK "Rte_SnsrOffsLrng_HwAgLrngDrvgDstPrev" 0 DISPLAY_IDENTIFIER SnsrOffsLrng.PerInstanceMemories.HwAgLrngDrvgDstPrev /end MEASUREMENT
/begin MEASUREMENT SnsrOffsLrng.HwAgLrngFil1.FilGain "MICROSAR RTE" FLOAT32_IEEE NO_COMPU_METHOD 0 0 -3.402823466e+38 3.402823466e+38 ECU_ADDRESS 0 SYMBOL_LINK "Rte_SnsrOffsLrng_HwAgLrngFil1.FilGain" 0 DISPLAY_IDENTIFIER SnsrOffsLrng.PerInstanceMemories.HwAgLrngFil1.FilGain /end MEASUREMENT
/begin MEASUREMENT SnsrOffsLrng.HwAgLrngFil1.FilSt "MICROSAR RTE" FLOAT32_IEEE NO_COMPU_METHOD 0 0 -3.402823466e+38 3.402823466e+38 ECU_ADDRESS 0 SYMBOL_LINK "Rte_SnsrOffsLrng_HwAgLrngFil1.FilSt" 0 DISPLAY_IDENTIFIER SnsrOffsLrng.PerInstanceMemories.HwAgLrngFil1.FilSt /end MEASUREMENT
/begin MEASUREMENT SnsrOffsLrng.HwAgLrngFil2.FilGain "MICROSAR RTE" FLOAT32_IEEE NO_COMPU_METHOD 0 0 -3.402823466e+38 3.402823466e+38 ECU_ADDRESS 0 SYMBOL_LINK "Rte_SnsrOffsLrng_HwAgLrngFil2.FilGain" 0 DISPLAY_IDENTIFIER SnsrOffsLrng.PerInstanceMemories.HwAgLrngFil2.FilGain /end MEASUREMENT
/begin MEASUREMENT SnsrOffsLrng.HwAgLrngFil2.FilSt "MICROSAR RTE" FLOAT32_IEEE NO_COMPU_METHOD 0 0 -3.402823466e+38 3.402823466e+38 ECU_ADDRESS 0 SYMBOL_LINK "Rte_SnsrOffsLrng_HwAgLrngFil2.FilSt" 0 DISPLAY_IDENTIFIER SnsrOffsLrng.PerInstanceMemories.HwAgLrngFil2.FilSt /end MEASUREMENT
/begin MEASUREMENT SnsrOffsLrng.HwAgLrngStRst "MICROSAR RTE" UBYTE RTE_CM_BOOLEAN 0 0 0 255 ECU_ADDRESS 0 SYMBOL_LINK "Rte_SnsrOffsLrng_HwAgLrngStRst" 0 DISPLAY_IDENTIFIER SnsrOffsLrng.PerInstanceMemories.HwAgLrngStRst /end MEASUREMENT
/begin MEASUREMENT SnsrOffsLrng.HwAgLrngSysTqFil1.FilGain "MICROSAR RTE" FLOAT32_IEEE NO_COMPU_METHOD 0 0 -3.402823466e+38 3.402823466e+38 ECU_ADDRESS 0 SYMBOL_LINK "Rte_SnsrOffsLrng_HwAgLrngSysTqFil1.FilGain" 0 DISPLAY_IDENTIFIER SnsrOffsLrng.PerInstanceMemories.HwAgLrngSysTqFil1.FilGain /end MEASUREMENT
/begin MEASUREMENT SnsrOffsLrng.HwAgLrngSysTqFil1.FilSt "MICROSAR RTE" FLOAT32_IEEE NO_COMPU_METHOD 0 0 -3.402823466e+38 3.402823466e+38 ECU_ADDRESS 0 SYMBOL_LINK "Rte_SnsrOffsLrng_HwAgLrngSysTqFil1.FilSt" 0 DISPLAY_IDENTIFIER SnsrOffsLrng.PerInstanceMemories.HwAgLrngSysTqFil1.FilSt /end MEASUREMENT
/begin MEASUREMENT SnsrOffsLrng.HwAgLrngSysTqFil2.FilGain "MICROSAR RTE" FLOAT32_IEEE NO_COMPU_METHOD 0 0 -3.402823466e+38 3.402823466e+38 ECU_ADDRESS 0 SYMBOL_LINK "Rte_SnsrOffsLrng_HwAgLrngSysTqFil2.FilGain" 0 DISPLAY_IDENTIFIER SnsrOffsLrng.PerInstanceMemories.HwAgLrngSysTqFil2.FilGain /end MEASUREMENT
/begin MEASUREMENT SnsrOffsLrng.HwAgLrngSysTqFil2.FilSt "MICROSAR RTE" FLOAT32_IEEE NO_COMPU_METHOD 0 0 -3.402823466e+38 3.402823466e+38 ECU_ADDRESS 0 SYMBOL_LINK "Rte_SnsrOffsLrng_HwAgLrngSysTqFil2.FilSt" 0 DISPLAY_IDENTIFIER SnsrOffsLrng.PerInstanceMemories.HwAgLrngSysTqFil2.FilSt /end MEASUREMENT
/begin MEASUREMENT SnsrOffsLrng.HwAgMeasFil1.FilGain "MICROSAR RTE" FLOAT32_IEEE NO_COMPU_METHOD 0 0 -3.402823466e+38 3.402823466e+38 ECU_ADDRESS 0 SYMBOL_LINK "Rte_SnsrOffsLrng_HwAgMeasFil1.FilGain" 0 DISPLAY_IDENTIFIER SnsrOffsLrng.PerInstanceMemories.HwAgMeasFil1.FilGain /end MEASUREMENT
/begin MEASUREMENT SnsrOffsLrng.HwAgMeasFil1.FilSt "MICROSAR RTE" FLOAT32_IEEE NO_COMPU_METHOD 0 0 -3.402823466e+38 3.402823466e+38 ECU_ADDRESS 0 SYMBOL_LINK "Rte_SnsrOffsLrng_HwAgMeasFil1.FilSt" 0 DISPLAY_IDENTIFIER SnsrOffsLrng.PerInstanceMemories.HwAgMeasFil1.FilSt /end MEASUREMENT
/begin MEASUREMENT SnsrOffsLrng.HwAgMeasFil2.FilGain "MICROSAR RTE" FLOAT32_IEEE NO_COMPU_METHOD 0 0 -3.402823466e+38 3.402823466e+38 ECU_ADDRESS 0 SYMBOL_LINK "Rte_SnsrOffsLrng_HwAgMeasFil2.FilGain" 0 DISPLAY_IDENTIFIER SnsrOffsLrng.PerInstanceMemories.HwAgMeasFil2.FilGain /end MEASUREMENT
/begin MEASUREMENT SnsrOffsLrng.HwAgMeasFil2.FilSt "MICROSAR RTE" FLOAT32_IEEE NO_COMPU_METHOD 0 0 -3.402823466e+38 3.402823466e+38 ECU_ADDRESS 0 SYMBOL_LINK "Rte_SnsrOffsLrng_HwAgMeasFil2.FilSt" 0 DISPLAY_IDENTIFIER SnsrOffsLrng.PerInstanceMemories.HwAgMeasFil2.FilSt /end MEASUREMENT
/begin MEASUREMENT SnsrOffsLrng.HwAgOffs.Val "MICROSAR RTE" FLOAT32_IEEE NO_COMPU_METHOD 0 0 -3.402823466e+38 3.402823466e+38 ECU_ADDRESS 0 SYMBOL_LINK "Rte_SnsrOffsLrng_HwAgOffs_Val" 0 DISPLAY_IDENTIFIER SnsrOffsLrng.SenderPorts.HwAgOffs.Val /end MEASUREMENT
/begin MEASUREMENT SnsrOffsLrng.HwTq.Val "MICROSAR RTE" FLOAT32_IEEE NO_COMPU_METHOD 0 0 -3.402823466e+38 3.402823466e+38 ECU_ADDRESS 0 SYMBOL_LINK "Rte_HwTqArbn_HwTq_Val" 0 DISPLAY_IDENTIFIER SnsrOffsLrng.ReceiverPorts.HwTq.Val /end MEASUREMENT
/begin MEASUREMENT SnsrOffsLrng.HwTqLrngEnaTmrRef "MICROSAR RTE" ULONG NO_COMPU_METHOD 0 0 0 4294967295 ECU_ADDRESS 0 SYMBOL_LINK "Rte_SnsrOffsLrng_HwTqLrngEnaTmrRef" 0 DISPLAY_IDENTIFIER SnsrOffsLrng.PerInstanceMemories.HwTqLrngEnaTmrRef /end MEASUREMENT
/begin MEASUREMENT SnsrOffsLrng.HwTqLrngMeasTmrRef "MICROSAR RTE" ULONG NO_COMPU_METHOD 0 0 0 4294967295 ECU_ADDRESS 0 SYMBOL_LINK "Rte_SnsrOffsLrng_HwTqLrngMeasTmrRef" 0 DISPLAY_IDENTIFIER SnsrOffsLrng.PerInstanceMemories.HwTqLrngMeasTmrRef /end MEASUREMENT
/begin GROUP PwrLimr.ReceiverPorts "MICROSAR RTE"
 /begin SUB_GROUP PwrLimr.AltFltActv.Logl PwrLimr.BrdgVltg.Val PwrLimr.DualEcuFltMtgtnSca.Val PwrLimr.IvtrLoaMtgtnEna.Logl PwrLimr.MotBackEmfConEstimd.Val PwrLimr.MotTqCmdMrf.Val PwrLimr.MotVelMrf.Val /end SUB_GROUP
 /begin FUNCTION_LIST /end FUNCTION_LIST
 /begin REF_CHARACTERISTIC /end REF_CHARACTERISTIC
 /begin REF_MEASUREMENT /end REF_MEASUREMENT
/end GROUP
/begin GROUP PwrLimr.SenderPorts "MICROSAR RTE" /begin SUB_GROUP PwrLimr.MotTqCmdPwrLimd.Val PwrLimr.PwrLimrRednFac.Val /end SUB_GROUP /begin FUNCTION_LIST /end FUNCTION_LIST /begin REF_CHARACTERISTIC /end REF_CHARACTERISTIC /begin REF_MEASUREMENT /end REF_MEASUREMENT /end GROUP
/begin GROUP PwrLimr.SpdAdjSlewStVari "MICROSAR RTE" /begin SUB_GROUP /end SUB_GROUP /begin FUNCTION_LIST /end FUNCTION_LIST /begin REF_CHARACTERISTIC /end REF_CHARACTERISTIC /begin REF_MEASUREMENT PwrLimr.SpdAdjSlewStVari /end REF_MEASUREMENT /end GROUP
/begin GROUP PwrLimr.TqLimAssiRednLpFil "MICROSAR RTE" /begin SUB_GROUP /end SUB_GROUP /begin FUNCTION_LIST /end FUNCTION_LIST /begin REF_CHARACTERISTIC /end REF_CHARACTERISTIC
 /begin REF_MEASUREMENT PwrLimr.TqLimAssiRednLpFil.FilGain PwrLimr.TqLimAssiRednLpFil.FilSt /end REF_MEASUREMENT
/end GROUP
/begin GROUP PwrLimr.dPwrLimrFildMotVel "MICROSAR RTE" /begin SUB_GROUP /end SUB_GROUP /begin FUNCTION_LIST /end FUNCTION_LIST /begin REF_CHARACTERISTIC /end REF_CHARACTERISTIC /begin REF_MEASUREMENT PwrLimr.dPwrLimrFildMotVel /end REF_MEASUREMENT /end GROUP
/begin GROUP PwrLimr.dPwrLimrLimDif "MICROSAR RTE" /begin SUB_GROUP /end SUB_GROUP /begin FUNCTION_LIST /end FUNCTION_LIST /begin REF_CHARACTERISTIC /end REF_CHARACTERISTIC /begin REF_MEASUREMENT PwrLimr.dPwrLimrLimDif /end REF_MEASUREMENT /end GROUP
/begin GROUP PwrLimr.dPwrLimrMinStdOperLim "MICROSAR RTE" /begin SUB_GROUP /end SUB_GROUP /begin FUNCTION_LIST /end FUNCTION_LIST /begin REF_CHARACTERISTIC /end REF_CHARACTERISTIC /begin REF_MEASUREMENT PwrLimr.dPwrLimrMinStdOperLim /end REF_MEASUREMENT /end GROUP
/begin GROUP PwrLimr.dPwrLimrMotEnvlpSpd "MICROSAR RTE" /begin SUB_GROUP /end SUB_GROUP /begin FUNCTION_LIST /end FUNCTION_LIST /begin REF_CHARACTERISTIC /end REF_CHARACTERISTIC /begin REF_MEASUREMENT PwrLimr.dPwrLimrMotEnvlpSpd /end REF_MEASUREMENT /end GROUP
/begin GROUP PwrLimr.dPwrLimrMotTqCmdIvtrLoaSca "MICROSAR RTE" /begin SUB_GROUP /end SUB_GROUP /begin FUNCTION_LIST /end FUNCTION_LIST /begin REF_CHARACTERISTIC /end REF_CHARACTERISTIC /begin REF_MEASUREMENT PwrLimr.dPwrLimrMotTqCmdIvtrLoaSca /end REF_MEASUREMENT /end GROUP
/begin GROUP PwrLimr.dPwrLimrOutpVelOffs "MICROSAR RTE" /begin SUB_GROUP /end SUB_GROUP /begin FUNCTION_LIST /end FUNCTION_LIST /begin REF_CHARACTERISTIC /end REF_CHARACTERISTIC /begin REF_MEASUREMENT PwrLimr.dPwrLimrOutpVelOffs /end REF_MEASUREMENT /end GROUP
/begin GROUP PwrLimr.dPwrLimrSpdAdj "MICROSAR RTE" /begin SUB_GROUP /end SUB_GROUP /begin FUNCTION_LIST /end FUNCTION_LIST /begin REF_CHARACTERISTIC /end REF_CHARACTERISTIC /begin REF_MEASUREMENT PwrLimr.dPwrLimrSpdAdj /end REF_MEASUREMENT /end GROUP
/begin GROUP PwrLimr.dPwrLimrTLimMaxCurr "MICROSAR RTE" /begin SUB_GROUP /end SUB_GROUP /begin FUNCTION_LIST /end FUNCTION_LIST /begin REF_CHARACTERISTIC /end REF_CHARACTERISTIC /begin REF_MEASUREMENT PwrLimr.dPwrLimrTLimMaxCurr /end REF_MEASUREMENT /end GROUP
/begin GROUP PwrLimr.dPwrLimrTqEnvlpLim1 "MICROSAR RTE" /begin SUB_GROUP /end SUB_GROUP /begin FUNCTION_LIST /end FUNCTION_LIST /begin REF_CHARACTERISTIC /end REF_CHARACTERISTIC /begin REF_MEASUREMENT PwrLimr.dPwrLimrTqEnvlpLim1 /end REF_MEASUREMENT /end GROUP
/begin GROUP PwrLimr.dPwrLimrTqEnvlpLim4 "MICROSAR RTE" /begin SUB_GROUP /end SUB_GROUP /begin FUNCTION_LIST /end FUNCTION_LIST /begin REF_CHARACTERISTIC /end REF_CHARACTERISTIC /begin REF_MEASUREMENT PwrLimr.dPwrLimrTqEnvlpLim4 /end REF_MEASUREMENT /end GROUP
/begin GROUP PwrLimr.dPwrLimrTqLim "MICROSAR RTE" /begin SUB_GROUP /end SUB_GROUP /begin FUNCTION_LIST /end FUNCTION_LIST /begin REF_CHARACTERISTIC /end REF_CHARACTERISTIC /begin REF_MEASUREMENT PwrLimr.dPwrLimrTqLim /end REF_MEASUREMENT /end GROUP
/begin GROUP PwrLimr.dPwrLimrTqLim1 "MICROSAR RTE" /begin SUB_GROUP /end SUB_GROUP /begin FUNCTION_LIST /end FUNCTION_LIST /begin REF_CHARACTERISTIC /end REF_CHARACTERISTIC /begin REF_MEASUREMENT PwrLimr.dPwrLimrTqLim1 /end REF_MEASUREMENT /end GROUP
/begin GROUP PwrLimr.dPwrLimrTqLim4 "MICROSAR RTE" /begin SUB_GROUP /end SUB_GROUP /begin FUNCTION_LIST /end FUNCTION_LIST /begin REF_CHARACTERISTIC /end REF_CHARACTERISTIC /begin REF_MEASUREMENT PwrLimr.dPwrLimrTqLim4 /end REF_MEASUREMENT /end GROUP
/begin GROUP PwrSply "MICROSAR RTE"
 /begin SUB_GROUP PwrSply.CalibrationPorts PwrSply.PerInstanceMemories PwrSply.ReceiverPorts /end SUB_GROUP
 /begin FUNCTION_LIST /end FUNCTION_LIST
 /begin REF_CHARACTERISTIC /end REF_CHARACTERISTIC
 /begin REF_MEASUREMENT /end REF_MEASUREMENT
/end GROUP
/begin GROUP PwrSply.CalibrationPorts "MICROSAR RTE"
 /begin SUB_GROUP PwrSply.PwrSplyNtc0x07BFailStep.Val PwrSply.PwrSplyNtc0x07BPassStep.Val PwrSply.PwrSplyNtc0x07CFailStep.Val PwrSply.PwrSplyNtc0x07CPassStep.Val PwrSply.PwrSplyNtc0x07DFailStep.Val PwrSply.PwrSplyNtc0x07DPassStep.Val /end SUB_GROUP
 /begin FUNCTION_LIST /end FUNCTION_LIST
 /begin REF_CHARACTERISTIC /end REF_CHARACTERISTIC
 /begin REF_MEASUREMENT /end REF_MEASUREMENT
/end GROUP
/begin GROUP PwrSply.PerInstanceMemories "MICROSAR RTE"
 /begin SUB_GROUP PwrSply.PwrSplyReadWrOrderFlg1 PwrSply.PwrSplyReadWrOrderFlg2 PwrSply.PwrSplyStrtUpSelfTestCmpl /end SUB_GROUP
 /begin FUNCTION_LIST /end FUNCTION_LIST
 /begin REF_CHARACTERISTIC /end REF_CHARACTERISTIC
 /begin REF_MEASUREMENT /end REF_MEASUREMENT
/end GROUP
/begin GROUP PwrSply.PwrSplyNtc0x07BFailStep.Val "MICROSAR RTE" /begin SUB_GROUP /end SUB_GROUP /begin FUNCTION_LIST /end FUNCTION_LIST /begin REF_CHARACTERISTIC PwrSply.PwrSplyNtc0x07BFailStep.Val /end REF_CHARACTERISTIC /begin REF_MEASUREMENT /end REF_MEASUREMENT /end GROUP
/begin GROUP PwrSply.PwrSplyNtc0x07BPassStep.Val "MICROSAR RTE" /begin SUB_GROUP /end SUB_GROUP /begin FUNCTION_LIST /end FUNCTION_LIST /begin REF_CHARACTERISTIC PwrSply.PwrSplyNtc0x07BPassStep.Val /end REF_CHARACTERISTIC /begin REF_MEASUREMENT /end REF_MEASUREMENT /end GROUP
/begin GROUP PwrSply.PwrSplyNtc0x07CFailStep.Val "MICROSAR RTE" /begin SUB_GROUP /end SUB_GROUP /begin FUNCTION_LIST /end FUNCTION_LIST /begin REF_CHARACTERISTIC PwrSply.PwrSplyNtc0x07CFailStep.Val /end REF_CHARACTERISTIC /begin REF_MEASUREMENT /end REF_MEASUREMENT /end GROUP
/begin GROUP PwrSply.PwrSplyNtc0x07CPassStep.Val "MICROSAR RTE" /begin SUB_GROUP /end SUB_GROUP /begin FUNCTION_LIST /end FUNCTION_LIST /begin REF_CHARACTERISTIC PwrSply.PwrSplyNtc0x07CPassStep.Val /end REF_CHARACTERISTIC /begin REF_MEASUREMENT /end REF_MEASUREMENT /end GROUP
/begin GROUP PwrSply.PwrSplyNtc0x07DFailStep.Val "MICROSAR RTE" /begin SUB_GROUP /end SUB_GROUP /begin FUNCTION_LIST /end FUNCTION_LIST /begin REF_CHARACTERISTIC PwrSply.PwrSplyNtc0x07DFailStep.Val /end REF_CHARACTERISTIC /begin REF_MEASUREMENT /end REF_MEASUREMENT /end GROUP
/begin GROUP PwrSply.PwrSplyNtc0x07DPassStep.Val "MICROSAR RTE" /begin SUB_GROUP /end SUB_GROUP /begin FUNCTION_LIST /end FUNCTION_LIST /begin REF_CHARACTERISTIC PwrSply.PwrSplyNtc0x07DPassStep.Val /end REF_CHARACTERISTIC /begin REF_MEASUREMENT /end REF_MEASUREMENT /end GROUP
/begin GROUP PwrSply.PwrSplyReadWrOrderFlg1 "MICROSAR RTE" /begin SUB_GROUP /end SUB_GROUP /begin FUNCTION_LIST /end FUNCTION_LIST /begin REF_CHARACTERISTIC /end REF_CHARACTERISTIC /begin REF_MEASUREMENT PwrSply.PwrSplyReadWrOrderFlg1 /end REF_MEASUREMENT /end GROUP
/begin GROUP PwrSply.PwrSplyReadWrOrderFlg2 "MICROSAR RTE" /begin SUB_GROUP /end SUB_GROUP /begin FUNCTION_LIST /end FUNCTION_LIST /begin REF_CHARACTERISTIC /end REF_CHARACTERISTIC /begin REF_MEASUREMENT PwrSply.PwrSplyReadWrOrderFlg2 /end REF_MEASUREMENT /end GROUP
/begin GROUP PwrSply.PwrSplyStrtUpSelfTestCmpl "MICROSAR RTE" /begin SUB_GROUP /end SUB_GROUP /begin FUNCTION_LIST /end FUNCTION_LIST /begin REF_CHARACTERISTIC /end REF_CHARACTERISTIC /begin REF_MEASUREMENT PwrSply.PwrSplyStrtUpSelfTestCmpl /end REF_MEASUREMENT /end GROUP
/begin GROUP PwrSply.ReceiverPorts "MICROSAR RTE" /begin SUB_GROUP PwrSply.SysSt.Val /end SUB_GROUP /begin FUNCTION_LIST /end FUNCTION_LIST /begin REF_CHARACTERISTIC /end REF_CHARACTERISTIC /begin REF_MEASUREMENT /end REF_MEASUREMENT /end GROUP
/begin GROUP PwrSply.SysSt.Val "MICROSAR RTE" /begin SUB_GROUP /end SUB_GROUP /begin FUNCTION_LIST /end FUNCTION_LIST /begin REF_CHARACTERISTIC /end REF_CHARACTERISTIC /begin REF_MEASUREMENT PwrSply.SysSt.Val /end REF_MEASUREMENT /end GROUP
/begin GROUP PwrUpSeq "MICROSAR RTE" /begin SUB_GROUP PwrUpSeq.ReceiverPorts PwrUpSeq.SenderPorts /end SUB_GROUP /begin FUNCTION_LIST /end FUNCTION_LIST /begin REF_CHARACTERISTIC /end REF_CHARACTERISTIC /begin REF_MEASUREMENT /end REF_MEASUREMENT /end GROUP
/begin GROUP PwrUpSeq.CodFlsCrcChkCmpl.Logl "MICROSAR RTE" /begin SUB_GROUP /end SUB_GROUP /begin FUNCTION_LIST /end FUNCTION_LIST /begin REF_CHARACTERISTIC /end REF_CHARACTERISTIC /begin REF_MEASUREMENT PwrUpSeq.CodFlsCrcChkCmpl.Logl /end REF_MEASUREMENT /end GROUP
/begin GROUP PwrUpSeq.CurrMeasWrmIninTestCmpl.Logl "MICROSAR RTE" /begin SUB_GROUP /end SUB_GROUP /begin FUNCTION_LIST /end FUNCTION_LIST /begin REF_CHARACTERISTIC /end REF_CHARACTERISTIC /begin REF_MEASUREMENT PwrUpSeq.CurrMeasWrmIninTestCmpl.Logl /end REF_MEASUREMENT /end GROUP
/begin GROUP PwrUpSeq.MotDrvr0IninTestCmpl.Logl "MICROSAR RTE" /begin SUB_GROUP /end SUB_GROUP /begin FUNCTION_LIST /end FUNCTION_LIST /begin REF_CHARACTERISTIC /end REF_CHARACTERISTIC /begin REF_MEASUREMENT PwrUpSeq.MotDrvr0IninTestCmpl.Logl /end REF_MEASUREMENT /end GROUP
/begin GROUP PwrUpSeq.MotDrvr1IninTestCmpl.Logl "MICROSAR RTE" /begin SUB_GROUP /end SUB_GROUP /begin FUNCTION_LIST /end FUNCTION_LIST /begin REF_CHARACTERISTIC /end REF_CHARACTERISTIC /begin REF_MEASUREMENT PwrUpSeq.MotDrvr1IninTestCmpl.Logl /end REF_MEASUREMENT /end GROUP
/begin GROUP PwrUpSeq.PwrDiscnctATestCmpl.Logl "MICROSAR RTE" /begin SUB_GROUP /end SUB_GROUP /begin FUNCTION_LIST /end FUNCTION_LIST /begin REF_CHARACTERISTIC /end REF_CHARACTERISTIC /begin REF_MEASUREMENT PwrUpSeq.PwrDiscnctATestCmpl.Logl /end REF_MEASUREMENT /end GROUP
/begin GROUP PwrUpSeq.PwrDiscnctBTestCmpl.Logl "MICROSAR RTE" /begin SUB_GROUP /end SUB_GROUP /begin FUNCTION_LIST /end FUNCTION_LIST /begin REF_CHARACTERISTIC /end REF_CHARACTERISTIC /begin REF_MEASUREMENT PwrUpSeq.PwrDiscnctBTestCmpl.Logl /end REF_MEASUREMENT /end GROUP
/begin GROUP PwrUpSeq.ReceiverPorts "MICROSAR RTE"
 /begin SUB_GROUP PwrUpSeq.CodFlsCrcChkCmpl.Logl PwrUpSeq.CurrMeasWrmIninTestCmpl.Logl PwrUpSeq.MotDrvr0IninTestCmpl.Logl PwrUpSeq.MotDrvr1IninTestCmpl.Logl PwrUpSeq.PwrDiscnctATestCmpl.Logl PwrUpSeq.PwrDiscnctBTestCmpl.Logl PwrUpSeq.SysSt.Val PwrUpSeq.TmplMonIninTestCmpl.Logl /end SUB_GROUP
 /begin FUNCTION_LIST /end FUNCTION_LIST
 /begin REF_CHARACTERISTIC /end REF_CHARACTERISTIC
 /begin REF_MEASUREMENT /end REF_MEASUREMENT
/end GROUP
/begin GROUP PwrUpSeq.SenderPorts "MICROSAR RTE" /begin SUB_GROUP PwrUpSeq.StrtUpSt.Val PwrUpSeq.SysStWrmIninCmpl.Logl /end SUB_GROUP /begin FUNCTION_LIST /end FUNCTION_LIST /begin REF_CHARACTERISTIC /end REF_CHARACTERISTIC /begin REF_MEASUREMENT /end REF_MEASUREMENT /end GROUP
/begin GROUP PwrUpSeq.StrtUpSt.Val "MICROSAR RTE" /begin SUB_GROUP /end SUB_GROUP /begin FUNCTION_LIST /end FUNCTION_LIST /begin REF_CHARACTERISTIC /end REF_CHARACTERISTIC /begin REF_MEASUREMENT PwrUpSeq.StrtUpSt.Val /end REF_MEASUREMENT /end GROUP
/begin GROUP PwrUpSeq.SysSt.Val "MICROSAR RTE" /begin SUB_GROUP /end SUB_GROUP /begin FUNCTION_LIST /end FUNCTION_LIST /begin REF_CHARACTERISTIC /end REF_CHARACTERISTIC /begin REF_MEASUREMENT PwrUpSeq.SysSt.Val /end REF_MEASUREMENT /end GROUP
/begin GROUP PwrUpSeq.SysStWrmIninCmpl.Logl "MICROSAR RTE" /begin SUB_GROUP /end SUB_GROUP /begin FUNCTION_LIST /end FUNCTION_LIST /begin REF_CHARACTERISTIC /end REF_CHARACTERISTIC /begin REF_MEASUREMENT PwrUpSeq.SysStWrmIninCmpl.Logl /end REF_MEASUREMENT /end GROUP
/begin GROUP PwrUpSeq.TmplMonIninTestCmpl.Logl "MICROSAR RTE" /begin SUB_GROUP /end SUB_GROUP /begin FUNCTION_LIST /end FUNCTION_LIST /begin REF_CHARACTERISTIC /end REF_CHARACTERISTIC /begin REF_MEASUREMENT PwrUpSeq.TmplMonIninTestCmpl.Logl /end REF_MEASUREMENT /end GROUP
/begin GROUP PwrpkCmpbltyChk "MICROSAR RTE"
 /begin SUB_GROUP PwrpkCmpbltyChk.CalibrationPorts PwrpkCmpbltyChk.PerInstanceMemories PwrpkCmpbltyChk.ReceiverPorts /end SUB_GROUP
 /begin FUNCTION_LIST /end FUNCTION_LIST
 /begin REF_CHARACTERISTIC /end REF_CHARACTERISTIC
 /begin REF_MEASUREMENT /end REF_MEASUREMENT
/end GROUP
/begin GROUP PwrpkCmpbltyChk.CalibrationPorts "MICROSAR RTE" /begin SUB_GROUP PwrpkCmpbltyChk.PwrpkCmpbltyChkGearId.Val /end SUB_GROUP /begin FUNCTION_LIST /end FUNCTION_LIST /begin REF_CHARACTERISTIC /end REF_CHARACTERISTIC /begin REF_MEASUREMENT /end REF_MEASUREMENT /end GROUP
/begin GROUP PwrpkCmpbltyChk.GearIdn1.Val "MICROSAR RTE" /begin SUB_GROUP /end SUB_GROUP /begin FUNCTION_LIST /end FUNCTION_LIST /begin REF_CHARACTERISTIC /end REF_CHARACTERISTIC /begin REF_MEASUREMENT PwrpkCmpbltyChk.GearIdn1.Val /end REF_MEASUREMENT /end GROUP
/begin GROUP PwrpkCmpbltyChk.GearIdn1Vld.Logl "MICROSAR RTE" /begin SUB_GROUP /end SUB_GROUP /begin FUNCTION_LIST /end FUNCTION_LIST /begin REF_CHARACTERISTIC /end REF_CHARACTERISTIC /begin REF_MEASUREMENT PwrpkCmpbltyChk.GearIdn1Vld.Logl /end REF_MEASUREMENT /end GROUP
/begin GROUP PwrpkCmpbltyChk.GearIdn2.Val "MICROSAR RTE" /begin SUB_GROUP /end SUB_GROUP /begin FUNCTION_LIST /end FUNCTION_LIST /begin REF_CHARACTERISTIC /end REF_CHARACTERISTIC /begin REF_MEASUREMENT PwrpkCmpbltyChk.GearIdn2.Val /end REF_MEASUREMENT /end GROUP
/begin GROUP PwrpkCmpbltyChk.GearIdn2Vld.Logl "MICROSAR RTE" /begin SUB_GROUP /end SUB_GROUP /begin FUNCTION_LIST /end FUNCTION_LIST /begin REF_CHARACTERISTIC /end REF_CHARACTERISTIC /begin REF_MEASUREMENT PwrpkCmpbltyChk.GearIdn2Vld.Logl /end REF_MEASUREMENT /end GROUP
/begin GROUP PwrpkCmpbltyChk.GearIdnRefTmr "MICROSAR RTE" /begin SUB_GROUP /end SUB_GROUP /begin FUNCTION_LIST /end FUNCTION_LIST /begin REF_CHARACTERISTIC /end REF_CHARACTERISTIC /begin REF_MEASUREMENT PwrpkCmpbltyChk.GearIdnRefTmr /end REF_MEASUREMENT /end GROUP
/begin GROUP PwrpkCmpbltyChk.PerInstanceMemories "MICROSAR RTE" /begin SUB_GROUP PwrpkCmpbltyChk.GearIdnRefTmr /end SUB_GROUP /begin FUNCTION_LIST /end FUNCTION_LIST /begin REF_CHARACTERISTIC /end REF_CHARACTERISTIC /begin REF_MEASUREMENT /end REF_MEASUREMENT /end GROUP
/begin GROUP PwrpkCmpbltyChk.PwrpkCmpbltyChkGearId.Val "MICROSAR RTE" /begin SUB_GROUP /end SUB_GROUP /begin FUNCTION_LIST /end FUNCTION_LIST /begin REF_CHARACTERISTIC PwrpkCmpbltyChk.PwrpkCmpbltyChkGearId.Val /end REF_CHARACTERISTIC /begin REF_MEASUREMENT /end REF_MEASUREMENT /end GROUP
/begin GROUP PwrpkCmpbltyChk.ReceiverPorts "MICROSAR RTE"
 /begin SUB_GROUP PwrpkCmpbltyChk.GearIdn1.Val PwrpkCmpbltyChk.GearIdn1Vld.Logl PwrpkCmpbltyChk.GearIdn2.Val PwrpkCmpbltyChk.GearIdn2Vld.Logl /end SUB_GROUP
 /begin FUNCTION_LIST /end FUNCTION_LIST
 /begin REF_CHARACTERISTIC /end REF_CHARACTERISTIC
 /begin REF_MEASUREMENT /end REF_MEASUREMENT
/end GROUP
/begin GROUP RTE "MICROSAR RTE" /begin SUB_GROUP SWCs /end SUB_GROUP /begin FUNCTION_LIST /end FUNCTION_LIST /begin REF_CHARACTERISTIC /end REF_CHARACTERISTIC /begin REF_MEASUREMENT /end REF_MEASUREMENT /end GROUP
/begin GROUP Rtn "MICROSAR RTE"
 /begin SUB_GROUP Rtn.CalibrationPorts Rtn.PerInstanceMemories Rtn.ReceiverPorts Rtn.SenderPorts /end SUB_GROUP
 /begin FUNCTION_LIST /end FUNCTION_LIST
 /begin REF_CHARACTERISTIC /end REF_CHARACTERISTIC
 /begin REF_MEASUREMENT /end REF_MEASUREMENT
/end GROUP
/begin GROUP Rtn.AssiMechT.Val "MICROSAR RTE" /begin SUB_GROUP /end SUB_GROUP /begin FUNCTION_LIST /end FUNCTION_LIST /begin REF_CHARACTERISTIC /end REF_CHARACTERISTIC /begin REF_MEASUREMENT Rtn.AssiMechT.Val /end REF_MEASUREMENT /end GROUP
/begin GROUP Rtn.CalibrationPorts "MICROSAR RTE"
 /begin SUB_GROUP Rtn.RtnHwAgOffsCalcdX.Ary2D Rtn.RtnHwAgOffsCalcdY.Ary2D Rtn.RtnHwAuthyScaX.Ary1D Rtn.RtnHwAuthyScaY.Ary1D Rtn.RtnHwAuthySlew.Val Rtn.RtnOffsRng.Val Rtn.RtnOffsSlew.Val Rtn.RtnScaTqX.Ary2D Rtn.RtnScaTqY.Ary2D Rtn.RtnScaVelX.Ary2D Rtn.RtnScaVelY.Ary2D Rtn.RtnTScaX.Ary1D Rtn.RtnTScaY.Ary1D Rtn.RtnVehSpdSeln.Ary1D /end SUB_GROUP
 /begin FUNCTION_LIST /end FUNCTION_LIST
 /begin REF_CHARACTERISTIC /end REF_CHARACTERISTIC
 /begin REF_MEASUREMENT /end REF_MEASUREMENT
/end GROUP
/begin GROUP Rtn.HwAg.Val "MICROSAR RTE" /begin SUB_GROUP /end SUB_GROUP /begin FUNCTION_LIST /end FUNCTION_LIST /begin REF_CHARACTERISTIC /end REF_CHARACTERISTIC /begin REF_MEASUREMENT Rtn.HwAg.Val /end REF_MEASUREMENT /end GROUP
/begin GROUP Rtn.HwAgAuthySca.Val "MICROSAR RTE" /begin SUB_GROUP /end SUB_GROUP /begin FUNCTION_LIST /end FUNCTION_LIST /begin REF_CHARACTERISTIC /end REF_CHARACTERISTIC /begin REF_MEASUREMENT Rtn.HwAgAuthySca.Val /end REF_MEASUREMENT /end GROUP
/begin GROUP Rtn.HwAgRtnOffs.Val "MICROSAR RTE" /begin SUB_GROUP /end SUB_GROUP /begin FUNCTION_LIST /end FUNCTION_LIST /begin REF_CHARACTERISTIC /end REF_CHARACTERISTIC /begin REF_MEASUREMENT Rtn.HwAgRtnOffs.Val /end REF_MEASUREMENT /end GROUP
/begin GROUP Rtn.HwTq.Val "MICROSAR RTE" /begin SUB_GROUP /end SUB_GROUP /begin FUNCTION_LIST /end FUNCTION_LIST /begin REF_CHARACTERISTIC /end REF_CHARACTERISTIC /begin REF_MEASUREMENT Rtn.HwTq.Val /end REF_MEASUREMENT /end GROUP
/begin GROUP Rtn.HwVel.Val "MICROSAR RTE" /begin SUB_GROUP /end SUB_GROUP /begin FUNCTION_LIST /end FUNCTION_LIST /begin REF_CHARACTERISTIC /end REF_CHARACTERISTIC /begin REF_MEASUREMENT Rtn.HwVel.Val /end REF_MEASUREMENT /end GROUP
/begin GROUP Rtn.PerInstanceMemories "MICROSAR RTE"
 /begin SUB_GROUP Rtn.PrevHwAgAuthy Rtn.PrevHwAgOffsLimd Rtn.dRtnAbsltHwAgOffsCalcd Rtn.dRtnAssiMechTRtnSca Rtn.dRtnBascRtn Rtn.dRtnHwAgAuthySca Rtn.dRtnHwAgRtnCmd Rtn.dRtnHwTqRtnSca Rtn.dRtnHwVelRtnSca /end SUB_GROUP
 /begin FUNCTION_LIST /end FUNCTION_LIST
 /begin REF_CHARACTERISTIC /end REF_CHARACTERISTIC
 /begin REF_MEASUREMENT /end REF_MEASUREMENT
/end GROUP
/begin GROUP Rtn.PrevHwAgAuthy "MICROSAR RTE" /begin SUB_GROUP /end SUB_GROUP /begin FUNCTION_LIST /end FUNCTION_LIST /begin REF_CHARACTERISTIC /end REF_CHARACTERISTIC /begin REF_MEASUREMENT Rtn.PrevHwAgAuthy /end REF_MEASUREMENT /end GROUP
/begin GROUP Rtn.PrevHwAgOffsLimd "MICROSAR RTE" /begin SUB_GROUP /end SUB_GROUP /begin FUNCTION_LIST /end FUNCTION_LIST /begin REF_CHARACTERISTIC /end REF_CHARACTERISTIC /begin REF_MEASUREMENT Rtn.PrevHwAgOffsLimd /end REF_MEASUREMENT /end GROUP
/begin GROUP Rtn.ReceiverPorts "MICROSAR RTE"
 /begin SUB_GROUP Rtn.AssiMechT.Val Rtn.HwAg.Val Rtn.HwAgAuthySca.Val Rtn.HwAgRtnOffs.Val Rtn.HwTq.Val Rtn.HwVel.Val Rtn.RtnCmdDi.Logl Rtn.RtnCmdDiagcDi.Logl Rtn.RtnCmdSca.Val Rtn.RtnCmdScaServo.Val Rtn.VehSpd.Val /end SUB_GROUP
 /begin FUNCTION_LIST /end FUNCTION_LIST
 /begin REF_CHARACTERISTIC /end REF_CHARACTERISTIC
 /begin REF_MEASUREMENT /end REF_MEASUREMENT
/end GROUP
/begin GROUP Rtn.RtnCmd.Val "MICROSAR RTE" /begin SUB_GROUP /end SUB_GROUP /begin FUNCTION_LIST /end FUNCTION_LIST /begin REF_CHARACTERISTIC /end REF_CHARACTERISTIC /begin REF_MEASUREMENT Rtn.RtnCmd.Val /end REF_MEASUREMENT /end GROUP
/begin GROUP Rtn.RtnCmdDi.Logl "MICROSAR RTE" /begin SUB_GROUP /end SUB_GROUP /begin FUNCTION_LIST /end FUNCTION_LIST /begin REF_CHARACTERISTIC /end REF_CHARACTERISTIC /begin REF_MEASUREMENT Rtn.RtnCmdDi.Logl /end REF_MEASUREMENT /end GROUP
/begin GROUP Rtn.RtnCmdDiagcDi.Logl "MICROSAR RTE" /begin SUB_GROUP /end SUB_GROUP /begin FUNCTION_LIST /end FUNCTION_LIST /begin REF_CHARACTERISTIC /end REF_CHARACTERISTIC /begin REF_MEASUREMENT Rtn.RtnCmdDiagcDi.Logl /end REF_MEASUREMENT /end GROUP
/begin GROUP Rtn.RtnCmdSca.Val "MICROSAR RTE" /begin SUB_GROUP /end SUB_GROUP /begin FUNCTION_LIST /end FUNCTION_LIST /begin REF_CHARACTERISTIC /end REF_CHARACTERISTIC /begin REF_MEASUREMENT Rtn.RtnCmdSca.Val /end REF_MEASUREMENT /end GROUP
/begin GROUP Rtn.RtnCmdScaServo.Val "MICROSAR RTE" /begin SUB_GROUP /end SUB_GROUP /begin FUNCTION_LIST /end FUNCTION_LIST /begin REF_CHARACTERISTIC /end REF_CHARACTERISTIC /begin REF_MEASUREMENT Rtn.RtnCmdScaServo.Val /end REF_MEASUREMENT /end GROUP
/begin GROUP Rtn.RtnHwAgOffsCalcdX.Ary2D "MICROSAR RTE" /begin SUB_GROUP /end SUB_GROUP /begin FUNCTION_LIST /end FUNCTION_LIST /begin REF_CHARACTERISTIC Rtn.RtnHwAgOffsCalcdX.Ary2D /end REF_CHARACTERISTIC /begin REF_MEASUREMENT /end REF_MEASUREMENT /end GROUP
/begin GROUP Rtn.RtnHwAgOffsCalcdY.Ary2D "MICROSAR RTE" /begin SUB_GROUP /end SUB_GROUP /begin FUNCTION_LIST /end FUNCTION_LIST /begin REF_CHARACTERISTIC Rtn.RtnHwAgOffsCalcdY.Ary2D /end REF_CHARACTERISTIC /begin REF_MEASUREMENT /end REF_MEASUREMENT /end GROUP
/begin GROUP Rtn.RtnHwAuthyScaX.Ary1D "MICROSAR RTE" /begin SUB_GROUP /end SUB_GROUP /begin FUNCTION_LIST /end FUNCTION_LIST /begin REF_CHARACTERISTIC Rtn.RtnHwAuthyScaX.Ary1D /end REF_CHARACTERISTIC /begin REF_MEASUREMENT /end REF_MEASUREMENT /end GROUP
/begin GROUP Rtn.RtnHwAuthyScaY.Ary1D "MICROSAR RTE" /begin SUB_GROUP /end SUB_GROUP /begin FUNCTION_LIST /end FUNCTION_LIST /begin REF_CHARACTERISTIC Rtn.RtnHwAuthyScaY.Ary1D /end REF_CHARACTERISTIC /begin REF_MEASUREMENT /end REF_MEASUREMENT /end GROUP
/begin GROUP Rtn.RtnHwAuthySlew.Val "MICROSAR RTE" /begin SUB_GROUP /end SUB_GROUP /begin FUNCTION_LIST /end FUNCTION_LIST /begin REF_CHARACTERISTIC Rtn.RtnHwAuthySlew.Val /end REF_CHARACTERISTIC /begin REF_MEASUREMENT /end REF_MEASUREMENT /end GROUP
/begin GROUP Rtn.RtnOffsRng.Val "MICROSAR RTE" /begin SUB_GROUP /end SUB_GROUP /begin FUNCTION_LIST /end FUNCTION_LIST /begin REF_CHARACTERISTIC Rtn.RtnOffsRng.Val /end REF_CHARACTERISTIC /begin REF_MEASUREMENT /end REF_MEASUREMENT /end GROUP
/begin GROUP Rtn.RtnOffsSlew.Val "MICROSAR RTE" /begin SUB_GROUP /end SUB_GROUP /begin FUNCTION_LIST /end FUNCTION_LIST /begin REF_CHARACTERISTIC Rtn.RtnOffsSlew.Val /end REF_CHARACTERISTIC /begin REF_MEASUREMENT /end REF_MEASUREMENT /end GROUP
/begin GROUP Rtn.RtnScaTqX.Ary2D "MICROSAR RTE" /begin SUB_GROUP /end SUB_GROUP /begin FUNCTION_LIST /end FUNCTION_LIST /begin REF_CHARACTERISTIC Rtn.RtnScaTqX.Ary2D /end REF_CHARACTERISTIC /begin REF_MEASUREMENT /end REF_MEASUREMENT /end GROUP
/begin GROUP Rtn.RtnScaTqY.Ary2D "MICROSAR RTE" /begin SUB_GROUP /end SUB_GROUP /begin FUNCTION_LIST /end FUNCTION_LIST /begin REF_CHARACTERISTIC Rtn.RtnScaTqY.Ary2D /end REF_CHARACTERISTIC /begin REF_MEASUREMENT /end REF_MEASUREMENT /end GROUP
/begin GROUP Rtn.RtnScaVelX.Ary2D "MICROSAR RTE" /begin SUB_GROUP /end SUB_GROUP /begin FUNCTION_LIST /end FUNCTION_LIST /begin REF_CHARACTERISTIC Rtn.RtnScaVelX.Ary2D /end REF_CHARACTERISTIC /begin REF_MEASUREMENT /end REF_MEASUREMENT /end GROUP
/begin GROUP Rtn.RtnScaVelY.Ary2D "MICROSAR RTE" /begin SUB_GROUP /end SUB_GROUP /begin FUNCTION_LIST /end FUNCTION_LIST /begin REF_CHARACTERISTIC Rtn.RtnScaVelY.Ary2D /end REF_CHARACTERISTIC /begin REF_MEASUREMENT /end REF_MEASUREMENT /end GROUP
/begin GROUP Rtn.RtnTScaX.Ary1D "MICROSAR RTE" /begin SUB_GROUP /end SUB_GROUP /begin FUNCTION_LIST /end FUNCTION_LIST /begin REF_CHARACTERISTIC Rtn.RtnTScaX.Ary1D /end REF_CHARACTERISTIC /begin REF_MEASUREMENT /end REF_MEASUREMENT /end GROUP
/begin GROUP Rtn.RtnTScaY.Ary1D "MICROSAR RTE" /begin SUB_GROUP /end SUB_GROUP /begin FUNCTION_LIST /end FUNCTION_LIST /begin REF_CHARACTERISTIC Rtn.RtnTScaY.Ary1D /end REF_CHARACTERISTIC /begin REF_MEASUREMENT /end REF_MEASUREMENT /end GROUP
/begin GROUP Rtn.RtnVehSpdSeln.Ary1D "MICROSAR RTE" /begin SUB_GROUP /end SUB_GROUP /begin FUNCTION_LIST /end FUNCTION_LIST /begin REF_CHARACTERISTIC Rtn.RtnVehSpdSeln.Ary1D /end REF_CHARACTERISTIC /begin REF_MEASUREMENT /end REF_MEASUREMENT /end GROUP
/begin GROUP Rtn.SenderPorts "MICROSAR RTE" /begin SUB_GROUP Rtn.RtnCmd.Val /end SUB_GROUP /begin FUNCTION_LIST /end FUNCTION_LIST /begin REF_CHARACTERISTIC /end REF_CHARACTERISTIC /begin REF_MEASUREMENT /end REF_MEASUREMENT /end GROUP
/begin GROUP Rtn.VehSpd.Val "MICROSAR RTE" /begin SUB_GROUP /end SUB_GROUP /begin FUNCTION_LIST /end FUNCTION_LIST /begin REF_CHARACTERISTIC /end REF_CHARACTERISTIC /begin REF_MEASUREMENT Rtn.VehSpd.Val /end REF_MEASUREMENT /end GROUP
/begin GROUP Rtn.dRtnAbsltHwAgOffsCalcd "MICROSAR RTE" /begin SUB_GROUP /end SUB_GROUP /begin FUNCTION_LIST /end FUNCTION_LIST /begin REF_CHARACTERISTIC /end REF_CHARACTERISTIC /begin REF_MEASUREMENT Rtn.dRtnAbsltHwAgOffsCalcd /end REF_MEASUREMENT /end GROUP
/begin GROUP Rtn.dRtnAssiMechTRtnSca "MICROSAR RTE" /begin SUB_GROUP /end SUB_GROUP /begin FUNCTION_LIST /end FUNCTION_LIST /begin REF_CHARACTERISTIC /end REF_CHARACTERISTIC /begin REF_MEASUREMENT Rtn.dRtnAssiMechTRtnSca /end REF_MEASUREMENT /end GROUP
/begin GROUP Rtn.dRtnBascRtn "MICROSAR RTE" /begin SUB_GROUP /end SUB_GROUP /begin FUNCTION_LIST /end FUNCTION_LIST /begin REF_CHARACTERISTIC /end REF_CHARACTERISTIC /begin REF_MEASUREMENT Rtn.dRtnBascRtn /end REF_MEASUREMENT /end GROUP
/begin GROUP Rtn.dRtnHwAgAuthySca "MICROSAR RTE" /begin SUB_GROUP /end SUB_GROUP /begin FUNCTION_LIST /end FUNCTION_LIST /begin REF_CHARACTERISTIC /end REF_CHARACTERISTIC /begin REF_MEASUREMENT Rtn.dRtnHwAgAuthySca /end REF_MEASUREMENT /end GROUP
/begin GROUP Rtn.dRtnHwAgRtnCmd "MICROSAR RTE" /begin SUB_GROUP /end SUB_GROUP /begin FUNCTION_LIST /end FUNCTION_LIST /begin REF_CHARACTERISTIC /end REF_CHARACTERISTIC /begin REF_MEASUREMENT Rtn.dRtnHwAgRtnCmd /end REF_MEASUREMENT /end GROUP
/begin GROUP Rtn.dRtnHwTqRtnSca "MICROSAR RTE" /begin SUB_GROUP /end SUB_GROUP /begin FUNCTION_LIST /end FUNCTION_LIST /begin REF_CHARACTERISTIC /end REF_CHARACTERISTIC /begin REF_MEASUREMENT Rtn.dRtnHwTqRtnSca /end REF_MEASUREMENT /end GROUP
/begin GROUP Rtn.dRtnHwVelRtnSca "MICROSAR RTE" /begin SUB_GROUP /end SUB_GROUP /begin FUNCTION_LIST /end FUNCTION_LIST /begin REF_CHARACTERISTIC /end REF_CHARACTERISTIC /begin REF_MEASUREMENT Rtn.dRtnHwVelRtnSca /end REF_MEASUREMENT /end GROUP
/begin GROUP RtnPahFwl "MICROSAR RTE"
 /begin SUB_GROUP RtnPahFwl.CalibrationPorts RtnPahFwl.PerInstanceMemories RtnPahFwl.ReceiverPorts RtnPahFwl.SenderPorts /end SUB_GROUP
 /begin FUNCTION_LIST /end FUNCTION_LIST
 /begin REF_CHARACTERISTIC /end REF_CHARACTERISTIC
 /begin REF_MEASUREMENT /end REF_MEASUREMENT
/end GROUP
/begin GROUP RtnPahFwl.CalibrationPorts "MICROSAR RTE"
 /begin SUB_GROUP RtnPahFwl.RtnPahFwlUpprBndTblX.Ary1D RtnPahFwl.RtnPahFwlUpprBndTblY.Ary2D RtnPahFwl.RtnPahFwlVehSpd.Ary1D /end SUB_GROUP
 /begin FUNCTION_LIST /end FUNCTION_LIST
 /begin REF_CHARACTERISTIC /end REF_CHARACTERISTIC
 /begin REF_MEASUREMENT /end REF_MEASUREMENT
/end GROUP
/begin GROUP RtnPahFwl.HwAg.Val "MICROSAR RTE" /begin SUB_GROUP /end SUB_GROUP /begin FUNCTION_LIST /end FUNCTION_LIST /begin REF_CHARACTERISTIC /end REF_CHARACTERISTIC /begin REF_MEASUREMENT RtnPahFwl.HwAg.Val /end REF_MEASUREMENT /end GROUP
/begin GROUP RtnPahFwl.PerInstanceMemories "MICROSAR RTE"
 /begin SUB_GROUP RtnPahFwl.dRtnPahFwlLowrBnd RtnPahFwl.dRtnPahFwlOverBnd RtnPahFwl.dRtnPahFwlUpprBnd /end SUB_GROUP
 /begin FUNCTION_LIST /end FUNCTION_LIST
 /begin REF_CHARACTERISTIC /end REF_CHARACTERISTIC
 /begin REF_MEASUREMENT /end REF_MEASUREMENT
/end GROUP
/begin GROUP RtnPahFwl.ReceiverPorts "MICROSAR RTE"
 /begin SUB_GROUP RtnPahFwl.HwAg.Val RtnPahFwl.RtnCmd.Val RtnPahFwl.RtnCmdDi.Logl RtnPahFwl.VehSpd.Val /end SUB_GROUP
 /begin FUNCTION_LIST /end FUNCTION_LIST
 /begin REF_CHARACTERISTIC /end REF_CHARACTERISTIC
 /begin REF_MEASUREMENT /end REF_MEASUREMENT
/end GROUP
/begin GROUP RtnPahFwl.RtnCmd.Val "MICROSAR RTE" /begin SUB_GROUP /end SUB_GROUP /begin FUNCTION_LIST /end FUNCTION_LIST /begin REF_CHARACTERISTIC /end REF_CHARACTERISTIC /begin REF_MEASUREMENT RtnPahFwl.RtnCmd.Val /end REF_MEASUREMENT /end GROUP
/begin GROUP RtnPahFwl.RtnCmdDi.Logl "MICROSAR RTE" /begin SUB_GROUP /end SUB_GROUP /begin FUNCTION_LIST /end FUNCTION_LIST /begin REF_CHARACTERISTIC /end REF_CHARACTERISTIC /begin REF_MEASUREMENT RtnPahFwl.RtnCmdDi.Logl /end REF_MEASUREMENT /end GROUP
/begin GROUP RtnPahFwl.RtnCmdLimd.Val "MICROSAR RTE" /begin SUB_GROUP /end SUB_GROUP /begin FUNCTION_LIST /end FUNCTION_LIST /begin REF_CHARACTERISTIC /end REF_CHARACTERISTIC /begin REF_MEASUREMENT RtnPahFwl.RtnCmdLimd.Val /end REF_MEASUREMENT /end GROUP
/begin GROUP RtnPahFwl.RtnPahFwlUpprBndTblX.Ary1D "MICROSAR RTE" /begin SUB_GROUP /end SUB_GROUP /begin FUNCTION_LIST /end FUNCTION_LIST /begin REF_CHARACTERISTIC RtnPahFwl.RtnPahFwlUpprBndTblX.Ary1D /end REF_CHARACTERISTIC /begin REF_MEASUREMENT /end REF_MEASUREMENT /end GROUP
/begin GROUP RtnPahFwl.RtnPahFwlUpprBndTblY.Ary2D "MICROSAR RTE" /begin SUB_GROUP /end SUB_GROUP /begin FUNCTION_LIST /end FUNCTION_LIST /begin REF_CHARACTERISTIC RtnPahFwl.RtnPahFwlUpprBndTblY.Ary2D /end REF_CHARACTERISTIC /begin REF_MEASUREMENT /end REF_MEASUREMENT /end GROUP
/begin GROUP RtnPahFwl.RtnPahFwlVehSpd.Ary1D "MICROSAR RTE" /begin SUB_GROUP /end SUB_GROUP /begin FUNCTION_LIST /end FUNCTION_LIST /begin REF_CHARACTERISTIC RtnPahFwl.RtnPahFwlVehSpd.Ary1D /end REF_CHARACTERISTIC /begin REF_MEASUREMENT /end REF_MEASUREMENT /end GROUP
/begin GROUP RtnPahFwl.SenderPorts "MICROSAR RTE" /begin SUB_GROUP RtnPahFwl.RtnCmdLimd.Val /end SUB_GROUP /begin FUNCTION_LIST /end FUNCTION_LIST /begin REF_CHARACTERISTIC /end REF_CHARACTERISTIC /begin REF_MEASUREMENT /end REF_MEASUREMENT /end GROUP
/begin GROUP RtnPahFwl.VehSpd.Val "MICROSAR RTE" /begin SUB_GROUP /end SUB_GROUP /begin FUNCTION_LIST /end FUNCTION_LIST /begin REF_CHARACTERISTIC /end REF_CHARACTERISTIC /begin REF_MEASUREMENT RtnPahFwl.VehSpd.Val /end REF_MEASUREMENT /end GROUP
/begin GROUP RtnPahFwl.dRtnPahFwlLowrBnd "MICROSAR RTE" /begin SUB_GROUP /end SUB_GROUP /begin FUNCTION_LIST /end FUNCTION_LIST /begin REF_CHARACTERISTIC /end REF_CHARACTERISTIC /begin REF_MEASUREMENT RtnPahFwl.dRtnPahFwlLowrBnd /end REF_MEASUREMENT /end GROUP
/begin GROUP RtnPahFwl.dRtnPahFwlOverBnd "MICROSAR RTE" /begin SUB_GROUP /end SUB_GROUP /begin FUNCTION_LIST /end FUNCTION_LIST /begin REF_CHARACTERISTIC /end REF_CHARACTERISTIC /begin REF_MEASUREMENT RtnPahFwl.dRtnPahFwlOverBnd /end REF_MEASUREMENT /end GROUP
/begin GROUP RtnPahFwl.dRtnPahFwlUpprBnd "MICROSAR RTE" /begin SUB_GROUP /end SUB_GROUP /begin FUNCTION_LIST /end FUNCTION_LIST /begin REF_CHARACTERISTIC /end REF_CHARACTERISTIC /begin REF_MEASUREMENT RtnPahFwl.dRtnPahFwlUpprBnd /end REF_MEASUREMENT /end GROUP
/begin GROUP SWCs "MICROSAR RTE"
 /begin SUB_GROUP Assi AssiHiFrq AssiPahFwl AssiSumLim BattVltg BattVltgCorrln CDD_Adc0CfgAndUse CDD_Adc1CfgAndUse CDD_AdcDiagc CDD_CurrMeas CDD_CurrMeasArbn CDD_DmaCfgAndUse CDD_FlsMem CDD_GmG2kcaMcuCfg CDD_HwTq0Meas CDD_HwTq1Meas CDD_HwTq2Meas CDD_HwTq3Meas CDD_McuCoreCfgAndDiagc CDD_McuDiagc CDD_MotAg0Meas CDD_MotAg1Meas CDD_MotAg3Meas CDD_MotAg4Meas CDD_MotAgArbn CDD_MotAgCmp CDD_MotCtrlMgr CDD_MotCurrRegVltgLimr CDD_MotRplCoggCmd CDD_MotVel CDD_NvMProxy CDD_RamMem CDD_Sci30CfgAndUse CDD_SinVltgGenn CDD_SnsrMeasStrt CDD_SyncCrc CDD_TSG31CfgAndUse CDD_Tauj0CfgAndUse CDD_Tauj1CfgAndUse CDD_VrfyCritReg CDD_XcpIf CalRegn01Cmn CalRegn01CmnGroupA CalRegn01CmnGroupB CalRegn01CmnGroupC CalRegn01Inin00 CalRegn01Inin00GroupB CalRegn01Inin00GroupC CalRegn01Rt00 CalRegn01Rt01 CalRegn01Rt01_Dummy CalRegn01Rt01_Dummy_1 CalRegn01Rt01_Dummy_2 CalRegn01Rt01_Dummy_3 CalRegn01Rt01_Dummy_4 CalRegn01Rt02 CalRegn01Rt03 CalRegn01Rt04 CalRegn02Cmn CalRegn02CmnGroupA CalRegn02CmnGroupB CalRegn02CmnGroupC CalRegn02Inin00 CalRegn02Inin00GroupA CalRegn02Inin00GroupC CalRegn02Rt00GroupC CalRegn02Rt01GroupC CalRegn02Rt01GroupC_Dummy CalRegn02Rt01GroupC_Dummy_1 CalRegn02Rt01GroupC_Dummy_2 CalRegn02Rt01GroupC_Dummy_3 CalRegn02Rt01GroupC_Dummy_4 CalRegn02Rt02GroupC CalRegn02Rt03GroupC CalRegn02Rt04GroupC CalRegn03Cmn CalRegn03CmnGroupA CalRegn03CmnGroupB CalRegn03CmnGroupC CalRegn03Inin00 CalRegn03Inin00GroupA CalRegn03Inin00GroupB CalRegn03Inin00GroupC CalRegn03Rt00 CalRegn03Rt00GroupA CalRegn03Rt00GroupB CalRegn03Rt01 CalRegn03Rt01GroupA CalRegn03Rt01GroupA_Dummy CalRegn03Rt01GroupA_Dummy_1 CalRegn03Rt01GroupA_Dummy_2 CalRegn03Rt01GroupA_Dummy_3 CalRegn03Rt01GroupA_Dummy_4 CalRegn03Rt01GroupB CalRegn03Rt01GroupB_Dummy CalRegn03Rt01GroupB_Dummy_1 CalRegn03Rt01GroupB_Dummy_2 CalRegn03Rt01GroupB_Dummy_3 CalRegn03Rt01GroupB_Dummy_4 CalRegn03Rt01_Dummy CalRegn03Rt01_Dummy_1 CalRegn03Rt01_Dummy_2 CalRegn03Rt01_Dummy_3 CalRegn03Rt01_Dummy_4 CalRegn03Rt02 CalRegn03Rt02GroupA CalRegn03Rt02GroupB CalRegn03Rt03 CalRegn03Rt03GroupA CalRegn03Rt03GroupB CalRegn03Rt04 CalRegn03Rt04GroupA CalRegn03Rt04GroupB CmnMfgSrv CmnMfgSrvIf CmplncErr CurrMeasCorrln CurrReasbnDiagc CustDiagc Dampg DampgPahFwl DiagcMgr DiagcMgrProxyAppl10 DiagcMgrProxyAppl6 DualEcuIdn DutyCycThermProtn EcuTMeas ElecPwrCns EotLrng EotProtn EotProtnFwl FltInj GateDrv0Ctrl GmFctDiArbn GmMsg0C5BusHiSpd GmMsg0C9BusHiSpd GmMsg148BusHiSpd GmMsg17DBusHiSpd GmMsg180BusChassisExp GmMsg180BusHiSpd GmMsg182BusChassisExp GmMsg184BusHiSpd GmMsg1CABusChassisExp GmMsg1E5BusChassisExp GmMsg1E5BusHiSpd GmMsg1E9BusHiSpd GmMsg1F1BusHiSpd GmMsg1F5BusHiSpd GmMsg214BusHiSpd GmMsg232BusHiSpd GmMsg335BusChassisExp GmMsg337BusChassisExp GmMsg348BusChassisExp GmMsg348BusHiSpd GmMsg34ABusChassisExp GmMsg34ABusHiSpd GmMsg3F1BusHiSpd GmMsg4D1BusHiSpd GmMsg500BusHiSpd GmMsg778BusHiSpd GmOvrlStMgr GmRoadWhlInQlfr GmStrtStop GmTqArbn GmVehPwrMod GmVehSpdArbn HiLoadStallLimr HowDetn HwAg0Meas HwAg1Meas HwAgArbn HwAgCorrln HwAgSnsrls HwAgSysArbn HwAgTrajGenn HwAgTrakgServo HwAgVehCentrTrim HwTqArbn HwTqCorrln HysCmp ImcArbn InertiaCmpVel LimrCdng LoaMgr MotAgCorrln MotCtrlPrmEstimn MotCurrPeakEstimn MotCurrRegCfg MotDrvDiagc MotQuadDetn MotRefMdl MotRplCoggCfg MotTqCmdSca MotTqTranlDampg MotVelCtrl NxtrCalIds PartNr PolarityCfg PullCmpActv PwrDiscnct PwrLimr PwrSply PwrUpSeq PwrpkCmpbltyChk Rtn RtnPahFwl SerlComInpProxy SerlComOutpProxy SnsrOffsCorrn SnsrOffsLrng StHlthSigNormn StHlthSigStc StOutpCtrl StabyCmp Swp SysFricLrng SysStMod TEstimn TmplMonr TqLoa TqOscn TunSelnAuthy TunSelnMngt VehSigCdng VehSpdLimr WhlImbRejctn /end SUB_GROUP
 /begin FUNCTION_LIST /end FUNCTION_LIST
 /begin REF_CHARACTERISTIC /end REF_CHARACTERISTIC
 /begin REF_MEASUREMENT /end REF_MEASUREMENT
/end GROUP
/begin GROUP SerlComInpProxy "MICROSAR RTE" /begin SUB_GROUP SerlComInpProxy.SenderPorts /end SUB_GROUP /begin FUNCTION_LIST /end FUNCTION_LIST /begin REF_CHARACTERISTIC /end REF_CHARACTERISTIC /begin REF_MEASUREMENT /end REF_MEASUREMENT /end GROUP
/begin GROUP SerlComInpProxy.AbsActvProtdProtnValRaw.Val "MICROSAR RTE" /begin SUB_GROUP /end SUB_GROUP /begin FUNCTION_LIST /end FUNCTION_LIST /begin REF_CHARACTERISTIC /end REF_CHARACTERISTIC /begin REF_MEASUREMENT SerlComInpProxy.AbsActvProtdProtnValRaw.Val /end REF_MEASUREMENT /end GROUP
/begin GROUP SerlComInpProxy.AbsActvProtdRaw.Val "MICROSAR RTE" /begin SUB_GROUP /end SUB_GROUP /begin FUNCTION_LIST /end FUNCTION_LIST /begin REF_CHARACTERISTIC /end REF_CHARACTERISTIC /begin REF_MEASUREMENT SerlComInpProxy.AbsActvProtdRaw.Val /end REF_MEASUREMENT /end GROUP
/begin GROUP SerlComInpProxy.AbsActvProtdRollgCntrRaw.Val "MICROSAR RTE" /begin SUB_GROUP /end SUB_GROUP /begin FUNCTION_LIST /end FUNCTION_LIST /begin REF_CHARACTERISTIC /end REF_CHARACTERISTIC /begin REF_MEASUREMENT SerlComInpProxy.AbsActvProtdRollgCntrRaw.Val /end REF_MEASUREMENT /end GROUP
/begin GROUP SerlComInpProxy.AbsActvRaw.Val "MICROSAR RTE" /begin SUB_GROUP /end SUB_GROUP /begin FUNCTION_LIST /end FUNCTION_LIST /begin REF_CHARACTERISTIC /end REF_CHARACTERISTIC /begin REF_MEASUREMENT SerlComInpProxy.AbsActvRaw.Val /end REF_MEASUREMENT /end GROUP
/begin GROUP SerlComInpProxy.AbsFaildRaw.Val "MICROSAR RTE" /begin SUB_GROUP /end SUB_GROUP /begin FUNCTION_LIST /end FUNCTION_LIST /begin REF_CHARACTERISTIC /end REF_CHARACTERISTIC /begin REF_MEASUREMENT SerlComInpProxy.AbsFaildRaw.Val /end REF_MEASUREMENT /end GROUP
/begin GROUP SerlComInpProxy.BackUpPwrModMstVirtDevAuthyRaw.Val "MICROSAR RTE" /begin SUB_GROUP /end SUB_GROUP /begin FUNCTION_LIST /end FUNCTION_LIST /begin REF_CHARACTERISTIC /end REF_CHARACTERISTIC /begin REF_MEASUREMENT SerlComInpProxy.BackUpPwrModMstVirtDevAuthyRaw.Val /end REF_MEASUREMENT /end GROUP
/begin GROUP SerlComInpProxy.BusOffChassisExp.Logl "MICROSAR RTE" /begin SUB_GROUP /end SUB_GROUP /begin FUNCTION_LIST /end FUNCTION_LIST /begin REF_CHARACTERISTIC /end REF_CHARACTERISTIC /begin REF_MEASUREMENT SerlComInpProxy.BusOffChassisExp.Logl /end REF_MEASUREMENT /end GROUP
/begin GROUP SerlComInpProxy.BusOffHiSpd.Logl "MICROSAR RTE" /begin SUB_GROUP /end SUB_GROUP /begin FUNCTION_LIST /end FUNCTION_LIST /begin REF_CHARACTERISTIC /end REF_CHARACTERISTIC /begin REF_MEASUREMENT SerlComInpProxy.BusOffHiSpd.Logl /end REF_MEASUREMENT /end GROUP
/begin GROUP SerlComInpProxy.EngOilTRaw.Val "MICROSAR RTE" /begin SUB_GROUP /end SUB_GROUP /begin FUNCTION_LIST /end FUNCTION_LIST /begin REF_CHARACTERISTIC /end REF_CHARACTERISTIC /begin REF_MEASUREMENT SerlComInpProxy.EngOilTRaw.Val /end REF_MEASUREMENT /end GROUP
/begin GROUP SerlComInpProxy.EngOilVldRaw.Val "MICROSAR RTE" /begin SUB_GROUP /end SUB_GROUP /begin FUNCTION_LIST /end FUNCTION_LIST /begin REF_CHARACTERISTIC /end REF_CHARACTERISTIC /begin REF_MEASUREMENT SerlComInpProxy.EngOilVldRaw.Val /end REF_MEASUREMENT /end GROUP
/begin GROUP SerlComInpProxy.EngRunActvRaw.Val "MICROSAR RTE" /begin SUB_GROUP /end SUB_GROUP /begin FUNCTION_LIST /end FUNCTION_LIST /begin REF_CHARACTERISTIC /end REF_CHARACTERISTIC /begin REF_MEASUREMENT SerlComInpProxy.EngRunActvRaw.Val /end REF_MEASUREMENT /end GROUP
/begin GROUP SerlComInpProxy.EngSpdRaw.Val "MICROSAR RTE" /begin SUB_GROUP /end SUB_GROUP /begin FUNCTION_LIST /end FUNCTION_LIST /begin REF_CHARACTERISTIC /end REF_CHARACTERISTIC /begin REF_MEASUREMENT SerlComInpProxy.EngSpdRaw.Val /end REF_MEASUREMENT /end GROUP
/begin GROUP SerlComInpProxy.EngSpdStsRaw.Val "MICROSAR RTE" /begin SUB_GROUP /end SUB_GROUP /begin FUNCTION_LIST /end FUNCTION_LIST /begin REF_CHARACTERISTIC /end REF_CHARACTERISTIC /begin REF_MEASUREMENT SerlComInpProxy.EngSpdStsRaw.Val /end REF_MEASUREMENT /end GROUP
/begin GROUP SerlComInpProxy.LeWhlDstPlsCntrRaw.Val "MICROSAR RTE" /begin SUB_GROUP /end SUB_GROUP /begin FUNCTION_LIST /end FUNCTION_LIST /begin REF_CHARACTERISTIC /end REF_CHARACTERISTIC /begin REF_MEASUREMENT SerlComInpProxy.LeWhlDstPlsCntrRaw.Val /end REF_MEASUREMENT /end GROUP
/begin GROUP SerlComInpProxy.LeWhlDstTiStampRaw.Val "MICROSAR RTE" /begin SUB_GROUP /end SUB_GROUP /begin FUNCTION_LIST /end FUNCTION_LIST /begin REF_CHARACTERISTIC /end REF_CHARACTERISTIC /begin REF_MEASUREMENT SerlComInpProxy.LeWhlDstTiStampRaw.Val /end REF_MEASUREMENT /end GROUP
/begin GROUP SerlComInpProxy.LeWhlDstVldRaw.Val "MICROSAR RTE" /begin SUB_GROUP /end SUB_GROUP /begin FUNCTION_LIST /end FUNCTION_LIST /begin REF_CHARACTERISTIC /end REF_CHARACTERISTIC /begin REF_MEASUREMENT SerlComInpProxy.LeWhlDstVldRaw.Val /end REF_MEASUREMENT /end GROUP
/begin GROUP SerlComInpProxy.LeWhlRotlStsRstRaw.Val "MICROSAR RTE" /begin SUB_GROUP /end SUB_GROUP /begin FUNCTION_LIST /end FUNCTION_LIST /begin REF_CHARACTERISTIC /end REF_CHARACTERISTIC /begin REF_MEASUREMENT SerlComInpProxy.LeWhlRotlStsRstRaw.Val /end REF_MEASUREMENT /end GROUP
/begin GROUP SerlComInpProxy.LeWhlSeqNrRaw.Val "MICROSAR RTE" /begin SUB_GROUP /end SUB_GROUP /begin FUNCTION_LIST /end FUNCTION_LIST /begin REF_CHARACTERISTIC /end REF_CHARACTERISTIC /begin REF_MEASUREMENT SerlComInpProxy.LeWhlSeqNrRaw.Val /end REF_MEASUREMENT /end GROUP
/begin GROUP SerlComInpProxy.LkaCmdProtnValRaw.Val "MICROSAR RTE" /begin SUB_GROUP /end SUB_GROUP /begin FUNCTION_LIST /end FUNCTION_LIST /begin REF_CHARACTERISTIC /end REF_CHARACTERISTIC /begin REF_MEASUREMENT SerlComInpProxy.LkaCmdProtnValRaw.Val /end REF_MEASUREMENT /end GROUP
/begin GROUP SerlComInpProxy.LkaCmdRollgCntrRaw.Val "MICROSAR RTE" /begin SUB_GROUP /end SUB_GROUP /begin FUNCTION_LIST /end FUNCTION_LIST /begin REF_CHARACTERISTIC /end REF_CHARACTERISTIC /begin REF_MEASUREMENT SerlComInpProxy.LkaCmdRollgCntrRaw.Val /end REF_MEASUREMENT /end GROUP
/begin GROUP SerlComInpProxy.LkaCmdTqReqActvRaw.Val "MICROSAR RTE" /begin SUB_GROUP /end SUB_GROUP /begin FUNCTION_LIST /end FUNCTION_LIST /begin REF_CHARACTERISTIC /end REF_CHARACTERISTIC /begin REF_MEASUREMENT SerlComInpProxy.LkaCmdTqReqActvRaw.Val /end REF_MEASUREMENT /end GROUP
/begin GROUP SerlComInpProxy.LkaCmdTqValRaw.Val "MICROSAR RTE" /begin SUB_GROUP /end SUB_GROUP /begin FUNCTION_LIST /end FUNCTION_LIST /begin REF_CHARACTERISTIC /end REF_CHARACTERISTIC /begin REF_MEASUREMENT SerlComInpProxy.LkaCmdTqValRaw.Val /end REF_MEASUREMENT /end GROUP
/begin GROUP SerlComInpProxy.LstRxnTiMsg0C5.Val "MICROSAR RTE" /begin SUB_GROUP /end SUB_GROUP /begin FUNCTION_LIST /end FUNCTION_LIST /begin REF_CHARACTERISTIC /end REF_CHARACTERISTIC /begin REF_MEASUREMENT SerlComInpProxy.LstRxnTiMsg0C5.Val /end REF_MEASUREMENT /end GROUP
/begin GROUP SerlComInpProxy.LstRxnTiMsg0C9.Val "MICROSAR RTE" /begin SUB_GROUP /end SUB_GROUP /begin FUNCTION_LIST /end FUNCTION_LIST /begin REF_CHARACTERISTIC /end REF_CHARACTERISTIC /begin REF_MEASUREMENT SerlComInpProxy.LstRxnTiMsg0C9.Val /end REF_MEASUREMENT /end GROUP
/begin GROUP SerlComInpProxy.LstRxnTiMsg17D.Val "MICROSAR RTE" /begin SUB_GROUP /end SUB_GROUP /begin FUNCTION_LIST /end FUNCTION_LIST /begin REF_CHARACTERISTIC /end REF_CHARACTERISTIC /begin REF_MEASUREMENT SerlComInpProxy.LstRxnTiMsg17D.Val /end REF_MEASUREMENT /end GROUP
/begin GROUP SerlComInpProxy.LstRxnTiMsg180BusChassisExp.Val "MICROSAR RTE" /begin SUB_GROUP /end SUB_GROUP /begin FUNCTION_LIST /end FUNCTION_LIST /begin REF_CHARACTERISTIC /end REF_CHARACTERISTIC /begin REF_MEASUREMENT SerlComInpProxy.LstRxnTiMsg180BusChassisExp.Val /end REF_MEASUREMENT /end GROUP
/begin GROUP SerlComInpProxy.LstRxnTiMsg180BusHiSpd.Val "MICROSAR RTE" /begin SUB_GROUP /end SUB_GROUP /begin FUNCTION_LIST /end FUNCTION_LIST /begin REF_CHARACTERISTIC /end REF_CHARACTERISTIC /begin REF_MEASUREMENT SerlComInpProxy.LstRxnTiMsg180BusHiSpd.Val /end REF_MEASUREMENT /end GROUP
/begin GROUP SerlComInpProxy.LstRxnTiMsg182.Val "MICROSAR RTE" /begin SUB_GROUP /end SUB_GROUP /begin FUNCTION_LIST /end FUNCTION_LIST /begin REF_CHARACTERISTIC /end REF_CHARACTERISTIC /begin REF_MEASUREMENT SerlComInpProxy.LstRxnTiMsg182.Val /end REF_MEASUREMENT /end GROUP
/begin GROUP SerlComInpProxy.LstRxnTiMsg1E9.Val "MICROSAR RTE" /begin SUB_GROUP /end SUB_GROUP /begin FUNCTION_LIST /end FUNCTION_LIST /begin REF_CHARACTERISTIC /end REF_CHARACTERISTIC /begin REF_MEASUREMENT SerlComInpProxy.LstRxnTiMsg1E9.Val /end REF_MEASUREMENT /end GROUP
/begin GROUP SerlComInpProxy.LstRxnTiMsg1F1.Val "MICROSAR RTE" /begin SUB_GROUP /end SUB_GROUP /begin FUNCTION_LIST /end FUNCTION_LIST /begin REF_CHARACTERISTIC /end REF_CHARACTERISTIC /begin REF_MEASUREMENT SerlComInpProxy.LstRxnTiMsg1F1.Val /end REF_MEASUREMENT /end GROUP
/begin GROUP SerlComInpProxy.LstRxnTiMsg1F5.Val "MICROSAR RTE" /begin SUB_GROUP /end SUB_GROUP /begin FUNCTION_LIST /end FUNCTION_LIST /begin REF_CHARACTERISTIC /end REF_CHARACTERISTIC /begin REF_MEASUREMENT SerlComInpProxy.LstRxnTiMsg1F5.Val /end REF_MEASUREMENT /end GROUP
/begin GROUP SerlComInpProxy.LstRxnTiMsg214.Val "MICROSAR RTE" /begin SUB_GROUP /end SUB_GROUP /begin FUNCTION_LIST /end FUNCTION_LIST /begin REF_CHARACTERISTIC /end REF_CHARACTERISTIC /begin REF_MEASUREMENT SerlComInpProxy.LstRxnTiMsg214.Val /end REF_MEASUREMENT /end GROUP
/begin GROUP SerlComInpProxy.LstRxnTiMsg232.Val "MICROSAR RTE" /begin SUB_GROUP /end SUB_GROUP /begin FUNCTION_LIST /end FUNCTION_LIST /begin REF_CHARACTERISTIC /end REF_CHARACTERISTIC /begin REF_MEASUREMENT SerlComInpProxy.LstRxnTiMsg232.Val /end REF_MEASUREMENT /end GROUP
/begin GROUP SerlComInpProxy.LstRxnTiMsg337BusChassisExp.Val "MICROSAR RTE" /begin SUB_GROUP /end SUB_GROUP /begin FUNCTION_LIST /end FUNCTION_LIST /begin REF_CHARACTERISTIC /end REF_CHARACTERISTIC /begin REF_MEASUREMENT SerlComInpProxy.LstRxnTiMsg337BusChassisExp.Val /end REF_MEASUREMENT /end GROUP
/begin GROUP SerlComInpProxy.LstRxnTiMsg348BusChassisExp.Val "MICROSAR RTE" /begin SUB_GROUP /end SUB_GROUP /begin FUNCTION_LIST /end FUNCTION_LIST /begin REF_CHARACTERISTIC /end REF_CHARACTERISTIC /begin REF_MEASUREMENT SerlComInpProxy.LstRxnTiMsg348BusChassisExp.Val /end REF_MEASUREMENT /end GROUP
/begin GROUP SerlComInpProxy.LstRxnTiMsg348BusHiSpd.Val "MICROSAR RTE" /begin SUB_GROUP /end SUB_GROUP /begin FUNCTION_LIST /end FUNCTION_LIST /begin REF_CHARACTERISTIC /end REF_CHARACTERISTIC /begin REF_MEASUREMENT SerlComInpProxy.LstRxnTiMsg348BusHiSpd.Val /end REF_MEASUREMENT /end GROUP
/begin GROUP SerlComInpProxy.LstRxnTiMsg34ABusChassisExp.Val "MICROSAR RTE" /begin SUB_GROUP /end SUB_GROUP /begin FUNCTION_LIST /end FUNCTION_LIST /begin REF_CHARACTERISTIC /end REF_CHARACTERISTIC /begin REF_MEASUREMENT SerlComInpProxy.LstRxnTiMsg34ABusChassisExp.Val /end REF_MEASUREMENT /end GROUP
/begin GROUP SerlComInpProxy.LstRxnTiMsg34ABusHiSpd.Val "MICROSAR RTE" /begin SUB_GROUP /end SUB_GROUP /begin FUNCTION_LIST /end FUNCTION_LIST /begin REF_CHARACTERISTIC /end REF_CHARACTERISTIC /begin REF_MEASUREMENT SerlComInpProxy.LstRxnTiMsg34ABusHiSpd.Val /end REF_MEASUREMENT /end GROUP
/begin GROUP SerlComInpProxy.LstRxnTiMsg3F1.Val "MICROSAR RTE" /begin SUB_GROUP /end SUB_GROUP /begin FUNCTION_LIST /end FUNCTION_LIST /begin REF_CHARACTERISTIC /end REF_CHARACTERISTIC /begin REF_MEASUREMENT SerlComInpProxy.LstRxnTiMsg3F1.Val /end REF_MEASUREMENT /end GROUP
/begin GROUP SerlComInpProxy.LstRxnTiMsg4D1.Val "MICROSAR RTE" /begin SUB_GROUP /end SUB_GROUP /begin FUNCTION_LIST /end FUNCTION_LIST /begin REF_CHARACTERISTIC /end REF_CHARACTERISTIC /begin REF_MEASUREMENT SerlComInpProxy.LstRxnTiMsg4D1.Val /end REF_MEASUREMENT /end GROUP
/begin GROUP SerlComInpProxy.LstRxnTiMsg500BusHiSpd.Val "MICROSAR RTE" /begin SUB_GROUP /end SUB_GROUP /begin FUNCTION_LIST /end FUNCTION_LIST /begin REF_CHARACTERISTIC /end REF_CHARACTERISTIC /begin REF_MEASUREMENT SerlComInpProxy.LstRxnTiMsg500BusHiSpd.Val /end REF_MEASUREMENT /end GROUP
/begin GROUP SerlComInpProxy.OutdAirTCorrdValMaskRaw.Val "MICROSAR RTE" /begin SUB_GROUP /end SUB_GROUP /begin FUNCTION_LIST /end FUNCTION_LIST /begin REF_CHARACTERISTIC /end REF_CHARACTERISTIC /begin REF_MEASUREMENT SerlComInpProxy.OutdAirTCorrdValMaskRaw.Val /end REF_MEASUREMENT /end GROUP
/begin GROUP SerlComInpProxy.OutdAirTCorrdValRaw.Val "MICROSAR RTE" /begin SUB_GROUP /end SUB_GROUP /begin FUNCTION_LIST /end FUNCTION_LIST /begin REF_CHARACTERISTIC /end REF_CHARACTERISTIC /begin REF_MEASUREMENT SerlComInpProxy.OutdAirTCorrdValRaw.Val /end REF_MEASUREMENT /end GROUP
/begin GROUP SerlComInpProxy.OutdAirTCorrdValVldRaw.Val "MICROSAR RTE" /begin SUB_GROUP /end SUB_GROUP /begin FUNCTION_LIST /end FUNCTION_LIST /begin REF_CHARACTERISTIC /end REF_CHARACTERISTIC /begin REF_MEASUREMENT SerlComInpProxy.OutdAirTCorrdValVldRaw.Val /end REF_MEASUREMENT /end GROUP
/begin GROUP SerlComInpProxy.PtCrkActvRaw.Val "MICROSAR RTE" /begin SUB_GROUP /end SUB_GROUP /begin FUNCTION_LIST /end FUNCTION_LIST /begin REF_CHARACTERISTIC /end REF_CHARACTERISTIC /begin REF_MEASUREMENT SerlComInpProxy.PtCrkActvRaw.Val /end REF_MEASUREMENT /end GROUP
/begin GROUP SerlComInpProxy.RdntVehStabyEnhmtSysActvRaw.Val "MICROSAR RTE" /begin SUB_GROUP /end SUB_GROUP /begin FUNCTION_LIST /end FUNCTION_LIST /begin REF_CHARACTERISTIC /end REF_CHARACTERISTIC /begin REF_MEASUREMENT SerlComInpProxy.RdntVehStabyEnhmtSysActvRaw.Val /end REF_MEASUREMENT /end GROUP
/begin GROUP SerlComInpProxy.RdntVehStabyEnhmtSysActvRollgCntrRaw.Val "MICROSAR RTE" /begin SUB_GROUP /end SUB_GROUP /begin FUNCTION_LIST /end FUNCTION_LIST /begin REF_CHARACTERISTIC /end REF_CHARACTERISTIC /begin REF_MEASUREMENT SerlComInpProxy.RdntVehStabyEnhmtSysActvRollgCntrRaw.Val /end REF_MEASUREMENT /end GROUP
/begin GROUP SerlComInpProxy.RiWhlDstPlsCntrRaw.Val "MICROSAR RTE" /begin SUB_GROUP /end SUB_GROUP /begin FUNCTION_LIST /end FUNCTION_LIST /begin REF_CHARACTERISTIC /end REF_CHARACTERISTIC /begin REF_MEASUREMENT SerlComInpProxy.RiWhlDstPlsCntrRaw.Val /end REF_MEASUREMENT /end GROUP
/begin GROUP SerlComInpProxy.RiWhlDstTiStampRaw.Val "MICROSAR RTE" /begin SUB_GROUP /end SUB_GROUP /begin FUNCTION_LIST /end FUNCTION_LIST /begin REF_CHARACTERISTIC /end REF_CHARACTERISTIC /begin REF_MEASUREMENT SerlComInpProxy.RiWhlDstTiStampRaw.Val /end REF_MEASUREMENT /end GROUP
/begin GROUP SerlComInpProxy.RiWhlDstVldRaw.Val "MICROSAR RTE" /begin SUB_GROUP /end SUB_GROUP /begin FUNCTION_LIST /end FUNCTION_LIST /begin REF_CHARACTERISTIC /end REF_CHARACTERISTIC /begin REF_MEASUREMENT SerlComInpProxy.RiWhlDstVldRaw.Val /end REF_MEASUREMENT /end GROUP
/begin GROUP SerlComInpProxy.RiWhlRotlStsRstRaw.Val "MICROSAR RTE" /begin SUB_GROUP /end SUB_GROUP /begin FUNCTION_LIST /end FUNCTION_LIST /begin REF_CHARACTERISTIC /end REF_CHARACTERISTIC /begin REF_MEASUREMENT SerlComInpProxy.RiWhlRotlStsRstRaw.Val /end REF_MEASUREMENT /end GROUP
/begin GROUP SerlComInpProxy.RiWhlSeqNrRaw.Val "MICROSAR RTE" /begin SUB_GROUP /end SUB_GROUP /begin FUNCTION_LIST /end FUNCTION_LIST /begin REF_CHARACTERISTIC /end REF_CHARACTERISTIC /begin REF_MEASUREMENT SerlComInpProxy.RiWhlSeqNrRaw.Val /end REF_MEASUREMENT /end GROUP
/begin GROUP SerlComInpProxy.SenderPorts "MICROSAR RTE"
 /begin SUB_GROUP SerlComInpProxy.AbsActvProtdProtnValRaw.Val SerlComInpProxy.AbsActvProtdRaw.Val SerlComInpProxy.AbsActvProtdRollgCntrRaw.Val SerlComInpProxy.AbsActvRaw.Val SerlComInpProxy.AbsFaildRaw.Val SerlComInpProxy.BackUpPwrModMstVirtDevAuthyRaw.Val SerlComInpProxy.BusOffChassisExp.Logl SerlComInpProxy.BusOffHiSpd.Logl SerlComInpProxy.EngOilTRaw.Val SerlComInpProxy.EngOilVldRaw.Val SerlComInpProxy.EngRunActvRaw.Val SerlComInpProxy.EngSpdRaw.Val SerlComInpProxy.EngSpdStsRaw.Val SerlComInpProxy.LeWhlDstPlsCntrRaw.Val SerlComInpProxy.LeWhlDstTiStampRaw.Val SerlComInpProxy.LeWhlDstVldRaw.Val SerlComInpProxy.LeWhlRotlStsRstRaw.Val SerlComInpProxy.LeWhlSeqNrRaw.Val SerlComInpProxy.LkaCmdProtnValRaw.Val SerlComInpProxy.LkaCmdRollgCntrRaw.Val SerlComInpProxy.LkaCmdTqReqActvRaw.Val SerlComInpProxy.LkaCmdTqValRaw.Val SerlComInpProxy.LstRxnTiMsg0C5.Val SerlComInpProxy.LstRxnTiMsg0C9.Val SerlComInpProxy.LstRxnTiMsg17D.Val SerlComInpProxy.LstRxnTiMsg180BusChassisExp.Val SerlComInpProxy.LstRxnTiMsg180BusHiSpd.Val SerlComInpProxy.LstRxnTiMsg182.Val SerlComInpProxy.LstRxnTiMsg1E9.Val SerlComInpProxy.LstRxnTiMsg1F1.Val SerlComInpProxy.LstRxnTiMsg1F5.Val SerlComInpProxy.LstRxnTiMsg214.Val SerlComInpProxy.LstRxnTiMsg232.Val SerlComInpProxy.LstRxnTiMsg337BusChassisExp.Val SerlComInpProxy.LstRxnTiMsg348BusChassisExp.Val SerlComInpProxy.LstRxnTiMsg348BusHiSpd.Val SerlComInpProxy.LstRxnTiMsg34ABusChassisExp.Val SerlComInpProxy.LstRxnTiMsg34ABusHiSpd.Val SerlComInpProxy.LstRxnTiMsg3F1.Val SerlComInpProxy.LstRxnTiMsg4D1.Val SerlComInpProxy.LstRxnTiMsg500BusHiSpd.Val SerlComInpProxy.OutdAirTCorrdValMaskRaw.Val SerlComInpProxy.OutdAirTCorrdValRaw.Val SerlComInpProxy.OutdAirTCorrdValVldRaw.Val SerlComInpProxy.PtCrkActvRaw.Val SerlComInpProxy.RdntVehStabyEnhmtSysActvRaw.Val SerlComInpProxy.RdntVehStabyEnhmtSysActvRollgCntrRaw.Val SerlComInpProxy.RiWhlDstPlsCntrRaw.Val SerlComInpProxy.RiWhlDstTiStampRaw.Val SerlComInpProxy.RiWhlDstVldRaw.Val SerlComInpProxy.RiWhlRotlStsRstRaw.Val SerlComInpProxy.RiWhlSeqNrRaw.Val SerlComInpProxy.ShiftLvrPosnRaw.Val SerlComInpProxy.ShiftLvrPosnVldRaw.Val SerlComInpProxy.SteerSysPrfmncModReqRaw.Val SerlComInpProxy.SteerWhlAgReqActvRaw.Val SerlComInpProxy.SteerWhlAgReqActvVldRaw.Val SerlComInpProxy.SteerWhlAgReqProtnValRaw.Val SerlComInpProxy.SteerWhlAgReqRollgCntrRaw.Val SerlComInpProxy.SteerWhlAgReqTarAgRaw.Val SerlComInpProxy.SteerWhlFbReqActvProtnValRaw.Val SerlComInpProxy.SteerWhlFbReqActvRaw.Val SerlComInpProxy.SteerWhlFbReqActvRollgCntrRaw.Val SerlComInpProxy.SysBackUpPwrModEnaRaw.Val SerlComInpProxy.SysBackUpPwrModRaw.Val SerlComInpProxy.SysPwrModRaw.Val SerlComInpProxy.TqOvrlAlvRollgCntrRaw.Val SerlComInpProxy.TqOvrlCmdChksRaw.Val SerlComInpProxy.TqOvrlDeltaTqCmdActvRaw.Val SerlComInpProxy.TqOvrlDeltaTqCmdValRaw.Val SerlComInpProxy.TracCtrlSysActvRaw.Val SerlComInpProxy.TracCtrlSysEnaRaw.Val SerlComInpProxy.VehDynCtrlSysStRaw.Val SerlComInpProxy.VehDynOverUnderSteerVldRaw.Val SerlComInpProxy.VehDynYawRateRaw.Val SerlComInpProxy.VehDynYawRateVldRaw.Val SerlComInpProxy.VehStabyEnhmtActvRaw.Val SerlComInpProxy.VehStabyEnhmtLatARaw.Val SerlComInpProxy.VehStabyEnhmtLatAVldRaw.Val SerlComInpProxy.VehStabyEnhmtLgtALoReslRaw.Val SerlComInpProxy.VehStabyEnhmtLgtALoReslVldRaw.Val SerlComInpProxy.VehStabyEnhmtStsRaw.Val SerlComInpProxy.WhlGndVelLeDrvnRawBusChassisExp.Val SerlComInpProxy.WhlGndVelLeDrvnRawBusHiSpd.Val SerlComInpProxy.WhlGndVelLeDrvnVldRawBusChassisExp.Val SerlComInpProxy.WhlGndVelLeDrvnVldRawBusHiSpd.Val SerlComInpProxy.WhlGndVelLeNonDrvnRawBusChassisExp.Val SerlComInpProxy.WhlGndVelLeNonDrvnRawBusHiSpd.Val SerlComInpProxy.WhlGndVelLeNonDrvnVldRawBusChassisExp.Val SerlComInpProxy.WhlGndVelLeNonDrvnVldRawBusHiSpd.Val SerlComInpProxy.WhlGndVelRiDrvnRawBusChassisExp.Val SerlComInpProxy.WhlGndVelRiDrvnRawBusHiSpd.Val SerlComInpProxy.WhlGndVelRiDrvnVldRawBusChassisExp.Val SerlComInpProxy.WhlGndVelRiDrvnVldRawBusHiSpd.Val SerlComInpProxy.WhlGndVelRiNonDrvnRawBusChassisExp.Val SerlComInpProxy.WhlGndVelRiNonDrvnRawBusHiSpd.Val SerlComInpProxy.WhlGndVelRiNonDrvnVldRawBusChassisExp.Val SerlComInpProxy.WhlGndVelRiNonDrvnVldRawBusHiSpd.Val SerlComInpProxy.WhlPlsPerRevRaw.Val SerlComInpProxy.WhlRotlStsTiStampReslRaw.Val /end SUB_GROUP
 /begin FUNCTION_LIST /end FUNCTION_LIST
 /begin REF_CHARACTERISTIC /end REF_CHARACTERISTIC
 /begin REF_MEASUREMENT /end REF_MEASUREMENT
/end GROUP
/begin GROUP SerlComInpProxy.ShiftLvrPosnRaw.Val "MICROSAR RTE" /begin SUB_GROUP /end SUB_GROUP /begin FUNCTION_LIST /end FUNCTION_LIST /begin REF_CHARACTERISTIC /end REF_CHARACTERISTIC /begin REF_MEASUREMENT SerlComInpProxy.ShiftLvrPosnRaw.Val /end REF_MEASUREMENT /end GROUP
/begin GROUP SerlComInpProxy.ShiftLvrPosnVldRaw.Val "MICROSAR RTE" /begin SUB_GROUP /end SUB_GROUP /begin FUNCTION_LIST /end FUNCTION_LIST /begin REF_CHARACTERISTIC /end REF_CHARACTERISTIC /begin REF_MEASUREMENT SerlComInpProxy.ShiftLvrPosnVldRaw.Val /end REF_MEASUREMENT /end GROUP
/begin GROUP SerlComInpProxy.SteerSysPrfmncModReqRaw.Val "MICROSAR RTE" /begin SUB_GROUP /end SUB_GROUP /begin FUNCTION_LIST /end FUNCTION_LIST /begin REF_CHARACTERISTIC /end REF_CHARACTERISTIC /begin REF_MEASUREMENT SerlComInpProxy.SteerSysPrfmncModReqRaw.Val /end REF_MEASUREMENT /end GROUP
/begin GROUP SerlComInpProxy.SteerWhlAgReqActvRaw.Val "MICROSAR RTE" /begin SUB_GROUP /end SUB_GROUP /begin FUNCTION_LIST /end FUNCTION_LIST /begin REF_CHARACTERISTIC /end REF_CHARACTERISTIC /begin REF_MEASUREMENT SerlComInpProxy.SteerWhlAgReqActvRaw.Val /end REF_MEASUREMENT /end GROUP
/begin GROUP SerlComInpProxy.SteerWhlAgReqActvVldRaw.Val "MICROSAR RTE" /begin SUB_GROUP /end SUB_GROUP /begin FUNCTION_LIST /end FUNCTION_LIST /begin REF_CHARACTERISTIC /end REF_CHARACTERISTIC /begin REF_MEASUREMENT SerlComInpProxy.SteerWhlAgReqActvVldRaw.Val /end REF_MEASUREMENT /end GROUP
/begin GROUP SerlComInpProxy.SteerWhlAgReqProtnValRaw.Val "MICROSAR RTE" /begin SUB_GROUP /end SUB_GROUP /begin FUNCTION_LIST /end FUNCTION_LIST /begin REF_CHARACTERISTIC /end REF_CHARACTERISTIC /begin REF_MEASUREMENT SerlComInpProxy.SteerWhlAgReqProtnValRaw.Val /end REF_MEASUREMENT /end GROUP
/begin GROUP SerlComInpProxy.SteerWhlAgReqRollgCntrRaw.Val "MICROSAR RTE" /begin SUB_GROUP /end SUB_GROUP /begin FUNCTION_LIST /end FUNCTION_LIST /begin REF_CHARACTERISTIC /end REF_CHARACTERISTIC /begin REF_MEASUREMENT SerlComInpProxy.SteerWhlAgReqRollgCntrRaw.Val /end REF_MEASUREMENT /end GROUP
/begin GROUP SerlComInpProxy.SteerWhlAgReqTarAgRaw.Val "MICROSAR RTE" /begin SUB_GROUP /end SUB_GROUP /begin FUNCTION_LIST /end FUNCTION_LIST /begin REF_CHARACTERISTIC /end REF_CHARACTERISTIC /begin REF_MEASUREMENT SerlComInpProxy.SteerWhlAgReqTarAgRaw.Val /end REF_MEASUREMENT /end GROUP
/begin GROUP SerlComInpProxy.SteerWhlFbReqActvProtnValRaw.Val "MICROSAR RTE" /begin SUB_GROUP /end SUB_GROUP /begin FUNCTION_LIST /end FUNCTION_LIST /begin REF_CHARACTERISTIC /end REF_CHARACTERISTIC /begin REF_MEASUREMENT SerlComInpProxy.SteerWhlFbReqActvProtnValRaw.Val /end REF_MEASUREMENT /end GROUP
/begin GROUP SerlComInpProxy.SteerWhlFbReqActvRaw.Val "MICROSAR RTE" /begin SUB_GROUP /end SUB_GROUP /begin FUNCTION_LIST /end FUNCTION_LIST /begin REF_CHARACTERISTIC /end REF_CHARACTERISTIC /begin REF_MEASUREMENT SerlComInpProxy.SteerWhlFbReqActvRaw.Val /end REF_MEASUREMENT /end GROUP
/begin GROUP SerlComInpProxy.SteerWhlFbReqActvRollgCntrRaw.Val "MICROSAR RTE" /begin SUB_GROUP /end SUB_GROUP /begin FUNCTION_LIST /end FUNCTION_LIST /begin REF_CHARACTERISTIC /end REF_CHARACTERISTIC /begin REF_MEASUREMENT SerlComInpProxy.SteerWhlFbReqActvRollgCntrRaw.Val /end REF_MEASUREMENT /end GROUP
/begin GROUP SerlComInpProxy.SysBackUpPwrModEnaRaw.Val "MICROSAR RTE" /begin SUB_GROUP /end SUB_GROUP /begin FUNCTION_LIST /end FUNCTION_LIST /begin REF_CHARACTERISTIC /end REF_CHARACTERISTIC /begin REF_MEASUREMENT SerlComInpProxy.SysBackUpPwrModEnaRaw.Val /end REF_MEASUREMENT /end GROUP
/begin GROUP SerlComInpProxy.SysBackUpPwrModRaw.Val "MICROSAR RTE" /begin SUB_GROUP /end SUB_GROUP /begin FUNCTION_LIST /end FUNCTION_LIST /begin REF_CHARACTERISTIC /end REF_CHARACTERISTIC /begin REF_MEASUREMENT SerlComInpProxy.SysBackUpPwrModRaw.Val /end REF_MEASUREMENT /end GROUP
/begin GROUP SerlComInpProxy.SysPwrModRaw.Val "MICROSAR RTE" /begin SUB_GROUP /end SUB_GROUP /begin FUNCTION_LIST /end FUNCTION_LIST /begin REF_CHARACTERISTIC /end REF_CHARACTERISTIC /begin REF_MEASUREMENT SerlComInpProxy.SysPwrModRaw.Val /end REF_MEASUREMENT /end GROUP
/begin GROUP SerlComInpProxy.TqOvrlAlvRollgCntrRaw.Val "MICROSAR RTE" /begin SUB_GROUP /end SUB_GROUP /begin FUNCTION_LIST /end FUNCTION_LIST /begin REF_CHARACTERISTIC /end REF_CHARACTERISTIC /begin REF_MEASUREMENT SerlComInpProxy.TqOvrlAlvRollgCntrRaw.Val /end REF_MEASUREMENT /end GROUP
/begin GROUP SerlComInpProxy.TqOvrlCmdChksRaw.Val "MICROSAR RTE" /begin SUB_GROUP /end SUB_GROUP /begin FUNCTION_LIST /end FUNCTION_LIST /begin REF_CHARACTERISTIC /end REF_CHARACTERISTIC /begin REF_MEASUREMENT SerlComInpProxy.TqOvrlCmdChksRaw.Val /end REF_MEASUREMENT /end GROUP
/begin GROUP SerlComInpProxy.TqOvrlDeltaTqCmdActvRaw.Val "MICROSAR RTE" /begin SUB_GROUP /end SUB_GROUP /begin FUNCTION_LIST /end FUNCTION_LIST /begin REF_CHARACTERISTIC /end REF_CHARACTERISTIC /begin REF_MEASUREMENT SerlComInpProxy.TqOvrlDeltaTqCmdActvRaw.Val /end REF_MEASUREMENT /end GROUP
/begin GROUP SerlComInpProxy.TqOvrlDeltaTqCmdValRaw.Val "MICROSAR RTE" /begin SUB_GROUP /end SUB_GROUP /begin FUNCTION_LIST /end FUNCTION_LIST /begin REF_CHARACTERISTIC /end REF_CHARACTERISTIC /begin REF_MEASUREMENT SerlComInpProxy.TqOvrlDeltaTqCmdValRaw.Val /end REF_MEASUREMENT /end GROUP
/begin GROUP SerlComInpProxy.TracCtrlSysActvRaw.Val "MICROSAR RTE" /begin SUB_GROUP /end SUB_GROUP /begin FUNCTION_LIST /end FUNCTION_LIST /begin REF_CHARACTERISTIC /end REF_CHARACTERISTIC /begin REF_MEASUREMENT SerlComInpProxy.TracCtrlSysActvRaw.Val /end REF_MEASUREMENT /end GROUP
/begin GROUP SerlComInpProxy.TracCtrlSysEnaRaw.Val "MICROSAR RTE" /begin SUB_GROUP /end SUB_GROUP /begin FUNCTION_LIST /end FUNCTION_LIST /begin REF_CHARACTERISTIC /end REF_CHARACTERISTIC /begin REF_MEASUREMENT SerlComInpProxy.TracCtrlSysEnaRaw.Val /end REF_MEASUREMENT /end GROUP
/begin GROUP SerlComInpProxy.VehDynCtrlSysStRaw.Val "MICROSAR RTE" /begin SUB_GROUP /end SUB_GROUP /begin FUNCTION_LIST /end FUNCTION_LIST /begin REF_CHARACTERISTIC /end REF_CHARACTERISTIC /begin REF_MEASUREMENT SerlComInpProxy.VehDynCtrlSysStRaw.Val /end REF_MEASUREMENT /end GROUP
/begin GROUP SerlComInpProxy.VehDynOverUnderSteerVldRaw.Val "MICROSAR RTE" /begin SUB_GROUP /end SUB_GROUP /begin FUNCTION_LIST /end FUNCTION_LIST /begin REF_CHARACTERISTIC /end REF_CHARACTERISTIC /begin REF_MEASUREMENT SerlComInpProxy.VehDynOverUnderSteerVldRaw.Val /end REF_MEASUREMENT /end GROUP
/begin GROUP SerlComInpProxy.VehDynYawRateRaw.Val "MICROSAR RTE" /begin SUB_GROUP /end SUB_GROUP /begin FUNCTION_LIST /end FUNCTION_LIST /begin REF_CHARACTERISTIC /end REF_CHARACTERISTIC /begin REF_MEASUREMENT SerlComInpProxy.VehDynYawRateRaw.Val /end REF_MEASUREMENT /end GROUP
/begin GROUP SerlComInpProxy.VehDynYawRateVldRaw.Val "MICROSAR RTE" /begin SUB_GROUP /end SUB_GROUP /begin FUNCTION_LIST /end FUNCTION_LIST /begin REF_CHARACTERISTIC /end REF_CHARACTERISTIC /begin REF_MEASUREMENT SerlComInpProxy.VehDynYawRateVldRaw.Val /end REF_MEASUREMENT /end GROUP
/begin GROUP SerlComInpProxy.VehStabyEnhmtActvRaw.Val "MICROSAR RTE" /begin SUB_GROUP /end SUB_GROUP /begin FUNCTION_LIST /end FUNCTION_LIST /begin REF_CHARACTERISTIC /end REF_CHARACTERISTIC /begin REF_MEASUREMENT SerlComInpProxy.VehStabyEnhmtActvRaw.Val /end REF_MEASUREMENT /end GROUP
/begin GROUP SerlComInpProxy.VehStabyEnhmtLatARaw.Val "MICROSAR RTE" /begin SUB_GROUP /end SUB_GROUP /begin FUNCTION_LIST /end FUNCTION_LIST /begin REF_CHARACTERISTIC /end REF_CHARACTERISTIC /begin REF_MEASUREMENT SerlComInpProxy.VehStabyEnhmtLatARaw.Val /end REF_MEASUREMENT /end GROUP
/begin GROUP SerlComInpProxy.VehStabyEnhmtLatAVldRaw.Val "MICROSAR RTE" /begin SUB_GROUP /end SUB_GROUP /begin FUNCTION_LIST /end FUNCTION_LIST /begin REF_CHARACTERISTIC /end REF_CHARACTERISTIC /begin REF_MEASUREMENT SerlComInpProxy.VehStabyEnhmtLatAVldRaw.Val /end REF_MEASUREMENT /end GROUP
/begin GROUP SerlComInpProxy.VehStabyEnhmtLgtALoReslRaw.Val "MICROSAR RTE" /begin SUB_GROUP /end SUB_GROUP /begin FUNCTION_LIST /end FUNCTION_LIST /begin REF_CHARACTERISTIC /end REF_CHARACTERISTIC /begin REF_MEASUREMENT SerlComInpProxy.VehStabyEnhmtLgtALoReslRaw.Val /end REF_MEASUREMENT /end GROUP
/begin GROUP SerlComInpProxy.VehStabyEnhmtLgtALoReslVldRaw.Val "MICROSAR RTE" /begin SUB_GROUP /end SUB_GROUP /begin FUNCTION_LIST /end FUNCTION_LIST /begin REF_CHARACTERISTIC /end REF_CHARACTERISTIC /begin REF_MEASUREMENT SerlComInpProxy.VehStabyEnhmtLgtALoReslVldRaw.Val /end REF_MEASUREMENT /end GROUP
/begin GROUP SerlComInpProxy.VehStabyEnhmtStsRaw.Val "MICROSAR RTE" /begin SUB_GROUP /end SUB_GROUP /begin FUNCTION_LIST /end FUNCTION_LIST /begin REF_CHARACTERISTIC /end REF_CHARACTERISTIC /begin REF_MEASUREMENT SerlComInpProxy.VehStabyEnhmtStsRaw.Val /end REF_MEASUREMENT /end GROUP
/begin GROUP SerlComInpProxy.WhlGndVelLeDrvnRawBusChassisExp.Val "MICROSAR RTE" /begin SUB_GROUP /end SUB_GROUP /begin FUNCTION_LIST /end FUNCTION_LIST /begin REF_CHARACTERISTIC /end REF_CHARACTERISTIC /begin REF_MEASUREMENT SerlComInpProxy.WhlGndVelLeDrvnRawBusChassisExp.Val /end REF_MEASUREMENT /end GROUP
/begin GROUP SerlComInpProxy.WhlGndVelLeDrvnRawBusHiSpd.Val "MICROSAR RTE" /begin SUB_GROUP /end SUB_GROUP /begin FUNCTION_LIST /end FUNCTION_LIST /begin REF_CHARACTERISTIC /end REF_CHARACTERISTIC /begin REF_MEASUREMENT SerlComInpProxy.WhlGndVelLeDrvnRawBusHiSpd.Val /end REF_MEASUREMENT /end GROUP
/begin GROUP SerlComInpProxy.WhlGndVelLeDrvnVldRawBusChassisExp.Val "MICROSAR RTE" /begin SUB_GROUP /end SUB_GROUP /begin FUNCTION_LIST /end FUNCTION_LIST /begin REF_CHARACTERISTIC /end REF_CHARACTERISTIC /begin REF_MEASUREMENT SerlComInpProxy.WhlGndVelLeDrvnVldRawBusChassisExp.Val /end REF_MEASUREMENT /end GROUP
/begin GROUP SerlComInpProxy.WhlGndVelLeDrvnVldRawBusHiSpd.Val "MICROSAR RTE" /begin SUB_GROUP /end SUB_GROUP /begin FUNCTION_LIST /end FUNCTION_LIST /begin REF_CHARACTERISTIC /end REF_CHARACTERISTIC /begin REF_MEASUREMENT SerlComInpProxy.WhlGndVelLeDrvnVldRawBusHiSpd.Val /end REF_MEASUREMENT /end GROUP
/begin GROUP SerlComInpProxy.WhlGndVelLeNonDrvnRawBusChassisExp.Val "MICROSAR RTE" /begin SUB_GROUP /end SUB_GROUP /begin FUNCTION_LIST /end FUNCTION_LIST /begin REF_CHARACTERISTIC /end REF_CHARACTERISTIC /begin REF_MEASUREMENT SerlComInpProxy.WhlGndVelLeNonDrvnRawBusChassisExp.Val /end REF_MEASUREMENT /end GROUP
/begin GROUP SerlComInpProxy.WhlGndVelLeNonDrvnRawBusHiSpd.Val "MICROSAR RTE" /begin SUB_GROUP /end SUB_GROUP /begin FUNCTION_LIST /end FUNCTION_LIST /begin REF_CHARACTERISTIC /end REF_CHARACTERISTIC /begin REF_MEASUREMENT SerlComInpProxy.WhlGndVelLeNonDrvnRawBusHiSpd.Val /end REF_MEASUREMENT /end GROUP
/begin GROUP SerlComInpProxy.WhlGndVelLeNonDrvnVldRawBusChassisExp.Val "MICROSAR RTE" /begin SUB_GROUP /end SUB_GROUP /begin FUNCTION_LIST /end FUNCTION_LIST /begin REF_CHARACTERISTIC /end REF_CHARACTERISTIC /begin REF_MEASUREMENT SerlComInpProxy.WhlGndVelLeNonDrvnVldRawBusChassisExp.Val /end REF_MEASUREMENT /end GROUP
/begin GROUP SerlComInpProxy.WhlGndVelLeNonDrvnVldRawBusHiSpd.Val "MICROSAR RTE" /begin SUB_GROUP /end SUB_GROUP /begin FUNCTION_LIST /end FUNCTION_LIST /begin REF_CHARACTERISTIC /end REF_CHARACTERISTIC /begin REF_MEASUREMENT SerlComInpProxy.WhlGndVelLeNonDrvnVldRawBusHiSpd.Val /end REF_MEASUREMENT /end GROUP
/begin GROUP SerlComInpProxy.WhlGndVelRiDrvnRawBusChassisExp.Val "MICROSAR RTE" /begin SUB_GROUP /end SUB_GROUP /begin FUNCTION_LIST /end FUNCTION_LIST /begin REF_CHARACTERISTIC /end REF_CHARACTERISTIC /begin REF_MEASUREMENT SerlComInpProxy.WhlGndVelRiDrvnRawBusChassisExp.Val /end REF_MEASUREMENT /end GROUP
/begin GROUP SerlComInpProxy.WhlGndVelRiDrvnRawBusHiSpd.Val "MICROSAR RTE" /begin SUB_GROUP /end SUB_GROUP /begin FUNCTION_LIST /end FUNCTION_LIST /begin REF_CHARACTERISTIC /end REF_CHARACTERISTIC /begin REF_MEASUREMENT SerlComInpProxy.WhlGndVelRiDrvnRawBusHiSpd.Val /end REF_MEASUREMENT /end GROUP
/begin GROUP SerlComInpProxy.WhlGndVelRiDrvnVldRawBusChassisExp.Val "MICROSAR RTE" /begin SUB_GROUP /end SUB_GROUP /begin FUNCTION_LIST /end FUNCTION_LIST /begin REF_CHARACTERISTIC /end REF_CHARACTERISTIC /begin REF_MEASUREMENT SerlComInpProxy.WhlGndVelRiDrvnVldRawBusChassisExp.Val /end REF_MEASUREMENT /end GROUP
/begin GROUP SerlComInpProxy.WhlGndVelRiDrvnVldRawBusHiSpd.Val "MICROSAR RTE" /begin SUB_GROUP /end SUB_GROUP /begin FUNCTION_LIST /end FUNCTION_LIST /begin REF_CHARACTERISTIC /end REF_CHARACTERISTIC /begin REF_MEASUREMENT SerlComInpProxy.WhlGndVelRiDrvnVldRawBusHiSpd.Val /end REF_MEASUREMENT /end GROUP
/begin GROUP SerlComInpProxy.WhlGndVelRiNonDrvnRawBusChassisExp.Val "MICROSAR RTE" /begin SUB_GROUP /end SUB_GROUP /begin FUNCTION_LIST /end FUNCTION_LIST /begin REF_CHARACTERISTIC /end REF_CHARACTERISTIC /begin REF_MEASUREMENT SerlComInpProxy.WhlGndVelRiNonDrvnRawBusChassisExp.Val /end REF_MEASUREMENT /end GROUP
/begin GROUP SerlComInpProxy.WhlGndVelRiNonDrvnRawBusHiSpd.Val "MICROSAR RTE" /begin SUB_GROUP /end SUB_GROUP /begin FUNCTION_LIST /end FUNCTION_LIST /begin REF_CHARACTERISTIC /end REF_CHARACTERISTIC /begin REF_MEASUREMENT SerlComInpProxy.WhlGndVelRiNonDrvnRawBusHiSpd.Val /end REF_MEASUREMENT /end GROUP
/begin GROUP SerlComInpProxy.WhlGndVelRiNonDrvnVldRawBusChassisExp.Val "MICROSAR RTE" /begin SUB_GROUP /end SUB_GROUP /begin FUNCTION_LIST /end FUNCTION_LIST /begin REF_CHARACTERISTIC /end REF_CHARACTERISTIC /begin REF_MEASUREMENT SerlComInpProxy.WhlGndVelRiNonDrvnVldRawBusChassisExp.Val /end REF_MEASUREMENT /end GROUP
/begin GROUP SerlComInpProxy.WhlGndVelRiNonDrvnVldRawBusHiSpd.Val "MICROSAR RTE" /begin SUB_GROUP /end SUB_GROUP /begin FUNCTION_LIST /end FUNCTION_LIST /begin REF_CHARACTERISTIC /end REF_CHARACTERISTIC /begin REF_MEASUREMENT SerlComInpProxy.WhlGndVelRiNonDrvnVldRawBusHiSpd.Val /end REF_MEASUREMENT /end GROUP
/begin GROUP SerlComInpProxy.WhlPlsPerRevRaw.Val "MICROSAR RTE" /begin SUB_GROUP /end SUB_GROUP /begin FUNCTION_LIST /end FUNCTION_LIST /begin REF_CHARACTERISTIC /end REF_CHARACTERISTIC /begin REF_MEASUREMENT SerlComInpProxy.WhlPlsPerRevRaw.Val /end REF_MEASUREMENT /end GROUP
/begin GROUP SerlComInpProxy.WhlRotlStsTiStampReslRaw.Val "MICROSAR RTE" /begin SUB_GROUP /end SUB_GROUP /begin FUNCTION_LIST /end FUNCTION_LIST /begin REF_CHARACTERISTIC /end REF_CHARACTERISTIC /begin REF_MEASUREMENT SerlComInpProxy.WhlRotlStsTiStampReslRaw.Val /end REF_MEASUREMENT /end GROUP
/begin GROUP SerlComOutpProxy "MICROSAR RTE"
 /begin SUB_GROUP SerlComOutpProxy.CalibrationPorts SerlComOutpProxy.PerInstanceMemories SerlComOutpProxy.ReceiverPorts SerlComOutpProxy.SenderPorts /end SUB_GROUP
 /begin FUNCTION_LIST /end FUNCTION_LIST
 /begin REF_CHARACTERISTIC /end REF_CHARACTERISTIC
 /begin REF_MEASUREMENT /end REF_MEASUREMENT
/end GROUP
/begin GROUP SerlComOutpProxy.BusOffChassisExp "MICROSAR RTE" /begin SUB_GROUP /end SUB_GROUP /begin FUNCTION_LIST /end FUNCTION_LIST /begin REF_CHARACTERISTIC /end REF_CHARACTERISTIC /begin REF_MEASUREMENT SerlComOutpProxy.BusOffChassisExp /end REF_MEASUREMENT /end GROUP
/begin GROUP SerlComOutpProxy.BusOffChassisExp.Logl "MICROSAR RTE" /begin SUB_GROUP /end SUB_GROUP /begin FUNCTION_LIST /end FUNCTION_LIST /begin REF_CHARACTERISTIC /end REF_CHARACTERISTIC /begin REF_MEASUREMENT SerlComOutpProxy.BusOffChassisExp.Logl /end REF_MEASUREMENT /end GROUP
/begin GROUP SerlComOutpProxy.BusOffHiSpd "MICROSAR RTE" /begin SUB_GROUP /end SUB_GROUP /begin FUNCTION_LIST /end FUNCTION_LIST /begin REF_CHARACTERISTIC /end REF_CHARACTERISTIC /begin REF_MEASUREMENT SerlComOutpProxy.BusOffHiSpd /end REF_MEASUREMENT /end GROUP
/begin GROUP SerlComOutpProxy.BusOffHiSpd.Logl "MICROSAR RTE" /begin SUB_GROUP /end SUB_GROUP /begin FUNCTION_LIST /end FUNCTION_LIST /begin REF_CHARACTERISTIC /end REF_CHARACTERISTIC /begin REF_MEASUREMENT SerlComOutpProxy.BusOffHiSpd.Logl /end REF_MEASUREMENT /end GROUP
/begin GROUP SerlComOutpProxy.CalibrationPorts "MICROSAR RTE"
 /begin SUB_GROUP SerlComOutpProxy.GmOvrlStMgrApaMfgEna.Logl SerlComOutpProxy.GmOvrlStMgrEscMfgEna.Logl SerlComOutpProxy.GmOvrlStMgrLkaMfgEna.Logl /end SUB_GROUP
 /begin FUNCTION_LIST /end FUNCTION_LIST
 /begin REF_CHARACTERISTIC /end REF_CHARACTERISTIC
 /begin REF_MEASUREMENT /end REF_MEASUREMENT
/end GROUP
/begin GROUP SerlComOutpProxy.CodSupported.Val "MICROSAR RTE" /begin SUB_GROUP /end SUB_GROUP /begin FUNCTION_LIST /end FUNCTION_LIST /begin REF_CHARACTERISTIC /end REF_CHARACTERISTIC /begin REF_MEASUREMENT SerlComOutpProxy.CodSupported.Val /end REF_MEASUREMENT /end GROUP
/begin GROUP SerlComOutpProxy.CurrSts.Val "MICROSAR RTE" /begin SUB_GROUP /end SUB_GROUP /begin FUNCTION_LIST /end FUNCTION_LIST /begin REF_CHARACTERISTIC /end REF_CHARACTERISTIC /begin REF_MEASUREMENT SerlComOutpProxy.CurrSts.Val /end REF_MEASUREMENT /end GROUP
/begin GROUP SerlComOutpProxy.DrvrSteerIntvDetd.Val "MICROSAR RTE" /begin SUB_GROUP /end SUB_GROUP /begin FUNCTION_LIST /end FUNCTION_LIST /begin REF_CHARACTERISTIC /end REF_CHARACTERISTIC /begin REF_MEASUREMENT SerlComOutpProxy.DrvrSteerIntvDetd.Val /end REF_MEASUREMENT /end GROUP
/begin GROUP SerlComOutpProxy.DrvrSteerIntvDetdProtnVal.Val "MICROSAR RTE" /begin SUB_GROUP /end SUB_GROUP /begin FUNCTION_LIST /end FUNCTION_LIST /begin REF_CHARACTERISTIC /end REF_CHARACTERISTIC /begin REF_MEASUREMENT SerlComOutpProxy.DrvrSteerIntvDetdProtnVal.Val /end REF_MEASUREMENT /end GROUP
/begin GROUP SerlComOutpProxy.DrvrSteerIntvDetdRollgCntr.Val "MICROSAR RTE" /begin SUB_GROUP /end SUB_GROUP /begin FUNCTION_LIST /end FUNCTION_LIST /begin REF_CHARACTERISTIC /end REF_CHARACTERISTIC /begin REF_MEASUREMENT SerlComOutpProxy.DrvrSteerIntvDetdRollgCntr.Val /end REF_MEASUREMENT /end GROUP
/begin GROUP SerlComOutpProxy.DrvrSteerIntvDetdVld.Val "MICROSAR RTE" /begin SUB_GROUP /end SUB_GROUP /begin FUNCTION_LIST /end FUNCTION_LIST /begin REF_CHARACTERISTIC /end REF_CHARACTERISTIC /begin REF_MEASUREMENT SerlComOutpProxy.DrvrSteerIntvDetdVld.Val /end REF_MEASUREMENT /end GROUP
/begin GROUP SerlComOutpProxy.DtcFailrTyp.Val "MICROSAR RTE" /begin SUB_GROUP /end SUB_GROUP /begin FUNCTION_LIST /end FUNCTION_LIST /begin REF_CHARACTERISTIC /end REF_CHARACTERISTIC /begin REF_MEASUREMENT SerlComOutpProxy.DtcFailrTyp.Val /end REF_MEASUREMENT /end GROUP
/begin GROUP SerlComOutpProxy.DtcFltTyp.Val "MICROSAR RTE" /begin SUB_GROUP /end SUB_GROUP /begin FUNCTION_LIST /end FUNCTION_LIST /begin REF_CHARACTERISTIC /end REF_CHARACTERISTIC /begin REF_MEASUREMENT SerlComOutpProxy.DtcFltTyp.Val /end REF_MEASUREMENT /end GROUP
/begin GROUP SerlComOutpProxy.DtcNr.Val "MICROSAR RTE" /begin SUB_GROUP /end SUB_GROUP /begin FUNCTION_LIST /end FUNCTION_LIST /begin REF_CHARACTERISTIC /end REF_CHARACTERISTIC /begin REF_MEASUREMENT SerlComOutpProxy.DtcNr.Val /end REF_MEASUREMENT /end GROUP
/begin GROUP SerlComOutpProxy.DtcSrc.Val "MICROSAR RTE" /begin SUB_GROUP /end SUB_GROUP /begin FUNCTION_LIST /end FUNCTION_LIST /begin REF_CHARACTERISTIC /end REF_CHARACTERISTIC /begin REF_MEASUREMENT SerlComOutpProxy.DtcSrc.Val /end REF_MEASUREMENT /end GROUP
/begin GROUP SerlComOutpProxy.DtcTrig.Val "MICROSAR RTE" /begin SUB_GROUP /end SUB_GROUP /begin FUNCTION_LIST /end FUNCTION_LIST /begin REF_CHARACTERISTIC /end REF_CHARACTERISTIC /begin REF_MEASUREMENT SerlComOutpProxy.DtcTrig.Val /end REF_MEASUREMENT /end GROUP
/begin GROUP SerlComOutpProxy.ElecPowerSteerAvlSts.Val "MICROSAR RTE" /begin SUB_GROUP /end SUB_GROUP /begin FUNCTION_LIST /end FUNCTION_LIST /begin REF_CHARACTERISTIC /end REF_CHARACTERISTIC /begin REF_MEASUREMENT SerlComOutpProxy.ElecPowerSteerAvlSts.Val /end REF_MEASUREMENT /end GROUP
/begin GROUP SerlComOutpProxy.ElecPowerSteerAvlStsProtnVal.Val "MICROSAR RTE" /begin SUB_GROUP /end SUB_GROUP /begin FUNCTION_LIST /end FUNCTION_LIST /begin REF_CHARACTERISTIC /end REF_CHARACTERISTIC /begin REF_MEASUREMENT SerlComOutpProxy.ElecPowerSteerAvlStsProtnVal.Val /end REF_MEASUREMENT /end GROUP
/begin GROUP SerlComOutpProxy.ElecPowerSteerAvlStsRollgCntr.Val "MICROSAR RTE" /begin SUB_GROUP /end SUB_GROUP /begin FUNCTION_LIST /end FUNCTION_LIST /begin REF_CHARACTERISTIC /end REF_CHARACTERISTIC /begin REF_MEASUREMENT SerlComOutpProxy.ElecPowerSteerAvlStsRollgCntr.Val /end REF_MEASUREMENT /end GROUP
/begin GROUP SerlComOutpProxy.ElecPwrSteerTotTqDlvd.Val "MICROSAR RTE" /begin SUB_GROUP /end SUB_GROUP /begin FUNCTION_LIST /end FUNCTION_LIST /begin REF_CHARACTERISTIC /end REF_CHARACTERISTIC /begin REF_MEASUREMENT SerlComOutpProxy.ElecPwrSteerTotTqDlvd.Val /end REF_MEASUREMENT /end GROUP
/begin GROUP SerlComOutpProxy.GmOvrlStMgrApaMfgEna.Logl "MICROSAR RTE" /begin SUB_GROUP /end SUB_GROUP /begin FUNCTION_LIST /end FUNCTION_LIST /begin REF_CHARACTERISTIC SerlComOutpProxy.GmOvrlStMgrApaMfgEna.Logl /end REF_CHARACTERISTIC /begin REF_MEASUREMENT /end REF_MEASUREMENT /end GROUP
/begin GROUP SerlComOutpProxy.GmOvrlStMgrEscMfgEna.Logl "MICROSAR RTE" /begin SUB_GROUP /end SUB_GROUP /begin FUNCTION_LIST /end FUNCTION_LIST /begin REF_CHARACTERISTIC SerlComOutpProxy.GmOvrlStMgrEscMfgEna.Logl /end REF_CHARACTERISTIC /begin REF_MEASUREMENT /end REF_MEASUREMENT /end GROUP
/begin GROUP SerlComOutpProxy.GmOvrlStMgrLkaMfgEna.Logl "MICROSAR RTE" /begin SUB_GROUP /end SUB_GROUP /begin FUNCTION_LIST /end FUNCTION_LIST /begin REF_CHARACTERISTIC SerlComOutpProxy.GmOvrlStMgrLkaMfgEna.Logl /end REF_CHARACTERISTIC /begin REF_MEASUREMENT /end REF_MEASUREMENT /end GROUP
/begin GROUP SerlComOutpProxy.HandsOffSteerWhlDetnMod.Val "MICROSAR RTE" /begin SUB_GROUP /end SUB_GROUP /begin FUNCTION_LIST /end FUNCTION_LIST /begin REF_CHARACTERISTIC /end REF_CHARACTERISTIC /begin REF_MEASUREMENT SerlComOutpProxy.HandsOffSteerWhlDetnMod.Val /end REF_MEASUREMENT /end GROUP
/begin GROUP SerlComOutpProxy.HandsOffSteerWhlDetnSt.Val "MICROSAR RTE" /begin SUB_GROUP /end SUB_GROUP /begin FUNCTION_LIST /end FUNCTION_LIST /begin REF_CHARACTERISTIC /end REF_CHARACTERISTIC /begin REF_MEASUREMENT SerlComOutpProxy.HandsOffSteerWhlDetnSt.Val /end REF_MEASUREMENT /end GROUP
/begin GROUP SerlComOutpProxy.HandsOffSteerWhlDetnStVld.Val "MICROSAR RTE" /begin SUB_GROUP /end SUB_GROUP /begin FUNCTION_LIST /end FUNCTION_LIST /begin REF_CHARACTERISTIC /end REF_CHARACTERISTIC /begin REF_MEASUREMENT SerlComOutpProxy.HandsOffSteerWhlDetnStVld.Val /end REF_MEASUREMENT /end GROUP
/begin GROUP SerlComOutpProxy.HistSts.Val "MICROSAR RTE" /begin SUB_GROUP /end SUB_GROUP /begin FUNCTION_LIST /end FUNCTION_LIST /begin REF_CHARACTERISTIC /end REF_CHARACTERISTIC /begin REF_MEASUREMENT SerlComOutpProxy.HistSts.Val /end REF_MEASUREMENT /end GROUP
/begin GROUP SerlComOutpProxy.LkaDrvrAppldTq.Val "MICROSAR RTE" /begin SUB_GROUP /end SUB_GROUP /begin FUNCTION_LIST /end FUNCTION_LIST /begin REF_CHARACTERISTIC /end REF_CHARACTERISTIC /begin REF_MEASUREMENT SerlComOutpProxy.LkaDrvrAppldTq.Val /end REF_MEASUREMENT /end GROUP
/begin GROUP SerlComOutpProxy.LkaDrvrAppldTqVld.Val "MICROSAR RTE" /begin SUB_GROUP /end SUB_GROUP /begin FUNCTION_LIST /end FUNCTION_LIST /begin REF_CHARACTERISTIC /end REF_CHARACTERISTIC /begin REF_MEASUREMENT SerlComOutpProxy.LkaDrvrAppldTqVld.Val /end REF_MEASUREMENT /end GROUP
/begin GROUP SerlComOutpProxy.LkaElecPwrSteerTotTqDlvd.Val "MICROSAR RTE" /begin SUB_GROUP /end SUB_GROUP /begin FUNCTION_LIST /end FUNCTION_LIST /begin REF_CHARACTERISTIC /end REF_CHARACTERISTIC /begin REF_MEASUREMENT SerlComOutpProxy.LkaElecPwrSteerTotTqDlvd.Val /end REF_MEASUREMENT /end GROUP
/begin GROUP SerlComOutpProxy.LkaTqOvrlDeltaTqDlvd.Val "MICROSAR RTE" /begin SUB_GROUP /end SUB_GROUP /begin FUNCTION_LIST /end FUNCTION_LIST /begin REF_CHARACTERISTIC /end REF_CHARACTERISTIC /begin REF_MEASUREMENT SerlComOutpProxy.LkaTqOvrlDeltaTqDlvd.Val /end REF_MEASUREMENT /end GROUP
/begin GROUP SerlComOutpProxy.LkaTqOvrlDlvdRollgCntr.Val "MICROSAR RTE" /begin SUB_GROUP /end SUB_GROUP /begin FUNCTION_LIST /end FUNCTION_LIST /begin REF_CHARACTERISTIC /end REF_CHARACTERISTIC /begin REF_MEASUREMENT SerlComOutpProxy.LkaTqOvrlDlvdRollgCntr.Val /end REF_MEASUREMENT /end GROUP
/begin GROUP SerlComOutpProxy.LkaTqOvrlStsChks.Val "MICROSAR RTE" /begin SUB_GROUP /end SUB_GROUP /begin FUNCTION_LIST /end FUNCTION_LIST /begin REF_CHARACTERISTIC /end REF_CHARACTERISTIC /begin REF_MEASUREMENT SerlComOutpProxy.LkaTqOvrlStsChks.Val /end REF_MEASUREMENT /end GROUP
/begin GROUP SerlComOutpProxy.LkaTqOvrlTqDlvdSts.Val "MICROSAR RTE" /begin SUB_GROUP /end SUB_GROUP /begin FUNCTION_LIST /end FUNCTION_LIST /begin REF_CHARACTERISTIC /end REF_CHARACTERISTIC /begin REF_MEASUREMENT SerlComOutpProxy.LkaTqOvrlTqDlvdSts.Val /end REF_MEASUREMENT /end GROUP
/begin GROUP SerlComOutpProxy.PerInstanceMemories "MICROSAR RTE"
 /begin SUB_GROUP SerlComOutpProxy.BusOffChassisExp SerlComOutpProxy.BusOffHiSpd /end SUB_GROUP
 /begin FUNCTION_LIST /end FUNCTION_LIST
 /begin REF_CHARACTERISTIC /end REF_CHARACTERISTIC
 /begin REF_MEASUREMENT /end REF_MEASUREMENT
/end GROUP
/begin GROUP SerlComOutpProxy.PwrSteerIndcr.Val "MICROSAR RTE" /begin SUB_GROUP /end SUB_GROUP /begin FUNCTION_LIST /end FUNCTION_LIST /begin REF_CHARACTERISTIC /end REF_CHARACTERISTIC /begin REF_MEASUREMENT SerlComOutpProxy.PwrSteerIndcr.Val /end REF_MEASUREMENT /end GROUP
/begin GROUP SerlComOutpProxy.ReceiverPorts "MICROSAR RTE"
 /begin SUB_GROUP SerlComOutpProxy.CodSupported.Val SerlComOutpProxy.CurrSts.Val SerlComOutpProxy.DrvrSteerIntvDetd.Val SerlComOutpProxy.DrvrSteerIntvDetdProtnVal.Val SerlComOutpProxy.DrvrSteerIntvDetdRollgCntr.Val SerlComOutpProxy.DrvrSteerIntvDetdVld.Val SerlComOutpProxy.DtcFailrTyp.Val SerlComOutpProxy.DtcFltTyp.Val SerlComOutpProxy.DtcNr.Val SerlComOutpProxy.DtcSrc.Val SerlComOutpProxy.DtcTrig.Val SerlComOutpProxy.ElecPowerSteerAvlSts.Val SerlComOutpProxy.ElecPowerSteerAvlStsProtnVal.Val SerlComOutpProxy.ElecPowerSteerAvlStsRollgCntr.Val SerlComOutpProxy.ElecPwrSteerTotTqDlvd.Val SerlComOutpProxy.HandsOffSteerWhlDetnMod.Val SerlComOutpProxy.HandsOffSteerWhlDetnSt.Val SerlComOutpProxy.HandsOffSteerWhlDetnStVld.Val SerlComOutpProxy.HistSts.Val SerlComOutpProxy.LkaDrvrAppldTq.Val SerlComOutpProxy.LkaDrvrAppldTqVld.Val SerlComOutpProxy.LkaElecPwrSteerTotTqDlvd.Val SerlComOutpProxy.LkaTqOvrlDeltaTqDlvd.Val SerlComOutpProxy.LkaTqOvrlDlvdRollgCntr.Val SerlComOutpProxy.LkaTqOvrlStsChks.Val SerlComOutpProxy.LkaTqOvrlTqDlvdSts.Val SerlComOutpProxy.PwrSteerIndcr.Val SerlComOutpProxy.SteerAssiLimd.Val SerlComOutpProxy.SteerAssiLimdLvl2.Val SerlComOutpProxy.SteerAssiLimdLvl3.Val SerlComOutpProxy.SteerWhlAgAlvRollgCntBusChassisExp.Val SerlComOutpProxy.SteerWhlAgAlvRollgCntBusHiSpd.Val SerlComOutpProxy.SteerWhlAgBusChassisExp.Val SerlComOutpProxy.SteerWhlAgBusHiSpd.Val SerlComOutpProxy.SteerWhlAgGrdtBusChassisExp.Val SerlComOutpProxy.SteerWhlAgGrdtBusHiSpd.Val SerlComOutpProxy.SteerWhlAgGrdtMaskBusChassisExp.Val SerlComOutpProxy.SteerWhlAgGrdtMaskBusHiSpd.Val SerlComOutpProxy.SteerWhlAgGrdtVldBusChassisExp.Val SerlComOutpProxy.SteerWhlAgGrdtVldBusHiSpd.Val SerlComOutpProxy.SteerWhlAgMaskBusChassisExp.Val SerlComOutpProxy.SteerWhlAgMaskBusHiSpd.Val SerlComOutpProxy.SteerWhlAgSnsrCalStsBusChassisExp.Val SerlComOutpProxy.SteerWhlAgSnsrCalStsBusHiSpd.Val SerlComOutpProxy.SteerWhlAgSnsrChksBusChassisExp.Val SerlComOutpProxy.SteerWhlAgSnsrChksBusHiSpd.Val SerlComOutpProxy.SteerWhlAgSnsrTypBusChassisExp.Val SerlComOutpProxy.SteerWhlAgSnsrTypBusHiSpd.Val SerlComOutpProxy.SteerWhlAgVldBusChassisExp.Val SerlComOutpProxy.SteerWhlAgVldBusHiSpd.Val SerlComOutpProxy.TqOvrlDeltaTqDlvd.Val SerlComOutpProxy.TqOvrlDlvdChks.Val SerlComOutpProxy.TqOvrlDlvdRollgCntr.Val SerlComOutpProxy.TqOvrlTqDlvdSts.Val SerlComOutpProxy.TstFaildCodClrdSts.Val SerlComOutpProxy.TstFaildPwrUpSts.Val SerlComOutpProxy.TstNotPassdCodClrdSts.Val SerlComOutpProxy.TstNotPassdPwrUpSts.Val SerlComOutpProxy.WarnIndcrReqdSts.Val /end SUB_GROUP
 /begin FUNCTION_LIST /end FUNCTION_LIST
 /begin REF_CHARACTERISTIC /end REF_CHARACTERISTIC
 /begin REF_MEASUREMENT /end REF_MEASUREMENT
/end GROUP
/begin GROUP SerlComOutpProxy.SenderPorts "MICROSAR RTE"
 /begin SUB_GROUP SerlComOutpProxy.BusOffChassisExp.Logl SerlComOutpProxy.BusOffHiSpd.Logl /end SUB_GROUP
 /begin FUNCTION_LIST /end FUNCTION_LIST
 /begin REF_CHARACTERISTIC /end REF_CHARACTERISTIC
 /begin REF_MEASUREMENT /end REF_MEASUREMENT
/end GROUP
/begin GROUP SerlComOutpProxy.SteerAssiLimd.Val "MICROSAR RTE" /begin SUB_GROUP /end SUB_GROUP /begin FUNCTION_LIST /end FUNCTION_LIST /begin REF_CHARACTERISTIC /end REF_CHARACTERISTIC /begin REF_MEASUREMENT SerlComOutpProxy.SteerAssiLimd.Val /end REF_MEASUREMENT /end GROUP
/begin GROUP SerlComOutpProxy.SteerAssiLimdLvl2.Val "MICROSAR RTE" /begin SUB_GROUP /end SUB_GROUP /begin FUNCTION_LIST /end FUNCTION_LIST /begin REF_CHARACTERISTIC /end REF_CHARACTERISTIC /begin REF_MEASUREMENT SerlComOutpProxy.SteerAssiLimdLvl2.Val /end REF_MEASUREMENT /end GROUP
/begin GROUP SerlComOutpProxy.SteerAssiLimdLvl3.Val "MICROSAR RTE" /begin SUB_GROUP /end SUB_GROUP /begin FUNCTION_LIST /end FUNCTION_LIST /begin REF_CHARACTERISTIC /end REF_CHARACTERISTIC /begin REF_MEASUREMENT SerlComOutpProxy.SteerAssiLimdLvl3.Val /end REF_MEASUREMENT /end GROUP
/begin GROUP SerlComOutpProxy.SteerWhlAgAlvRollgCntBusChassisExp.Val "MICROSAR RTE" /begin SUB_GROUP /end SUB_GROUP /begin FUNCTION_LIST /end FUNCTION_LIST /begin REF_CHARACTERISTIC /end REF_CHARACTERISTIC /begin REF_MEASUREMENT SerlComOutpProxy.SteerWhlAgAlvRollgCntBusChassisExp.Val /end REF_MEASUREMENT /end GROUP
/begin GROUP SerlComOutpProxy.SteerWhlAgAlvRollgCntBusHiSpd.Val "MICROSAR RTE" /begin SUB_GROUP /end SUB_GROUP /begin FUNCTION_LIST /end FUNCTION_LIST /begin REF_CHARACTERISTIC /end REF_CHARACTERISTIC /begin REF_MEASUREMENT SerlComOutpProxy.SteerWhlAgAlvRollgCntBusHiSpd.Val /end REF_MEASUREMENT /end GROUP
/begin GROUP SerlComOutpProxy.SteerWhlAgBusChassisExp.Val "MICROSAR RTE" /begin SUB_GROUP /end SUB_GROUP /begin FUNCTION_LIST /end FUNCTION_LIST /begin REF_CHARACTERISTIC /end REF_CHARACTERISTIC /begin REF_MEASUREMENT SerlComOutpProxy.SteerWhlAgBusChassisExp.Val /end REF_MEASUREMENT /end GROUP
/begin GROUP SerlComOutpProxy.SteerWhlAgBusHiSpd.Val "MICROSAR RTE" /begin SUB_GROUP /end SUB_GROUP /begin FUNCTION_LIST /end FUNCTION_LIST /begin REF_CHARACTERISTIC /end REF_CHARACTERISTIC /begin REF_MEASUREMENT SerlComOutpProxy.SteerWhlAgBusHiSpd.Val /end REF_MEASUREMENT /end GROUP
/begin GROUP SerlComOutpProxy.SteerWhlAgGrdtBusChassisExp.Val "MICROSAR RTE" /begin SUB_GROUP /end SUB_GROUP /begin FUNCTION_LIST /end FUNCTION_LIST /begin REF_CHARACTERISTIC /end REF_CHARACTERISTIC /begin REF_MEASUREMENT SerlComOutpProxy.SteerWhlAgGrdtBusChassisExp.Val /end REF_MEASUREMENT /end GROUP
/begin GROUP SerlComOutpProxy.SteerWhlAgGrdtBusHiSpd.Val "MICROSAR RTE" /begin SUB_GROUP /end SUB_GROUP /begin FUNCTION_LIST /end FUNCTION_LIST /begin REF_CHARACTERISTIC /end REF_CHARACTERISTIC /begin REF_MEASUREMENT SerlComOutpProxy.SteerWhlAgGrdtBusHiSpd.Val /end REF_MEASUREMENT /end GROUP
/begin GROUP SerlComOutpProxy.SteerWhlAgGrdtMaskBusChassisExp.Val "MICROSAR RTE" /begin SUB_GROUP /end SUB_GROUP /begin FUNCTION_LIST /end FUNCTION_LIST /begin REF_CHARACTERISTIC /end REF_CHARACTERISTIC /begin REF_MEASUREMENT SerlComOutpProxy.SteerWhlAgGrdtMaskBusChassisExp.Val /end REF_MEASUREMENT /end GROUP
/begin GROUP SerlComOutpProxy.SteerWhlAgGrdtMaskBusHiSpd.Val "MICROSAR RTE" /begin SUB_GROUP /end SUB_GROUP /begin FUNCTION_LIST /end FUNCTION_LIST /begin REF_CHARACTERISTIC /end REF_CHARACTERISTIC /begin REF_MEASUREMENT SerlComOutpProxy.SteerWhlAgGrdtMaskBusHiSpd.Val /end REF_MEASUREMENT /end GROUP
/begin GROUP SerlComOutpProxy.SteerWhlAgGrdtVldBusChassisExp.Val "MICROSAR RTE" /begin SUB_GROUP /end SUB_GROUP /begin FUNCTION_LIST /end FUNCTION_LIST /begin REF_CHARACTERISTIC /end REF_CHARACTERISTIC /begin REF_MEASUREMENT SerlComOutpProxy.SteerWhlAgGrdtVldBusChassisExp.Val /end REF_MEASUREMENT /end GROUP
/begin GROUP SerlComOutpProxy.SteerWhlAgGrdtVldBusHiSpd.Val "MICROSAR RTE" /begin SUB_GROUP /end SUB_GROUP /begin FUNCTION_LIST /end FUNCTION_LIST /begin REF_CHARACTERISTIC /end REF_CHARACTERISTIC /begin REF_MEASUREMENT SerlComOutpProxy.SteerWhlAgGrdtVldBusHiSpd.Val /end REF_MEASUREMENT /end GROUP
/begin GROUP SerlComOutpProxy.SteerWhlAgMaskBusChassisExp.Val "MICROSAR RTE" /begin SUB_GROUP /end SUB_GROUP /begin FUNCTION_LIST /end FUNCTION_LIST /begin REF_CHARACTERISTIC /end REF_CHARACTERISTIC /begin REF_MEASUREMENT SerlComOutpProxy.SteerWhlAgMaskBusChassisExp.Val /end REF_MEASUREMENT /end GROUP
/begin GROUP SerlComOutpProxy.SteerWhlAgMaskBusHiSpd.Val "MICROSAR RTE" /begin SUB_GROUP /end SUB_GROUP /begin FUNCTION_LIST /end FUNCTION_LIST /begin REF_CHARACTERISTIC /end REF_CHARACTERISTIC /begin REF_MEASUREMENT SerlComOutpProxy.SteerWhlAgMaskBusHiSpd.Val /end REF_MEASUREMENT /end GROUP
/begin GROUP SerlComOutpProxy.SteerWhlAgSnsrCalStsBusChassisExp.Val "MICROSAR RTE" /begin SUB_GROUP /end SUB_GROUP /begin FUNCTION_LIST /end FUNCTION_LIST /begin REF_CHARACTERISTIC /end REF_CHARACTERISTIC /begin REF_MEASUREMENT SerlComOutpProxy.SteerWhlAgSnsrCalStsBusChassisExp.Val /end REF_MEASUREMENT /end GROUP
/begin GROUP SerlComOutpProxy.SteerWhlAgSnsrCalStsBusHiSpd.Val "MICROSAR RTE" /begin SUB_GROUP /end SUB_GROUP /begin FUNCTION_LIST /end FUNCTION_LIST /begin REF_CHARACTERISTIC /end REF_CHARACTERISTIC /begin REF_MEASUREMENT SerlComOutpProxy.SteerWhlAgSnsrCalStsBusHiSpd.Val /end REF_MEASUREMENT /end GROUP
/begin GROUP SerlComOutpProxy.SteerWhlAgSnsrChksBusChassisExp.Val "MICROSAR RTE" /begin SUB_GROUP /end SUB_GROUP /begin FUNCTION_LIST /end FUNCTION_LIST /begin REF_CHARACTERISTIC /end REF_CHARACTERISTIC /begin REF_MEASUREMENT SerlComOutpProxy.SteerWhlAgSnsrChksBusChassisExp.Val /end REF_MEASUREMENT /end GROUP
/begin GROUP SerlComOutpProxy.SteerWhlAgSnsrChksBusHiSpd.Val "MICROSAR RTE" /begin SUB_GROUP /end SUB_GROUP /begin FUNCTION_LIST /end FUNCTION_LIST /begin REF_CHARACTERISTIC /end REF_CHARACTERISTIC /begin REF_MEASUREMENT SerlComOutpProxy.SteerWhlAgSnsrChksBusHiSpd.Val /end REF_MEASUREMENT /end GROUP
/begin GROUP SerlComOutpProxy.SteerWhlAgSnsrTypBusChassisExp.Val "MICROSAR RTE" /begin SUB_GROUP /end SUB_GROUP /begin FUNCTION_LIST /end FUNCTION_LIST /begin REF_CHARACTERISTIC /end REF_CHARACTERISTIC /begin REF_MEASUREMENT SerlComOutpProxy.SteerWhlAgSnsrTypBusChassisExp.Val /end REF_MEASUREMENT /end GROUP
/begin GROUP SerlComOutpProxy.SteerWhlAgSnsrTypBusHiSpd.Val "MICROSAR RTE" /begin SUB_GROUP /end SUB_GROUP /begin FUNCTION_LIST /end FUNCTION_LIST /begin REF_CHARACTERISTIC /end REF_CHARACTERISTIC /begin REF_MEASUREMENT SerlComOutpProxy.SteerWhlAgSnsrTypBusHiSpd.Val /end REF_MEASUREMENT /end GROUP
/begin GROUP SerlComOutpProxy.SteerWhlAgVldBusChassisExp.Val "MICROSAR RTE" /begin SUB_GROUP /end SUB_GROUP /begin FUNCTION_LIST /end FUNCTION_LIST /begin REF_CHARACTERISTIC /end REF_CHARACTERISTIC /begin REF_MEASUREMENT SerlComOutpProxy.SteerWhlAgVldBusChassisExp.Val /end REF_MEASUREMENT /end GROUP
/begin GROUP SerlComOutpProxy.SteerWhlAgVldBusHiSpd.Val "MICROSAR RTE" /begin SUB_GROUP /end SUB_GROUP /begin FUNCTION_LIST /end FUNCTION_LIST /begin REF_CHARACTERISTIC /end REF_CHARACTERISTIC /begin REF_MEASUREMENT SerlComOutpProxy.SteerWhlAgVldBusHiSpd.Val /end REF_MEASUREMENT /end GROUP
/begin GROUP SerlComOutpProxy.TqOvrlDeltaTqDlvd.Val "MICROSAR RTE" /begin SUB_GROUP /end SUB_GROUP /begin FUNCTION_LIST /end FUNCTION_LIST /begin REF_CHARACTERISTIC /end REF_CHARACTERISTIC /begin REF_MEASUREMENT SerlComOutpProxy.TqOvrlDeltaTqDlvd.Val /end REF_MEASUREMENT /end GROUP
/begin GROUP SerlComOutpProxy.TqOvrlDlvdChks.Val "MICROSAR RTE" /begin SUB_GROUP /end SUB_GROUP /begin FUNCTION_LIST /end FUNCTION_LIST /begin REF_CHARACTERISTIC /end REF_CHARACTERISTIC /begin REF_MEASUREMENT SerlComOutpProxy.TqOvrlDlvdChks.Val /end REF_MEASUREMENT /end GROUP
/begin GROUP SerlComOutpProxy.TqOvrlDlvdRollgCntr.Val "MICROSAR RTE" /begin SUB_GROUP /end SUB_GROUP /begin FUNCTION_LIST /end FUNCTION_LIST /begin REF_CHARACTERISTIC /end REF_CHARACTERISTIC /begin REF_MEASUREMENT SerlComOutpProxy.TqOvrlDlvdRollgCntr.Val /end REF_MEASUREMENT /end GROUP
/begin GROUP SerlComOutpProxy.TqOvrlTqDlvdSts.Val "MICROSAR RTE" /begin SUB_GROUP /end SUB_GROUP /begin FUNCTION_LIST /end FUNCTION_LIST /begin REF_CHARACTERISTIC /end REF_CHARACTERISTIC /begin REF_MEASUREMENT SerlComOutpProxy.TqOvrlTqDlvdSts.Val /end REF_MEASUREMENT /end GROUP
/begin GROUP SerlComOutpProxy.TstFaildCodClrdSts.Val "MICROSAR RTE" /begin SUB_GROUP /end SUB_GROUP /begin FUNCTION_LIST /end FUNCTION_LIST /begin REF_CHARACTERISTIC /end REF_CHARACTERISTIC /begin REF_MEASUREMENT SerlComOutpProxy.TstFaildCodClrdSts.Val /end REF_MEASUREMENT /end GROUP
/begin GROUP SerlComOutpProxy.TstFaildPwrUpSts.Val "MICROSAR RTE" /begin SUB_GROUP /end SUB_GROUP /begin FUNCTION_LIST /end FUNCTION_LIST /begin REF_CHARACTERISTIC /end REF_CHARACTERISTIC /begin REF_MEASUREMENT SerlComOutpProxy.TstFaildPwrUpSts.Val /end REF_MEASUREMENT /end GROUP
/begin GROUP SerlComOutpProxy.TstNotPassdCodClrdSts.Val "MICROSAR RTE" /begin SUB_GROUP /end SUB_GROUP /begin FUNCTION_LIST /end FUNCTION_LIST /begin REF_CHARACTERISTIC /end REF_CHARACTERISTIC /begin REF_MEASUREMENT SerlComOutpProxy.TstNotPassdCodClrdSts.Val /end REF_MEASUREMENT /end GROUP
/begin GROUP SerlComOutpProxy.TstNotPassdPwrUpSts.Val "MICROSAR RTE" /begin SUB_GROUP /end SUB_GROUP /begin FUNCTION_LIST /end FUNCTION_LIST /begin REF_CHARACTERISTIC /end REF_CHARACTERISTIC /begin REF_MEASUREMENT SerlComOutpProxy.TstNotPassdPwrUpSts.Val /end REF_MEASUREMENT /end GROUP
/begin GROUP SerlComOutpProxy.WarnIndcrReqdSts.Val "MICROSAR RTE" /begin SUB_GROUP /end SUB_GROUP /begin FUNCTION_LIST /end FUNCTION_LIST /begin REF_CHARACTERISTIC /end REF_CHARACTERISTIC /begin REF_MEASUREMENT SerlComOutpProxy.WarnIndcrReqdSts.Val /end REF_MEASUREMENT /end GROUP
/begin GROUP SnsrOffsCorrn "MICROSAR RTE"
 /begin SUB_GROUP SnsrOffsCorrn.CalibrationPorts SnsrOffsCorrn.ReceiverPorts SnsrOffsCorrn.SenderPorts /end SUB_GROUP
 /begin FUNCTION_LIST /end FUNCTION_LIST
 /begin REF_CHARACTERISTIC /end REF_CHARACTERISTIC
 /begin REF_MEASUREMENT /end REF_MEASUREMENT
/end GROUP
/begin GROUP SnsrOffsCorrn.CalibrationPorts "MICROSAR RTE"
 /begin SUB_GROUP SnsrOffsCorrn.SnsrOffsCorrnHwAgLrndOffsLim.Val SnsrOffsCorrn.SnsrOffsCorrnHwTqLrndOffsLim.Val SnsrOffsCorrn.SnsrOffsCorrnOffsEna.Logl SnsrOffsCorrn.SnsrOffsCorrnVehYawRateLrndOffsLim.Val /end SUB_GROUP
 /begin FUNCTION_LIST /end FUNCTION_LIST
 /begin REF_CHARACTERISTIC /end REF_CHARACTERISTIC
 /begin REF_MEASUREMENT /end REF_MEASUREMENT
/end GROUP
/begin GROUP SnsrOffsCorrn.HwAg.Val "MICROSAR RTE" /begin SUB_GROUP /end SUB_GROUP /begin FUNCTION_LIST /end FUNCTION_LIST /begin REF_CHARACTERISTIC /end REF_CHARACTERISTIC /begin REF_MEASUREMENT SnsrOffsCorrn.HwAg.Val /end REF_MEASUREMENT /end GROUP
/begin GROUP SnsrOffsCorrn.HwAgCorrd.Val "MICROSAR RTE" /begin SUB_GROUP /end SUB_GROUP /begin FUNCTION_LIST /end FUNCTION_LIST /begin REF_CHARACTERISTIC /end REF_CHARACTERISTIC /begin REF_MEASUREMENT SnsrOffsCorrn.HwAgCorrd.Val /end REF_MEASUREMENT /end GROUP
/begin GROUP SnsrOffsCorrn.HwAgOffs.Val "MICROSAR RTE" /begin SUB_GROUP /end SUB_GROUP /begin FUNCTION_LIST /end FUNCTION_LIST /begin REF_CHARACTERISTIC /end REF_CHARACTERISTIC /begin REF_MEASUREMENT SnsrOffsCorrn.HwAgOffs.Val /end REF_MEASUREMENT /end GROUP
/begin GROUP SnsrOffsCorrn.HwTq.Val "MICROSAR RTE" /begin SUB_GROUP /end SUB_GROUP /begin FUNCTION_LIST /end FUNCTION_LIST /begin REF_CHARACTERISTIC /end REF_CHARACTERISTIC /begin REF_MEASUREMENT SnsrOffsCorrn.HwTq.Val /end REF_MEASUREMENT /end GROUP
/begin GROUP SnsrOffsCorrn.HwTqCorrd.Val "MICROSAR RTE" /begin SUB_GROUP /end SUB_GROUP /begin FUNCTION_LIST /end FUNCTION_LIST /begin REF_CHARACTERISTIC /end REF_CHARACTERISTIC /begin REF_MEASUREMENT SnsrOffsCorrn.HwTqCorrd.Val /end REF_MEASUREMENT /end GROUP
/begin GROUP SnsrOffsCorrn.HwTqOffs.Val "MICROSAR RTE" /begin SUB_GROUP /end SUB_GROUP /begin FUNCTION_LIST /end FUNCTION_LIST /begin REF_CHARACTERISTIC /end REF_CHARACTERISTIC /begin REF_MEASUREMENT SnsrOffsCorrn.HwTqOffs.Val /end REF_MEASUREMENT /end GROUP
/begin GROUP SnsrOffsCorrn.ReceiverPorts "MICROSAR RTE"
 /begin SUB_GROUP SnsrOffsCorrn.HwAg.Val SnsrOffsCorrn.HwAgOffs.Val SnsrOffsCorrn.HwTq.Val SnsrOffsCorrn.HwTqOffs.Val SnsrOffsCorrn.VehYawRate.Val SnsrOffsCorrn.VehYawRateOffs.Val /end SUB_GROUP
 /begin FUNCTION_LIST /end FUNCTION_LIST
 /begin REF_CHARACTERISTIC /end REF_CHARACTERISTIC
 /begin REF_MEASUREMENT /end REF_MEASUREMENT
/end GROUP
/begin GROUP SnsrOffsCorrn.SenderPorts "MICROSAR RTE"
 /begin SUB_GROUP SnsrOffsCorrn.HwAgCorrd.Val SnsrOffsCorrn.HwTqCorrd.Val SnsrOffsCorrn.VehYawRateCorrd.Val /end SUB_GROUP
 /begin FUNCTION_LIST /end FUNCTION_LIST
 /begin REF_CHARACTERISTIC /end REF_CHARACTERISTIC
 /begin REF_MEASUREMENT /end REF_MEASUREMENT
/end GROUP
/begin GROUP SnsrOffsCorrn.SnsrOffsCorrnHwAgLrndOffsLim.Val "MICROSAR RTE" /begin SUB_GROUP /end SUB_GROUP /begin FUNCTION_LIST /end FUNCTION_LIST /begin REF_CHARACTERISTIC SnsrOffsCorrn.SnsrOffsCorrnHwAgLrndOffsLim.Val /end REF_CHARACTERISTIC /begin REF_MEASUREMENT /end REF_MEASUREMENT /end GROUP
/begin GROUP SnsrOffsCorrn.SnsrOffsCorrnHwTqLrndOffsLim.Val "MICROSAR RTE" /begin SUB_GROUP /end SUB_GROUP /begin FUNCTION_LIST /end FUNCTION_LIST /begin REF_CHARACTERISTIC SnsrOffsCorrn.SnsrOffsCorrnHwTqLrndOffsLim.Val /end REF_CHARACTERISTIC /begin REF_MEASUREMENT /end REF_MEASUREMENT /end GROUP
/begin GROUP SnsrOffsCorrn.SnsrOffsCorrnOffsEna.Logl "MICROSAR RTE" /begin SUB_GROUP /end SUB_GROUP /begin FUNCTION_LIST /end FUNCTION_LIST /begin REF_CHARACTERISTIC SnsrOffsCorrn.SnsrOffsCorrnOffsEna.Logl /end REF_CHARACTERISTIC /begin REF_MEASUREMENT /end REF_MEASUREMENT /end GROUP
/begin GROUP SnsrOffsCorrn.SnsrOffsCorrnVehYawRateLrndOffsLim.Val "MICROSAR RTE" /begin SUB_GROUP /end SUB_GROUP /begin FUNCTION_LIST /end FUNCTION_LIST /begin REF_CHARACTERISTIC SnsrOffsCorrn.SnsrOffsCorrnVehYawRateLrndOffsLim.Val /end REF_CHARACTERISTIC /begin REF_MEASUREMENT /end REF_MEASUREMENT /end GROUP
/begin GROUP SnsrOffsCorrn.VehYawRate.Val "MICROSAR RTE" /begin SUB_GROUP /end SUB_GROUP /begin FUNCTION_LIST /end FUNCTION_LIST /begin REF_CHARACTERISTIC /end REF_CHARACTERISTIC /begin REF_MEASUREMENT SnsrOffsCorrn.VehYawRate.Val /end REF_MEASUREMENT /end GROUP
/begin GROUP SnsrOffsCorrn.VehYawRateCorrd.Val "MICROSAR RTE" /begin SUB_GROUP /end SUB_GROUP /begin FUNCTION_LIST /end FUNCTION_LIST /begin REF_CHARACTERISTIC /end REF_CHARACTERISTIC /begin REF_MEASUREMENT SnsrOffsCorrn.VehYawRateCorrd.Val /end REF_MEASUREMENT /end GROUP
/begin GROUP SnsrOffsCorrn.VehYawRateOffs.Val "MICROSAR RTE" /begin SUB_GROUP /end SUB_GROUP /begin FUNCTION_LIST /end FUNCTION_LIST /begin REF_CHARACTERISTIC /end REF_CHARACTERISTIC /begin REF_MEASUREMENT SnsrOffsCorrn.VehYawRateOffs.Val /end REF_MEASUREMENT /end GROUP
/begin GROUP SnsrOffsLrng "MICROSAR RTE"
 /begin SUB_GROUP SnsrOffsLrng.CalibrationPorts SnsrOffsLrng.PerInstanceMemories SnsrOffsLrng.ReceiverPorts SnsrOffsLrng.SenderPorts /end SUB_GROUP
 /begin FUNCTION_LIST /end FUNCTION_LIST
 /begin REF_CHARACTERISTIC /end REF_CHARACTERISTIC
 /begin REF_MEASUREMENT /end REF_MEASUREMENT
/end GROUP
/begin GROUP SnsrOffsLrng.CalibrationPorts "MICROSAR RTE"
 /begin SUB_GROUP SnsrOffsLrng.SnsrOffsLrngFctEna.Logl SnsrOffsLrng.SnsrOffsLrngHwAgLrngDrvgDstThd.Val SnsrOffsLrng.SnsrOffsLrngHwAgLrngEna.Logl SnsrOffsLrng.SnsrOffsLrngHwAgLrngHwVelThd.Val SnsrOffsLrng.SnsrOffsLrngHwAgLrngSysTqThd.Val SnsrOffsLrng.SnsrOffsLrngHwAgLrngSysTqThdMed.Val SnsrOffsLrng.SnsrOffsLrngHwAgLrngSysTqThdTrustd.Val SnsrOffsLrng.SnsrOffsLrngHwAgLrngSysTqThdWide.Val SnsrOffsLrng.SnsrOffsLrngHwAgLrngTi.Val SnsrOffsLrng.SnsrOffsLrngHwAgLrngVehSpdThd.Val SnsrOffsLrng.SnsrOffsLrngHwAgLrngYawOffsDbnd.Val SnsrOffsLrng.SnsrOffsLrngHwAgLrngYawRateThd.Val SnsrOffsLrng.SnsrOffsLrngHwAgOffsLim.Val SnsrOffsLrng.SnsrOffsLrngHwTqLrngEna.Logl SnsrOffsLrng.SnsrOffsLrngHwTqLrngEnaTiThd.Val SnsrOffsLrng.SnsrOffsLrngHwTqLrngHwAgDbnd.Val SnsrOffsLrng.SnsrOffsLrngHwTqLrngHwAgThd.Val SnsrOffsLrng.SnsrOffsLrngHwTqLrngHwTqThd.Val SnsrOffsLrng.SnsrOffsLrngHwTqLrngHwTqZeroOffsThd.Val SnsrOffsLrng.SnsrOffsLrngHwTqLrngHwVelThd.Val SnsrOffsLrng.SnsrOffsLrngHwTqLrngMeasTi.Val SnsrOffsLrng.SnsrOffsLrngHwTqLrngMeasTiScar.Val SnsrOffsLrng.SnsrOffsLrngHwTqLrngSampleImbThd1.Val SnsrOffsLrng.SnsrOffsLrngHwTqLrngSampleImbThd2.Val SnsrOffsLrng.SnsrOffsLrngHwTqLrngSampleThd1.Val SnsrOffsLrng.SnsrOffsLrngHwTqLrngSampleThd2.Val SnsrOffsLrng.SnsrOffsLrngHwTqLrngTiWghtCoeff.Val SnsrOffsLrng.SnsrOffsLrngHwTqLrngVehSpdThd.Val SnsrOffsLrng.SnsrOffsLrngHwTqOffsLim.Val SnsrOffsLrng.SnsrOffsLrngHwVelFilFrq.Val SnsrOffsLrng.SnsrOffsLrngSampleCntForHwTqLrngRst.Val SnsrOffsLrng.SnsrOffsLrngTqAndAgFilFrq.Val SnsrOffsLrng.SnsrOffsLrngTqInpDetnHwTqFilFrq.Val SnsrOffsLrng.SnsrOffsLrngTqInpDetnPwrEstimnThd.Val SnsrOffsLrng.SnsrOffsLrngTqInpDetnSinGenrAmp.Val SnsrOffsLrng.SnsrOffsLrngTqInpDetnSinGenrFrq.Val SnsrOffsLrng.SnsrOffsLrngTqInpDetnStg1FilGain.Val SnsrOffsLrng.SnsrOffsLrngTqInpDetnStg1WinSize.Val SnsrOffsLrng.SnsrOffsLrngTqInpDetnStg2FilGainCen.Val SnsrOffsLrng.SnsrOffsLrngTqInpDetnStg2FilGainDwn.Val SnsrOffsLrng.SnsrOffsLrngTqInpDetnStg2FilGainUp.Val SnsrOffsLrng.SnsrOffsLrngTqInpDetnStg2WinSize.Val SnsrOffsLrng.SnsrOffsLrngYawACdngFilFrq.Val SnsrOffsLrng.SnsrOffsLrngYawLrngEna.Logl SnsrOffsLrng.SnsrOffsLrngYawLrngHwAgThd.Val SnsrOffsLrng.SnsrOffsLrngYawLrngTi.Val SnsrOffsLrng.SnsrOffsLrngYawLrngYawAThd.Val SnsrOffsLrng.SnsrOffsLrngYawOffsFrshTiThd.Val SnsrOffsLrng.SnsrOffsLrngYawRateCdngFilFrq.Val SnsrOffsLrng.SnsrOffsLrngYawRateOffsLim.Val SnsrOffsLrng.SysGlbPrmSysTqRat.Val /end SUB_GROUP
 /begin FUNCTION_LIST /end FUNCTION_LIST
 /begin REF_CHARACTERISTIC /end REF_CHARACTERISTIC
 /begin REF_MEASUREMENT /end REF_MEASUREMENT
/end GROUP
/begin GROUP SnsrOffsLrng.HwAg.Val "MICROSAR RTE" /begin SUB_GROUP /end SUB_GROUP /begin FUNCTION_LIST /end FUNCTION_LIST /begin REF_CHARACTERISTIC /end REF_CHARACTERISTIC /begin REF_MEASUREMENT SnsrOffsLrng.HwAg.Val /end REF_MEASUREMENT /end GROUP
/begin GROUP SnsrOffsLrng.HwAgAuthy.Val "MICROSAR RTE" /begin SUB_GROUP /end SUB_GROUP /begin FUNCTION_LIST /end FUNCTION_LIST /begin REF_CHARACTERISTIC /end REF_CHARACTERISTIC /begin REF_MEASUREMENT SnsrOffsLrng.HwAgAuthy.Val /end REF_MEASUREMENT /end GROUP
/begin GROUP SnsrOffsLrng.HwAgCdngFil "MICROSAR RTE" /begin SUB_GROUP /end SUB_GROUP /begin FUNCTION_LIST /end FUNCTION_LIST /begin REF_CHARACTERISTIC /end REF_CHARACTERISTIC
 /begin REF_MEASUREMENT SnsrOffsLrng.HwAgCdngFil.FilGain SnsrOffsLrng.HwAgCdngFil.FilSt /end REF_MEASUREMENT
/end GROUP
/begin GROUP SnsrOffsLrng.HwAgLrngDrvgDstPrev "MICROSAR RTE" /begin SUB_GROUP /end SUB_GROUP /begin FUNCTION_LIST /end FUNCTION_LIST /begin REF_CHARACTERISTIC /end REF_CHARACTERISTIC /begin REF_MEASUREMENT SnsrOffsLrng.HwAgLrngDrvgDstPrev /end REF_MEASUREMENT /end GROUP
/begin GROUP SnsrOffsLrng.HwAgLrngFil1 "MICROSAR RTE" /begin SUB_GROUP /end SUB_GROUP /begin FUNCTION_LIST /end FUNCTION_LIST /begin REF_CHARACTERISTIC /end REF_CHARACTERISTIC
 /begin REF_MEASUREMENT SnsrOffsLrng.HwAgLrngFil1.FilGain SnsrOffsLrng.HwAgLrngFil1.FilSt /end REF_MEASUREMENT
/end GROUP
/begin GROUP SnsrOffsLrng.HwAgLrngFil2 "MICROSAR RTE" /begin SUB_GROUP /end SUB_GROUP /begin FUNCTION_LIST /end FUNCTION_LIST /begin REF_CHARACTERISTIC /end REF_CHARACTERISTIC
 /begin REF_MEASUREMENT SnsrOffsLrng.HwAgLrngFil2.FilGain SnsrOffsLrng.HwAgLrngFil2.FilSt /end REF_MEASUREMENT
/end GROUP
/begin GROUP SnsrOffsLrng.HwAgLrngStRst "MICROSAR RTE" /begin SUB_GROUP /end SUB_GROUP /begin FUNCTION_LIST /end FUNCTION_LIST /begin REF_CHARACTERISTIC /end REF_CHARACTERISTIC /begin REF_MEASUREMENT SnsrOffsLrng.HwAgLrngStRst /end REF_MEASUREMENT /end GROUP
/begin GROUP SnsrOffsLrng.HwAgLrngSysTqFil1 "MICROSAR RTE" /begin SUB_GROUP /end SUB_GROUP /begin FUNCTION_LIST /end FUNCTION_LIST /begin REF_CHARACTERISTIC /end REF_CHARACTERISTIC
 /begin REF_MEASUREMENT SnsrOffsLrng.HwAgLrngSysTqFil1.FilGain SnsrOffsLrng.HwAgLrngSysTqFil1.FilSt /end REF_MEASUREMENT
/end GROUP
/begin GROUP SnsrOffsLrng.HwAgLrngSysTqFil2 "MICROSAR RTE" /begin SUB_GROUP /end SUB_GROUP /begin FUNCTION_LIST /end FUNCTION_LIST /begin REF_CHARACTERISTIC /end REF_CHARACTERISTIC
 /begin REF_MEASUREMENT SnsrOffsLrng.HwAgLrngSysTqFil2.FilGain SnsrOffsLrng.HwAgLrngSysTqFil2.FilSt /end REF_MEASUREMENT
/end GROUP
/begin GROUP SnsrOffsLrng.HwAgMeasFil1 "MICROSAR RTE" /begin SUB_GROUP /end SUB_GROUP /begin FUNCTION_LIST /end FUNCTION_LIST /begin REF_CHARACTERISTIC /end REF_CHARACTERISTIC
 /begin REF_MEASUREMENT SnsrOffsLrng.HwAgMeasFil1.FilGain SnsrOffsLrng.HwAgMeasFil1.FilSt /end REF_MEASUREMENT
/end GROUP
/begin GROUP SnsrOffsLrng.HwAgMeasFil2 "MICROSAR RTE" /begin SUB_GROUP /end SUB_GROUP /begin FUNCTION_LIST /end FUNCTION_LIST /begin REF_CHARACTERISTIC /end REF_CHARACTERISTIC
 /begin REF_MEASUREMENT SnsrOffsLrng.HwAgMeasFil2.FilGain SnsrOffsLrng.HwAgMeasFil2.FilSt /end REF_MEASUREMENT
/end GROUP
/begin GROUP SnsrOffsLrng.HwAgOffs.Val "MICROSAR RTE" /begin SUB_GROUP /end SUB_GROUP /begin FUNCTION_LIST /end FUNCTION_LIST /begin REF_CHARACTERISTIC /end REF_CHARACTERISTIC /begin REF_MEASUREMENT SnsrOffsLrng.HwAgOffs.Val /end REF_MEASUREMENT /end GROUP
/begin GROUP SnsrOffsLrng.HwTq.Val "MICROSAR RTE" /begin SUB_GROUP /end SUB_GROUP /begin FUNCTION_LIST /end FUNCTION_LIST /begin REF_CHARACTERISTIC /end REF_CHARACTERISTIC /begin REF_MEASUREMENT SnsrOffsLrng.HwTq.Val /end REF_MEASUREMENT /end GROUP
/begin GROUP SnsrOffsLrng.HwTqLrngEnaTmrRef "MICROSAR RTE" /begin SUB_GROUP /end SUB_GROUP /begin FUNCTION_LIST /end FUNCTION_LIST /begin REF_CHARACTERISTIC /end REF_CHARACTERISTIC /begin REF_MEASUREMENT SnsrOffsLrng.HwTqLrngEnaTmrRef /end REF_MEASUREMENT /end GROUP
/begin GROUP SnsrOffsLrng.HwTqLrngMeasTmrRef "MICROSAR RTE" /begin SUB_GROUP /end SUB_GROUP /begin FUNCTION_LIST /end FUNCTION_LIST /begin REF_CHARACTERISTIC /end REF_CHARACTERISTIC /begin REF_MEASUREMENT SnsrOffsLrng.HwTqLrngMeasTmrRef /end REF_MEASUREMENT /end GROUP
/**********************************************************************************************************************
* RECORD_LAYOUT
*********************************************************************************************************************/
/begin RECORD_LAYOUT RTE_RL_UBYTE FNC_VALUES 1 UBYTE ROW_DIR DIRECT /end RECORD_LAYOUT
/begin RECORD_LAYOUT RTE_RL_UWORD FNC_VALUES 1 UWORD ROW_DIR DIRECT /end RECORD_LAYOUT
/begin RECORD_LAYOUT RTE_RL_SWORD FNC_VALUES 1 SWORD ROW_DIR DIRECT /end RECORD_LAYOUT
/begin RECORD_LAYOUT RTE_RL_FLOAT32_IEEE FNC_VALUES 1 FLOAT32_IEEE ROW_DIR DIRECT /end RECORD_LAYOUT
/begin RECORD_LAYOUT RTE_RL_BOOLEAN FNC_VALUES 1 UBYTE ROW_DIR DIRECT /end RECORD_LAYOUT
/**********************************************************************************************************************
* COMPU_METHOD / COMPU_VTAB_RANGE
*********************************************************************************************************************/
/begin COMPU_METHOD RTE_CM_BOOLEAN "" TAB_VERB "%3.1" "" COMPU_TAB_REF RTE_CM_BOOLEAN /end COMPU_METHOD
/begin COMPU_VTAB_RANGE RTE_CM_BOOLEAN "" 2 0 0 "false" 1 255 "true" /end COMPU_VTAB_RANGE
/begin COMPU_METHOD RTE_CM_ENUM_SysSt1 "" TAB_VERB "%.1" "" COMPU_TAB_REF RTE_CM_ENUM_SysSt1 /end COMPU_METHOD
/begin COMPU_VTAB_RANGE RTE_CM_ENUM_SysSt1 "" 4 0 0 "SYSST_DI" 1 1 "SYSST_OFF" 2 2 "SYSST_ENA" 3 3 "SYSST_WRMININ" /end COMPU_VTAB_RANGE
/begin COMPU_METHOD RTE_CM_Tq6 "" RAT_FUNC "%.1" "HwNm" COEFFS 0 256 0 0 0 1 /end COMPU_METHOD
/begin COMPU_METHOD RTE_CM_Spd2 "" RAT_FUNC "%.1" "kph" COEFFS 0 128 0 0 0 1 /end COMPU_METHOD
/begin COMPU_METHOD RTE_CM_Uls17 "" RAT_FUNC "%.1" "Uls" COEFFS 0 256 0 0 0 1 /end COMPU_METHOD
/begin COMPU_METHOD RTE_CM_Uls18 "" RAT_FUNC "%.1" "Uls" COEFFS 0 128 0 0 0 1 /end COMPU_METHOD
/begin COMPU_METHOD RTE_CM_T6 "" RAT_FUNC "%.1" "degC" COEFFS 0 0.0625 0 0 0 1 /end COMPU_METHOD
/begin COMPU_METHOD RTE_CM_Uls23 "" RAT_FUNC "%.1" "Uls" COEFFS 0 256 0 0 0 1 /end COMPU_METHOD
/begin COMPU_METHOD RTE_CM_Ag18 "" RAT_FUNC "%.1" "HwDeg" COEFFS 0 0.0625 0 0 0 1 /end COMPU_METHOD
/begin COMPU_METHOD RTE_CM_Tq14 "" RAT_FUNC "%.1" "MotNm" COEFFS 0 2048 0 0 0 1 /end COMPU_METHOD
/begin COMPU_METHOD RTE_CM_Vel6 "" RAT_FUNC "%.1" "HwRad/s" COEFFS 0 0.001953125 0 0 0 1 /end COMPU_METHOD
/begin COMPU_METHOD RTE_CM_Uls19 "" RAT_FUNC "%.1" "Uls" COEFFS 0 256 0 0 0 1 /end COMPU_METHOD
