/begin CHARACTERISTIC CDD_CurrMeas.SysGlbPrmMotPoleCnt.Val "MICROSAR RTE" VALUE 0x0 RTE_RL_UBYTE 0 NO_COMPU_METHOD 0 255 SYMBOL_LINK "Rte_CalprmRom_CalRegn01Inin00_DEFAULT_RTE_CALPRM_GROUP.SysGlbPrmMotPoleCnt_Val" 0 DISPLAY_IDENTIFIER CDD_CurrMeas.CalibrationPorts.SysGlbPrmMotPoleCnt.Val /end CHARACTERISTIC
/begin CHARACTERISTIC CDD_CurrMeasArbn.CurrMeasArbnMaxStallCntr.Val "MICROSAR RTE" VALUE 0x0 RTE_RL_UBYTE 0 NO_COMPU_METHOD 0 255 SYMBOL_LINK "Rte_CalprmRom_CalRegn01Cmn_DEFAULT_RTE_CALPRM_GROUP.CurrMeasArbnMaxStallCntr_Val" 0 DISPLAY_IDENTIFIER CDD_CurrMeasArbn.CalibrationPorts.CurrMeasArbnMaxStallCntr.Val /end CHARACTERISTIC
/begin CHARACTERISTIC CDD_HwTq0Meas.HwTq0MeasHwTq0PrtclFltFailStep.Val "MICROSAR RTE" VALUE 0x0 RTE_RL_UWORD 0 NO_COMPU_METHOD 0 65535 SYMBOL_LINK "Rte_CalprmRom_CalRegn01Inin00_DEFAULT_RTE_CALPRM_GROUP.HwTq0MeasHwTq0PrtclFltFailStep_Val" 0 DISPLAY_IDENTIFIER CDD_HwTq0Meas.CalibrationPorts.HwTq0MeasHwTq0PrtclFltFailStep.Val /end CHARACTERISTIC
/begin CHARACTERISTIC CDD_HwTq0Meas.HwTq0MeasHwTq0PrtclFltPassStep.Val "MICROSAR RTE" VALUE 0x0 RTE_RL_UWORD 0 NO_COMPU_METHOD 0 65535 SYMBOL_LINK "Rte_CalprmRom_CalRegn01Inin00_DEFAULT_RTE_CALPRM_GROUP.HwTq0MeasHwTq0PrtclFltPassStep_Val" 0 DISPLAY_IDENTIFIER CDD_HwTq0Meas.CalibrationPorts.HwTq0MeasHwTq0PrtclFltPassStep.Val /end CHARACTERISTIC
/begin CHARACTERISTIC CDD_HwTq0Meas.HwTq0OffsDft.OffsTrim "MICROSAR RTE" VALUE 0x0 RTE_RL_FLOAT32_IEEE 0 NO_COMPU_METHOD -3.402823466e+38 3.402823466e+38 SYMBOL_LINK "Rte_CalprmRom_CDD_HwTq0Meas_DEFAULT_RTE_CDATA_GROUP.HwTq0OffsDft.OffsTrim" 0 DISPLAY_IDENTIFIER CDD_HwTq0Meas.CalibrationParameters.HwTq0OffsDft.OffsTrim /end CHARACTERISTIC
/begin CHARACTERISTIC CDD_HwTq0Meas.HwTq0OffsDft.OffsTrimPrfmdSts "MICROSAR RTE" VALUE 0x0 RTE_RL_BOOLEAN 0 RTE_CM_BOOLEAN 0 255 SYMBOL_LINK "Rte_CalprmRom_CDD_HwTq0Meas_DEFAULT_RTE_CDATA_GROUP.HwTq0OffsDft.OffsTrimPrfmdSts" 0 DISPLAY_IDENTIFIER CDD_HwTq0Meas.CalibrationParameters.HwTq0OffsDft.OffsTrimPrfmdSts /end CHARACTERISTIC
/begin CHARACTERISTIC CDD_HwTq1Meas.HwTq1MeasHwTq1PrtclFltFailStep.Val "MICROSAR RTE" VALUE 0x0 RTE_RL_UWORD 0 NO_COMPU_METHOD 0 65535 SYMBOL_LINK "Rte_CalprmRom_CalRegn01Inin00_DEFAULT_RTE_CALPRM_GROUP.HwTq1MeasHwTq1PrtclFltFailStep_Val" 0 DISPLAY_IDENTIFIER CDD_HwTq1Meas.CalibrationPorts.HwTq1MeasHwTq1PrtclFltFailStep.Val /end CHARACTERISTIC
/begin CHARACTERISTIC CDD_HwTq1Meas.HwTq1MeasHwTq1PrtclFltPassStep.Val "MICROSAR RTE" VALUE 0x0 RTE_RL_UWORD 0 NO_COMPU_METHOD 0 65535 SYMBOL_LINK "Rte_CalprmRom_CalRegn01Inin00_DEFAULT_RTE_CALPRM_GROUP.HwTq1MeasHwTq1PrtclFltPassStep_Val" 0 DISPLAY_IDENTIFIER CDD_HwTq1Meas.CalibrationPorts.HwTq1MeasHwTq1PrtclFltPassStep.Val /end CHARACTERISTIC
/begin CHARACTERISTIC CDD_HwTq1Meas.HwTq1OffsDft.OffsTrim "MICROSAR RTE" VALUE 0x0 RTE_RL_FLOAT32_IEEE 0 NO_COMPU_METHOD -3.402823466e+38 3.402823466e+38 SYMBOL_LINK "Rte_CalprmRom_CDD_HwTq1Meas_DEFAULT_RTE_CDATA_GROUP.HwTq1OffsDft.OffsTrim" 0 DISPLAY_IDENTIFIER CDD_HwTq1Meas.CalibrationParameters.HwTq1OffsDft.OffsTrim /end CHARACTERISTIC
/begin CHARACTERISTIC CDD_HwTq1Meas.HwTq1OffsDft.OffsTrimPrfmdSts "MICROSAR RTE" VALUE 0x0 RTE_RL_BOOLEAN 0 RTE_CM_BOOLEAN 0 255 SYMBOL_LINK "Rte_CalprmRom_CDD_HwTq1Meas_DEFAULT_RTE_CDATA_GROUP.HwTq1OffsDft.OffsTrimPrfmdSts" 0 DISPLAY_IDENTIFIER CDD_HwTq1Meas.CalibrationParameters.HwTq1OffsDft.OffsTrimPrfmdSts /end CHARACTERISTIC
/begin CHARACTERISTIC CDD_HwTq2Meas.HwTq2MeasHwTq2PrtclFltFailStep.Val "MICROSAR RTE" VALUE 0x0 RTE_RL_UWORD 0 NO_COMPU_METHOD 0 65535 SYMBOL_LINK "Rte_CalprmRom_CalRegn01Cmn_DEFAULT_RTE_CALPRM_GROUP.HwTq2MeasHwTq2PrtclFltFailStep_Val" 0 DISPLAY_IDENTIFIER CDD_HwTq2Meas.CalibrationPorts.HwTq2MeasHwTq2PrtclFltFailStep.Val /end CHARACTERISTIC
/begin CHARACTERISTIC CDD_HwTq2Meas.HwTq2MeasHwTq2PrtclFltPassStep.Val "MICROSAR RTE" VALUE 0x0 RTE_RL_UWORD 0 NO_COMPU_METHOD 0 65535 SYMBOL_LINK "Rte_CalprmRom_CalRegn01Cmn_DEFAULT_RTE_CALPRM_GROUP.HwTq2MeasHwTq2PrtclFltPassStep_Val" 0 DISPLAY_IDENTIFIER CDD_HwTq2Meas.CalibrationPorts.HwTq2MeasHwTq2PrtclFltPassStep.Val /end CHARACTERISTIC
/begin CHARACTERISTIC CDD_HwTq2Meas.HwTq2OffsDft.OffsTrim "MICROSAR RTE" VALUE 0x0 RTE_RL_FLOAT32_IEEE 0 NO_COMPU_METHOD -3.402823466e+38 3.402823466e+38 SYMBOL_LINK "Rte_CalprmRom_CDD_HwTq2Meas_DEFAULT_RTE_CDATA_GROUP.HwTq2OffsDft.OffsTrim" 0 DISPLAY_IDENTIFIER CDD_HwTq2Meas.CalibrationParameters.HwTq2OffsDft.OffsTrim /end CHARACTERISTIC
/begin CHARACTERISTIC CDD_HwTq2Meas.HwTq2OffsDft.OffsTrimPrfmdSts "MICROSAR RTE" VALUE 0x0 RTE_RL_BOOLEAN 0 RTE_CM_BOOLEAN 0 255 SYMBOL_LINK "Rte_CalprmRom_CDD_HwTq2Meas_DEFAULT_RTE_CDATA_GROUP.HwTq2OffsDft.OffsTrimPrfmdSts" 0 DISPLAY_IDENTIFIER CDD_HwTq2Meas.CalibrationParameters.HwTq2OffsDft.OffsTrimPrfmdSts /end CHARACTERISTIC
/begin CHARACTERISTIC CDD_HwTq3Meas.HwTq3MeasHwTq3PrtclFltFailStep.Val "MICROSAR RTE" VALUE 0x0 RTE_RL_UWORD 0 NO_COMPU_METHOD 0 65535 SYMBOL_LINK "Rte_CalprmRom_CalRegn01Cmn_DEFAULT_RTE_CALPRM_GROUP.HwTq3MeasHwTq3PrtclFltFailStep_Val" 0 DISPLAY_IDENTIFIER CDD_HwTq3Meas.CalibrationPorts.HwTq3MeasHwTq3PrtclFltFailStep.Val /end CHARACTERISTIC
/begin CHARACTERISTIC CDD_HwTq3Meas.HwTq3MeasHwTq3PrtclFltPassStep.Val "MICROSAR RTE" VALUE 0x0 RTE_RL_UWORD 0 NO_COMPU_METHOD 0 65535 SYMBOL_LINK "Rte_CalprmRom_CalRegn01Cmn_DEFAULT_RTE_CALPRM_GROUP.HwTq3MeasHwTq3PrtclFltPassStep_Val" 0 DISPLAY_IDENTIFIER CDD_HwTq3Meas.CalibrationPorts.HwTq3MeasHwTq3PrtclFltPassStep.Val /end CHARACTERISTIC
/begin CHARACTERISTIC CDD_HwTq3Meas.HwTq3OffsDft.OffsTrim "MICROSAR RTE" VALUE 0x0 RTE_RL_FLOAT32_IEEE 0 NO_COMPU_METHOD -3.402823466e+38 3.402823466e+38 SYMBOL_LINK "Rte_CalprmRom_CDD_HwTq3Meas_DEFAULT_RTE_CDATA_GROUP.HwTq3OffsDft.OffsTrim" 0 DISPLAY_IDENTIFIER CDD_HwTq3Meas.CalibrationParameters.HwTq3OffsDft.OffsTrim /end CHARACTERISTIC
/begin CHARACTERISTIC CDD_HwTq3Meas.HwTq3OffsDft.OffsTrimPrfmdSts "MICROSAR RTE" VALUE 0x0 RTE_RL_BOOLEAN 0 RTE_CM_BOOLEAN 0 255 SYMBOL_LINK "Rte_CalprmRom_CDD_HwTq3Meas_DEFAULT_RTE_CDATA_GROUP.HwTq3OffsDft.OffsTrimPrfmdSts" 0 DISPLAY_IDENTIFIER CDD_HwTq3Meas.CalibrationParameters.HwTq3OffsDft.OffsTrimPrfmdSts /end CHARACTERISTIC
/begin CHARACTERISTIC CDD_McuDiagc.McuDiagc2MilliSecCntrCompThd.Val "MICROSAR RTE" VALUE 0x0 RTE_RL_UWORD 0 NO_COMPU_METHOD 0 65535 SYMBOL_LINK "Rte_CalprmRom_CalRegn01Inin00_DEFAULT_RTE_CALPRM_GROUP.McuDiagc2MilliSecCntrCompThd_Val" 0 DISPLAY_IDENTIFIER CDD_McuDiagc.CalibrationPorts.McuDiagc2MilliSecCntrCompThd.Val /end CHARACTERISTIC
/begin CHARACTERISTIC CDD_McuDiagc.McuDiagcFltFailStep.Val "MICROSAR RTE" VALUE 0x0 RTE_RL_UWORD 0 NO_COMPU_METHOD 0 65535 SYMBOL_LINK "Rte_CalprmRom_CalRegn01Inin00_DEFAULT_RTE_CALPRM_GROUP.McuDiagcFltFailStep_Val" 0 DISPLAY_IDENTIFIER CDD_McuDiagc.CalibrationPorts.McuDiagcFltFailStep.Val /end CHARACTERISTIC
/begin CHARACTERISTIC CDD_McuDiagc.McuDiagcFltPassStep.Val "MICROSAR RTE" VALUE 0x0 RTE_RL_UWORD 0 NO_COMPU_METHOD 0 65535 SYMBOL_LINK "Rte_CalprmRom_CalRegn01Inin00_DEFAULT_RTE_CALPRM_GROUP.McuDiagcFltPassStep_Val" 0 DISPLAY_IDENTIFIER CDD_McuDiagc.CalibrationPorts.McuDiagcFltPassStep.Val /end CHARACTERISTIC
/begin CHARACTERISTIC CDD_MotAg0Meas.MotAg0CoeffTblDft "MICROSAR RTE" VAL_BLK 0x0 RTE_RL_FLOAT32_IEEE 0 NO_COMPU_METHOD -3.402823466e+38 3.402823466e+38 MATRIX_DIM 26 1 1 SYMBOL_LINK "Rte_CalprmRom_CDD_MotAg0Meas_DEFAULT_RTE_CDATA_GROUP.MotAg0CoeffTblDft" 0 DISPLAY_IDENTIFIER CDD_MotAg0Meas.CalibrationParameters.MotAg0CoeffTblDft /end CHARACTERISTIC
/begin CHARACTERISTIC CDD_MotAg1Meas.MotAg1CoeffTblDft "MICROSAR RTE" VAL_BLK 0x0 RTE_RL_FLOAT32_IEEE 0 NO_COMPU_METHOD -3.402823466e+38 3.402823466e+38 MATRIX_DIM 26 1 1 SYMBOL_LINK "Rte_CalprmRom_CDD_MotAg1Meas_DEFAULT_RTE_CDATA_GROUP.MotAg1CoeffTblDft" 0 DISPLAY_IDENTIFIER CDD_MotAg1Meas.CalibrationParameters.MotAg1CoeffTblDft /end CHARACTERISTIC
/begin CHARACTERISTIC CDD_MotAg1Meas.MotAg1MeasMotAgOffs.Val "MICROSAR RTE" VALUE 0x0 RTE_RL_UWORD 0 NO_COMPU_METHOD 0 65535 SYMBOL_LINK "Rte_CalprmRom_CalRegn01Inin00_DEFAULT_RTE_CALPRM_GROUP.MotAg1MeasMotAgOffs_Val" 0 DISPLAY_IDENTIFIER CDD_MotAg1Meas.CalibrationPorts.MotAg1MeasMotAgOffs.Val /end CHARACTERISTIC
/begin CHARACTERISTIC CDD_MotAgCmp.MotAgCmpMotAgBackEmfDft "MICROSAR RTE" VALUE 0x0 RTE_RL_UWORD 0 RTE_CM_Ag9 0 0 SYMBOL_LINK "Rte_CalprmRom_CDD_MotAgCmp_DEFAULT_RTE_CDATA_GROUP.MotAgCmpMotAgBackEmfDft" 0 DISPLAY_IDENTIFIER CDD_MotAgCmp.CalibrationParameters.MotAgCmpMotAgBackEmfDft /end CHARACTERISTIC
/begin CHARACTERISTIC CDD_MotAgCmp.SysGlbPrmMotPoleCnt.Val "MICROSAR RTE" VALUE 0x0 RTE_RL_UBYTE 0 NO_COMPU_METHOD 2 12 SYMBOL_LINK "Rte_CalprmRom_CalRegn01Inin00_DEFAULT_RTE_CALPRM_GROUP.SysGlbPrmMotPoleCnt_Val" 0 DISPLAY_IDENTIFIER CDD_MotAgCmp.CalibrationPorts.SysGlbPrmMotPoleCnt.Val /end CHARACTERISTIC
/begin MEASUREMENT CDD_CurrMeas.MotCurrEolOffsProcFlg "MICROSAR RTE" UBYTE RTE_CM_BOOLEAN 0 0 0 255 ECU_ADDRESS 0 SYMBOL_LINK "Rte_CDD_CurrMeas_MotCurrEolOffsProcFlg" 0 DISPLAY_IDENTIFIER CDD_CurrMeas.PerInstanceMemories.MotCurrEolOffsProcFlg /end MEASUREMENT
/begin MEASUREMENT CDD_CurrMeas.MotCurrOffsDeltaA "MICROSAR RTE" FLOAT32_IEEE NO_COMPU_METHOD 0 0 -3.402823466e+38 3.402823466e+38 ECU_ADDRESS 0 SYMBOL_LINK "Rte_CDD_CurrMeas_MotCurrOffsDeltaA" 0 DISPLAY_IDENTIFIER CDD_CurrMeas.PerInstanceMemories.MotCurrOffsDeltaA /end MEASUREMENT
/begin MEASUREMENT CDD_CurrMeas.MotCurrOffsDeltaB "MICROSAR RTE" FLOAT32_IEEE NO_COMPU_METHOD 0 0 -3.402823466e+38 3.402823466e+38 ECU_ADDRESS 0 SYMBOL_LINK "Rte_CDD_CurrMeas_MotCurrOffsDeltaB" 0 DISPLAY_IDENTIFIER CDD_CurrMeas.PerInstanceMemories.MotCurrOffsDeltaB /end MEASUREMENT
/begin MEASUREMENT CDD_CurrMeas.MotCurrOffsDeltaC "MICROSAR RTE" FLOAT32_IEEE NO_COMPU_METHOD 0 0 -3.402823466e+38 3.402823466e+38 ECU_ADDRESS 0 SYMBOL_LINK "Rte_CDD_CurrMeas_MotCurrOffsDeltaC" 0 DISPLAY_IDENTIFIER CDD_CurrMeas.PerInstanceMemories.MotCurrOffsDeltaC /end MEASUREMENT
/begin MEASUREMENT CDD_CurrMeas.MotCurrOffsDeltaD "MICROSAR RTE" FLOAT32_IEEE NO_COMPU_METHOD 0 0 -3.402823466e+38 3.402823466e+38 ECU_ADDRESS 0 SYMBOL_LINK "Rte_CDD_CurrMeas_MotCurrOffsDeltaD" 0 DISPLAY_IDENTIFIER CDD_CurrMeas.PerInstanceMemories.MotCurrOffsDeltaD /end MEASUREMENT
/begin MEASUREMENT CDD_CurrMeas.MotCurrOffsDeltaE "MICROSAR RTE" FLOAT32_IEEE NO_COMPU_METHOD 0 0 -3.402823466e+38 3.402823466e+38 ECU_ADDRESS 0 SYMBOL_LINK "Rte_CDD_CurrMeas_MotCurrOffsDeltaE" 0 DISPLAY_IDENTIFIER CDD_CurrMeas.PerInstanceMemories.MotCurrOffsDeltaE /end MEASUREMENT
/begin MEASUREMENT CDD_CurrMeas.MotCurrOffsDeltaF "MICROSAR RTE" FLOAT32_IEEE NO_COMPU_METHOD 0 0 -3.402823466e+38 3.402823466e+38 ECU_ADDRESS 0 SYMBOL_LINK "Rte_CDD_CurrMeas_MotCurrOffsDeltaF" 0 DISPLAY_IDENTIFIER CDD_CurrMeas.PerInstanceMemories.MotCurrOffsDeltaF /end MEASUREMENT
/begin MEASUREMENT CDD_CurrMeas.MotCurrOffsHiAvrgA "MICROSAR RTE" FLOAT32_IEEE NO_COMPU_METHOD 0 0 -3.402823466e+38 3.402823466e+38 ECU_ADDRESS 0 SYMBOL_LINK "Rte_CDD_CurrMeas_MotCurrOffsHiAvrgA" 0 DISPLAY_IDENTIFIER CDD_CurrMeas.PerInstanceMemories.MotCurrOffsHiAvrgA /end MEASUREMENT
/begin MEASUREMENT CDD_CurrMeas.MotCurrOffsHiAvrgB "MICROSAR RTE" FLOAT32_IEEE NO_COMPU_METHOD 0 0 -3.402823466e+38 3.402823466e+38 ECU_ADDRESS 0 SYMBOL_LINK "Rte_CDD_CurrMeas_MotCurrOffsHiAvrgB" 0 DISPLAY_IDENTIFIER CDD_CurrMeas.PerInstanceMemories.MotCurrOffsHiAvrgB /end MEASUREMENT
/begin MEASUREMENT CDD_CurrMeas.MotCurrOffsHiAvrgC "MICROSAR RTE" FLOAT32_IEEE NO_COMPU_METHOD 0 0 -3.402823466e+38 3.402823466e+38 ECU_ADDRESS 0 SYMBOL_LINK "Rte_CDD_CurrMeas_MotCurrOffsHiAvrgC" 0 DISPLAY_IDENTIFIER CDD_CurrMeas.PerInstanceMemories.MotCurrOffsHiAvrgC /end MEASUREMENT
/begin MEASUREMENT CDD_CurrMeas.MotCurrOffsHiAvrgD "MICROSAR RTE" FLOAT32_IEEE NO_COMPU_METHOD 0 0 -3.402823466e+38 3.402823466e+38 ECU_ADDRESS 0 SYMBOL_LINK "Rte_CDD_CurrMeas_MotCurrOffsHiAvrgD" 0 DISPLAY_IDENTIFIER CDD_CurrMeas.PerInstanceMemories.MotCurrOffsHiAvrgD /end MEASUREMENT
/begin MEASUREMENT CDD_CurrMeas.MotCurrOffsHiAvrgE "MICROSAR RTE" FLOAT32_IEEE NO_COMPU_METHOD 0 0 -3.402823466e+38 3.402823466e+38 ECU_ADDRESS 0 SYMBOL_LINK "Rte_CDD_CurrMeas_MotCurrOffsHiAvrgE" 0 DISPLAY_IDENTIFIER CDD_CurrMeas.PerInstanceMemories.MotCurrOffsHiAvrgE /end MEASUREMENT
/begin MEASUREMENT CDD_CurrMeas.MotCurrOffsHiAvrgF "MICROSAR RTE" FLOAT32_IEEE NO_COMPU_METHOD 0 0 -3.402823466e+38 3.402823466e+38 ECU_ADDRESS 0 SYMBOL_LINK "Rte_CDD_CurrMeas_MotCurrOffsHiAvrgF" 0 DISPLAY_IDENTIFIER CDD_CurrMeas.PerInstanceMemories.MotCurrOffsHiAvrgF /end MEASUREMENT
/begin MEASUREMENT CDD_CurrMeas.MotCurrOffsLoAvrgA "MICROSAR RTE" FLOAT32_IEEE NO_COMPU_METHOD 0 0 -3.402823466e+38 3.402823466e+38 ECU_ADDRESS 0 SYMBOL_LINK "Rte_CDD_CurrMeas_MotCurrOffsLoAvrgA" 0 DISPLAY_IDENTIFIER CDD_CurrMeas.PerInstanceMemories.MotCurrOffsLoAvrgA /end MEASUREMENT
/begin MEASUREMENT CDD_CurrMeas.MotCurrOffsLoAvrgB "MICROSAR RTE" FLOAT32_IEEE NO_COMPU_METHOD 0 0 -3.402823466e+38 3.402823466e+38 ECU_ADDRESS 0 SYMBOL_LINK "Rte_CDD_CurrMeas_MotCurrOffsLoAvrgB" 0 DISPLAY_IDENTIFIER CDD_CurrMeas.PerInstanceMemories.MotCurrOffsLoAvrgB /end MEASUREMENT
/begin MEASUREMENT CDD_CurrMeas.MotCurrOffsLoAvrgC "MICROSAR RTE" FLOAT32_IEEE NO_COMPU_METHOD 0 0 -3.402823466e+38 3.402823466e+38 ECU_ADDRESS 0 SYMBOL_LINK "Rte_CDD_CurrMeas_MotCurrOffsLoAvrgC" 0 DISPLAY_IDENTIFIER CDD_CurrMeas.PerInstanceMemories.MotCurrOffsLoAvrgC /end MEASUREMENT
/begin MEASUREMENT CDD_CurrMeas.MotCurrOffsLoAvrgD "MICROSAR RTE" FLOAT32_IEEE NO_COMPU_METHOD 0 0 -3.402823466e+38 3.402823466e+38 ECU_ADDRESS 0 SYMBOL_LINK "Rte_CDD_CurrMeas_MotCurrOffsLoAvrgD" 0 DISPLAY_IDENTIFIER CDD_CurrMeas.PerInstanceMemories.MotCurrOffsLoAvrgD /end MEASUREMENT
/begin MEASUREMENT CDD_CurrMeas.MotCurrOffsLoAvrgE "MICROSAR RTE" FLOAT32_IEEE NO_COMPU_METHOD 0 0 -3.402823466e+38 3.402823466e+38 ECU_ADDRESS 0 SYMBOL_LINK "Rte_CDD_CurrMeas_MotCurrOffsLoAvrgE" 0 DISPLAY_IDENTIFIER CDD_CurrMeas.PerInstanceMemories.MotCurrOffsLoAvrgE /end MEASUREMENT
/begin MEASUREMENT CDD_CurrMeas.MotCurrOffsLoAvrgF "MICROSAR RTE" FLOAT32_IEEE NO_COMPU_METHOD 0 0 -3.402823466e+38 3.402823466e+38 ECU_ADDRESS 0 SYMBOL_LINK "Rte_CDD_CurrMeas_MotCurrOffsLoAvrgF" 0 DISPLAY_IDENTIFIER CDD_CurrMeas.PerInstanceMemories.MotCurrOffsLoAvrgF /end MEASUREMENT
/begin MEASUREMENT CDD_CurrMeas.MotCurrOffsZeroAvrgA "MICROSAR RTE" FLOAT32_IEEE NO_COMPU_METHOD 0 0 -3.402823466e+38 3.402823466e+38 ECU_ADDRESS 0 SYMBOL_LINK "Rte_CDD_CurrMeas_MotCurrOffsZeroAvrgA" 0 DISPLAY_IDENTIFIER CDD_CurrMeas.PerInstanceMemories.MotCurrOffsZeroAvrgA /end MEASUREMENT
/begin MEASUREMENT CDD_CurrMeas.MotCurrOffsZeroAvrgB "MICROSAR RTE" FLOAT32_IEEE NO_COMPU_METHOD 0 0 -3.402823466e+38 3.402823466e+38 ECU_ADDRESS 0 SYMBOL_LINK "Rte_CDD_CurrMeas_MotCurrOffsZeroAvrgB" 0 DISPLAY_IDENTIFIER CDD_CurrMeas.PerInstanceMemories.MotCurrOffsZeroAvrgB /end MEASUREMENT
/begin MEASUREMENT CDD_CurrMeas.MotCurrOffsZeroAvrgC "MICROSAR RTE" FLOAT32_IEEE NO_COMPU_METHOD 0 0 -3.402823466e+38 3.402823466e+38 ECU_ADDRESS 0 SYMBOL_LINK "Rte_CDD_CurrMeas_MotCurrOffsZeroAvrgC" 0 DISPLAY_IDENTIFIER CDD_CurrMeas.PerInstanceMemories.MotCurrOffsZeroAvrgC /end MEASUREMENT
/begin MEASUREMENT CDD_CurrMeas.MotCurrOffsZeroAvrgD "MICROSAR RTE" FLOAT32_IEEE NO_COMPU_METHOD 0 0 -3.402823466e+38 3.402823466e+38 ECU_ADDRESS 0 SYMBOL_LINK "Rte_CDD_CurrMeas_MotCurrOffsZeroAvrgD" 0 DISPLAY_IDENTIFIER CDD_CurrMeas.PerInstanceMemories.MotCurrOffsZeroAvrgD /end MEASUREMENT
/begin MEASUREMENT CDD_CurrMeas.MotCurrOffsZeroAvrgE "MICROSAR RTE" FLOAT32_IEEE NO_COMPU_METHOD 0 0 -3.402823466e+38 3.402823466e+38 ECU_ADDRESS 0 SYMBOL_LINK "Rte_CDD_CurrMeas_MotCurrOffsZeroAvrgE" 0 DISPLAY_IDENTIFIER CDD_CurrMeas.PerInstanceMemories.MotCurrOffsZeroAvrgE /end MEASUREMENT
/begin MEASUREMENT CDD_CurrMeas.MotCurrOffsZeroAvrgF "MICROSAR RTE" FLOAT32_IEEE NO_COMPU_METHOD 0 0 -3.402823466e+38 3.402823466e+38 ECU_ADDRESS 0 SYMBOL_LINK "Rte_CDD_CurrMeas_MotCurrOffsZeroAvrgF" 0 DISPLAY_IDENTIFIER CDD_CurrMeas.PerInstanceMemories.MotCurrOffsZeroAvrgF /end MEASUREMENT
/begin MEASUREMENT CDD_CurrMeas.MotCurrQlfr1.Val "MICROSAR RTE" UBYTE RTE_CM_ENUM_SigQlfr1 0 0 0 255 ECU_ADDRESS 0 SYMBOL_LINK "Rte_CDD_CurrMeas_MotCurrQlfr1_Val" 0 DISPLAY_IDENTIFIER CDD_CurrMeas.SenderPorts.MotCurrQlfr1.Val /end MEASUREMENT
/begin MEASUREMENT CDD_CurrMeas.MotCurrQlfr2.Val "MICROSAR RTE" UBYTE RTE_CM_ENUM_SigQlfr1 0 0 0 255 ECU_ADDRESS 0 SYMBOL_LINK "Rte_CDD_CurrMeas_MotCurrQlfr2_Val" 0 DISPLAY_IDENTIFIER CDD_CurrMeas.SenderPorts.MotCurrQlfr2.Val /end MEASUREMENT
/begin MEASUREMENT CDD_CurrMeas.MotCurrRollgCnt1Prev "MICROSAR RTE" UBYTE NO_COMPU_METHOD 0 0 0 255 ECU_ADDRESS 0 SYMBOL_LINK "Rte_CDD_CurrMeas_MotCurrRollgCnt1Prev" 0 DISPLAY_IDENTIFIER CDD_CurrMeas.PerInstanceMemories.MotCurrRollgCnt1Prev /end MEASUREMENT
/begin MEASUREMENT CDD_CurrMeas.MotCurrRollgCnt2Prev "MICROSAR RTE" UBYTE NO_COMPU_METHOD 0 0 0 255 ECU_ADDRESS 0 SYMBOL_LINK "Rte_CDD_CurrMeas_MotCurrRollgCnt2Prev" 0 DISPLAY_IDENTIFIER CDD_CurrMeas.PerInstanceMemories.MotCurrRollgCnt2Prev /end MEASUREMENT
/begin MEASUREMENT CDD_CurrMeas.MotCurrSumAPrev "MICROSAR RTE" FLOAT32_IEEE NO_COMPU_METHOD 0 0 -3.402823466e+38 3.402823466e+38 ECU_ADDRESS 0 SYMBOL_LINK "Rte_CDD_CurrMeas_MotCurrSumAPrev" 0 DISPLAY_IDENTIFIER CDD_CurrMeas.PerInstanceMemories.MotCurrSumAPrev /end MEASUREMENT
/begin MEASUREMENT CDD_CurrMeas.MotCurrSumBPrev "MICROSAR RTE" FLOAT32_IEEE NO_COMPU_METHOD 0 0 -3.402823466e+38 3.402823466e+38 ECU_ADDRESS 0 SYMBOL_LINK "Rte_CDD_CurrMeas_MotCurrSumBPrev" 0 DISPLAY_IDENTIFIER CDD_CurrMeas.PerInstanceMemories.MotCurrSumBPrev /end MEASUREMENT
/begin MEASUREMENT CDD_CurrMeas.MotCurrSumCPrev "MICROSAR RTE" FLOAT32_IEEE NO_COMPU_METHOD 0 0 -3.402823466e+38 3.402823466e+38 ECU_ADDRESS 0 SYMBOL_LINK "Rte_CDD_CurrMeas_MotCurrSumCPrev" 0 DISPLAY_IDENTIFIER CDD_CurrMeas.PerInstanceMemories.MotCurrSumCPrev /end MEASUREMENT
/begin MEASUREMENT CDD_CurrMeas.MotCurrSumDPrev "MICROSAR RTE" FLOAT32_IEEE NO_COMPU_METHOD 0 0 -3.402823466e+38 3.402823466e+38 ECU_ADDRESS 0 SYMBOL_LINK "Rte_CDD_CurrMeas_MotCurrSumDPrev" 0 DISPLAY_IDENTIFIER CDD_CurrMeas.PerInstanceMemories.MotCurrSumDPrev /end MEASUREMENT
/begin MEASUREMENT CDD_CurrMeas.MotCurrSumEPrev "MICROSAR RTE" FLOAT32_IEEE NO_COMPU_METHOD 0 0 -3.402823466e+38 3.402823466e+38 ECU_ADDRESS 0 SYMBOL_LINK "Rte_CDD_CurrMeas_MotCurrSumEPrev" 0 DISPLAY_IDENTIFIER CDD_CurrMeas.PerInstanceMemories.MotCurrSumEPrev /end MEASUREMENT
/begin MEASUREMENT CDD_CurrMeas.MotCurrSumFPrev "MICROSAR RTE" FLOAT32_IEEE NO_COMPU_METHOD 0 0 -3.402823466e+38 3.402823466e+38 ECU_ADDRESS 0 SYMBOL_LINK "Rte_CDD_CurrMeas_MotCurrSumFPrev" 0 DISPLAY_IDENTIFIER CDD_CurrMeas.PerInstanceMemories.MotCurrSumFPrev /end MEASUREMENT
/begin MEASUREMENT CDD_CurrMeas.MotVelMrf.Val "MICROSAR RTE" FLOAT32_IEEE NO_COMPU_METHOD 0 0 -3.402823466e+38 3.402823466e+38 ECU_ADDRESS 0 SYMBOL_LINK "Rte_CDD_MotVel_MotVelMrf_Val" 0 DISPLAY_IDENTIFIER CDD_CurrMeas.ReceiverPorts.MotVelMrf.Val /end MEASUREMENT
/begin MEASUREMENT CDD_CurrMeas.Ntc5DErrCnt.Val "MICROSAR RTE" UWORD NO_COMPU_METHOD 0 0 0 65535 ECU_ADDRESS 0 SYMBOL_LINK "Rte_CDD_MotCtrlMgr_Ntc5DErrCnt_Val" 0 DISPLAY_IDENTIFIER CDD_CurrMeas.ReceiverPorts.Ntc5DErrCnt.Val /end MEASUREMENT
/begin MEASUREMENT CDD_CurrMeas.Ntc5DErrCnt2MilliSecPrev "MICROSAR RTE" UWORD NO_COMPU_METHOD 0 0 0 65535 ECU_ADDRESS 0 SYMBOL_LINK "Rte_CDD_CurrMeas_Ntc5DErrCnt2MilliSecPrev" 0 DISPLAY_IDENTIFIER CDD_CurrMeas.PerInstanceMemories.Ntc5DErrCnt2MilliSecPrev /end MEASUREMENT
/begin MEASUREMENT CDD_CurrMeas.Ntc6DErrCnt.Val "MICROSAR RTE" UWORD NO_COMPU_METHOD 0 0 0 65535 ECU_ADDRESS 0 SYMBOL_LINK "Rte_CDD_MotCtrlMgr_Ntc6DErrCnt_Val" 0 DISPLAY_IDENTIFIER CDD_CurrMeas.ReceiverPorts.Ntc6DErrCnt.Val /end MEASUREMENT
/begin MEASUREMENT CDD_CurrMeas.Ntc6DErrCnt2MilliSecPrev "MICROSAR RTE" UWORD NO_COMPU_METHOD 0 0 0 65535 ECU_ADDRESS 0 SYMBOL_LINK "Rte_CDD_CurrMeas_Ntc6DErrCnt2MilliSecPrev" 0 DISPLAY_IDENTIFIER CDD_CurrMeas.PerInstanceMemories.Ntc6DErrCnt2MilliSecPrev /end MEASUREMENT
/begin MEASUREMENT CDD_CurrMeas.OffsEolAvrgCntrPrev "MICROSAR RTE" UWORD NO_COMPU_METHOD 0 0 0 65535 ECU_ADDRESS 0 SYMBOL_LINK "Rte_CDD_CurrMeas_OffsEolAvrgCntrPrev" 0 DISPLAY_IDENTIFIER CDD_CurrMeas.PerInstanceMemories.OffsEolAvrgCntrPrev /end MEASUREMENT
/begin MEASUREMENT CDD_CurrMeas.PhaOnTiErrCntPrev "MICROSAR RTE" UWORD NO_COMPU_METHOD 0 0 0 65535 ECU_ADDRESS 0 SYMBOL_LINK "Rte_CDD_CurrMeas_PhaOnTiErrCntPrev" 0 DISPLAY_IDENTIFIER CDD_CurrMeas.PerInstanceMemories.PhaOnTiErrCntPrev /end MEASUREMENT
/begin MEASUREMENT CDD_CurrMeas.StrtUpSt.Val "MICROSAR RTE" UBYTE NO_COMPU_METHOD 0 0 0 255 ECU_ADDRESS 0 SYMBOL_LINK "Rte_PwrUpSeq_StrtUpSt_Val" 0 DISPLAY_IDENTIFIER CDD_CurrMeas.ReceiverPorts.StrtUpSt.Val /end MEASUREMENT
/begin MEASUREMENT CDD_CurrMeas.SysSt.Val "MICROSAR RTE" UBYTE RTE_CM_ENUM_SysSt1 0 0 0 255 ECU_ADDRESS 0 SYMBOL_LINK "Rte_SysStMod_SysSt_Val" 0 DISPLAY_IDENTIFIER CDD_CurrMeas.ReceiverPorts.SysSt.Val /end MEASUREMENT
/begin MEASUREMENT CDD_CurrMeas.TempMotCurrAdcVlySum1Prev "MICROSAR RTE" FLOAT32_IEEE NO_COMPU_METHOD 0 0 -3.402823466e+38 3.402823466e+38 ECU_ADDRESS 0 SYMBOL_LINK "Rte_CDD_CurrMeas_TempMotCurrAdcVlySum1Prev" 0 DISPLAY_IDENTIFIER CDD_CurrMeas.PerInstanceMemories.TempMotCurrAdcVlySum1Prev /end MEASUREMENT
/begin MEASUREMENT CDD_CurrMeas.TempMotCurrAdcVlySum2Prev "MICROSAR RTE" FLOAT32_IEEE NO_COMPU_METHOD 0 0 -3.402823466e+38 3.402823466e+38 ECU_ADDRESS 0 SYMBOL_LINK "Rte_CDD_CurrMeas_TempMotCurrAdcVlySum2Prev" 0 DISPLAY_IDENTIFIER CDD_CurrMeas.PerInstanceMemories.TempMotCurrAdcVlySum2Prev /end MEASUREMENT
/begin MEASUREMENT CDD_CurrMeas.VehSpd.Val "MICROSAR RTE" FLOAT32_IEEE NO_COMPU_METHOD 0 0 -3.402823466e+38 3.402823466e+38 ECU_ADDRESS 0 SYMBOL_LINK "Rte_VehSigCdng_VehSpd_Val" 0 DISPLAY_IDENTIFIER CDD_CurrMeas.ReceiverPorts.VehSpd.Val /end MEASUREMENT
/begin MEASUREMENT CDD_CurrMeas.VehSpdVld.Logl "MICROSAR RTE" UBYTE RTE_CM_BOOLEAN 0 0 0 255 ECU_ADDRESS 0 SYMBOL_LINK "Rte_VehSigCdng_VehSpdVld_Logl" 0 DISPLAY_IDENTIFIER CDD_CurrMeas.ReceiverPorts.VehSpdVld.Logl /end MEASUREMENT
/begin MEASUREMENT CDD_CurrMeas.WrmIninTestCmplPrev "MICROSAR RTE" UBYTE RTE_CM_BOOLEAN 0 0 0 255 ECU_ADDRESS 0 SYMBOL_LINK "Rte_CDD_CurrMeas_WrmIninTestCmplPrev" 0 DISPLAY_IDENTIFIER CDD_CurrMeas.PerInstanceMemories.WrmIninTestCmplPrev /end MEASUREMENT
/begin MEASUREMENT CDD_CurrMeasArbn.CurrMeasArbnSens0RollgCntPrev "MICROSAR RTE" UBYTE NO_COMPU_METHOD 0 0 0 255 ECU_ADDRESS 0 SYMBOL_LINK "Rte_CDD_CurrMeasArbn_CurrMeasArbnSens0RollgCntPrev" 0 DISPLAY_IDENTIFIER CDD_CurrMeasArbn.PerInstanceMemories.CurrMeasArbnSens0RollgCntPrev /end MEASUREMENT
/begin MEASUREMENT CDD_CurrMeasArbn.CurrMeasArbnSens0StallCntPrev "MICROSAR RTE" UBYTE NO_COMPU_METHOD 0 0 0 255 ECU_ADDRESS 0 SYMBOL_LINK "Rte_CDD_CurrMeasArbn_CurrMeasArbnSens0StallCntPrev" 0 DISPLAY_IDENTIFIER CDD_CurrMeasArbn.PerInstanceMemories.CurrMeasArbnSens0StallCntPrev /end MEASUREMENT
/begin MEASUREMENT CDD_CurrMeasArbn.CurrMeasArbnSens1RollgCntPrev "MICROSAR RTE" UBYTE NO_COMPU_METHOD 0 0 0 255 ECU_ADDRESS 0 SYMBOL_LINK "Rte_CDD_CurrMeasArbn_CurrMeasArbnSens1RollgCntPrev" 0 DISPLAY_IDENTIFIER CDD_CurrMeasArbn.PerInstanceMemories.CurrMeasArbnSens1RollgCntPrev /end MEASUREMENT
/begin MEASUREMENT CDD_CurrMeasArbn.CurrMeasArbnSens1StallCntPrev "MICROSAR RTE" UBYTE NO_COMPU_METHOD 0 0 0 255 ECU_ADDRESS 0 SYMBOL_LINK "Rte_CDD_CurrMeasArbn_CurrMeasArbnSens1StallCntPrev" 0 DISPLAY_IDENTIFIER CDD_CurrMeasArbn.PerInstanceMemories.CurrMeasArbnSens1StallCntPrev /end MEASUREMENT
/begin MEASUREMENT CDD_DmaCfgAndUse.DmaCfgAndUse2MilliSecAdcStrtTi "MICROSAR RTE" ULONG NO_COMPU_METHOD 0 0 0 4294967295 ECU_ADDRESS 0 SYMBOL_LINK "Rte_CDD_DmaCfgAndUse_DmaCfgAndUse2MilliSecAdcStrtTi" 0 DISPLAY_IDENTIFIER CDD_DmaCfgAndUse.PerInstanceMemories.DmaCfgAndUse2MilliSecAdcStrtTi /end MEASUREMENT
/begin MEASUREMENT CDD_DmaCfgAndUse.d2MilliSecAdcActDmaTrfTi "MICROSAR RTE" ULONG NO_COMPU_METHOD 0 0 0 4294967295 ECU_ADDRESS 0 SYMBOL_LINK "Rte_CDD_DmaCfgAndUse_d2MilliSecAdcActDmaTrfTi" 0 DISPLAY_IDENTIFIER CDD_DmaCfgAndUse.PerInstanceMemories.d2MilliSecAdcActDmaTrfTi /end MEASUREMENT
/begin MEASUREMENT CDD_DmaCfgAndUse.d2MilliSecAdcMaxDmaTrfTi "MICROSAR RTE" ULONG NO_COMPU_METHOD 0 0 0 4294967295 ECU_ADDRESS 0 SYMBOL_LINK "Rte_CDD_DmaCfgAndUse_d2MilliSecAdcMaxDmaTrfTi" 0 DISPLAY_IDENTIFIER CDD_DmaCfgAndUse.PerInstanceMemories.d2MilliSecAdcMaxDmaTrfTi /end MEASUREMENT
/begin MEASUREMENT CDD_FlsMem.CodFlsCrcChkCmpl.Logl "MICROSAR RTE" UBYTE RTE_CM_BOOLEAN 0 0 0 255 ECU_ADDRESS 0 SYMBOL_LINK "Rte_CDD_FlsMem_CodFlsCrcChkCmpl_Logl" 0 DISPLAY_IDENTIFIER CDD_FlsMem.SenderPorts.CodFlsCrcChkCmpl.Logl /end MEASUREMENT
/begin MEASUREMENT CDD_FlsMem.CodFlsCrcChkStrtTi "MICROSAR RTE" ULONG NO_COMPU_METHOD 0 0 0 4294967295 ECU_ADDRESS 0 SYMBOL_LINK "Rte_CDD_FlsMem_CodFlsCrcChkStrtTi" 0 DISPLAY_IDENTIFIER CDD_FlsMem.PerInstanceMemories.CodFlsCrcChkStrtTi /end MEASUREMENT
/begin MEASUREMENT CDD_FlsMem.CodFlsSngBitErr "MICROSAR RTE" UBYTE RTE_CM_BOOLEAN 0 0 0 255 ECU_ADDRESS 0 SYMBOL_LINK "Rte_CDD_FlsMem_CodFlsSngBitErr" 0 DISPLAY_IDENTIFIER CDD_FlsMem.PerInstanceMemories.CodFlsSngBitErr /end MEASUREMENT
/begin MEASUREMENT CDD_FlsMem.CrcChkCmpl "MICROSAR RTE" UBYTE RTE_CM_BOOLEAN 0 0 0 255 ECU_ADDRESS 0 SYMBOL_LINK "Rte_CDD_FlsMem_CrcChkCmpl" 0 DISPLAY_IDENTIFIER CDD_FlsMem.PerInstanceMemories.CrcChkCmpl /end MEASUREMENT
/begin MEASUREMENT CDD_FlsMem.CrcHwIdxKey "MICROSAR RTE" UWORD NO_COMPU_METHOD 0 0 0 65535 ECU_ADDRESS 0 SYMBOL_LINK "Rte_CDD_FlsMem_CrcHwIdxKey" 0 DISPLAY_IDENTIFIER CDD_FlsMem.PerInstanceMemories.CrcHwIdxKey /end MEASUREMENT
/begin MEASUREMENT CDD_FlsMem.PwrOnRstCrcChkCmpl "MICROSAR RTE" UBYTE RTE_CM_BOOLEAN 0 0 0 255 ECU_ADDRESS 0 SYMBOL_LINK "Rte_CDD_FlsMem_PwrOnRstCrcChkCmpl" 0 DISPLAY_IDENTIFIER CDD_FlsMem.PerInstanceMemories.PwrOnRstCrcChkCmpl /end MEASUREMENT
/begin MEASUREMENT CDD_GmG2kcaMcuCfg.Adc0Faild.Logl "MICROSAR RTE" UBYTE RTE_CM_BOOLEAN 0 0 0 255 ECU_ADDRESS 0 SYMBOL_LINK "Rte_CDD_AdcDiagc_Adc0Faild_Logl" 0 DISPLAY_IDENTIFIER CDD_GmG2kcaMcuCfg.ReceiverPorts.Adc0Faild.Logl /end MEASUREMENT
/begin MEASUREMENT CDD_GmG2kcaMcuCfg.Adc1Faild.Logl "MICROSAR RTE" UBYTE RTE_CM_BOOLEAN 0 0 0 255 ECU_ADDRESS 0 SYMBOL_LINK "Rte_CDD_AdcDiagc_Adc1Faild_Logl" 0 DISPLAY_IDENTIFIER CDD_GmG2kcaMcuCfg.ReceiverPorts.Adc1Faild.Logl /end MEASUREMENT
/begin MEASUREMENT CDD_GmG2kcaMcuCfg.Adc1ScanGroup2Ref0.Val "MICROSAR RTE" FLOAT32_IEEE NO_COMPU_METHOD 0 0 -3.402823466e+38 3.402823466e+38 ECU_ADDRESS 0 SYMBOL_LINK "Rte_CDD_GmG2kcaMcuCfg_Adc1ScanGroup2Ref0_Val" 0 DISPLAY_IDENTIFIER CDD_GmG2kcaMcuCfg.SenderPorts.Adc1ScanGroup2Ref0.Val /end MEASUREMENT
/begin MEASUREMENT CDD_GmG2kcaMcuCfg.Adc1ScanGroup2Ref1.Val "MICROSAR RTE" FLOAT32_IEEE NO_COMPU_METHOD 0 0 -3.402823466e+38 3.402823466e+38 ECU_ADDRESS 0 SYMBOL_LINK "Rte_CDD_GmG2kcaMcuCfg_Adc1ScanGroup2Ref1_Val" 0 DISPLAY_IDENTIFIER CDD_GmG2kcaMcuCfg.SenderPorts.Adc1ScanGroup2Ref1.Val /end MEASUREMENT
/begin MEASUREMENT CDD_GmG2kcaMcuCfg.Adc1ScanGroup3Ref0.Val "MICROSAR RTE" FLOAT32_IEEE NO_COMPU_METHOD 0 0 -3.402823466e+38 3.402823466e+38 ECU_ADDRESS 0 SYMBOL_LINK "Rte_CDD_GmG2kcaMcuCfg_Adc1ScanGroup3Ref0_Val" 0 DISPLAY_IDENTIFIER CDD_GmG2kcaMcuCfg.SenderPorts.Adc1ScanGroup3Ref0.Val /end MEASUREMENT
/begin MEASUREMENT CDD_GmG2kcaMcuCfg.Adc1ScanGroup3Ref1.Val "MICROSAR RTE" FLOAT32_IEEE NO_COMPU_METHOD 0 0 -3.402823466e+38 3.402823466e+38 ECU_ADDRESS 0 SYMBOL_LINK "Rte_CDD_GmG2kcaMcuCfg_Adc1ScanGroup3Ref1_Val" 0 DISPLAY_IDENTIFIER CDD_GmG2kcaMcuCfg.SenderPorts.Adc1ScanGroup3Ref1.Val /end MEASUREMENT
/begin MEASUREMENT CDD_GmG2kcaMcuCfg.Adc1SelfDiag0.Val "MICROSAR RTE" FLOAT32_IEEE NO_COMPU_METHOD 0 0 0.0 5.0 ECU_ADDRESS 0 SYMBOL_LINK "Rte_CDD_GmG2kcaMcuCfg_Adc1SelfDiag0_Val" 0 DISPLAY_IDENTIFIER CDD_GmG2kcaMcuCfg.SenderPorts.Adc1SelfDiag0.Val /end MEASUREMENT
/begin MEASUREMENT CDD_GmG2kcaMcuCfg.Adc1SelfDiag2.Val "MICROSAR RTE" FLOAT32_IEEE NO_COMPU_METHOD 0 0 0.0 5.0 ECU_ADDRESS 0 SYMBOL_LINK "Rte_CDD_GmG2kcaMcuCfg_Adc1SelfDiag2_Val" 0 DISPLAY_IDENTIFIER CDD_GmG2kcaMcuCfg.SenderPorts.Adc1SelfDiag2.Val /end MEASUREMENT
/begin MEASUREMENT CDD_GmG2kcaMcuCfg.Adc1SelfDiag4.Val "MICROSAR RTE" FLOAT32_IEEE NO_COMPU_METHOD 0 0 0.0 5.0 ECU_ADDRESS 0 SYMBOL_LINK "Rte_CDD_GmG2kcaMcuCfg_Adc1SelfDiag4_Val" 0 DISPLAY_IDENTIFIER CDD_GmG2kcaMcuCfg.SenderPorts.Adc1SelfDiag4.Val /end MEASUREMENT
/begin MEASUREMENT CDD_GmG2kcaMcuCfg.BattVltg.Val "MICROSAR RTE" FLOAT32_IEEE NO_COMPU_METHOD 0 0 0.0 40.0 ECU_ADDRESS 0 SYMBOL_LINK "Rte_CDD_GmG2kcaMcuCfg_BattVltg_Val" 0 DISPLAY_IDENTIFIER CDD_GmG2kcaMcuCfg.SenderPorts.BattVltg.Val /end MEASUREMENT
/begin MEASUREMENT CDD_GmG2kcaMcuCfg.BattVltgAdcFaild.Logl "MICROSAR RTE" UBYTE RTE_CM_BOOLEAN 0 0 0 255 ECU_ADDRESS 0 SYMBOL_LINK "Rte_CDD_GmG2kcaMcuCfg_BattVltgAdcFaild_Logl" 0 DISPLAY_IDENTIFIER CDD_GmG2kcaMcuCfg.SenderPorts.BattVltgAdcFaild.Logl /end MEASUREMENT
/begin MEASUREMENT CDD_GmG2kcaMcuCfg.BattVltgSwd1.Val "MICROSAR RTE" FLOAT32_IEEE NO_COMPU_METHOD 0 0 0.0 40.0 ECU_ADDRESS 0 SYMBOL_LINK "Rte_CDD_GmG2kcaMcuCfg_BattVltgSwd1_Val" 0 DISPLAY_IDENTIFIER CDD_GmG2kcaMcuCfg.SenderPorts.BattVltgSwd1.Val /end MEASUREMENT
/begin MEASUREMENT CDD_GmG2kcaMcuCfg.BattVltgSwd1AdcFaild.Logl "MICROSAR RTE" UBYTE RTE_CM_BOOLEAN 0 0 0 255 ECU_ADDRESS 0 SYMBOL_LINK "Rte_CDD_GmG2kcaMcuCfg_BattVltgSwd1AdcFaild_Logl" 0 DISPLAY_IDENTIFIER CDD_GmG2kcaMcuCfg.SenderPorts.BattVltgSwd1AdcFaild.Logl /end MEASUREMENT
/begin MEASUREMENT CDD_GmG2kcaMcuCfg.BattVltgSwd2.Val "MICROSAR RTE" FLOAT32_IEEE NO_COMPU_METHOD 0 0 0.0 40.0 ECU_ADDRESS 0 SYMBOL_LINK "Rte_CDD_GmG2kcaMcuCfg_BattVltgSwd2_Val" 0 DISPLAY_IDENTIFIER CDD_GmG2kcaMcuCfg.SenderPorts.BattVltgSwd2.Val /end MEASUREMENT
/begin MEASUREMENT CDD_GmG2kcaMcuCfg.BattVltgSwd2AdcFaild.Logl "MICROSAR RTE" UBYTE RTE_CM_BOOLEAN 0 0 0 255 ECU_ADDRESS 0 SYMBOL_LINK "Rte_CDD_GmG2kcaMcuCfg_BattVltgSwd2AdcFaild_Logl" 0 DISPLAY_IDENTIFIER CDD_GmG2kcaMcuCfg.SenderPorts.BattVltgSwd2AdcFaild.Logl /end MEASUREMENT
/begin MEASUREMENT CDD_GmG2kcaMcuCfg.EcuT.Val "MICROSAR RTE" FLOAT32_IEEE NO_COMPU_METHOD 0 0 0.0 5.0 ECU_ADDRESS 0 SYMBOL_LINK "Rte_CDD_GmG2kcaMcuCfg_EcuT_Val" 0 DISPLAY_IDENTIFIER CDD_GmG2kcaMcuCfg.SenderPorts.EcuT.Val /end MEASUREMENT
/begin MEASUREMENT CDD_GmG2kcaMcuCfg.EcuTAdcFaild.Logl "MICROSAR RTE" UBYTE RTE_CM_BOOLEAN 0 0 0 255 ECU_ADDRESS 0 SYMBOL_LINK "Rte_CDD_GmG2kcaMcuCfg_EcuTAdcFaild_Logl" 0 DISPLAY_IDENTIFIER CDD_GmG2kcaMcuCfg.SenderPorts.EcuTAdcFaild.Logl /end MEASUREMENT
/begin MEASUREMENT CDD_GmG2kcaMcuCfg.MotAg2Cos.Val "MICROSAR RTE" FLOAT32_IEEE NO_COMPU_METHOD 0 0 0.0 5.0 ECU_ADDRESS 0 SYMBOL_LINK "Rte_CDD_GmG2kcaMcuCfg_MotAg2Cos_Val" 0 DISPLAY_IDENTIFIER CDD_GmG2kcaMcuCfg.SenderPorts.MotAg2Cos.Val /end MEASUREMENT
/begin MEASUREMENT CDD_GmG2kcaMcuCfg.MotAg2CosAdcFaild.Logl "MICROSAR RTE" UBYTE RTE_CM_BOOLEAN 0 0 0 255 ECU_ADDRESS 0 SYMBOL_LINK "Rte_CDD_GmG2kcaMcuCfg_MotAg2CosAdcFaild_Logl" 0 DISPLAY_IDENTIFIER CDD_GmG2kcaMcuCfg.SenderPorts.MotAg2CosAdcFaild.Logl /end MEASUREMENT
/begin MEASUREMENT CDD_GmG2kcaMcuCfg.MotAg2Sin.Val "MICROSAR RTE" FLOAT32_IEEE NO_COMPU_METHOD 0 0 0.0 5.0 ECU_ADDRESS 0 SYMBOL_LINK "Rte_CDD_GmG2kcaMcuCfg_MotAg2Sin_Val" 0 DISPLAY_IDENTIFIER CDD_GmG2kcaMcuCfg.SenderPorts.MotAg2Sin.Val /end MEASUREMENT
/begin MEASUREMENT CDD_GmG2kcaMcuCfg.MotAg2SinAdcFaild.Logl "MICROSAR RTE" UBYTE RTE_CM_BOOLEAN 0 0 0 255 ECU_ADDRESS 0 SYMBOL_LINK "Rte_CDD_GmG2kcaMcuCfg_MotAg2SinAdcFaild_Logl" 0 DISPLAY_IDENTIFIER CDD_GmG2kcaMcuCfg.SenderPorts.MotAg2SinAdcFaild.Logl /end MEASUREMENT
/begin MEASUREMENT CDD_GmG2kcaMcuCfg.MotCurrAdcPeakAAdcFaild.Logl "MICROSAR RTE" UBYTE RTE_CM_BOOLEAN 0 0 0 255 ECU_ADDRESS 0 SYMBOL_LINK "Rte_CDD_GmG2kcaMcuCfg_MotCurrAdcPeakAAdcFaild_Logl" 0 DISPLAY_IDENTIFIER CDD_GmG2kcaMcuCfg.SenderPorts.MotCurrAdcPeakAAdcFaild.Logl /end MEASUREMENT
/begin MEASUREMENT CDD_GmG2kcaMcuCfg.MotCurrAdcPeakBAdcFaild.Logl "MICROSAR RTE" UBYTE RTE_CM_BOOLEAN 0 0 0 255 ECU_ADDRESS 0 SYMBOL_LINK "Rte_CDD_GmG2kcaMcuCfg_MotCurrAdcPeakBAdcFaild_Logl" 0 DISPLAY_IDENTIFIER CDD_GmG2kcaMcuCfg.SenderPorts.MotCurrAdcPeakBAdcFaild.Logl /end MEASUREMENT
/begin MEASUREMENT CDD_GmG2kcaMcuCfg.MotCurrAdcPeakCAdcFaild.Logl "MICROSAR RTE" UBYTE RTE_CM_BOOLEAN 0 0 0 255 ECU_ADDRESS 0 SYMBOL_LINK "Rte_CDD_GmG2kcaMcuCfg_MotCurrAdcPeakCAdcFaild_Logl" 0 DISPLAY_IDENTIFIER CDD_GmG2kcaMcuCfg.SenderPorts.MotCurrAdcPeakCAdcFaild.Logl /end MEASUREMENT
/begin MEASUREMENT CDD_GmG2kcaMcuCfg.MotCurrAdcPeakDAdcFaild.Logl "MICROSAR RTE" UBYTE RTE_CM_BOOLEAN 0 0 0 255 ECU_ADDRESS 0 SYMBOL_LINK "Rte_CDD_GmG2kcaMcuCfg_MotCurrAdcPeakDAdcFaild_Logl" 0 DISPLAY_IDENTIFIER CDD_GmG2kcaMcuCfg.SenderPorts.MotCurrAdcPeakDAdcFaild.Logl /end MEASUREMENT
/begin MEASUREMENT CDD_GmG2kcaMcuCfg.MotCurrAdcPeakEAdcFaild.Logl "MICROSAR RTE" UBYTE RTE_CM_BOOLEAN 0 0 0 255 ECU_ADDRESS 0 SYMBOL_LINK "Rte_CDD_GmG2kcaMcuCfg_MotCurrAdcPeakEAdcFaild_Logl" 0 DISPLAY_IDENTIFIER CDD_GmG2kcaMcuCfg.SenderPorts.MotCurrAdcPeakEAdcFaild.Logl /end MEASUREMENT
/begin MEASUREMENT CDD_GmG2kcaMcuCfg.MotCurrAdcPeakFAdcFaild.Logl "MICROSAR RTE" UBYTE RTE_CM_BOOLEAN 0 0 0 255 ECU_ADDRESS 0 SYMBOL_LINK "Rte_CDD_GmG2kcaMcuCfg_MotCurrAdcPeakFAdcFaild_Logl" 0 DISPLAY_IDENTIFIER CDD_GmG2kcaMcuCfg.SenderPorts.MotCurrAdcPeakFAdcFaild.Logl /end MEASUREMENT
/begin MEASUREMENT CDD_GmG2kcaMcuCfg.MotCurrAdcVlyAAdcFaild.Logl "MICROSAR RTE" UBYTE RTE_CM_BOOLEAN 0 0 0 255 ECU_ADDRESS 0 SYMBOL_LINK "Rte_CDD_GmG2kcaMcuCfg_MotCurrAdcVlyAAdcFaild_Logl" 0 DISPLAY_IDENTIFIER CDD_GmG2kcaMcuCfg.SenderPorts.MotCurrAdcVlyAAdcFaild.Logl /end MEASUREMENT
/begin MEASUREMENT CDD_GmG2kcaMcuCfg.MotCurrAdcVlyBAdcFaild.Logl "MICROSAR RTE" UBYTE RTE_CM_BOOLEAN 0 0 0 255 ECU_ADDRESS 0 SYMBOL_LINK "Rte_CDD_GmG2kcaMcuCfg_MotCurrAdcVlyBAdcFaild_Logl" 0 DISPLAY_IDENTIFIER CDD_GmG2kcaMcuCfg.SenderPorts.MotCurrAdcVlyBAdcFaild.Logl /end MEASUREMENT
/begin MEASUREMENT CDD_GmG2kcaMcuCfg.MotCurrAdcVlyCAdcFaild.Logl "MICROSAR RTE" UBYTE RTE_CM_BOOLEAN 0 0 0 255 ECU_ADDRESS 0 SYMBOL_LINK "Rte_CDD_GmG2kcaMcuCfg_MotCurrAdcVlyCAdcFaild_Logl" 0 DISPLAY_IDENTIFIER CDD_GmG2kcaMcuCfg.SenderPorts.MotCurrAdcVlyCAdcFaild.Logl /end MEASUREMENT
/begin MEASUREMENT CDD_GmG2kcaMcuCfg.MotCurrAdcVlyDAdcFaild.Logl "MICROSAR RTE" UBYTE RTE_CM_BOOLEAN 0 0 0 255 ECU_ADDRESS 0 SYMBOL_LINK "Rte_CDD_GmG2kcaMcuCfg_MotCurrAdcVlyDAdcFaild_Logl" 0 DISPLAY_IDENTIFIER CDD_GmG2kcaMcuCfg.SenderPorts.MotCurrAdcVlyDAdcFaild.Logl /end MEASUREMENT
/begin MEASUREMENT CDD_GmG2kcaMcuCfg.MotCurrAdcVlyEAdcFaild.Logl "MICROSAR RTE" UBYTE RTE_CM_BOOLEAN 0 0 0 255 ECU_ADDRESS 0 SYMBOL_LINK "Rte_CDD_GmG2kcaMcuCfg_MotCurrAdcVlyEAdcFaild_Logl" 0 DISPLAY_IDENTIFIER CDD_GmG2kcaMcuCfg.SenderPorts.MotCurrAdcVlyEAdcFaild.Logl /end MEASUREMENT
/begin MEASUREMENT CDD_GmG2kcaMcuCfg.MotCurrAdcVlyFAdcFaild.Logl "MICROSAR RTE" UBYTE RTE_CM_BOOLEAN 0 0 0 255 ECU_ADDRESS 0 SYMBOL_LINK "Rte_CDD_GmG2kcaMcuCfg_MotCurrAdcVlyFAdcFaild_Logl" 0 DISPLAY_IDENTIFIER CDD_GmG2kcaMcuCfg.SenderPorts.MotCurrAdcVlyFAdcFaild.Logl /end MEASUREMENT
/begin MEASUREMENT CDD_GmG2kcaMcuCfg.MotCurrSnsrOffs1AdcFaild.Logl "MICROSAR RTE" UBYTE RTE_CM_BOOLEAN 0 0 0 255 ECU_ADDRESS 0 SYMBOL_LINK "Rte_CDD_GmG2kcaMcuCfg_MotCurrSnsrOffs1AdcFaild_Logl" 0 DISPLAY_IDENTIFIER CDD_GmG2kcaMcuCfg.SenderPorts.MotCurrSnsrOffs1AdcFaild.Logl /end MEASUREMENT
/begin MEASUREMENT CDD_GmG2kcaMcuCfg.MotCurrSnsrOffs2AdcFaild.Logl "MICROSAR RTE" UBYTE RTE_CM_BOOLEAN 0 0 0 255 ECU_ADDRESS 0 SYMBOL_LINK "Rte_CDD_GmG2kcaMcuCfg_MotCurrSnsrOffs2AdcFaild_Logl" 0 DISPLAY_IDENTIFIER CDD_GmG2kcaMcuCfg.SenderPorts.MotCurrSnsrOffs2AdcFaild.Logl /end MEASUREMENT
/begin MEASUREMENT CDD_HwTq0Meas.HwTq0.Val "MICROSAR RTE" FLOAT32_IEEE NO_COMPU_METHOD 0 0 -3.402823466e+38 3.402823466e+38 ECU_ADDRESS 0 SYMBOL_LINK "Rte_CDD_HwTq0Meas_HwTq0_Val" 0 DISPLAY_IDENTIFIER CDD_HwTq0Meas.SenderPorts.HwTq0.Val /end MEASUREMENT
/begin MEASUREMENT CDD_HwTq0Meas.HwTq0ComStsErrCntr "MICROSAR RTE" UBYTE NO_COMPU_METHOD 0 0 0 255 ECU_ADDRESS 0 SYMBOL_LINK "Rte_CDD_HwTq0Meas_HwTq0ComStsErrCntr" 0 DISPLAY_IDENTIFIER CDD_HwTq0Meas.PerInstanceMemories.HwTq0ComStsErrCntr /end MEASUREMENT
/begin MEASUREMENT CDD_HwTq0Meas.HwTq0IntSnsrErrCntr "MICROSAR RTE" UBYTE NO_COMPU_METHOD 0 0 0 255 ECU_ADDRESS 0 SYMBOL_LINK "Rte_CDD_HwTq0Meas_HwTq0IntSnsrErrCntr" 0 DISPLAY_IDENTIFIER CDD_HwTq0Meas.PerInstanceMemories.HwTq0IntSnsrErrCntr /end MEASUREMENT
/begin MEASUREMENT CDD_HwTq0Meas.HwTq0MeasPrevHwTq0 "MICROSAR RTE" FLOAT32_IEEE NO_COMPU_METHOD 0 0 -3.402823466e+38 3.402823466e+38 ECU_ADDRESS 0 SYMBOL_LINK "Rte_CDD_HwTq0Meas_HwTq0MeasPrevHwTq0" 0 DISPLAY_IDENTIFIER CDD_HwTq0Meas.PerInstanceMemories.HwTq0MeasPrevHwTq0 /end MEASUREMENT
/begin MEASUREMENT CDD_HwTq0Meas.HwTq0MeasPrevRollgCntr "MICROSAR RTE" UBYTE NO_COMPU_METHOD 0 0 0 255 ECU_ADDRESS 0 SYMBOL_LINK "Rte_CDD_HwTq0Meas_HwTq0MeasPrevRollgCntr" 0 DISPLAY_IDENTIFIER CDD_HwTq0Meas.PerInstanceMemories.HwTq0MeasPrevRollgCntr /end MEASUREMENT
/begin MEASUREMENT CDD_HwTq0Meas.HwTq0MsgMissRxCnt "MICROSAR RTE" ULONG NO_COMPU_METHOD 0 0 0 4294967295 ECU_ADDRESS 0 SYMBOL_LINK "Rte_CDD_HwTq0Meas_HwTq0MsgMissRxCnt" 0 DISPLAY_IDENTIFIER CDD_HwTq0Meas.PerInstanceMemories.HwTq0MsgMissRxCnt /end MEASUREMENT
/begin MEASUREMENT CDD_HwTq0Meas.HwTq0Offs.OffsTrim "MICROSAR RTE" FLOAT32_IEEE NO_COMPU_METHOD 0 0 -3.402823466e+38 3.402823466e+38 ECU_ADDRESS 0 SYMBOL_LINK "Rte_CDD_HwTq0Meas_HwTq0Offs.OffsTrim" 0 DISPLAY_IDENTIFIER CDD_HwTq0Meas.PerInstanceMemories.HwTq0Offs.OffsTrim /end MEASUREMENT
/begin MEASUREMENT CDD_HwTq0Meas.HwTq0Offs.OffsTrimPrfmdSts "MICROSAR RTE" UBYTE RTE_CM_BOOLEAN 0 0 0 255 ECU_ADDRESS 0 SYMBOL_LINK "Rte_CDD_HwTq0Meas_HwTq0Offs.OffsTrimPrfmdSts" 0 DISPLAY_IDENTIFIER CDD_HwTq0Meas.PerInstanceMemories.HwTq0Offs.OffsTrimPrfmdSts /end MEASUREMENT
/begin MEASUREMENT CDD_HwTq0Meas.HwTq0Polarity.Val "MICROSAR RTE" SBYTE NO_COMPU_METHOD 0 0 -128 127 ECU_ADDRESS 0 SYMBOL_LINK "Rte_PolarityCfg_HwTq0Polarity_Val" 0 DISPLAY_IDENTIFIER CDD_HwTq0Meas.ReceiverPorts.HwTq0Polarity.Val /end MEASUREMENT
/begin MEASUREMENT CDD_HwTq0Meas.HwTq0Qlfr.Val "MICROSAR RTE" UBYTE RTE_CM_ENUM_SigQlfr1 0 0 0 255 ECU_ADDRESS 0 SYMBOL_LINK "Rte_CDD_HwTq0Meas_HwTq0Qlfr_Val" 0 DISPLAY_IDENTIFIER CDD_HwTq0Meas.SenderPorts.HwTq0Qlfr.Val /end MEASUREMENT
/begin MEASUREMENT CDD_HwTq0Meas.HwTq0RollgCntr.Val "MICROSAR RTE" UBYTE NO_COMPU_METHOD 0 0 0 255 ECU_ADDRESS 0 SYMBOL_LINK "Rte_CDD_HwTq0Meas_HwTq0RollgCntr_Val" 0 DISPLAY_IDENTIFIER CDD_HwTq0Meas.SenderPorts.HwTq0RollgCntr.Val /end MEASUREMENT
/begin MEASUREMENT CDD_HwTq0Meas.RackLimrCcwEot0 "MICROSAR RTE" FLOAT32_IEEE NO_COMPU_METHOD 0 0 -3.402823466e+38 3.402823466e+38 ECU_ADDRESS 0 SYMBOL_LINK "Rte_CDD_HwTq0Meas_RackLimrCcwEot0" 0 DISPLAY_IDENTIFIER CDD_HwTq0Meas.PerInstanceMemories.RackLimrCcwEot0 /end MEASUREMENT
/begin MEASUREMENT CDD_HwTq0Meas.RackLimrCcwEotSig0.Val "MICROSAR RTE" FLOAT32_IEEE NO_COMPU_METHOD 0 0 -3.402823466e+38 3.402823466e+38 ECU_ADDRESS 0 SYMBOL_LINK "Rte_CDD_HwTq0Meas_RackLimrCcwEotSig0_Val" 0 DISPLAY_IDENTIFIER CDD_HwTq0Meas.SenderPorts.RackLimrCcwEotSig0.Val /end MEASUREMENT
/begin MEASUREMENT CDD_HwTq0Meas.RackLimrCwEot0 "MICROSAR RTE" FLOAT32_IEEE NO_COMPU_METHOD 0 0 -3.402823466e+38 3.402823466e+38 ECU_ADDRESS 0 SYMBOL_LINK "Rte_CDD_HwTq0Meas_RackLimrCwEot0" 0 DISPLAY_IDENTIFIER CDD_HwTq0Meas.PerInstanceMemories.RackLimrCwEot0 /end MEASUREMENT
/begin MEASUREMENT CDD_HwTq0Meas.RackLimrCwEotSig0.Val "MICROSAR RTE" FLOAT32_IEEE NO_COMPU_METHOD 0 0 -3.402823466e+38 3.402823466e+38 ECU_ADDRESS 0 SYMBOL_LINK "Rte_CDD_HwTq0Meas_RackLimrCwEotSig0_Val" 0 DISPLAY_IDENTIFIER CDD_HwTq0Meas.SenderPorts.RackLimrCwEotSig0.Val /end MEASUREMENT
/begin MEASUREMENT CDD_HwTq0Meas.RackLimrEot0Avl "MICROSAR RTE" UBYTE RTE_CM_BOOLEAN 0 0 0 255 ECU_ADDRESS 0 SYMBOL_LINK "Rte_CDD_HwTq0Meas_RackLimrEot0Avl" 0 DISPLAY_IDENTIFIER CDD_HwTq0Meas.PerInstanceMemories.RackLimrEot0Avl /end MEASUREMENT
/begin MEASUREMENT CDD_HwTq0Meas.RackLimrEot0Data0 "MICROSAR RTE" UBYTE NO_COMPU_METHOD 0 0 0 255 ECU_ADDRESS 0 SYMBOL_LINK "Rte_CDD_HwTq0Meas_RackLimrEot0Data0" 0 DISPLAY_IDENTIFIER CDD_HwTq0Meas.PerInstanceMemories.RackLimrEot0Data0 /end MEASUREMENT
/begin MEASUREMENT CDD_HwTq0Meas.RackLimrEot0Data1 "MICROSAR RTE" UBYTE NO_COMPU_METHOD 0 0 0 255 ECU_ADDRESS 0 SYMBOL_LINK "Rte_CDD_HwTq0Meas_RackLimrEot0Data1" 0 DISPLAY_IDENTIFIER CDD_HwTq0Meas.PerInstanceMemories.RackLimrEot0Data1 /end MEASUREMENT
/begin MEASUREMENT CDD_HwTq0Meas.RackLimrEot0Data2 "MICROSAR RTE" UBYTE NO_COMPU_METHOD 0 0 0 255 ECU_ADDRESS 0 SYMBOL_LINK "Rte_CDD_HwTq0Meas_RackLimrEot0Data2" 0 DISPLAY_IDENTIFIER CDD_HwTq0Meas.PerInstanceMemories.RackLimrEot0Data2 /end MEASUREMENT
/begin MEASUREMENT CDD_HwTq0Meas.RackLimrEot0Id2DataReadCmpl "MICROSAR RTE" UBYTE RTE_CM_BOOLEAN 0 0 0 255 ECU_ADDRESS 0 SYMBOL_LINK "Rte_CDD_HwTq0Meas_RackLimrEot0Id2DataReadCmpl" 0 DISPLAY_IDENTIFIER CDD_HwTq0Meas.PerInstanceMemories.RackLimrEot0Id2DataReadCmpl /end MEASUREMENT
/begin MEASUREMENT CDD_HwTq0Meas.RackLimrEot0Id3DataReadCmpl "MICROSAR RTE" UBYTE RTE_CM_BOOLEAN 0 0 0 255 ECU_ADDRESS 0 SYMBOL_LINK "Rte_CDD_HwTq0Meas_RackLimrEot0Id3DataReadCmpl" 0 DISPLAY_IDENTIFIER CDD_HwTq0Meas.PerInstanceMemories.RackLimrEot0Id3DataReadCmpl /end MEASUREMENT
/begin MEASUREMENT CDD_HwTq0Meas.RackLimrEot0Id4DataReadCmpl "MICROSAR RTE" UBYTE RTE_CM_BOOLEAN 0 0 0 255 ECU_ADDRESS 0 SYMBOL_LINK "Rte_CDD_HwTq0Meas_RackLimrEot0Id4DataReadCmpl" 0 DISPLAY_IDENTIFIER CDD_HwTq0Meas.PerInstanceMemories.RackLimrEot0Id4DataReadCmpl /end MEASUREMENT
/begin MEASUREMENT CDD_HwTq0Meas.RackLimrEotSig0Avl.Logl "MICROSAR RTE" UBYTE RTE_CM_BOOLEAN 0 0 0 255 ECU_ADDRESS 0 SYMBOL_LINK "Rte_CDD_HwTq0Meas_RackLimrEotSig0Avl_Logl" 0 DISPLAY_IDENTIFIER CDD_HwTq0Meas.SenderPorts.RackLimrEotSig0Avl.Logl /end MEASUREMENT
/begin MEASUREMENT CDD_HwTq1Meas.HwTq1.Val "MICROSAR RTE" FLOAT32_IEEE NO_COMPU_METHOD 0 0 -3.402823466e+38 3.402823466e+38 ECU_ADDRESS 0 SYMBOL_LINK "Rte_CDD_HwTq1Meas_HwTq1_Val" 0 DISPLAY_IDENTIFIER CDD_HwTq1Meas.SenderPorts.HwTq1.Val /end MEASUREMENT
/begin MEASUREMENT CDD_HwTq1Meas.HwTq1ComStsErrCntr "MICROSAR RTE" UBYTE NO_COMPU_METHOD 0 0 0 255 ECU_ADDRESS 0 SYMBOL_LINK "Rte_CDD_HwTq1Meas_HwTq1ComStsErrCntr" 0 DISPLAY_IDENTIFIER CDD_HwTq1Meas.PerInstanceMemories.HwTq1ComStsErrCntr /end MEASUREMENT
/begin MEASUREMENT CDD_HwTq1Meas.HwTq1IntSnsrErrCntr "MICROSAR RTE" UBYTE NO_COMPU_METHOD 0 0 0 255 ECU_ADDRESS 0 SYMBOL_LINK "Rte_CDD_HwTq1Meas_HwTq1IntSnsrErrCntr" 0 DISPLAY_IDENTIFIER CDD_HwTq1Meas.PerInstanceMemories.HwTq1IntSnsrErrCntr /end MEASUREMENT
/begin MEASUREMENT CDD_HwTq1Meas.HwTq1MeasPrevHwTq1 "MICROSAR RTE" FLOAT32_IEEE NO_COMPU_METHOD 0 0 -3.402823466e+38 3.402823466e+38 ECU_ADDRESS 0 SYMBOL_LINK "Rte_CDD_HwTq1Meas_HwTq1MeasPrevHwTq1" 0 DISPLAY_IDENTIFIER CDD_HwTq1Meas.PerInstanceMemories.HwTq1MeasPrevHwTq1 /end MEASUREMENT
/begin MEASUREMENT CDD_HwTq1Meas.HwTq1MeasPrevRollgCntr "MICROSAR RTE" UBYTE NO_COMPU_METHOD 0 0 0 255 ECU_ADDRESS 0 SYMBOL_LINK "Rte_CDD_HwTq1Meas_HwTq1MeasPrevRollgCntr" 0 DISPLAY_IDENTIFIER CDD_HwTq1Meas.PerInstanceMemories.HwTq1MeasPrevRollgCntr /end MEASUREMENT
/begin MEASUREMENT CDD_HwTq1Meas.HwTq1MsgMissRxCnt "MICROSAR RTE" ULONG NO_COMPU_METHOD 0 0 0 4294967295 ECU_ADDRESS 0 SYMBOL_LINK "Rte_CDD_HwTq1Meas_HwTq1MsgMissRxCnt" 0 DISPLAY_IDENTIFIER CDD_HwTq1Meas.PerInstanceMemories.HwTq1MsgMissRxCnt /end MEASUREMENT
/begin MEASUREMENT CDD_HwTq1Meas.HwTq1Offs.OffsTrim "MICROSAR RTE" FLOAT32_IEEE NO_COMPU_METHOD 0 0 -3.402823466e+38 3.402823466e+38 ECU_ADDRESS 0 SYMBOL_LINK "Rte_CDD_HwTq1Meas_HwTq1Offs.OffsTrim" 0 DISPLAY_IDENTIFIER CDD_HwTq1Meas.PerInstanceMemories.HwTq1Offs.OffsTrim /end MEASUREMENT
/begin MEASUREMENT CDD_HwTq1Meas.HwTq1Offs.OffsTrimPrfmdSts "MICROSAR RTE" UBYTE RTE_CM_BOOLEAN 0 0 0 255 ECU_ADDRESS 0 SYMBOL_LINK "Rte_CDD_HwTq1Meas_HwTq1Offs.OffsTrimPrfmdSts" 0 DISPLAY_IDENTIFIER CDD_HwTq1Meas.PerInstanceMemories.HwTq1Offs.OffsTrimPrfmdSts /end MEASUREMENT
/begin MEASUREMENT CDD_HwTq1Meas.HwTq1Polarity.Val "MICROSAR RTE" SBYTE NO_COMPU_METHOD 0 0 -128 127 ECU_ADDRESS 0 SYMBOL_LINK "Rte_PolarityCfg_HwTq1Polarity_Val" 0 DISPLAY_IDENTIFIER CDD_HwTq1Meas.ReceiverPorts.HwTq1Polarity.Val /end MEASUREMENT
/begin MEASUREMENT CDD_HwTq1Meas.HwTq1Qlfr.Val "MICROSAR RTE" UBYTE RTE_CM_ENUM_SigQlfr1 0 0 0 255 ECU_ADDRESS 0 SYMBOL_LINK "Rte_CDD_HwTq1Meas_HwTq1Qlfr_Val" 0 DISPLAY_IDENTIFIER CDD_HwTq1Meas.SenderPorts.HwTq1Qlfr.Val /end MEASUREMENT
/begin MEASUREMENT CDD_HwTq1Meas.HwTq1RollgCntr.Val "MICROSAR RTE" UBYTE NO_COMPU_METHOD 0 0 0 255 ECU_ADDRESS 0 SYMBOL_LINK "Rte_CDD_HwTq1Meas_HwTq1RollgCntr_Val" 0 DISPLAY_IDENTIFIER CDD_HwTq1Meas.SenderPorts.HwTq1RollgCntr.Val /end MEASUREMENT
/begin MEASUREMENT CDD_HwTq1Meas.RackLimrCcwEot1 "MICROSAR RTE" FLOAT32_IEEE NO_COMPU_METHOD 0 0 -3.402823466e+38 3.402823466e+38 ECU_ADDRESS 0 SYMBOL_LINK "Rte_CDD_HwTq1Meas_RackLimrCcwEot1" 0 DISPLAY_IDENTIFIER CDD_HwTq1Meas.PerInstanceMemories.RackLimrCcwEot1 /end MEASUREMENT
/begin MEASUREMENT CDD_HwTq1Meas.RackLimrCcwEotSig1.Val "MICROSAR RTE" FLOAT32_IEEE NO_COMPU_METHOD 0 0 -3.402823466e+38 3.402823466e+38 ECU_ADDRESS 0 SYMBOL_LINK "Rte_CDD_HwTq1Meas_RackLimrCcwEotSig1_Val" 0 DISPLAY_IDENTIFIER CDD_HwTq1Meas.SenderPorts.RackLimrCcwEotSig1.Val /end MEASUREMENT
/begin MEASUREMENT CDD_HwTq1Meas.RackLimrCwEot1 "MICROSAR RTE" FLOAT32_IEEE NO_COMPU_METHOD 0 0 -3.402823466e+38 3.402823466e+38 ECU_ADDRESS 0 SYMBOL_LINK "Rte_CDD_HwTq1Meas_RackLimrCwEot1" 0 DISPLAY_IDENTIFIER CDD_HwTq1Meas.PerInstanceMemories.RackLimrCwEot1 /end MEASUREMENT
/begin MEASUREMENT CDD_HwTq1Meas.RackLimrCwEotSig1.Val "MICROSAR RTE" FLOAT32_IEEE NO_COMPU_METHOD 0 0 -3.402823466e+38 3.402823466e+38 ECU_ADDRESS 0 SYMBOL_LINK "Rte_CDD_HwTq1Meas_RackLimrCwEotSig1_Val" 0 DISPLAY_IDENTIFIER CDD_HwTq1Meas.SenderPorts.RackLimrCwEotSig1.Val /end MEASUREMENT
/begin MEASUREMENT CDD_HwTq1Meas.RackLimrEot1Avl "MICROSAR RTE" UBYTE RTE_CM_BOOLEAN 0 0 0 255 ECU_ADDRESS 0 SYMBOL_LINK "Rte_CDD_HwTq1Meas_RackLimrEot1Avl" 0 DISPLAY_IDENTIFIER CDD_HwTq1Meas.PerInstanceMemories.RackLimrEot1Avl /end MEASUREMENT
/begin MEASUREMENT CDD_HwTq1Meas.RackLimrEot1Data0 "MICROSAR RTE" UBYTE NO_COMPU_METHOD 0 0 0 255 ECU_ADDRESS 0 SYMBOL_LINK "Rte_CDD_HwTq1Meas_RackLimrEot1Data0" 0 DISPLAY_IDENTIFIER CDD_HwTq1Meas.PerInstanceMemories.RackLimrEot1Data0 /end MEASUREMENT
/begin MEASUREMENT CDD_HwTq1Meas.RackLimrEot1Data1 "MICROSAR RTE" UBYTE NO_COMPU_METHOD 0 0 0 255 ECU_ADDRESS 0 SYMBOL_LINK "Rte_CDD_HwTq1Meas_RackLimrEot1Data1" 0 DISPLAY_IDENTIFIER CDD_HwTq1Meas.PerInstanceMemories.RackLimrEot1Data1 /end MEASUREMENT
/begin MEASUREMENT CDD_HwTq1Meas.RackLimrEot1Data2 "MICROSAR RTE" UBYTE NO_COMPU_METHOD 0 0 0 255 ECU_ADDRESS 0 SYMBOL_LINK "Rte_CDD_HwTq1Meas_RackLimrEot1Data2" 0 DISPLAY_IDENTIFIER CDD_HwTq1Meas.PerInstanceMemories.RackLimrEot1Data2 /end MEASUREMENT
/begin MEASUREMENT CDD_HwTq1Meas.RackLimrEot1Id2DataReadCmpl "MICROSAR RTE" UBYTE RTE_CM_BOOLEAN 0 0 0 255 ECU_ADDRESS 0 SYMBOL_LINK "Rte_CDD_HwTq1Meas_RackLimrEot1Id2DataReadCmpl" 0 DISPLAY_IDENTIFIER CDD_HwTq1Meas.PerInstanceMemories.RackLimrEot1Id2DataReadCmpl /end MEASUREMENT
/begin MEASUREMENT CDD_HwTq1Meas.RackLimrEot1Id3DataReadCmpl "MICROSAR RTE" UBYTE RTE_CM_BOOLEAN 0 0 0 255 ECU_ADDRESS 0 SYMBOL_LINK "Rte_CDD_HwTq1Meas_RackLimrEot1Id3DataReadCmpl" 0 DISPLAY_IDENTIFIER CDD_HwTq1Meas.PerInstanceMemories.RackLimrEot1Id3DataReadCmpl /end MEASUREMENT
/begin MEASUREMENT CDD_HwTq1Meas.RackLimrEot1Id4DataReadCmpl "MICROSAR RTE" UBYTE RTE_CM_BOOLEAN 0 0 0 255 ECU_ADDRESS 0 SYMBOL_LINK "Rte_CDD_HwTq1Meas_RackLimrEot1Id4DataReadCmpl" 0 DISPLAY_IDENTIFIER CDD_HwTq1Meas.PerInstanceMemories.RackLimrEot1Id4DataReadCmpl /end MEASUREMENT
/begin MEASUREMENT CDD_HwTq1Meas.RackLimrEotSig1Avl.Logl "MICROSAR RTE" UBYTE RTE_CM_BOOLEAN 0 0 0 255 ECU_ADDRESS 0 SYMBOL_LINK "Rte_CDD_HwTq1Meas_RackLimrEotSig1Avl_Logl" 0 DISPLAY_IDENTIFIER CDD_HwTq1Meas.SenderPorts.RackLimrEotSig1Avl.Logl /end MEASUREMENT
/begin MEASUREMENT CDD_HwTq2Meas.GearIdn1.Val "MICROSAR RTE" UBYTE NO_COMPU_METHOD 0 0 0 255 ECU_ADDRESS 0 SYMBOL_LINK "Rte_CDD_HwTq2Meas_GearIdn1_Val" 0 DISPLAY_IDENTIFIER CDD_HwTq2Meas.SenderPorts.GearIdn1.Val /end MEASUREMENT
/begin MEASUREMENT CDD_HwTq2Meas.GearIdn1Avl "MICROSAR RTE" UBYTE RTE_CM_BOOLEAN 0 0 0 255 ECU_ADDRESS 0 SYMBOL_LINK "Rte_CDD_HwTq2Meas_GearIdn1Avl" 0 DISPLAY_IDENTIFIER CDD_HwTq2Meas.PerInstanceMemories.GearIdn1Avl /end MEASUREMENT
/begin MEASUREMENT CDD_HwTq2Meas.GearIdn1Data "MICROSAR RTE" UBYTE NO_COMPU_METHOD 0 0 0 255 ECU_ADDRESS 0 SYMBOL_LINK "Rte_CDD_HwTq2Meas_GearIdn1Data" 0 DISPLAY_IDENTIFIER CDD_HwTq2Meas.PerInstanceMemories.GearIdn1Data /end MEASUREMENT
/begin MEASUREMENT CDD_HwTq2Meas.GearIdn1Vld.Logl "MICROSAR RTE" UBYTE RTE_CM_BOOLEAN 0 0 0 255 ECU_ADDRESS 0 SYMBOL_LINK "Rte_CDD_HwTq2Meas_GearIdn1Vld_Logl" 0 DISPLAY_IDENTIFIER CDD_HwTq2Meas.SenderPorts.GearIdn1Vld.Logl /end MEASUREMENT
/begin MEASUREMENT CDD_HwTq2Meas.HwTq2.Val "MICROSAR RTE" FLOAT32_IEEE NO_COMPU_METHOD 0 0 -3.402823466e+38 3.402823466e+38 ECU_ADDRESS 0 SYMBOL_LINK "Rte_CDD_HwTq2Meas_HwTq2_Val" 0 DISPLAY_IDENTIFIER CDD_HwTq2Meas.SenderPorts.HwTq2.Val /end MEASUREMENT
/begin MEASUREMENT CDD_HwTq2Meas.HwTq2ComStsErrCntr "MICROSAR RTE" UBYTE NO_COMPU_METHOD 0 0 0 255 ECU_ADDRESS 0 SYMBOL_LINK "Rte_CDD_HwTq2Meas_HwTq2ComStsErrCntr" 0 DISPLAY_IDENTIFIER CDD_HwTq2Meas.PerInstanceMemories.HwTq2ComStsErrCntr /end MEASUREMENT
/begin MEASUREMENT CDD_HwTq2Meas.HwTq2IntSnsrErrCntr "MICROSAR RTE" UBYTE NO_COMPU_METHOD 0 0 0 255 ECU_ADDRESS 0 SYMBOL_LINK "Rte_CDD_HwTq2Meas_HwTq2IntSnsrErrCntr" 0 DISPLAY_IDENTIFIER CDD_HwTq2Meas.PerInstanceMemories.HwTq2IntSnsrErrCntr /end MEASUREMENT
/begin MEASUREMENT CDD_HwTq2Meas.HwTq2MeasPrevHwTq2 "MICROSAR RTE" FLOAT32_IEEE NO_COMPU_METHOD 0 0 -3.402823466e+38 3.402823466e+38 ECU_ADDRESS 0 SYMBOL_LINK "Rte_CDD_HwTq2Meas_HwTq2MeasPrevHwTq2" 0 DISPLAY_IDENTIFIER CDD_HwTq2Meas.PerInstanceMemories.HwTq2MeasPrevHwTq2 /end MEASUREMENT
/begin MEASUREMENT CDD_HwTq2Meas.HwTq2MeasPrevRollgCntr "MICROSAR RTE" UBYTE NO_COMPU_METHOD 0 0 0 255 ECU_ADDRESS 0 SYMBOL_LINK "Rte_CDD_HwTq2Meas_HwTq2MeasPrevRollgCntr" 0 DISPLAY_IDENTIFIER CDD_HwTq2Meas.PerInstanceMemories.HwTq2MeasPrevRollgCntr /end MEASUREMENT
/begin MEASUREMENT CDD_HwTq2Meas.HwTq2MsgMissRxCnt "MICROSAR RTE" ULONG NO_COMPU_METHOD 0 0 0 4294967295 ECU_ADDRESS 0 SYMBOL_LINK "Rte_CDD_HwTq2Meas_HwTq2MsgMissRxCnt" 0 DISPLAY_IDENTIFIER CDD_HwTq2Meas.PerInstanceMemories.HwTq2MsgMissRxCnt /end MEASUREMENT
/begin MEASUREMENT CDD_HwTq2Meas.HwTq2Offs.OffsTrim "MICROSAR RTE" FLOAT32_IEEE NO_COMPU_METHOD 0 0 -3.402823466e+38 3.402823466e+38 ECU_ADDRESS 0 SYMBOL_LINK "Rte_CDD_HwTq2Meas_HwTq2Offs.OffsTrim" 0 DISPLAY_IDENTIFIER CDD_HwTq2Meas.PerInstanceMemories.HwTq2Offs.OffsTrim /end MEASUREMENT
/begin MEASUREMENT CDD_HwTq2Meas.HwTq2Offs.OffsTrimPrfmdSts "MICROSAR RTE" UBYTE RTE_CM_BOOLEAN 0 0 0 255 ECU_ADDRESS 0 SYMBOL_LINK "Rte_CDD_HwTq2Meas_HwTq2Offs.OffsTrimPrfmdSts" 0 DISPLAY_IDENTIFIER CDD_HwTq2Meas.PerInstanceMemories.HwTq2Offs.OffsTrimPrfmdSts /end MEASUREMENT
/begin MEASUREMENT CDD_HwTq2Meas.HwTq2Polarity.Val "MICROSAR RTE" SBYTE NO_COMPU_METHOD 0 0 -128 127 ECU_ADDRESS 0 SYMBOL_LINK "Rte_PolarityCfg_HwTq2Polarity_Val" 0 DISPLAY_IDENTIFIER CDD_HwTq2Meas.ReceiverPorts.HwTq2Polarity.Val /end MEASUREMENT
/begin MEASUREMENT CDD_HwTq2Meas.HwTq2Qlfr.Val "MICROSAR RTE" UBYTE RTE_CM_ENUM_SigQlfr1 0 0 0 255 ECU_ADDRESS 0 SYMBOL_LINK "Rte_CDD_HwTq2Meas_HwTq2Qlfr_Val" 0 DISPLAY_IDENTIFIER CDD_HwTq2Meas.SenderPorts.HwTq2Qlfr.Val /end MEASUREMENT
/begin MEASUREMENT CDD_HwTq2Meas.HwTq2RollgCntr.Val "MICROSAR RTE" UBYTE NO_COMPU_METHOD 0 0 0 255 ECU_ADDRESS 0 SYMBOL_LINK "Rte_CDD_HwTq2Meas_HwTq2RollgCntr_Val" 0 DISPLAY_IDENTIFIER CDD_HwTq2Meas.SenderPorts.HwTq2RollgCntr.Val /end MEASUREMENT
/begin MEASUREMENT CDD_HwTq3Meas.GearIdn2.Val "MICROSAR RTE" UBYTE NO_COMPU_METHOD 0 0 0 255 ECU_ADDRESS 0 SYMBOL_LINK "Rte_CDD_HwTq3Meas_GearIdn2_Val" 0 DISPLAY_IDENTIFIER CDD_HwTq3Meas.SenderPorts.GearIdn2.Val /end MEASUREMENT
/begin MEASUREMENT CDD_HwTq3Meas.GearIdn2Avl "MICROSAR RTE" UBYTE RTE_CM_BOOLEAN 0 0 0 255 ECU_ADDRESS 0 SYMBOL_LINK "Rte_CDD_HwTq3Meas_GearIdn2Avl" 0 DISPLAY_IDENTIFIER CDD_HwTq3Meas.PerInstanceMemories.GearIdn2Avl /end MEASUREMENT
/begin MEASUREMENT CDD_HwTq3Meas.GearIdn2Data "MICROSAR RTE" UBYTE NO_COMPU_METHOD 0 0 0 255 ECU_ADDRESS 0 SYMBOL_LINK "Rte_CDD_HwTq3Meas_GearIdn2Data" 0 DISPLAY_IDENTIFIER CDD_HwTq3Meas.PerInstanceMemories.GearIdn2Data /end MEASUREMENT
/begin MEASUREMENT CDD_HwTq3Meas.GearIdn2Vld.Logl "MICROSAR RTE" UBYTE RTE_CM_BOOLEAN 0 0 0 255 ECU_ADDRESS 0 SYMBOL_LINK "Rte_CDD_HwTq3Meas_GearIdn2Vld_Logl" 0 DISPLAY_IDENTIFIER CDD_HwTq3Meas.SenderPorts.GearIdn2Vld.Logl /end MEASUREMENT
/begin MEASUREMENT CDD_HwTq3Meas.HwTq3.Val "MICROSAR RTE" FLOAT32_IEEE NO_COMPU_METHOD 0 0 -3.402823466e+38 3.402823466e+38 ECU_ADDRESS 0 SYMBOL_LINK "Rte_CDD_HwTq3Meas_HwTq3_Val" 0 DISPLAY_IDENTIFIER CDD_HwTq3Meas.SenderPorts.HwTq3.Val /end MEASUREMENT
/begin MEASUREMENT CDD_HwTq3Meas.HwTq3ComStsErrCntr "MICROSAR RTE" UBYTE NO_COMPU_METHOD 0 0 0 255 ECU_ADDRESS 0 SYMBOL_LINK "Rte_CDD_HwTq3Meas_HwTq3ComStsErrCntr" 0 DISPLAY_IDENTIFIER CDD_HwTq3Meas.PerInstanceMemories.HwTq3ComStsErrCntr /end MEASUREMENT
/begin MEASUREMENT CDD_HwTq3Meas.HwTq3IntSnsrErrCntr "MICROSAR RTE" UBYTE NO_COMPU_METHOD 0 0 0 255 ECU_ADDRESS 0 SYMBOL_LINK "Rte_CDD_HwTq3Meas_HwTq3IntSnsrErrCntr" 0 DISPLAY_IDENTIFIER CDD_HwTq3Meas.PerInstanceMemories.HwTq3IntSnsrErrCntr /end MEASUREMENT
/begin MEASUREMENT CDD_HwTq3Meas.HwTq3MeasPrevHwTq3 "MICROSAR RTE" FLOAT32_IEEE NO_COMPU_METHOD 0 0 -3.402823466e+38 3.402823466e+38 ECU_ADDRESS 0 SYMBOL_LINK "Rte_CDD_HwTq3Meas_HwTq3MeasPrevHwTq3" 0 DISPLAY_IDENTIFIER CDD_HwTq3Meas.PerInstanceMemories.HwTq3MeasPrevHwTq3 /end MEASUREMENT
/begin MEASUREMENT CDD_HwTq3Meas.HwTq3MeasPrevRollgCntr "MICROSAR RTE" UBYTE NO_COMPU_METHOD 0 0 0 255 ECU_ADDRESS 0 SYMBOL_LINK "Rte_CDD_HwTq3Meas_HwTq3MeasPrevRollgCntr" 0 DISPLAY_IDENTIFIER CDD_HwTq3Meas.PerInstanceMemories.HwTq3MeasPrevRollgCntr /end MEASUREMENT
/begin MEASUREMENT CDD_HwTq3Meas.HwTq3MsgMissRxCnt "MICROSAR RTE" ULONG NO_COMPU_METHOD 0 0 0 4294967295 ECU_ADDRESS 0 SYMBOL_LINK "Rte_CDD_HwTq3Meas_HwTq3MsgMissRxCnt" 0 DISPLAY_IDENTIFIER CDD_HwTq3Meas.PerInstanceMemories.HwTq3MsgMissRxCnt /end MEASUREMENT
/begin MEASUREMENT CDD_HwTq3Meas.HwTq3Offs.OffsTrim "MICROSAR RTE" FLOAT32_IEEE NO_COMPU_METHOD 0 0 -3.402823466e+38 3.402823466e+38 ECU_ADDRESS 0 SYMBOL_LINK "Rte_CDD_HwTq3Meas_HwTq3Offs.OffsTrim" 0 DISPLAY_IDENTIFIER CDD_HwTq3Meas.PerInstanceMemories.HwTq3Offs.OffsTrim /end MEASUREMENT
/begin MEASUREMENT CDD_HwTq3Meas.HwTq3Offs.OffsTrimPrfmdSts "MICROSAR RTE" UBYTE RTE_CM_BOOLEAN 0 0 0 255 ECU_ADDRESS 0 SYMBOL_LINK "Rte_CDD_HwTq3Meas_HwTq3Offs.OffsTrimPrfmdSts" 0 DISPLAY_IDENTIFIER CDD_HwTq3Meas.PerInstanceMemories.HwTq3Offs.OffsTrimPrfmdSts /end MEASUREMENT
/begin MEASUREMENT CDD_HwTq3Meas.HwTq3Polarity.Val "MICROSAR RTE" SBYTE NO_COMPU_METHOD 0 0 -128 127 ECU_ADDRESS 0 SYMBOL_LINK "Rte_PolarityCfg_HwTq3Polarity_Val" 0 DISPLAY_IDENTIFIER CDD_HwTq3Meas.ReceiverPorts.HwTq3Polarity.Val /end MEASUREMENT
/begin MEASUREMENT CDD_HwTq3Meas.HwTq3Qlfr.Val "MICROSAR RTE" UBYTE RTE_CM_ENUM_SigQlfr1 0 0 0 255 ECU_ADDRESS 0 SYMBOL_LINK "Rte_CDD_HwTq3Meas_HwTq3Qlfr_Val" 0 DISPLAY_IDENTIFIER CDD_HwTq3Meas.SenderPorts.HwTq3Qlfr.Val /end MEASUREMENT
/begin MEASUREMENT CDD_HwTq3Meas.HwTq3RollgCntr.Val "MICROSAR RTE" UBYTE NO_COMPU_METHOD 0 0 0 255 ECU_ADDRESS 0 SYMBOL_LINK "Rte_CDD_HwTq3Meas_HwTq3RollgCntr_Val" 0 DISPLAY_IDENTIFIER CDD_HwTq3Meas.SenderPorts.HwTq3RollgCntr.Val /end MEASUREMENT
/begin MEASUREMENT CDD_McuCoreCfgAndDiagc.CoreCompTestRegRead "MICROSAR RTE" ULONG NO_COMPU_METHOD 0 0 0 4294967295 ECU_ADDRESS 0 SYMBOL_LINK "Rte_CDD_McuCoreCfgAndDiagc_CoreCompTestRegRead" 0 DISPLAY_IDENTIFIER CDD_McuCoreCfgAndDiagc.PerInstanceMemories.CoreCompTestRegRead /end MEASUREMENT
/begin MEASUREMENT CDD_McuDiagc.FastLoopCntr.Val "MICROSAR RTE" UWORD NO_COMPU_METHOD 0 0 0 65535 ECU_ADDRESS 0 SYMBOL_LINK "Rte_CDD_MotCtrlMgr_FastLoopCntr_Val" 0 DISPLAY_IDENTIFIER CDD_McuDiagc.ReceiverPorts.FastLoopCntr.Val /end MEASUREMENT
/begin MEASUREMENT CDD_McuDiagc.FastLoopCntrDiagcCfgd "MICROSAR RTE" UBYTE NO_COMPU_METHOD 0 0 0 255 ECU_ADDRESS 0 SYMBOL_LINK "Rte_CDD_McuDiagc_FastLoopCntrDiagcCfgd" 0 DISPLAY_IDENTIFIER CDD_McuDiagc.PerInstanceMemories.FastLoopCntrDiagcCfgd /end MEASUREMENT
/begin MEASUREMENT CDD_McuDiagc.FastLoopCntrPrev "MICROSAR RTE" UWORD NO_COMPU_METHOD 0 0 0 65535 ECU_ADDRESS 0 SYMBOL_LINK "Rte_CDD_McuDiagc_FastLoopCntrPrev" 0 DISPLAY_IDENTIFIER CDD_McuDiagc.PerInstanceMemories.FastLoopCntrPrev /end MEASUREMENT
/begin MEASUREMENT CDD_McuDiagc.LoopCntr2MilliSec.Val "MICROSAR RTE" UWORD NO_COMPU_METHOD 0 0 0 65535 ECU_ADDRESS 0 SYMBOL_LINK "Rte_CDD_McuDiagc_LoopCntr2MilliSec_Val" 0 DISPLAY_IDENTIFIER CDD_McuDiagc.SenderPorts.LoopCntr2MilliSec.Val /end MEASUREMENT
/begin MEASUREMENT CDD_McuDiagc.LoopCntr2MilliSecStore "MICROSAR RTE" UWORD NO_COMPU_METHOD 0 0 0 65535 ECU_ADDRESS 0 SYMBOL_LINK "Rte_CDD_McuDiagc_LoopCntr2MilliSecStore" 0 DISPLAY_IDENTIFIER CDD_McuDiagc.PerInstanceMemories.LoopCntr2MilliSecStore /end MEASUREMENT
/begin MEASUREMENT CDD_McuDiagc.LoopCntrPrev "MICROSAR RTE" UWORD NO_COMPU_METHOD 0 0 0 65535 ECU_ADDRESS 0 SYMBOL_LINK "Rte_CDD_McuDiagc_LoopCntrPrev" 0 DISPLAY_IDENTIFIER CDD_McuDiagc.PerInstanceMemories.LoopCntrPrev /end MEASUREMENT
/begin MEASUREMENT CDD_McuDiagc.SlowLoopCntr.Val "MICROSAR RTE" UWORD NO_COMPU_METHOD 0 0 0 65535 ECU_ADDRESS 0 SYMBOL_LINK "Rte_CDD_MotCtrlMgr_SlowLoopCntr_Val" 0 DISPLAY_IDENTIFIER CDD_McuDiagc.ReceiverPorts.SlowLoopCntr.Val /end MEASUREMENT
/begin MEASUREMENT CDD_McuDiagc.dMcuDiagcFastLoopCntrMax "MICROSAR RTE" UWORD NO_COMPU_METHOD 0 0 0 65535 ECU_ADDRESS 0 SYMBOL_LINK "Rte_CDD_McuDiagc_dMcuDiagcFastLoopCntrMax" 0 DISPLAY_IDENTIFIER CDD_McuDiagc.PerInstanceMemories.dMcuDiagcFastLoopCntrMax /end MEASUREMENT
/begin MEASUREMENT CDD_McuDiagc.dMcuDiagcFastLoopCntrMin "MICROSAR RTE" UWORD NO_COMPU_METHOD 0 0 0 65535 ECU_ADDRESS 0 SYMBOL_LINK "Rte_CDD_McuDiagc_dMcuDiagcFastLoopCntrMin" 0 DISPLAY_IDENTIFIER CDD_McuDiagc.PerInstanceMemories.dMcuDiagcFastLoopCntrMin /end MEASUREMENT
/begin MEASUREMENT CDD_McuDiagc.dMcuDiagcLoopCntr2MilliSecMotCtrlDif "MICROSAR RTE" UWORD NO_COMPU_METHOD 0 0 0 65535 ECU_ADDRESS 0 SYMBOL_LINK "Rte_CDD_McuDiagc_dMcuDiagcLoopCntr2MilliSecMotCtrlDif" 0 DISPLAY_IDENTIFIER CDD_McuDiagc.PerInstanceMemories.dMcuDiagcLoopCntr2MilliSecMotCtrlDif /end MEASUREMENT
/begin MEASUREMENT CDD_MotAg0Meas.MotAg0CoeffTbl "MICROSAR RTE" FLOAT32_IEEE NO_COMPU_METHOD 0 0 -3.402823466e+38 3.402823466e+38 MATRIX_DIM 26 1 1 ECU_ADDRESS 0 SYMBOL_LINK "Rte_CDD_MotAg0Meas_MotAg0CoeffTbl" 0 DISPLAY_IDENTIFIER CDD_MotAg0Meas.PerInstanceMemories.MotAg0CoeffTbl /end MEASUREMENT
/begin MEASUREMENT CDD_MotAg0Meas.MotAg0CorrnTbl "MICROSAR RTE" SBYTE NO_COMPU_METHOD 0 0 -128 127 MATRIX_DIM 128 1 1 ECU_ADDRESS 0 SYMBOL_LINK "Rte_CDD_MotAg0Meas_MotAg0CorrnTbl" 0 DISPLAY_IDENTIFIER CDD_MotAg0Meas.PerInstanceMemories.MotAg0CorrnTbl /end MEASUREMENT
/begin MEASUREMENT CDD_MotAg0Meas.MotAg0Diagc "MICROSAR RTE" UWORD NO_COMPU_METHOD 0 0 0 65535 ECU_ADDRESS 0 SYMBOL_LINK "Rte_CDD_MotAg0Meas_MotAg0Diagc" 0 DISPLAY_IDENTIFIER CDD_MotAg0Meas.PerInstanceMemories.MotAg0Diagc /end MEASUREMENT
/begin MEASUREMENT CDD_MotAg0Meas.MotAg0InitOffs "MICROSAR RTE" UBYTE NO_COMPU_METHOD 0 0 0 255 ECU_ADDRESS 0 SYMBOL_LINK "Rte_CDD_MotAg0Meas_MotAg0InitOffs" 0 DISPLAY_IDENTIFIER CDD_MotAg0Meas.PerInstanceMemories.MotAg0InitOffs /end MEASUREMENT
/begin MEASUREMENT CDD_MotAg0Meas.MotAg0MeclQlfr.Val "MICROSAR RTE" UBYTE RTE_CM_ENUM_SigQlfr1 0 0 0 255 ECU_ADDRESS 0 SYMBOL_LINK "Rte_CDD_MotAg0Meas_MotAg0MeclQlfr_Val" 0 DISPLAY_IDENTIFIER CDD_MotAg0Meas.SenderPorts.MotAg0MeclQlfr.Val /end MEASUREMENT
/begin MEASUREMENT CDD_MotAg0Meas.MotAg0MeclRollgCntr.Val "MICROSAR RTE" UBYTE NO_COMPU_METHOD 0 0 0 255 ECU_ADDRESS 0 SYMBOL_LINK "Rte_CDD_MotAg0Meas_MotAg0MeclRollgCntr_Val" 0 DISPLAY_IDENTIFIER CDD_MotAg0Meas.SenderPorts.MotAg0MeclRollgCntr.Val /end MEASUREMENT
/begin MEASUREMENT CDD_MotAg0Meas.MotAg0Offs.Val "MICROSAR RTE" SLONG NO_COMPU_METHOD 0 0 -2147483648 2147483647 ECU_ADDRESS 0 SYMBOL_LINK "Rte_CDD_MotAg0Meas_MotAg0Offs_Val" 0 DISPLAY_IDENTIFIER CDD_MotAg0Meas.SenderPorts.MotAg0Offs.Val /end MEASUREMENT
/begin MEASUREMENT CDD_MotAg0Meas.MotAg0PrevOffs "MICROSAR RTE" SLONG NO_COMPU_METHOD 0 0 -2147483648 2147483647 ECU_ADDRESS 0 SYMBOL_LINK "Rte_CDD_MotAg0Meas_MotAg0PrevOffs" 0 DISPLAY_IDENTIFIER CDD_MotAg0Meas.PerInstanceMemories.MotAg0PrevOffs /end MEASUREMENT
/begin MEASUREMENT CDD_MotAg0Meas.MotAg0PrevRollgCntr "MICROSAR RTE" UBYTE NO_COMPU_METHOD 0 0 0 255 ECU_ADDRESS 0 SYMBOL_LINK "Rte_CDD_MotAg0Meas_MotAg0PrevRollgCntr" 0 DISPLAY_IDENTIFIER CDD_MotAg0Meas.PerInstanceMemories.MotAg0PrevRollgCntr /end MEASUREMENT
/begin MEASUREMENT CDD_MotAg0Meas.MotAg0PrevSpiErrFltCntr "MICROSAR RTE" UWORD NO_COMPU_METHOD 0 0 0 65535 ECU_ADDRESS 0 SYMBOL_LINK "Rte_CDD_MotAg0Meas_MotAg0PrevSpiErrFltCntr" 0 DISPLAY_IDENTIFIER CDD_MotAg0Meas.PerInstanceMemories.MotAg0PrevSpiErrFltCntr /end MEASUREMENT
/begin MEASUREMENT CDD_MotAg0Meas.MotAgMecl0Polarity.Val "MICROSAR RTE" SBYTE NO_COMPU_METHOD 0 0 -128 127 ECU_ADDRESS 0 SYMBOL_LINK "Rte_PolarityCfg_MotAgMecl0Polarity_Val" 0 DISPLAY_IDENTIFIER CDD_MotAg0Meas.ReceiverPorts.MotAgMecl0Polarity.Val /end MEASUREMENT
/begin MEASUREMENT CDD_MotAg0Meas.dMotAg0MeasMotAg0Delta "MICROSAR RTE" UWORD NO_COMPU_METHOD 0 0 0 65535 ECU_ADDRESS 0 SYMBOL_LINK "Rte_CDD_MotAg0Meas_dMotAg0MeasMotAg0Delta" 0 DISPLAY_IDENTIFIER CDD_MotAg0Meas.PerInstanceMemories.dMotAg0MeasMotAg0Delta /end MEASUREMENT
/begin MEASUREMENT CDD_MotAg0Meas.dMotAg0MeasMotAg0RawAgReg "MICROSAR RTE" ULONG NO_COMPU_METHOD 0 0 0 4294967295 ECU_ADDRESS 0 SYMBOL_LINK "Rte_CDD_MotAg0Meas_dMotAg0MeasMotAg0RawAgReg" 0 DISPLAY_IDENTIFIER CDD_MotAg0Meas.PerInstanceMemories.dMotAg0MeasMotAg0RawAgReg /end MEASUREMENT
/begin MEASUREMENT CDD_MotAg0Meas.dMotAg0MeasMotAg0RawErrReg "MICROSAR RTE" ULONG NO_COMPU_METHOD 0 0 0 4294967295 ECU_ADDRESS 0 SYMBOL_LINK "Rte_CDD_MotAg0Meas_dMotAg0MeasMotAg0RawErrReg" 0 DISPLAY_IDENTIFIER CDD_MotAg0Meas.PerInstanceMemories.dMotAg0MeasMotAg0RawErrReg /end MEASUREMENT
/begin MEASUREMENT CDD_MotAg0Meas.dMotAg0MeasMotAg0RawReg "MICROSAR RTE" ULONG NO_COMPU_METHOD 0 0 0 4294967295 MATRIX_DIM 10 1 1 ECU_ADDRESS 0 SYMBOL_LINK "Rte_CDD_MotAg0Meas_dMotAg0MeasMotAg0RawReg" 0 DISPLAY_IDENTIFIER CDD_MotAg0Meas.PerInstanceMemories.dMotAg0MeasMotAg0RawReg /end MEASUREMENT
/begin MEASUREMENT CDD_MotAg0Meas.dMotAg0MeasMotAg0RawTurnCntrReg "MICROSAR RTE" ULONG NO_COMPU_METHOD 0 0 0 4294967295 ECU_ADDRESS 0 SYMBOL_LINK "Rte_CDD_MotAg0Meas_dMotAg0MeasMotAg0RawTurnCntrReg" 0 DISPLAY_IDENTIFIER CDD_MotAg0Meas.PerInstanceMemories.dMotAg0MeasMotAg0RawTurnCntrReg /end MEASUREMENT
/begin MEASUREMENT CDD_MotAg0Meas.dMotAg0MeasMotAg0RtOffs "MICROSAR RTE" SLONG NO_COMPU_METHOD 0 0 -2147483648 2147483647 ECU_ADDRESS 0 SYMBOL_LINK "Rte_CDD_MotAg0Meas_dMotAg0MeasMotAg0RtOffs" 0 DISPLAY_IDENTIFIER CDD_MotAg0Meas.PerInstanceMemories.dMotAg0MeasMotAg0RtOffs /end MEASUREMENT
/begin MEASUREMENT CDD_MotAg0Meas.dMotAg0MeasMotAg0SpiCntrAg "MICROSAR RTE" UWORD NO_COMPU_METHOD 0 0 0 65535 ECU_ADDRESS 0 SYMBOL_LINK "Rte_CDD_MotAg0Meas_dMotAg0MeasMotAg0SpiCntrAg" 0 DISPLAY_IDENTIFIER CDD_MotAg0Meas.PerInstanceMemories.dMotAg0MeasMotAg0SpiCntrAg /end MEASUREMENT
/begin MEASUREMENT CDD_MotAg0Meas.dMotAg0MeasMotAg0SpiMecl "MICROSAR RTE" UWORD NO_COMPU_METHOD 0 0 0 65535 ECU_ADDRESS 0 SYMBOL_LINK "Rte_CDD_MotAg0Meas_dMotAg0MeasMotAg0SpiMecl" 0 DISPLAY_IDENTIFIER CDD_MotAg0Meas.PerInstanceMemories.dMotAg0MeasMotAg0SpiMecl /end MEASUREMENT
/begin MEASUREMENT CDD_MotAg0Meas.dMotAg0MeasMotAg0TurnCntr "MICROSAR RTE" FLOAT32_IEEE NO_COMPU_METHOD 0 0 -3.402823466e+38 3.402823466e+38 ECU_ADDRESS 0 SYMBOL_LINK "Rte_CDD_MotAg0Meas_dMotAg0MeasMotAg0TurnCntr" 0 DISPLAY_IDENTIFIER CDD_MotAg0Meas.PerInstanceMemories.dMotAg0MeasMotAg0TurnCntr /end MEASUREMENT
/begin MEASUREMENT CDD_MotAg0Meas.dMotAg0MeasMotCtrlMotAg3Mecl "MICROSAR RTE" UWORD NO_COMPU_METHOD 0 0 0 65535 ECU_ADDRESS 0 SYMBOL_LINK "Rte_CDD_MotAg0Meas_dMotAg0MeasMotCtrlMotAg3Mecl" 0 DISPLAY_IDENTIFIER CDD_MotAg0Meas.PerInstanceMemories.dMotAg0MeasMotCtrlMotAg3Mecl /end MEASUREMENT
/begin MEASUREMENT CDD_MotAg1Meas.MotAg1CoeffTbl "MICROSAR RTE" FLOAT32_IEEE NO_COMPU_METHOD 0 0 -3.402823466e+38 3.402823466e+38 MATRIX_DIM 26 1 1 ECU_ADDRESS 0 SYMBOL_LINK "Rte_CDD_MotAg1Meas_MotAg1CoeffTbl" 0 DISPLAY_IDENTIFIER CDD_MotAg1Meas.PerInstanceMemories.MotAg1CoeffTbl /end MEASUREMENT
/begin MEASUREMENT CDD_MotAg1Meas.MotAg1CorrnTbl "MICROSAR RTE" SBYTE NO_COMPU_METHOD 0 0 -128 127 MATRIX_DIM 128 1 1 ECU_ADDRESS 0 SYMBOL_LINK "Rte_CDD_MotAg1Meas_MotAg1CorrnTbl" 0 DISPLAY_IDENTIFIER CDD_MotAg1Meas.PerInstanceMemories.MotAg1CorrnTbl /end MEASUREMENT
/begin MEASUREMENT CDD_MotAg1Meas.MotAg1Diagc "MICROSAR RTE" UWORD NO_COMPU_METHOD 0 0 0 65535 ECU_ADDRESS 0 SYMBOL_LINK "Rte_CDD_MotAg1Meas_MotAg1Diagc" 0 DISPLAY_IDENTIFIER CDD_MotAg1Meas.PerInstanceMemories.MotAg1Diagc /end MEASUREMENT
/begin MEASUREMENT CDD_MotAg1Meas.MotAg1InitOffs "MICROSAR RTE" UBYTE NO_COMPU_METHOD 0 0 0 255 ECU_ADDRESS 0 SYMBOL_LINK "Rte_CDD_MotAg1Meas_MotAg1InitOffs" 0 DISPLAY_IDENTIFIER CDD_MotAg1Meas.PerInstanceMemories.MotAg1InitOffs /end MEASUREMENT
/begin MEASUREMENT CDD_MotAg1Meas.MotAg1MeclQlfr.Val "MICROSAR RTE" UBYTE RTE_CM_ENUM_SigQlfr1 0 0 0 255 ECU_ADDRESS 0 SYMBOL_LINK "Rte_CDD_MotAg1Meas_MotAg1MeclQlfr_Val" 0 DISPLAY_IDENTIFIER CDD_MotAg1Meas.SenderPorts.MotAg1MeclQlfr.Val /end MEASUREMENT
/begin MEASUREMENT CDD_MotAg1Meas.MotAg1MeclRollgCntr.Val "MICROSAR RTE" UBYTE NO_COMPU_METHOD 0 0 0 255 ECU_ADDRESS 0 SYMBOL_LINK "Rte_CDD_MotAg1Meas_MotAg1MeclRollgCntr_Val" 0 DISPLAY_IDENTIFIER CDD_MotAg1Meas.SenderPorts.MotAg1MeclRollgCntr.Val /end MEASUREMENT
/begin MEASUREMENT CDD_MotAg1Meas.MotAg1Offs.Val "MICROSAR RTE" SLONG NO_COMPU_METHOD 0 0 -2147483648 2147483647 ECU_ADDRESS 0 SYMBOL_LINK "Rte_CDD_MotAg1Meas_MotAg1Offs_Val" 0 DISPLAY_IDENTIFIER CDD_MotAg1Meas.SenderPorts.MotAg1Offs.Val /end MEASUREMENT
/begin MEASUREMENT CDD_MotAg1Meas.MotAg1PrevOffs "MICROSAR RTE" SLONG NO_COMPU_METHOD 0 0 -2147483648 2147483647 ECU_ADDRESS 0 SYMBOL_LINK "Rte_CDD_MotAg1Meas_MotAg1PrevOffs" 0 DISPLAY_IDENTIFIER CDD_MotAg1Meas.PerInstanceMemories.MotAg1PrevOffs /end MEASUREMENT
/begin MEASUREMENT CDD_MotAg1Meas.MotAg1PrevRollgCntr "MICROSAR RTE" UBYTE NO_COMPU_METHOD 0 0 0 255 ECU_ADDRESS 0 SYMBOL_LINK "Rte_CDD_MotAg1Meas_MotAg1PrevRollgCntr" 0 DISPLAY_IDENTIFIER CDD_MotAg1Meas.PerInstanceMemories.MotAg1PrevRollgCntr /end MEASUREMENT
/begin MEASUREMENT CDD_MotAg1Meas.MotAg1PrevSpiErrFltCntr "MICROSAR RTE" UWORD NO_COMPU_METHOD 0 0 0 65535 ECU_ADDRESS 0 SYMBOL_LINK "Rte_CDD_MotAg1Meas_MotAg1PrevSpiErrFltCntr" 0 DISPLAY_IDENTIFIER CDD_MotAg1Meas.PerInstanceMemories.MotAg1PrevSpiErrFltCntr /end MEASUREMENT
/begin MEASUREMENT CDD_MotAg1Meas.MotAgMecl1Polarity.Val "MICROSAR RTE" SBYTE NO_COMPU_METHOD 0 0 -128 127 ECU_ADDRESS 0 SYMBOL_LINK "Rte_PolarityCfg_MotAgMecl1Polarity_Val" 0 DISPLAY_IDENTIFIER CDD_MotAg1Meas.ReceiverPorts.MotAgMecl1Polarity.Val /end MEASUREMENT
/begin MEASUREMENT CDD_MotAg1Meas.dMotAg1MeasMotAg1Delta "MICROSAR RTE" UWORD NO_COMPU_METHOD 0 0 0 65535 ECU_ADDRESS 0 SYMBOL_LINK "Rte_CDD_MotAg1Meas_dMotAg1MeasMotAg1Delta" 0 DISPLAY_IDENTIFIER CDD_MotAg1Meas.PerInstanceMemories.dMotAg1MeasMotAg1Delta /end MEASUREMENT
/begin MEASUREMENT CDD_MotAg1Meas.dMotAg1MeasMotAg1RawAgReg "MICROSAR RTE" ULONG NO_COMPU_METHOD 0 0 0 4294967295 ECU_ADDRESS 0 SYMBOL_LINK "Rte_CDD_MotAg1Meas_dMotAg1MeasMotAg1RawAgReg" 0 DISPLAY_IDENTIFIER CDD_MotAg1Meas.PerInstanceMemories.dMotAg1MeasMotAg1RawAgReg /end MEASUREMENT
/begin MEASUREMENT CDD_MotAg1Meas.dMotAg1MeasMotAg1RawErrReg "MICROSAR RTE" ULONG NO_COMPU_METHOD 0 0 0 4294967295 ECU_ADDRESS 0 SYMBOL_LINK "Rte_CDD_MotAg1Meas_dMotAg1MeasMotAg1RawErrReg" 0 DISPLAY_IDENTIFIER CDD_MotAg1Meas.PerInstanceMemories.dMotAg1MeasMotAg1RawErrReg /end MEASUREMENT
/begin MEASUREMENT CDD_MotAg1Meas.dMotAg1MeasMotAg1RawReg "MICROSAR RTE" ULONG NO_COMPU_METHOD 0 0 0 4294967295 MATRIX_DIM 10 1 1 ECU_ADDRESS 0 SYMBOL_LINK "Rte_CDD_MotAg1Meas_dMotAg1MeasMotAg1RawReg" 0 DISPLAY_IDENTIFIER CDD_MotAg1Meas.PerInstanceMemories.dMotAg1MeasMotAg1RawReg /end MEASUREMENT
/begin MEASUREMENT CDD_MotAg1Meas.dMotAg1MeasMotAg1RawTurnCntrReg "MICROSAR RTE" ULONG NO_COMPU_METHOD 0 0 0 4294967295 ECU_ADDRESS 0 SYMBOL_LINK "Rte_CDD_MotAg1Meas_dMotAg1MeasMotAg1RawTurnCntrReg" 0 DISPLAY_IDENTIFIER CDD_MotAg1Meas.PerInstanceMemories.dMotAg1MeasMotAg1RawTurnCntrReg /end MEASUREMENT
/begin MEASUREMENT CDD_MotAg1Meas.dMotAg1MeasMotAg1RtOffs "MICROSAR RTE" SLONG NO_COMPU_METHOD 0 0 -2147483648 2147483647 ECU_ADDRESS 0 SYMBOL_LINK "Rte_CDD_MotAg1Meas_dMotAg1MeasMotAg1RtOffs" 0 DISPLAY_IDENTIFIER CDD_MotAg1Meas.PerInstanceMemories.dMotAg1MeasMotAg1RtOffs /end MEASUREMENT
/begin MEASUREMENT CDD_MotAg1Meas.dMotAg1MeasMotAg1SpiCntrAg "MICROSAR RTE" UWORD NO_COMPU_METHOD 0 0 0 65535 ECU_ADDRESS 0 SYMBOL_LINK "Rte_CDD_MotAg1Meas_dMotAg1MeasMotAg1SpiCntrAg" 0 DISPLAY_IDENTIFIER CDD_MotAg1Meas.PerInstanceMemories.dMotAg1MeasMotAg1SpiCntrAg /end MEASUREMENT
/begin MEASUREMENT CDD_MotAg1Meas.dMotAg1MeasMotAg1SpiMecl "MICROSAR RTE" UWORD NO_COMPU_METHOD 0 0 0 65535 ECU_ADDRESS 0 SYMBOL_LINK "Rte_CDD_MotAg1Meas_dMotAg1MeasMotAg1SpiMecl" 0 DISPLAY_IDENTIFIER CDD_MotAg1Meas.PerInstanceMemories.dMotAg1MeasMotAg1SpiMecl /end MEASUREMENT
/begin MEASUREMENT CDD_MotAg1Meas.dMotAg1MeasMotAg1TurnCntr "MICROSAR RTE" FLOAT32_IEEE NO_COMPU_METHOD 0 0 -3.402823466e+38 3.402823466e+38 ECU_ADDRESS 0 SYMBOL_LINK "Rte_CDD_MotAg1Meas_dMotAg1MeasMotAg1TurnCntr" 0 DISPLAY_IDENTIFIER CDD_MotAg1Meas.PerInstanceMemories.dMotAg1MeasMotAg1TurnCntr /end MEASUREMENT
/begin MEASUREMENT CDD_MotAg1Meas.dMotAg1MeasMotCtrlMotAg4Mecl "MICROSAR RTE" UWORD NO_COMPU_METHOD 0 0 0 65535 ECU_ADDRESS 0 SYMBOL_LINK "Rte_CDD_MotAg1Meas_dMotAg1MeasMotCtrlMotAg4Mecl" 0 DISPLAY_IDENTIFIER CDD_MotAg1Meas.PerInstanceMemories.dMotAg1MeasMotCtrlMotAg4Mecl /end MEASUREMENT
/begin MEASUREMENT CDD_MotAg3Meas.MotAgMecl3Polarity.Val "MICROSAR RTE" SBYTE NO_COMPU_METHOD 0 0 -128 127 ECU_ADDRESS 0 SYMBOL_LINK "Rte_PolarityCfg_MotAgMecl3Polarity_Val" 0 DISPLAY_IDENTIFIER CDD_MotAg3Meas.ReceiverPorts.MotAgMecl3Polarity.Val /end MEASUREMENT
/begin MEASUREMENT CDD_MotAg4Meas.MotAgMecl4Polarity.Val "MICROSAR RTE" SBYTE NO_COMPU_METHOD 0 0 -128 127 ECU_ADDRESS 0 SYMBOL_LINK "Rte_PolarityCfg_MotAgMecl4Polarity_Val" 0 DISPLAY_IDENTIFIER CDD_MotAg4Meas.ReceiverPorts.MotAgMecl4Polarity.Val /end MEASUREMENT
/begin MEASUREMENT CDD_MotAgArbn.MotAgARollgCntPrev "MICROSAR RTE" UBYTE NO_COMPU_METHOD 0 0 0 255 ECU_ADDRESS 0 SYMBOL_LINK "Rte_CDD_MotAgArbn_MotAgARollgCntPrev" 0 DISPLAY_IDENTIFIER CDD_MotAgArbn.PerInstanceMemories.MotAgARollgCntPrev /end MEASUREMENT
/begin MEASUREMENT CDD_MotAgArbn.MotAgAStallCntPrev "MICROSAR RTE" UBYTE NO_COMPU_METHOD 0 0 0 255 ECU_ADDRESS 0 SYMBOL_LINK "Rte_CDD_MotAgArbn_MotAgAStallCntPrev" 0 DISPLAY_IDENTIFIER CDD_MotAgArbn.PerInstanceMemories.MotAgAStallCntPrev /end MEASUREMENT
/begin MEASUREMENT CDD_MotAgArbn.MotAgMeclPrev "MICROSAR RTE" UWORD NO_COMPU_METHOD 0 0 0 65535 ECU_ADDRESS 0 SYMBOL_LINK "Rte_CDD_MotAgArbn_MotAgMeclPrev" 0 DISPLAY_IDENTIFIER CDD_MotAgArbn.PerInstanceMemories.MotAgMeclPrev /end MEASUREMENT
/begin MEASUREMENT CDD_MotAgCmp.AssiMechPolarity.Val "MICROSAR RTE" SBYTE NO_COMPU_METHOD 0 0 -1.0 1.0 ECU_ADDRESS 0 SYMBOL_LINK "Rte_PolarityCfg_AssiMechPolarity_Val" 0 DISPLAY_IDENTIFIER CDD_MotAgCmp.ReceiverPorts.AssiMechPolarity.Val /end MEASUREMENT
/begin MEASUREMENT CDD_MotAgCmp.MotAgCmpFirstRunCmpl "MICROSAR RTE" UBYTE RTE_CM_BOOLEAN 0 0 0 255 ECU_ADDRESS 0 SYMBOL_LINK "Rte_CDD_MotAgCmp_MotAgCmpFirstRunCmpl" 0 DISPLAY_IDENTIFIER CDD_MotAgCmp.PerInstanceMemories.MotAgCmpFirstRunCmpl /end MEASUREMENT
/begin MEASUREMENT CDD_MotAgCmp.MotAgCmpMotAgBackEmf "MICROSAR RTE" UWORD RTE_CM_Ag9 0 0 0 0 ECU_ADDRESS 0 SYMBOL_LINK "Rte_CDD_MotAgCmp_MotAgCmpMotAgBackEmf" 0 DISPLAY_IDENTIFIER CDD_MotAgCmp.PerInstanceMemories.MotAgCmpMotAgBackEmf /end MEASUREMENT
/begin MEASUREMENT CDD_MotAgCmp.MotAgCmpMotCtrlMotAgCumvAlgndMrfRevSVPrev "MICROSAR RTE" SLONG RTE_CM_Ag8 0 0 0 0 ECU_ADDRESS 0 SYMBOL_LINK "Rte_CDD_MotAgCmp_MotAgCmpMotCtrlMotAgCumvAlgndMrfRevSVPrev" 0 DISPLAY_IDENTIFIER CDD_MotAgCmp.PerInstanceMemories.MotAgCmpMotCtrlMotAgCumvAlgndMrfRevSVPrev /end MEASUREMENT
/begin MEASUREMENT CDD_MotAgCmp.MotAgCmpMotCtrlMotAgMeclPrev "MICROSAR RTE" SLONG RTE_CM_Ag8 0 0 0 0 ECU_ADDRESS 0 SYMBOL_LINK "Rte_CDD_MotAgCmp_MotAgCmpMotCtrlMotAgMeclPrev" 0 DISPLAY_IDENTIFIER CDD_MotAgCmp.PerInstanceMemories.MotAgCmpMotCtrlMotAgMeclPrev /end MEASUREMENT
/begin MEASUREMENT CDD_MotAgCmp.MotAgCumvAlgndCrf.Val "MICROSAR RTE" SLONG RTE_CM_Ag7 0 0 0 0 ECU_ADDRESS 0 SYMBOL_LINK "Rte_CDD_MotAgCmp_MotAgCumvAlgndCrf_Val" 0 DISPLAY_IDENTIFIER CDD_MotAgCmp.SenderPorts.MotAgCumvAlgndCrf.Val /end MEASUREMENT
/begin MEASUREMENT CDD_MotAgCmp.MotAgCumvAlgndMrf.Val "MICROSAR RTE" SLONG RTE_CM_Ag7 0 0 0 0 ECU_ADDRESS 0 SYMBOL_LINK "Rte_CDD_MotAgCmp_MotAgCumvAlgndMrf_Val" 0 DISPLAY_IDENTIFIER CDD_MotAgCmp.SenderPorts.MotAgCumvAlgndMrf.Val /end MEASUREMENT
/begin MEASUREMENT CDD_MotAgCmp.MotAgCumvAlgndMrfRev.Val "MICROSAR RTE" SLONG RTE_CM_Ag8 0 0 0 0 ECU_ADDRESS 0 SYMBOL_LINK "Rte_CDD_MotCtrlMgr_MotAgCumvAlgndMrfRev_Val" 0 DISPLAY_IDENTIFIER CDD_MotAgCmp.ReceiverPorts.MotAgCumvAlgndMrfRev.Val /end MEASUREMENT
/begin MEASUREMENT CDD_MotCtrlMgr.Adc0ScanGroup2Ref0.Val "MICROSAR RTE" FLOAT32_IEEE NO_COMPU_METHOD 0 0 -3.402823466e+38 3.402823466e+38 ECU_ADDRESS 0 SYMBOL_LINK "Rte_CDD_MotCtrlMgr_Adc0ScanGroup2Ref0_Val" 0 DISPLAY_IDENTIFIER CDD_MotCtrlMgr.SenderPorts.Adc0ScanGroup2Ref0.Val /end MEASUREMENT
/begin MEASUREMENT CDD_MotCtrlMgr.Adc0ScanGroup2Ref1.Val "MICROSAR RTE" FLOAT32_IEEE NO_COMPU_METHOD 0 0 -3.402823466e+38 3.402823466e+38 ECU_ADDRESS 0 SYMBOL_LINK "Rte_CDD_MotCtrlMgr_Adc0ScanGroup2Ref1_Val" 0 DISPLAY_IDENTIFIER CDD_MotCtrlMgr.SenderPorts.Adc0ScanGroup2Ref1.Val /end MEASUREMENT
/begin MEASUREMENT CDD_MotCtrlMgr.Adc0ScanGroup3Ref0.Val "MICROSAR RTE" FLOAT32_IEEE NO_COMPU_METHOD 0 0 -3.402823466e+38 3.402823466e+38 ECU_ADDRESS 0 SYMBOL_LINK "Rte_CDD_MotCtrlMgr_Adc0ScanGroup3Ref0_Val" 0 DISPLAY_IDENTIFIER CDD_MotCtrlMgr.SenderPorts.Adc0ScanGroup3Ref0.Val /end MEASUREMENT
/begin MEASUREMENT CDD_MotCtrlMgr.Adc0ScanGroup3Ref1.Val "MICROSAR RTE" FLOAT32_IEEE NO_COMPU_METHOD 0 0 -3.402823466e+38 3.402823466e+38 ECU_ADDRESS 0 SYMBOL_LINK "Rte_CDD_MotCtrlMgr_Adc0ScanGroup3Ref1_Val" 0 DISPLAY_IDENTIFIER CDD_MotCtrlMgr.SenderPorts.Adc0ScanGroup3Ref1.Val /end MEASUREMENT
/begin MEASUREMENT CDD_MotCtrlMgr.Adc0SelfDiag0.Val "MICROSAR RTE" FLOAT32_IEEE NO_COMPU_METHOD 0 0 0.0 5.0 ECU_ADDRESS 0 SYMBOL_LINK "Rte_CDD_MotCtrlMgr_Adc0SelfDiag0_Val" 0 DISPLAY_IDENTIFIER CDD_MotCtrlMgr.SenderPorts.Adc0SelfDiag0.Val /end MEASUREMENT
/begin MEASUREMENT CDD_MotCtrlMgr.Adc0SelfDiag2.Val "MICROSAR RTE" FLOAT32_IEEE NO_COMPU_METHOD 0 0 0.0 5.0 ECU_ADDRESS 0 SYMBOL_LINK "Rte_CDD_MotCtrlMgr_Adc0SelfDiag2_Val" 0 DISPLAY_IDENTIFIER CDD_MotCtrlMgr.SenderPorts.Adc0SelfDiag2.Val /end MEASUREMENT
/begin MEASUREMENT CDD_MotCtrlMgr.Adc0SelfDiag4.Val "MICROSAR RTE" FLOAT32_IEEE NO_COMPU_METHOD 0 0 0.0 5.0 ECU_ADDRESS 0 SYMBOL_LINK "Rte_CDD_MotCtrlMgr_Adc0SelfDiag4_Val" 0 DISPLAY_IDENTIFIER CDD_MotCtrlMgr.SenderPorts.Adc0SelfDiag4.Val /end MEASUREMENT
/begin MEASUREMENT CDD_MotCtrlMgr.AdcDiagcEndPtrOutp.Val "MICROSAR RTE" UBYTE NO_COMPU_METHOD 0 0 0 255 ECU_ADDRESS 0 SYMBOL_LINK "Rte_CDD_AdcDiagc_AdcDiagcEndPtrOutp_Val" 0 DISPLAY_IDENTIFIER CDD_MotCtrlMgr.ReceiverPorts.AdcDiagcEndPtrOutp.Val /end MEASUREMENT
/begin MEASUREMENT CDD_MotCtrlMgr.AdcDiagcStrtPtrOutp.Val "MICROSAR RTE" UBYTE NO_COMPU_METHOD 0 0 0 255 ECU_ADDRESS 0 SYMBOL_LINK "Rte_CDD_AdcDiagc_AdcDiagcStrtPtrOutp_Val" 0 DISPLAY_IDENTIFIER CDD_MotCtrlMgr.ReceiverPorts.AdcDiagcStrtPtrOutp.Val /end MEASUREMENT
/begin MEASUREMENT CDD_MotCtrlMgr.BrdgVltg.Val "MICROSAR RTE" FLOAT32_IEEE NO_COMPU_METHOD 0 0 6.0 26.5 ECU_ADDRESS 0 SYMBOL_LINK "Rte_BattVltg_BrdgVltg_Val" 0 DISPLAY_IDENTIFIER CDD_MotCtrlMgr.ReceiverPorts.BrdgVltg.Val /end MEASUREMENT
/begin MEASUREMENT CDD_MotCtrlMgr.CurrMeasCorrlnSts.Val "MICROSAR RTE" UBYTE NO_COMPU_METHOD 0 0 0 255 ECU_ADDRESS 0 SYMBOL_LINK "Rte_CurrMeasCorrln_CurrMeasCorrlnSts_Val" 0 DISPLAY_IDENTIFIER CDD_MotCtrlMgr.ReceiverPorts.CurrMeasCorrlnSts.Val /end MEASUREMENT
/begin MEASUREMENT CDD_MotCtrlMgr.CurrMeasLoaMtgtnEna.Logl "MICROSAR RTE" UBYTE RTE_CM_BOOLEAN 0 0 0 255 ECU_ADDRESS 0 SYMBOL_LINK "Rte_LoaMgr_CurrMeasLoaMtgtnEna_Logl" 0 DISPLAY_IDENTIFIER CDD_MotCtrlMgr.ReceiverPorts.CurrMeasLoaMtgtnEna.Logl /end MEASUREMENT
/begin MEASUREMENT CDD_MotCtrlMgr.CurrMeasWrmIninTestCmpl.Logl "MICROSAR RTE" UBYTE RTE_CM_BOOLEAN 0 0 0 255 ECU_ADDRESS 0 SYMBOL_LINK "Rte_CDD_CurrMeas_CurrMeasWrmIninTestCmpl_Logl" 0 DISPLAY_IDENTIFIER CDD_MotCtrlMgr.ReceiverPorts.CurrMeasWrmIninTestCmpl.Logl /end MEASUREMENT
/begin MEASUREMENT CDD_MotCtrlMgr.DiagcStsIvtr1Inactv.Logl "MICROSAR RTE" UBYTE RTE_CM_BOOLEAN 0 0 0 255 ECU_ADDRESS 0 SYMBOL_LINK "Rte_DiagcMgr_DiagcStsIvtr1Inactv_Logl" 0 DISPLAY_IDENTIFIER CDD_MotCtrlMgr.ReceiverPorts.DiagcStsIvtr1Inactv.Logl /end MEASUREMENT
/begin MEASUREMENT CDD_MotCtrlMgr.DiagcStsIvtr2Inactv.Logl "MICROSAR RTE" UBYTE RTE_CM_BOOLEAN 0 0 0 255 ECU_ADDRESS 0 SYMBOL_LINK "Rte_DiagcMgr_DiagcStsIvtr2Inactv_Logl" 0 DISPLAY_IDENTIFIER CDD_MotCtrlMgr.ReceiverPorts.DiagcStsIvtr2Inactv.Logl /end MEASUREMENT
/begin MEASUREMENT CDD_MotCtrlMgr.EcuTFild.Val "MICROSAR RTE" FLOAT32_IEEE NO_COMPU_METHOD 0 0 -50.0 150.0 ECU_ADDRESS 0 SYMBOL_LINK "Rte_EcuTMeas_EcuTFild_Val" 0 DISPLAY_IDENTIFIER CDD_MotCtrlMgr.ReceiverPorts.EcuTFild.Val /end MEASUREMENT
/begin MEASUREMENT CDD_MotCtrlMgr.FastLoopCntr.Val "MICROSAR RTE" UWORD NO_COMPU_METHOD 0 0 0 65535 ECU_ADDRESS 0 SYMBOL_LINK "Rte_CDD_MotCtrlMgr_FastLoopCntr_Val" 0 DISPLAY_IDENTIFIER CDD_MotCtrlMgr.SenderPorts.FastLoopCntr.Val /end MEASUREMENT
/begin GROUP CDD_CurrMeas.MotCurrEolOffsProcFlg "MICROSAR RTE" /begin SUB_GROUP /end SUB_GROUP /begin FUNCTION_LIST /end FUNCTION_LIST /begin REF_CHARACTERISTIC /end REF_CHARACTERISTIC /begin REF_MEASUREMENT CDD_CurrMeas.MotCurrEolOffsProcFlg /end REF_MEASUREMENT /end GROUP
/begin GROUP CDD_CurrMeas.MotCurrOffsDeltaA "MICROSAR RTE" /begin SUB_GROUP /end SUB_GROUP /begin FUNCTION_LIST /end FUNCTION_LIST /begin REF_CHARACTERISTIC /end REF_CHARACTERISTIC /begin REF_MEASUREMENT CDD_CurrMeas.MotCurrOffsDeltaA /end REF_MEASUREMENT /end GROUP
/begin GROUP CDD_CurrMeas.MotCurrOffsDeltaB "MICROSAR RTE" /begin SUB_GROUP /end SUB_GROUP /begin FUNCTION_LIST /end FUNCTION_LIST /begin REF_CHARACTERISTIC /end REF_CHARACTERISTIC /begin REF_MEASUREMENT CDD_CurrMeas.MotCurrOffsDeltaB /end REF_MEASUREMENT /end GROUP
/begin GROUP CDD_CurrMeas.MotCurrOffsDeltaC "MICROSAR RTE" /begin SUB_GROUP /end SUB_GROUP /begin FUNCTION_LIST /end FUNCTION_LIST /begin REF_CHARACTERISTIC /end REF_CHARACTERISTIC /begin REF_MEASUREMENT CDD_CurrMeas.MotCurrOffsDeltaC /end REF_MEASUREMENT /end GROUP
/begin GROUP CDD_CurrMeas.MotCurrOffsDeltaD "MICROSAR RTE" /begin SUB_GROUP /end SUB_GROUP /begin FUNCTION_LIST /end FUNCTION_LIST /begin REF_CHARACTERISTIC /end REF_CHARACTERISTIC /begin REF_MEASUREMENT CDD_CurrMeas.MotCurrOffsDeltaD /end REF_MEASUREMENT /end GROUP
/begin GROUP CDD_CurrMeas.MotCurrOffsDeltaE "MICROSAR RTE" /begin SUB_GROUP /end SUB_GROUP /begin FUNCTION_LIST /end FUNCTION_LIST /begin REF_CHARACTERISTIC /end REF_CHARACTERISTIC /begin REF_MEASUREMENT CDD_CurrMeas.MotCurrOffsDeltaE /end REF_MEASUREMENT /end GROUP
/begin GROUP CDD_CurrMeas.MotCurrOffsDeltaF "MICROSAR RTE" /begin SUB_GROUP /end SUB_GROUP /begin FUNCTION_LIST /end FUNCTION_LIST /begin REF_CHARACTERISTIC /end REF_CHARACTERISTIC /begin REF_MEASUREMENT CDD_CurrMeas.MotCurrOffsDeltaF /end REF_MEASUREMENT /end GROUP
/begin GROUP CDD_CurrMeas.MotCurrOffsHiAvrgA "MICROSAR RTE" /begin SUB_GROUP /end SUB_GROUP /begin FUNCTION_LIST /end FUNCTION_LIST /begin REF_CHARACTERISTIC /end REF_CHARACTERISTIC /begin REF_MEASUREMENT CDD_CurrMeas.MotCurrOffsHiAvrgA /end REF_MEASUREMENT /end GROUP
/begin GROUP CDD_CurrMeas.MotCurrOffsHiAvrgB "MICROSAR RTE" /begin SUB_GROUP /end SUB_GROUP /begin FUNCTION_LIST /end FUNCTION_LIST /begin REF_CHARACTERISTIC /end REF_CHARACTERISTIC /begin REF_MEASUREMENT CDD_CurrMeas.MotCurrOffsHiAvrgB /end REF_MEASUREMENT /end GROUP
/begin GROUP CDD_CurrMeas.MotCurrOffsHiAvrgC "MICROSAR RTE" /begin SUB_GROUP /end SUB_GROUP /begin FUNCTION_LIST /end FUNCTION_LIST /begin REF_CHARACTERISTIC /end REF_CHARACTERISTIC /begin REF_MEASUREMENT CDD_CurrMeas.MotCurrOffsHiAvrgC /end REF_MEASUREMENT /end GROUP
/begin GROUP CDD_CurrMeas.MotCurrOffsHiAvrgD "MICROSAR RTE" /begin SUB_GROUP /end SUB_GROUP /begin FUNCTION_LIST /end FUNCTION_LIST /begin REF_CHARACTERISTIC /end REF_CHARACTERISTIC /begin REF_MEASUREMENT CDD_CurrMeas.MotCurrOffsHiAvrgD /end REF_MEASUREMENT /end GROUP
/begin GROUP CDD_CurrMeas.MotCurrOffsHiAvrgE "MICROSAR RTE" /begin SUB_GROUP /end SUB_GROUP /begin FUNCTION_LIST /end FUNCTION_LIST /begin REF_CHARACTERISTIC /end REF_CHARACTERISTIC /begin REF_MEASUREMENT CDD_CurrMeas.MotCurrOffsHiAvrgE /end REF_MEASUREMENT /end GROUP
/begin GROUP CDD_CurrMeas.MotCurrOffsHiAvrgF "MICROSAR RTE" /begin SUB_GROUP /end SUB_GROUP /begin FUNCTION_LIST /end FUNCTION_LIST /begin REF_CHARACTERISTIC /end REF_CHARACTERISTIC /begin REF_MEASUREMENT CDD_CurrMeas.MotCurrOffsHiAvrgF /end REF_MEASUREMENT /end GROUP
/begin GROUP CDD_CurrMeas.MotCurrOffsLoAvrgA "MICROSAR RTE" /begin SUB_GROUP /end SUB_GROUP /begin FUNCTION_LIST /end FUNCTION_LIST /begin REF_CHARACTERISTIC /end REF_CHARACTERISTIC /begin REF_MEASUREMENT CDD_CurrMeas.MotCurrOffsLoAvrgA /end REF_MEASUREMENT /end GROUP
/begin GROUP CDD_CurrMeas.MotCurrOffsLoAvrgB "MICROSAR RTE" /begin SUB_GROUP /end SUB_GROUP /begin FUNCTION_LIST /end FUNCTION_LIST /begin REF_CHARACTERISTIC /end REF_CHARACTERISTIC /begin REF_MEASUREMENT CDD_CurrMeas.MotCurrOffsLoAvrgB /end REF_MEASUREMENT /end GROUP
/begin GROUP CDD_CurrMeas.MotCurrOffsLoAvrgC "MICROSAR RTE" /begin SUB_GROUP /end SUB_GROUP /begin FUNCTION_LIST /end FUNCTION_LIST /begin REF_CHARACTERISTIC /end REF_CHARACTERISTIC /begin REF_MEASUREMENT CDD_CurrMeas.MotCurrOffsLoAvrgC /end REF_MEASUREMENT /end GROUP
/begin GROUP CDD_CurrMeas.MotCurrOffsLoAvrgD "MICROSAR RTE" /begin SUB_GROUP /end SUB_GROUP /begin FUNCTION_LIST /end FUNCTION_LIST /begin REF_CHARACTERISTIC /end REF_CHARACTERISTIC /begin REF_MEASUREMENT CDD_CurrMeas.MotCurrOffsLoAvrgD /end REF_MEASUREMENT /end GROUP
/begin GROUP CDD_CurrMeas.MotCurrOffsLoAvrgE "MICROSAR RTE" /begin SUB_GROUP /end SUB_GROUP /begin FUNCTION_LIST /end FUNCTION_LIST /begin REF_CHARACTERISTIC /end REF_CHARACTERISTIC /begin REF_MEASUREMENT CDD_CurrMeas.MotCurrOffsLoAvrgE /end REF_MEASUREMENT /end GROUP
/begin GROUP CDD_CurrMeas.MotCurrOffsLoAvrgF "MICROSAR RTE" /begin SUB_GROUP /end SUB_GROUP /begin FUNCTION_LIST /end FUNCTION_LIST /begin REF_CHARACTERISTIC /end REF_CHARACTERISTIC /begin REF_MEASUREMENT CDD_CurrMeas.MotCurrOffsLoAvrgF /end REF_MEASUREMENT /end GROUP
/begin GROUP CDD_CurrMeas.MotCurrOffsZeroAvrgA "MICROSAR RTE" /begin SUB_GROUP /end SUB_GROUP /begin FUNCTION_LIST /end FUNCTION_LIST /begin REF_CHARACTERISTIC /end REF_CHARACTERISTIC /begin REF_MEASUREMENT CDD_CurrMeas.MotCurrOffsZeroAvrgA /end REF_MEASUREMENT /end GROUP
/begin GROUP CDD_CurrMeas.MotCurrOffsZeroAvrgB "MICROSAR RTE" /begin SUB_GROUP /end SUB_GROUP /begin FUNCTION_LIST /end FUNCTION_LIST /begin REF_CHARACTERISTIC /end REF_CHARACTERISTIC /begin REF_MEASUREMENT CDD_CurrMeas.MotCurrOffsZeroAvrgB /end REF_MEASUREMENT /end GROUP
/begin GROUP CDD_CurrMeas.MotCurrOffsZeroAvrgC "MICROSAR RTE" /begin SUB_GROUP /end SUB_GROUP /begin FUNCTION_LIST /end FUNCTION_LIST /begin REF_CHARACTERISTIC /end REF_CHARACTERISTIC /begin REF_MEASUREMENT CDD_CurrMeas.MotCurrOffsZeroAvrgC /end REF_MEASUREMENT /end GROUP
/begin GROUP CDD_CurrMeas.MotCurrOffsZeroAvrgD "MICROSAR RTE" /begin SUB_GROUP /end SUB_GROUP /begin FUNCTION_LIST /end FUNCTION_LIST /begin REF_CHARACTERISTIC /end REF_CHARACTERISTIC /begin REF_MEASUREMENT CDD_CurrMeas.MotCurrOffsZeroAvrgD /end REF_MEASUREMENT /end GROUP
/begin GROUP CDD_CurrMeas.MotCurrOffsZeroAvrgE "MICROSAR RTE" /begin SUB_GROUP /end SUB_GROUP /begin FUNCTION_LIST /end FUNCTION_LIST /begin REF_CHARACTERISTIC /end REF_CHARACTERISTIC /begin REF_MEASUREMENT CDD_CurrMeas.MotCurrOffsZeroAvrgE /end REF_MEASUREMENT /end GROUP
/begin GROUP CDD_CurrMeas.MotCurrOffsZeroAvrgF "MICROSAR RTE" /begin SUB_GROUP /end SUB_GROUP /begin FUNCTION_LIST /end FUNCTION_LIST /begin REF_CHARACTERISTIC /end REF_CHARACTERISTIC /begin REF_MEASUREMENT CDD_CurrMeas.MotCurrOffsZeroAvrgF /end REF_MEASUREMENT /end GROUP
/begin GROUP CDD_CurrMeas.MotCurrQlfr1.Val "MICROSAR RTE" /begin SUB_GROUP /end SUB_GROUP /begin FUNCTION_LIST /end FUNCTION_LIST /begin REF_CHARACTERISTIC /end REF_CHARACTERISTIC /begin REF_MEASUREMENT CDD_CurrMeas.MotCurrQlfr1.Val /end REF_MEASUREMENT /end GROUP
/begin GROUP CDD_CurrMeas.MotCurrQlfr2.Val "MICROSAR RTE" /begin SUB_GROUP /end SUB_GROUP /begin FUNCTION_LIST /end FUNCTION_LIST /begin REF_CHARACTERISTIC /end REF_CHARACTERISTIC /begin REF_MEASUREMENT CDD_CurrMeas.MotCurrQlfr2.Val /end REF_MEASUREMENT /end GROUP
/begin GROUP CDD_CurrMeas.MotCurrRollgCnt1Prev "MICROSAR RTE" /begin SUB_GROUP /end SUB_GROUP /begin FUNCTION_LIST /end FUNCTION_LIST /begin REF_CHARACTERISTIC /end REF_CHARACTERISTIC /begin REF_MEASUREMENT CDD_CurrMeas.MotCurrRollgCnt1Prev /end REF_MEASUREMENT /end GROUP
/begin GROUP CDD_CurrMeas.MotCurrRollgCnt2Prev "MICROSAR RTE" /begin SUB_GROUP /end SUB_GROUP /begin FUNCTION_LIST /end FUNCTION_LIST /begin REF_CHARACTERISTIC /end REF_CHARACTERISTIC /begin REF_MEASUREMENT CDD_CurrMeas.MotCurrRollgCnt2Prev /end REF_MEASUREMENT /end GROUP
/begin GROUP CDD_CurrMeas.MotCurrSumAPrev "MICROSAR RTE" /begin SUB_GROUP /end SUB_GROUP /begin FUNCTION_LIST /end FUNCTION_LIST /begin REF_CHARACTERISTIC /end REF_CHARACTERISTIC /begin REF_MEASUREMENT CDD_CurrMeas.MotCurrSumAPrev /end REF_MEASUREMENT /end GROUP
/begin GROUP CDD_CurrMeas.MotCurrSumBPrev "MICROSAR RTE" /begin SUB_GROUP /end SUB_GROUP /begin FUNCTION_LIST /end FUNCTION_LIST /begin REF_CHARACTERISTIC /end REF_CHARACTERISTIC /begin REF_MEASUREMENT CDD_CurrMeas.MotCurrSumBPrev /end REF_MEASUREMENT /end GROUP
/begin GROUP CDD_CurrMeas.MotCurrSumCPrev "MICROSAR RTE" /begin SUB_GROUP /end SUB_GROUP /begin FUNCTION_LIST /end FUNCTION_LIST /begin REF_CHARACTERISTIC /end REF_CHARACTERISTIC /begin REF_MEASUREMENT CDD_CurrMeas.MotCurrSumCPrev /end REF_MEASUREMENT /end GROUP
/begin GROUP CDD_CurrMeas.MotCurrSumDPrev "MICROSAR RTE" /begin SUB_GROUP /end SUB_GROUP /begin FUNCTION_LIST /end FUNCTION_LIST /begin REF_CHARACTERISTIC /end REF_CHARACTERISTIC /begin REF_MEASUREMENT CDD_CurrMeas.MotCurrSumDPrev /end REF_MEASUREMENT /end GROUP
/begin GROUP CDD_CurrMeas.MotCurrSumEPrev "MICROSAR RTE" /begin SUB_GROUP /end SUB_GROUP /begin FUNCTION_LIST /end FUNCTION_LIST /begin REF_CHARACTERISTIC /end REF_CHARACTERISTIC /begin REF_MEASUREMENT CDD_CurrMeas.MotCurrSumEPrev /end REF_MEASUREMENT /end GROUP
/begin GROUP CDD_CurrMeas.MotCurrSumFPrev "MICROSAR RTE" /begin SUB_GROUP /end SUB_GROUP /begin FUNCTION_LIST /end FUNCTION_LIST /begin REF_CHARACTERISTIC /end REF_CHARACTERISTIC /begin REF_MEASUREMENT CDD_CurrMeas.MotCurrSumFPrev /end REF_MEASUREMENT /end GROUP
/begin GROUP CDD_CurrMeas.MotVelMrf.Val "MICROSAR RTE" /begin SUB_GROUP /end SUB_GROUP /begin FUNCTION_LIST /end FUNCTION_LIST /begin REF_CHARACTERISTIC /end REF_CHARACTERISTIC /begin REF_MEASUREMENT CDD_CurrMeas.MotVelMrf.Val /end REF_MEASUREMENT /end GROUP
/begin GROUP CDD_CurrMeas.Ntc5DErrCnt.Val "MICROSAR RTE" /begin SUB_GROUP /end SUB_GROUP /begin FUNCTION_LIST /end FUNCTION_LIST /begin REF_CHARACTERISTIC /end REF_CHARACTERISTIC /begin REF_MEASUREMENT CDD_CurrMeas.Ntc5DErrCnt.Val /end REF_MEASUREMENT /end GROUP
/begin GROUP CDD_CurrMeas.Ntc5DErrCnt2MilliSecPrev "MICROSAR RTE" /begin SUB_GROUP /end SUB_GROUP /begin FUNCTION_LIST /end FUNCTION_LIST /begin REF_CHARACTERISTIC /end REF_CHARACTERISTIC /begin REF_MEASUREMENT CDD_CurrMeas.Ntc5DErrCnt2MilliSecPrev /end REF_MEASUREMENT /end GROUP
/begin GROUP CDD_CurrMeas.Ntc6DErrCnt.Val "MICROSAR RTE" /begin SUB_GROUP /end SUB_GROUP /begin FUNCTION_LIST /end FUNCTION_LIST /begin REF_CHARACTERISTIC /end REF_CHARACTERISTIC /begin REF_MEASUREMENT CDD_CurrMeas.Ntc6DErrCnt.Val /end REF_MEASUREMENT /end GROUP
/begin GROUP CDD_CurrMeas.Ntc6DErrCnt2MilliSecPrev "MICROSAR RTE" /begin SUB_GROUP /end SUB_GROUP /begin FUNCTION_LIST /end FUNCTION_LIST /begin REF_CHARACTERISTIC /end REF_CHARACTERISTIC /begin REF_MEASUREMENT CDD_CurrMeas.Ntc6DErrCnt2MilliSecPrev /end REF_MEASUREMENT /end GROUP
/begin GROUP CDD_CurrMeas.OffsEolAvrgCntrPrev "MICROSAR RTE" /begin SUB_GROUP /end SUB_GROUP /begin FUNCTION_LIST /end FUNCTION_LIST /begin REF_CHARACTERISTIC /end REF_CHARACTERISTIC /begin REF_MEASUREMENT CDD_CurrMeas.OffsEolAvrgCntrPrev /end REF_MEASUREMENT /end GROUP
/begin GROUP CDD_CurrMeas.PerInstanceMemories "MICROSAR RTE"
 /begin SUB_GROUP CDD_CurrMeas.BrdgVltgSumPrev CDD_CurrMeas.CurrMeasEolGainCalSet CDD_CurrMeas.CurrMeasEolOffsCalSet CDD_CurrMeas.EolGainSts CDD_CurrMeas.EolOffsHiBrdgVltg CDD_CurrMeas.EolOffsSts CDD_CurrMeas.EolTranCntrPrev CDD_CurrMeas.GainEolAvrgCntrPrev CDD_CurrMeas.MotCtrlNtc5DErrCntPrev CDD_CurrMeas.MotCtrlNtc6DErrCntPrev CDD_CurrMeas.MotCurrEolCalStPrev CDD_CurrMeas.MotCurrEolGainA CDD_CurrMeas.MotCurrEolGainB CDD_CurrMeas.MotCurrEolGainC CDD_CurrMeas.MotCurrEolGainD CDD_CurrMeas.MotCurrEolGainE CDD_CurrMeas.MotCurrEolGainF CDD_CurrMeas.MotCurrEolOffsProcFlg CDD_CurrMeas.MotCurrOffsDeltaA CDD_CurrMeas.MotCurrOffsDeltaB CDD_CurrMeas.MotCurrOffsDeltaC CDD_CurrMeas.MotCurrOffsDeltaD CDD_CurrMeas.MotCurrOffsDeltaE CDD_CurrMeas.MotCurrOffsDeltaF CDD_CurrMeas.MotCurrOffsHiAvrgA CDD_CurrMeas.MotCurrOffsHiAvrgB CDD_CurrMeas.MotCurrOffsHiAvrgC CDD_CurrMeas.MotCurrOffsHiAvrgD CDD_CurrMeas.MotCurrOffsHiAvrgE CDD_CurrMeas.MotCurrOffsHiAvrgF CDD_CurrMeas.MotCurrOffsLoAvrgA CDD_CurrMeas.MotCurrOffsLoAvrgB CDD_CurrMeas.MotCurrOffsLoAvrgC CDD_CurrMeas.MotCurrOffsLoAvrgD CDD_CurrMeas.MotCurrOffsLoAvrgE CDD_CurrMeas.MotCurrOffsLoAvrgF CDD_CurrMeas.MotCurrOffsZeroAvrgA CDD_CurrMeas.MotCurrOffsZeroAvrgB CDD_CurrMeas.MotCurrOffsZeroAvrgC CDD_CurrMeas.MotCurrOffsZeroAvrgD CDD_CurrMeas.MotCurrOffsZeroAvrgE CDD_CurrMeas.MotCurrOffsZeroAvrgF CDD_CurrMeas.MotCurrRollgCnt1Prev CDD_CurrMeas.MotCurrRollgCnt2Prev CDD_CurrMeas.MotCurrSumAPrev CDD_CurrMeas.MotCurrSumBPrev CDD_CurrMeas.MotCurrSumCPrev CDD_CurrMeas.MotCurrSumDPrev CDD_CurrMeas.MotCurrSumEPrev CDD_CurrMeas.MotCurrSumFPrev CDD_CurrMeas.Ntc5DErrCnt2MilliSecPrev CDD_CurrMeas.Ntc6DErrCnt2MilliSecPrev CDD_CurrMeas.OffsEolAvrgCntrPrev CDD_CurrMeas.PhaOnTiErrCntPrev CDD_CurrMeas.TempMotCurrAdcVlySum1Prev CDD_CurrMeas.TempMotCurrAdcVlySum2Prev CDD_CurrMeas.WrmIninTestCmplPrev /end SUB_GROUP
 /begin FUNCTION_LIST /end FUNCTION_LIST
 /begin REF_CHARACTERISTIC /end REF_CHARACTERISTIC
 /begin REF_MEASUREMENT /end REF_MEASUREMENT
/end GROUP
/begin GROUP CDD_CurrMeas.PhaOnTiErrCntPrev "MICROSAR RTE" /begin SUB_GROUP /end SUB_GROUP /begin FUNCTION_LIST /end FUNCTION_LIST /begin REF_CHARACTERISTIC /end REF_CHARACTERISTIC /begin REF_MEASUREMENT CDD_CurrMeas.PhaOnTiErrCntPrev /end REF_MEASUREMENT /end GROUP
/begin GROUP CDD_CurrMeas.ReceiverPorts "MICROSAR RTE"
 /begin SUB_GROUP CDD_CurrMeas.BrdgVltg.Val CDD_CurrMeas.DiagcStsIvtr1Inactv.Logl CDD_CurrMeas.DiagcStsIvtr2Inactv.Logl CDD_CurrMeas.MotCurrAdcVlyA.Val CDD_CurrMeas.MotCurrAdcVlyB.Val CDD_CurrMeas.MotCurrAdcVlyC.Val CDD_CurrMeas.MotCurrAdcVlyD.Val CDD_CurrMeas.MotCurrAdcVlyE.Val CDD_CurrMeas.MotCurrAdcVlyF.Val CDD_CurrMeas.MotVelMrf.Val CDD_CurrMeas.Ntc5DErrCnt.Val CDD_CurrMeas.Ntc6DErrCnt.Val CDD_CurrMeas.StrtUpSt.Val CDD_CurrMeas.SysSt.Val CDD_CurrMeas.VehSpd.Val CDD_CurrMeas.VehSpdVld.Logl /end SUB_GROUP
 /begin FUNCTION_LIST /end FUNCTION_LIST
 /begin REF_CHARACTERISTIC /end REF_CHARACTERISTIC
 /begin REF_MEASUREMENT /end REF_MEASUREMENT
/end GROUP
/begin GROUP CDD_CurrMeas.SenderPorts "MICROSAR RTE"
 /begin SUB_GROUP CDD_CurrMeas.CurrMeasWrmIninTestCmpl.Logl CDD_CurrMeas.MotCurrEolCalSt.Val CDD_CurrMeas.MotCurrQlfr1.Val CDD_CurrMeas.MotCurrQlfr2.Val /end SUB_GROUP
 /begin FUNCTION_LIST /end FUNCTION_LIST
 /begin REF_CHARACTERISTIC /end REF_CHARACTERISTIC
 /begin REF_MEASUREMENT /end REF_MEASUREMENT
/end GROUP
/begin GROUP CDD_CurrMeas.StrtUpSt.Val "MICROSAR RTE" /begin SUB_GROUP /end SUB_GROUP /begin FUNCTION_LIST /end FUNCTION_LIST /begin REF_CHARACTERISTIC /end REF_CHARACTERISTIC /begin REF_MEASUREMENT CDD_CurrMeas.StrtUpSt.Val /end REF_MEASUREMENT /end GROUP
/begin GROUP CDD_CurrMeas.SysGlbPrmMotPoleCnt.Val "MICROSAR RTE" /begin SUB_GROUP /end SUB_GROUP /begin FUNCTION_LIST /end FUNCTION_LIST /begin REF_CHARACTERISTIC CDD_CurrMeas.SysGlbPrmMotPoleCnt.Val /end REF_CHARACTERISTIC /begin REF_MEASUREMENT /end REF_MEASUREMENT /end GROUP
/begin GROUP CDD_CurrMeas.SysSt.Val "MICROSAR RTE" /begin SUB_GROUP /end SUB_GROUP /begin FUNCTION_LIST /end FUNCTION_LIST /begin REF_CHARACTERISTIC /end REF_CHARACTERISTIC /begin REF_MEASUREMENT CDD_CurrMeas.SysSt.Val /end REF_MEASUREMENT /end GROUP
/begin GROUP CDD_CurrMeas.TempMotCurrAdcVlySum1Prev "MICROSAR RTE" /begin SUB_GROUP /end SUB_GROUP /begin FUNCTION_LIST /end FUNCTION_LIST /begin REF_CHARACTERISTIC /end REF_CHARACTERISTIC /begin REF_MEASUREMENT CDD_CurrMeas.TempMotCurrAdcVlySum1Prev /end REF_MEASUREMENT /end GROUP
/begin GROUP CDD_CurrMeas.TempMotCurrAdcVlySum2Prev "MICROSAR RTE" /begin SUB_GROUP /end SUB_GROUP /begin FUNCTION_LIST /end FUNCTION_LIST /begin REF_CHARACTERISTIC /end REF_CHARACTERISTIC /begin REF_MEASUREMENT CDD_CurrMeas.TempMotCurrAdcVlySum2Prev /end REF_MEASUREMENT /end GROUP
/begin GROUP CDD_CurrMeas.VehSpd.Val "MICROSAR RTE" /begin SUB_GROUP /end SUB_GROUP /begin FUNCTION_LIST /end FUNCTION_LIST /begin REF_CHARACTERISTIC /end REF_CHARACTERISTIC /begin REF_MEASUREMENT CDD_CurrMeas.VehSpd.Val /end REF_MEASUREMENT /end GROUP
/begin GROUP CDD_CurrMeas.VehSpdVld.Logl "MICROSAR RTE" /begin SUB_GROUP /end SUB_GROUP /begin FUNCTION_LIST /end FUNCTION_LIST /begin REF_CHARACTERISTIC /end REF_CHARACTERISTIC /begin REF_MEASUREMENT CDD_CurrMeas.VehSpdVld.Logl /end REF_MEASUREMENT /end GROUP
/begin GROUP CDD_CurrMeas.WrmIninTestCmplPrev "MICROSAR RTE" /begin SUB_GROUP /end SUB_GROUP /begin FUNCTION_LIST /end FUNCTION_LIST /begin REF_CHARACTERISTIC /end REF_CHARACTERISTIC /begin REF_MEASUREMENT CDD_CurrMeas.WrmIninTestCmplPrev /end REF_MEASUREMENT /end GROUP
/begin GROUP CDD_CurrMeasArbn "MICROSAR RTE"
 /begin SUB_GROUP CDD_CurrMeasArbn.CalibrationPorts CDD_CurrMeasArbn.PerInstanceMemories /end SUB_GROUP
 /begin FUNCTION_LIST /end FUNCTION_LIST
 /begin REF_CHARACTERISTIC /end REF_CHARACTERISTIC
 /begin REF_MEASUREMENT /end REF_MEASUREMENT
/end GROUP
/begin GROUP CDD_CurrMeasArbn.CalibrationPorts "MICROSAR RTE" /begin SUB_GROUP CDD_CurrMeasArbn.CurrMeasArbnMaxStallCntr.Val /end SUB_GROUP /begin FUNCTION_LIST /end FUNCTION_LIST /begin REF_CHARACTERISTIC /end REF_CHARACTERISTIC /begin REF_MEASUREMENT /end REF_MEASUREMENT /end GROUP
/begin GROUP CDD_CurrMeasArbn.CurrMeasArbnMaxStallCntr.Val "MICROSAR RTE" /begin SUB_GROUP /end SUB_GROUP /begin FUNCTION_LIST /end FUNCTION_LIST /begin REF_CHARACTERISTIC CDD_CurrMeasArbn.CurrMeasArbnMaxStallCntr.Val /end REF_CHARACTERISTIC /begin REF_MEASUREMENT /end REF_MEASUREMENT /end GROUP
/begin GROUP CDD_CurrMeasArbn.CurrMeasArbnSens0RollgCntPrev "MICROSAR RTE" /begin SUB_GROUP /end SUB_GROUP /begin FUNCTION_LIST /end FUNCTION_LIST /begin REF_CHARACTERISTIC /end REF_CHARACTERISTIC /begin REF_MEASUREMENT CDD_CurrMeasArbn.CurrMeasArbnSens0RollgCntPrev /end REF_MEASUREMENT /end GROUP
/begin GROUP CDD_CurrMeasArbn.CurrMeasArbnSens0StallCntPrev "MICROSAR RTE" /begin SUB_GROUP /end SUB_GROUP /begin FUNCTION_LIST /end FUNCTION_LIST /begin REF_CHARACTERISTIC /end REF_CHARACTERISTIC /begin REF_MEASUREMENT CDD_CurrMeasArbn.CurrMeasArbnSens0StallCntPrev /end REF_MEASUREMENT /end GROUP
/begin GROUP CDD_CurrMeasArbn.CurrMeasArbnSens1RollgCntPrev "MICROSAR RTE" /begin SUB_GROUP /end SUB_GROUP /begin FUNCTION_LIST /end FUNCTION_LIST /begin REF_CHARACTERISTIC /end REF_CHARACTERISTIC /begin REF_MEASUREMENT CDD_CurrMeasArbn.CurrMeasArbnSens1RollgCntPrev /end REF_MEASUREMENT /end GROUP
/begin GROUP CDD_CurrMeasArbn.CurrMeasArbnSens1StallCntPrev "MICROSAR RTE" /begin SUB_GROUP /end SUB_GROUP /begin FUNCTION_LIST /end FUNCTION_LIST /begin REF_CHARACTERISTIC /end REF_CHARACTERISTIC /begin REF_MEASUREMENT CDD_CurrMeasArbn.CurrMeasArbnSens1StallCntPrev /end REF_MEASUREMENT /end GROUP
/begin GROUP CDD_CurrMeasArbn.PerInstanceMemories "MICROSAR RTE"
 /begin SUB_GROUP CDD_CurrMeasArbn.CurrMeasArbnSens0RollgCntPrev CDD_CurrMeasArbn.CurrMeasArbnSens0StallCntPrev CDD_CurrMeasArbn.CurrMeasArbnSens1RollgCntPrev CDD_CurrMeasArbn.CurrMeasArbnSens1StallCntPrev /end SUB_GROUP
 /begin FUNCTION_LIST /end FUNCTION_LIST
 /begin REF_CHARACTERISTIC /end REF_CHARACTERISTIC
 /begin REF_MEASUREMENT /end REF_MEASUREMENT
/end GROUP
/begin GROUP CDD_DmaCfgAndUse "MICROSAR RTE" /begin SUB_GROUP CDD_DmaCfgAndUse.PerInstanceMemories /end SUB_GROUP /begin FUNCTION_LIST /end FUNCTION_LIST /begin REF_CHARACTERISTIC /end REF_CHARACTERISTIC /begin REF_MEASUREMENT /end REF_MEASUREMENT /end GROUP
/begin GROUP CDD_DmaCfgAndUse.DmaCfgAndUse2MilliSecAdcStrtTi "MICROSAR RTE" /begin SUB_GROUP /end SUB_GROUP /begin FUNCTION_LIST /end FUNCTION_LIST /begin REF_CHARACTERISTIC /end REF_CHARACTERISTIC /begin REF_MEASUREMENT CDD_DmaCfgAndUse.DmaCfgAndUse2MilliSecAdcStrtTi /end REF_MEASUREMENT /end GROUP
/begin GROUP CDD_DmaCfgAndUse.PerInstanceMemories "MICROSAR RTE"
 /begin SUB_GROUP CDD_DmaCfgAndUse.DmaCfgAndUse2MilliSecAdcStrtTi CDD_DmaCfgAndUse.d2MilliSecAdcActDmaTrfTi CDD_DmaCfgAndUse.d2MilliSecAdcMaxDmaTrfTi /end SUB_GROUP
 /begin FUNCTION_LIST /end FUNCTION_LIST
 /begin REF_CHARACTERISTIC /end REF_CHARACTERISTIC
 /begin REF_MEASUREMENT /end REF_MEASUREMENT
/end GROUP
/begin GROUP CDD_DmaCfgAndUse.d2MilliSecAdcActDmaTrfTi "MICROSAR RTE" /begin SUB_GROUP /end SUB_GROUP /begin FUNCTION_LIST /end FUNCTION_LIST /begin REF_CHARACTERISTIC /end REF_CHARACTERISTIC /begin REF_MEASUREMENT CDD_DmaCfgAndUse.d2MilliSecAdcActDmaTrfTi /end REF_MEASUREMENT /end GROUP
/begin GROUP CDD_DmaCfgAndUse.d2MilliSecAdcMaxDmaTrfTi "MICROSAR RTE" /begin SUB_GROUP /end SUB_GROUP /begin FUNCTION_LIST /end FUNCTION_LIST /begin REF_CHARACTERISTIC /end REF_CHARACTERISTIC /begin REF_MEASUREMENT CDD_DmaCfgAndUse.d2MilliSecAdcMaxDmaTrfTi /end REF_MEASUREMENT /end GROUP
/begin GROUP CDD_FlsMem "MICROSAR RTE" /begin SUB_GROUP CDD_FlsMem.PerInstanceMemories CDD_FlsMem.SenderPorts /end SUB_GROUP /begin FUNCTION_LIST /end FUNCTION_LIST /begin REF_CHARACTERISTIC /end REF_CHARACTERISTIC /begin REF_MEASUREMENT /end REF_MEASUREMENT /end GROUP
/begin GROUP CDD_FlsMem.CodFlsCrcChkCmpl.Logl "MICROSAR RTE" /begin SUB_GROUP /end SUB_GROUP /begin FUNCTION_LIST /end FUNCTION_LIST /begin REF_CHARACTERISTIC /end REF_CHARACTERISTIC /begin REF_MEASUREMENT CDD_FlsMem.CodFlsCrcChkCmpl.Logl /end REF_MEASUREMENT /end GROUP
/begin GROUP CDD_FlsMem.CodFlsCrcChkStrtTi "MICROSAR RTE" /begin SUB_GROUP /end SUB_GROUP /begin FUNCTION_LIST /end FUNCTION_LIST /begin REF_CHARACTERISTIC /end REF_CHARACTERISTIC /begin REF_MEASUREMENT CDD_FlsMem.CodFlsCrcChkStrtTi /end REF_MEASUREMENT /end GROUP
/begin GROUP CDD_FlsMem.CodFlsSngBitErr "MICROSAR RTE" /begin SUB_GROUP /end SUB_GROUP /begin FUNCTION_LIST /end FUNCTION_LIST /begin REF_CHARACTERISTIC /end REF_CHARACTERISTIC /begin REF_MEASUREMENT CDD_FlsMem.CodFlsSngBitErr /end REF_MEASUREMENT /end GROUP
/begin GROUP CDD_FlsMem.CrcChkCmpl "MICROSAR RTE" /begin SUB_GROUP /end SUB_GROUP /begin FUNCTION_LIST /end FUNCTION_LIST /begin REF_CHARACTERISTIC /end REF_CHARACTERISTIC /begin REF_MEASUREMENT CDD_FlsMem.CrcChkCmpl /end REF_MEASUREMENT /end GROUP
/begin GROUP CDD_FlsMem.CrcHwIdxKey "MICROSAR RTE" /begin SUB_GROUP /end SUB_GROUP /begin FUNCTION_LIST /end FUNCTION_LIST /begin REF_CHARACTERISTIC /end REF_CHARACTERISTIC /begin REF_MEASUREMENT CDD_FlsMem.CrcHwIdxKey /end REF_MEASUREMENT /end GROUP
/begin GROUP CDD_FlsMem.PerInstanceMemories "MICROSAR RTE"
 /begin SUB_GROUP CDD_FlsMem.CodFlsCrcChkStrtTi CDD_FlsMem.CodFlsSngBitErr CDD_FlsMem.CrcChkCmpl CDD_FlsMem.CrcHwIdxKey CDD_FlsMem.PwrOnRstCrcChkCmpl /end SUB_GROUP
 /begin FUNCTION_LIST /end FUNCTION_LIST
 /begin REF_CHARACTERISTIC /end REF_CHARACTERISTIC
 /begin REF_MEASUREMENT /end REF_MEASUREMENT
/end GROUP
/begin GROUP CDD_FlsMem.PwrOnRstCrcChkCmpl "MICROSAR RTE" /begin SUB_GROUP /end SUB_GROUP /begin FUNCTION_LIST /end FUNCTION_LIST /begin REF_CHARACTERISTIC /end REF_CHARACTERISTIC /begin REF_MEASUREMENT CDD_FlsMem.PwrOnRstCrcChkCmpl /end REF_MEASUREMENT /end GROUP
/begin GROUP CDD_FlsMem.SenderPorts "MICROSAR RTE" /begin SUB_GROUP CDD_FlsMem.CodFlsCrcChkCmpl.Logl /end SUB_GROUP /begin FUNCTION_LIST /end FUNCTION_LIST /begin REF_CHARACTERISTIC /end REF_CHARACTERISTIC /begin REF_MEASUREMENT /end REF_MEASUREMENT /end GROUP
/begin GROUP CDD_GmG2kcaMcuCfg "MICROSAR RTE"
 /begin SUB_GROUP CDD_GmG2kcaMcuCfg.ReceiverPorts CDD_GmG2kcaMcuCfg.SenderPorts /end SUB_GROUP
 /begin FUNCTION_LIST /end FUNCTION_LIST
 /begin REF_CHARACTERISTIC /end REF_CHARACTERISTIC
 /begin REF_MEASUREMENT /end REF_MEASUREMENT
/end GROUP
/begin GROUP CDD_GmG2kcaMcuCfg.Adc0Faild.Logl "MICROSAR RTE" /begin SUB_GROUP /end SUB_GROUP /begin FUNCTION_LIST /end FUNCTION_LIST /begin REF_CHARACTERISTIC /end REF_CHARACTERISTIC /begin REF_MEASUREMENT CDD_GmG2kcaMcuCfg.Adc0Faild.Logl /end REF_MEASUREMENT /end GROUP
/begin GROUP CDD_GmG2kcaMcuCfg.Adc1Faild.Logl "MICROSAR RTE" /begin SUB_GROUP /end SUB_GROUP /begin FUNCTION_LIST /end FUNCTION_LIST /begin REF_CHARACTERISTIC /end REF_CHARACTERISTIC /begin REF_MEASUREMENT CDD_GmG2kcaMcuCfg.Adc1Faild.Logl /end REF_MEASUREMENT /end GROUP
/begin GROUP CDD_GmG2kcaMcuCfg.Adc1ScanGroup2Ref0.Val "MICROSAR RTE" /begin SUB_GROUP /end SUB_GROUP /begin FUNCTION_LIST /end FUNCTION_LIST /begin REF_CHARACTERISTIC /end REF_CHARACTERISTIC /begin REF_MEASUREMENT CDD_GmG2kcaMcuCfg.Adc1ScanGroup2Ref0.Val /end REF_MEASUREMENT /end GROUP
/begin GROUP CDD_GmG2kcaMcuCfg.Adc1ScanGroup2Ref1.Val "MICROSAR RTE" /begin SUB_GROUP /end SUB_GROUP /begin FUNCTION_LIST /end FUNCTION_LIST /begin REF_CHARACTERISTIC /end REF_CHARACTERISTIC /begin REF_MEASUREMENT CDD_GmG2kcaMcuCfg.Adc1ScanGroup2Ref1.Val /end REF_MEASUREMENT /end GROUP
/begin GROUP CDD_GmG2kcaMcuCfg.Adc1ScanGroup3Ref0.Val "MICROSAR RTE" /begin SUB_GROUP /end SUB_GROUP /begin FUNCTION_LIST /end FUNCTION_LIST /begin REF_CHARACTERISTIC /end REF_CHARACTERISTIC /begin REF_MEASUREMENT CDD_GmG2kcaMcuCfg.Adc1ScanGroup3Ref0.Val /end REF_MEASUREMENT /end GROUP
/begin GROUP CDD_GmG2kcaMcuCfg.Adc1ScanGroup3Ref1.Val "MICROSAR RTE" /begin SUB_GROUP /end SUB_GROUP /begin FUNCTION_LIST /end FUNCTION_LIST /begin REF_CHARACTERISTIC /end REF_CHARACTERISTIC /begin REF_MEASUREMENT CDD_GmG2kcaMcuCfg.Adc1ScanGroup3Ref1.Val /end REF_MEASUREMENT /end GROUP
/begin GROUP CDD_GmG2kcaMcuCfg.Adc1SelfDiag0.Val "MICROSAR RTE" /begin SUB_GROUP /end SUB_GROUP /begin FUNCTION_LIST /end FUNCTION_LIST /begin REF_CHARACTERISTIC /end REF_CHARACTERISTIC /begin REF_MEASUREMENT CDD_GmG2kcaMcuCfg.Adc1SelfDiag0.Val /end REF_MEASUREMENT /end GROUP
/begin GROUP CDD_GmG2kcaMcuCfg.Adc1SelfDiag2.Val "MICROSAR RTE" /begin SUB_GROUP /end SUB_GROUP /begin FUNCTION_LIST /end FUNCTION_LIST /begin REF_CHARACTERISTIC /end REF_CHARACTERISTIC /begin REF_MEASUREMENT CDD_GmG2kcaMcuCfg.Adc1SelfDiag2.Val /end REF_MEASUREMENT /end GROUP
/begin GROUP CDD_GmG2kcaMcuCfg.Adc1SelfDiag4.Val "MICROSAR RTE" /begin SUB_GROUP /end SUB_GROUP /begin FUNCTION_LIST /end FUNCTION_LIST /begin REF_CHARACTERISTIC /end REF_CHARACTERISTIC /begin REF_MEASUREMENT CDD_GmG2kcaMcuCfg.Adc1SelfDiag4.Val /end REF_MEASUREMENT /end GROUP
/begin GROUP CDD_GmG2kcaMcuCfg.BattVltg.Val "MICROSAR RTE" /begin SUB_GROUP /end SUB_GROUP /begin FUNCTION_LIST /end FUNCTION_LIST /begin REF_CHARACTERISTIC /end REF_CHARACTERISTIC /begin REF_MEASUREMENT CDD_GmG2kcaMcuCfg.BattVltg.Val /end REF_MEASUREMENT /end GROUP
/begin GROUP CDD_GmG2kcaMcuCfg.BattVltgAdcFaild.Logl "MICROSAR RTE" /begin SUB_GROUP /end SUB_GROUP /begin FUNCTION_LIST /end FUNCTION_LIST /begin REF_CHARACTERISTIC /end REF_CHARACTERISTIC /begin REF_MEASUREMENT CDD_GmG2kcaMcuCfg.BattVltgAdcFaild.Logl /end REF_MEASUREMENT /end GROUP
/begin GROUP CDD_GmG2kcaMcuCfg.BattVltgSwd1.Val "MICROSAR RTE" /begin SUB_GROUP /end SUB_GROUP /begin FUNCTION_LIST /end FUNCTION_LIST /begin REF_CHARACTERISTIC /end REF_CHARACTERISTIC /begin REF_MEASUREMENT CDD_GmG2kcaMcuCfg.BattVltgSwd1.Val /end REF_MEASUREMENT /end GROUP
/begin GROUP CDD_GmG2kcaMcuCfg.BattVltgSwd1AdcFaild.Logl "MICROSAR RTE" /begin SUB_GROUP /end SUB_GROUP /begin FUNCTION_LIST /end FUNCTION_LIST /begin REF_CHARACTERISTIC /end REF_CHARACTERISTIC /begin REF_MEASUREMENT CDD_GmG2kcaMcuCfg.BattVltgSwd1AdcFaild.Logl /end REF_MEASUREMENT /end GROUP
/begin GROUP CDD_GmG2kcaMcuCfg.BattVltgSwd2.Val "MICROSAR RTE" /begin SUB_GROUP /end SUB_GROUP /begin FUNCTION_LIST /end FUNCTION_LIST /begin REF_CHARACTERISTIC /end REF_CHARACTERISTIC /begin REF_MEASUREMENT CDD_GmG2kcaMcuCfg.BattVltgSwd2.Val /end REF_MEASUREMENT /end GROUP
/begin GROUP CDD_GmG2kcaMcuCfg.BattVltgSwd2AdcFaild.Logl "MICROSAR RTE" /begin SUB_GROUP /end SUB_GROUP /begin FUNCTION_LIST /end FUNCTION_LIST /begin REF_CHARACTERISTIC /end REF_CHARACTERISTIC /begin REF_MEASUREMENT CDD_GmG2kcaMcuCfg.BattVltgSwd2AdcFaild.Logl /end REF_MEASUREMENT /end GROUP
/begin GROUP CDD_GmG2kcaMcuCfg.EcuT.Val "MICROSAR RTE" /begin SUB_GROUP /end SUB_GROUP /begin FUNCTION_LIST /end FUNCTION_LIST /begin REF_CHARACTERISTIC /end REF_CHARACTERISTIC /begin REF_MEASUREMENT CDD_GmG2kcaMcuCfg.EcuT.Val /end REF_MEASUREMENT /end GROUP
/begin GROUP CDD_GmG2kcaMcuCfg.EcuTAdcFaild.Logl "MICROSAR RTE" /begin SUB_GROUP /end SUB_GROUP /begin FUNCTION_LIST /end FUNCTION_LIST /begin REF_CHARACTERISTIC /end REF_CHARACTERISTIC /begin REF_MEASUREMENT CDD_GmG2kcaMcuCfg.EcuTAdcFaild.Logl /end REF_MEASUREMENT /end GROUP
/begin GROUP CDD_GmG2kcaMcuCfg.MotAg2Cos.Val "MICROSAR RTE" /begin SUB_GROUP /end SUB_GROUP /begin FUNCTION_LIST /end FUNCTION_LIST /begin REF_CHARACTERISTIC /end REF_CHARACTERISTIC /begin REF_MEASUREMENT CDD_GmG2kcaMcuCfg.MotAg2Cos.Val /end REF_MEASUREMENT /end GROUP
/begin GROUP CDD_GmG2kcaMcuCfg.MotAg2CosAdcFaild.Logl "MICROSAR RTE" /begin SUB_GROUP /end SUB_GROUP /begin FUNCTION_LIST /end FUNCTION_LIST /begin REF_CHARACTERISTIC /end REF_CHARACTERISTIC /begin REF_MEASUREMENT CDD_GmG2kcaMcuCfg.MotAg2CosAdcFaild.Logl /end REF_MEASUREMENT /end GROUP
/begin GROUP CDD_GmG2kcaMcuCfg.MotAg2Sin.Val "MICROSAR RTE" /begin SUB_GROUP /end SUB_GROUP /begin FUNCTION_LIST /end FUNCTION_LIST /begin REF_CHARACTERISTIC /end REF_CHARACTERISTIC /begin REF_MEASUREMENT CDD_GmG2kcaMcuCfg.MotAg2Sin.Val /end REF_MEASUREMENT /end GROUP
/begin GROUP CDD_GmG2kcaMcuCfg.MotAg2SinAdcFaild.Logl "MICROSAR RTE" /begin SUB_GROUP /end SUB_GROUP /begin FUNCTION_LIST /end FUNCTION_LIST /begin REF_CHARACTERISTIC /end REF_CHARACTERISTIC /begin REF_MEASUREMENT CDD_GmG2kcaMcuCfg.MotAg2SinAdcFaild.Logl /end REF_MEASUREMENT /end GROUP
/begin GROUP CDD_GmG2kcaMcuCfg.MotCurrAdcPeakAAdcFaild.Logl "MICROSAR RTE" /begin SUB_GROUP /end SUB_GROUP /begin FUNCTION_LIST /end FUNCTION_LIST /begin REF_CHARACTERISTIC /end REF_CHARACTERISTIC /begin REF_MEASUREMENT CDD_GmG2kcaMcuCfg.MotCurrAdcPeakAAdcFaild.Logl /end REF_MEASUREMENT /end GROUP
/begin GROUP CDD_GmG2kcaMcuCfg.MotCurrAdcPeakBAdcFaild.Logl "MICROSAR RTE" /begin SUB_GROUP /end SUB_GROUP /begin FUNCTION_LIST /end FUNCTION_LIST /begin REF_CHARACTERISTIC /end REF_CHARACTERISTIC /begin REF_MEASUREMENT CDD_GmG2kcaMcuCfg.MotCurrAdcPeakBAdcFaild.Logl /end REF_MEASUREMENT /end GROUP
/begin GROUP CDD_GmG2kcaMcuCfg.MotCurrAdcPeakCAdcFaild.Logl "MICROSAR RTE" /begin SUB_GROUP /end SUB_GROUP /begin FUNCTION_LIST /end FUNCTION_LIST /begin REF_CHARACTERISTIC /end REF_CHARACTERISTIC /begin REF_MEASUREMENT CDD_GmG2kcaMcuCfg.MotCurrAdcPeakCAdcFaild.Logl /end REF_MEASUREMENT /end GROUP
/begin GROUP CDD_GmG2kcaMcuCfg.MotCurrAdcPeakDAdcFaild.Logl "MICROSAR RTE" /begin SUB_GROUP /end SUB_GROUP /begin FUNCTION_LIST /end FUNCTION_LIST /begin REF_CHARACTERISTIC /end REF_CHARACTERISTIC /begin REF_MEASUREMENT CDD_GmG2kcaMcuCfg.MotCurrAdcPeakDAdcFaild.Logl /end REF_MEASUREMENT /end GROUP
/begin GROUP CDD_GmG2kcaMcuCfg.MotCurrAdcPeakEAdcFaild.Logl "MICROSAR RTE" /begin SUB_GROUP /end SUB_GROUP /begin FUNCTION_LIST /end FUNCTION_LIST /begin REF_CHARACTERISTIC /end REF_CHARACTERISTIC /begin REF_MEASUREMENT CDD_GmG2kcaMcuCfg.MotCurrAdcPeakEAdcFaild.Logl /end REF_MEASUREMENT /end GROUP
/begin GROUP CDD_GmG2kcaMcuCfg.MotCurrAdcPeakFAdcFaild.Logl "MICROSAR RTE" /begin SUB_GROUP /end SUB_GROUP /begin FUNCTION_LIST /end FUNCTION_LIST /begin REF_CHARACTERISTIC /end REF_CHARACTERISTIC /begin REF_MEASUREMENT CDD_GmG2kcaMcuCfg.MotCurrAdcPeakFAdcFaild.Logl /end REF_MEASUREMENT /end GROUP
/begin GROUP CDD_GmG2kcaMcuCfg.MotCurrAdcVlyAAdcFaild.Logl "MICROSAR RTE" /begin SUB_GROUP /end SUB_GROUP /begin FUNCTION_LIST /end FUNCTION_LIST /begin REF_CHARACTERISTIC /end REF_CHARACTERISTIC /begin REF_MEASUREMENT CDD_GmG2kcaMcuCfg.MotCurrAdcVlyAAdcFaild.Logl /end REF_MEASUREMENT /end GROUP
/begin GROUP CDD_GmG2kcaMcuCfg.MotCurrAdcVlyBAdcFaild.Logl "MICROSAR RTE" /begin SUB_GROUP /end SUB_GROUP /begin FUNCTION_LIST /end FUNCTION_LIST /begin REF_CHARACTERISTIC /end REF_CHARACTERISTIC /begin REF_MEASUREMENT CDD_GmG2kcaMcuCfg.MotCurrAdcVlyBAdcFaild.Logl /end REF_MEASUREMENT /end GROUP
/begin GROUP CDD_GmG2kcaMcuCfg.MotCurrAdcVlyCAdcFaild.Logl "MICROSAR RTE" /begin SUB_GROUP /end SUB_GROUP /begin FUNCTION_LIST /end FUNCTION_LIST /begin REF_CHARACTERISTIC /end REF_CHARACTERISTIC /begin REF_MEASUREMENT CDD_GmG2kcaMcuCfg.MotCurrAdcVlyCAdcFaild.Logl /end REF_MEASUREMENT /end GROUP
/begin GROUP CDD_GmG2kcaMcuCfg.MotCurrAdcVlyDAdcFaild.Logl "MICROSAR RTE" /begin SUB_GROUP /end SUB_GROUP /begin FUNCTION_LIST /end FUNCTION_LIST /begin REF_CHARACTERISTIC /end REF_CHARACTERISTIC /begin REF_MEASUREMENT CDD_GmG2kcaMcuCfg.MotCurrAdcVlyDAdcFaild.Logl /end REF_MEASUREMENT /end GROUP
/begin GROUP CDD_GmG2kcaMcuCfg.MotCurrAdcVlyEAdcFaild.Logl "MICROSAR RTE" /begin SUB_GROUP /end SUB_GROUP /begin FUNCTION_LIST /end FUNCTION_LIST /begin REF_CHARACTERISTIC /end REF_CHARACTERISTIC /begin REF_MEASUREMENT CDD_GmG2kcaMcuCfg.MotCurrAdcVlyEAdcFaild.Logl /end REF_MEASUREMENT /end GROUP
/begin GROUP CDD_GmG2kcaMcuCfg.MotCurrAdcVlyFAdcFaild.Logl "MICROSAR RTE" /begin SUB_GROUP /end SUB_GROUP /begin FUNCTION_LIST /end FUNCTION_LIST /begin REF_CHARACTERISTIC /end REF_CHARACTERISTIC /begin REF_MEASUREMENT CDD_GmG2kcaMcuCfg.MotCurrAdcVlyFAdcFaild.Logl /end REF_MEASUREMENT /end GROUP
/begin GROUP CDD_GmG2kcaMcuCfg.MotCurrSnsrOffs1AdcFaild.Logl "MICROSAR RTE" /begin SUB_GROUP /end SUB_GROUP /begin FUNCTION_LIST /end FUNCTION_LIST /begin REF_CHARACTERISTIC /end REF_CHARACTERISTIC /begin REF_MEASUREMENT CDD_GmG2kcaMcuCfg.MotCurrSnsrOffs1AdcFaild.Logl /end REF_MEASUREMENT /end GROUP
/begin GROUP CDD_GmG2kcaMcuCfg.MotCurrSnsrOffs2AdcFaild.Logl "MICROSAR RTE" /begin SUB_GROUP /end SUB_GROUP /begin FUNCTION_LIST /end FUNCTION_LIST /begin REF_CHARACTERISTIC /end REF_CHARACTERISTIC /begin REF_MEASUREMENT CDD_GmG2kcaMcuCfg.MotCurrSnsrOffs2AdcFaild.Logl /end REF_MEASUREMENT /end GROUP
/begin GROUP CDD_GmG2kcaMcuCfg.ReceiverPorts "MICROSAR RTE"
 /begin SUB_GROUP CDD_GmG2kcaMcuCfg.Adc0Faild.Logl CDD_GmG2kcaMcuCfg.Adc1Faild.Logl /end SUB_GROUP
 /begin FUNCTION_LIST /end FUNCTION_LIST
 /begin REF_CHARACTERISTIC /end REF_CHARACTERISTIC
 /begin REF_MEASUREMENT /end REF_MEASUREMENT
/end GROUP
/begin GROUP CDD_GmG2kcaMcuCfg.SenderPorts "MICROSAR RTE"
 /begin SUB_GROUP CDD_GmG2kcaMcuCfg.Adc1ScanGroup2Ref0.Val CDD_GmG2kcaMcuCfg.Adc1ScanGroup2Ref1.Val CDD_GmG2kcaMcuCfg.Adc1ScanGroup3Ref0.Val CDD_GmG2kcaMcuCfg.Adc1ScanGroup3Ref1.Val CDD_GmG2kcaMcuCfg.Adc1SelfDiag0.Val CDD_GmG2kcaMcuCfg.Adc1SelfDiag2.Val CDD_GmG2kcaMcuCfg.Adc1SelfDiag4.Val CDD_GmG2kcaMcuCfg.BattVltg.Val CDD_GmG2kcaMcuCfg.BattVltgAdcFaild.Logl CDD_GmG2kcaMcuCfg.BattVltgSwd1.Val CDD_GmG2kcaMcuCfg.BattVltgSwd1AdcFaild.Logl CDD_GmG2kcaMcuCfg.BattVltgSwd2.Val CDD_GmG2kcaMcuCfg.BattVltgSwd2AdcFaild.Logl CDD_GmG2kcaMcuCfg.EcuT.Val CDD_GmG2kcaMcuCfg.EcuTAdcFaild.Logl CDD_GmG2kcaMcuCfg.MotAg2Cos.Val CDD_GmG2kcaMcuCfg.MotAg2CosAdcFaild.Logl CDD_GmG2kcaMcuCfg.MotAg2Sin.Val CDD_GmG2kcaMcuCfg.MotAg2SinAdcFaild.Logl CDD_GmG2kcaMcuCfg.MotCurrAdcPeakAAdcFaild.Logl CDD_GmG2kcaMcuCfg.MotCurrAdcPeakBAdcFaild.Logl CDD_GmG2kcaMcuCfg.MotCurrAdcPeakCAdcFaild.Logl CDD_GmG2kcaMcuCfg.MotCurrAdcPeakDAdcFaild.Logl CDD_GmG2kcaMcuCfg.MotCurrAdcPeakEAdcFaild.Logl CDD_GmG2kcaMcuCfg.MotCurrAdcPeakFAdcFaild.Logl CDD_GmG2kcaMcuCfg.MotCurrAdcVlyAAdcFaild.Logl CDD_GmG2kcaMcuCfg.MotCurrAdcVlyBAdcFaild.Logl CDD_GmG2kcaMcuCfg.MotCurrAdcVlyCAdcFaild.Logl CDD_GmG2kcaMcuCfg.MotCurrAdcVlyDAdcFaild.Logl CDD_GmG2kcaMcuCfg.MotCurrAdcVlyEAdcFaild.Logl CDD_GmG2kcaMcuCfg.MotCurrAdcVlyFAdcFaild.Logl CDD_GmG2kcaMcuCfg.MotCurrSnsrOffs1AdcFaild.Logl CDD_GmG2kcaMcuCfg.MotCurrSnsrOffs2AdcFaild.Logl /end SUB_GROUP
 /begin FUNCTION_LIST /end FUNCTION_LIST
 /begin REF_CHARACTERISTIC /end REF_CHARACTERISTIC
 /begin REF_MEASUREMENT /end REF_MEASUREMENT
/end GROUP
/begin GROUP CDD_HwTq0Meas "MICROSAR RTE"
 /begin SUB_GROUP CDD_HwTq0Meas.CalibrationParameters CDD_HwTq0Meas.CalibrationPorts CDD_HwTq0Meas.PerInstanceMemories CDD_HwTq0Meas.ReceiverPorts CDD_HwTq0Meas.SenderPorts /end SUB_GROUP
 /begin FUNCTION_LIST /end FUNCTION_LIST
 /begin REF_CHARACTERISTIC /end REF_CHARACTERISTIC
 /begin REF_MEASUREMENT /end REF_MEASUREMENT
/end GROUP
/begin GROUP CDD_HwTq0Meas.CalibrationParameters "MICROSAR RTE" /begin SUB_GROUP CDD_HwTq0Meas.HwTq0OffsDft /end SUB_GROUP /begin FUNCTION_LIST /end FUNCTION_LIST /begin REF_CHARACTERISTIC /end REF_CHARACTERISTIC /begin REF_MEASUREMENT /end REF_MEASUREMENT /end GROUP
/begin GROUP CDD_HwTq0Meas.CalibrationPorts "MICROSAR RTE"
 /begin SUB_GROUP CDD_HwTq0Meas.HwTq0MeasHwTq0PrtclFltFailStep.Val CDD_HwTq0Meas.HwTq0MeasHwTq0PrtclFltPassStep.Val /end SUB_GROUP
 /begin FUNCTION_LIST /end FUNCTION_LIST
 /begin REF_CHARACTERISTIC /end REF_CHARACTERISTIC
 /begin REF_MEASUREMENT /end REF_MEASUREMENT
/end GROUP
/begin GROUP CDD_HwTq0Meas.HwTq0.Val "MICROSAR RTE" /begin SUB_GROUP /end SUB_GROUP /begin FUNCTION_LIST /end FUNCTION_LIST /begin REF_CHARACTERISTIC /end REF_CHARACTERISTIC /begin REF_MEASUREMENT CDD_HwTq0Meas.HwTq0.Val /end REF_MEASUREMENT /end GROUP
/begin GROUP CDD_HwTq0Meas.HwTq0ComStsErrCntr "MICROSAR RTE" /begin SUB_GROUP /end SUB_GROUP /begin FUNCTION_LIST /end FUNCTION_LIST /begin REF_CHARACTERISTIC /end REF_CHARACTERISTIC /begin REF_MEASUREMENT CDD_HwTq0Meas.HwTq0ComStsErrCntr /end REF_MEASUREMENT /end GROUP
/begin GROUP CDD_HwTq0Meas.HwTq0IntSnsrErrCntr "MICROSAR RTE" /begin SUB_GROUP /end SUB_GROUP /begin FUNCTION_LIST /end FUNCTION_LIST /begin REF_CHARACTERISTIC /end REF_CHARACTERISTIC /begin REF_MEASUREMENT CDD_HwTq0Meas.HwTq0IntSnsrErrCntr /end REF_MEASUREMENT /end GROUP
/begin GROUP CDD_HwTq0Meas.HwTq0MeasHwTq0PrtclFltFailStep.Val "MICROSAR RTE" /begin SUB_GROUP /end SUB_GROUP /begin FUNCTION_LIST /end FUNCTION_LIST /begin REF_CHARACTERISTIC CDD_HwTq0Meas.HwTq0MeasHwTq0PrtclFltFailStep.Val /end REF_CHARACTERISTIC /begin REF_MEASUREMENT /end REF_MEASUREMENT /end GROUP
/begin GROUP CDD_HwTq0Meas.HwTq0MeasHwTq0PrtclFltPassStep.Val "MICROSAR RTE" /begin SUB_GROUP /end SUB_GROUP /begin FUNCTION_LIST /end FUNCTION_LIST /begin REF_CHARACTERISTIC CDD_HwTq0Meas.HwTq0MeasHwTq0PrtclFltPassStep.Val /end REF_CHARACTERISTIC /begin REF_MEASUREMENT /end REF_MEASUREMENT /end GROUP
/begin GROUP CDD_HwTq0Meas.HwTq0MeasPrevHwTq0 "MICROSAR RTE" /begin SUB_GROUP /end SUB_GROUP /begin FUNCTION_LIST /end FUNCTION_LIST /begin REF_CHARACTERISTIC /end REF_CHARACTERISTIC /begin REF_MEASUREMENT CDD_HwTq0Meas.HwTq0MeasPrevHwTq0 /end REF_MEASUREMENT /end GROUP
/begin GROUP CDD_HwTq0Meas.HwTq0MeasPrevRollgCntr "MICROSAR RTE" /begin SUB_GROUP /end SUB_GROUP /begin FUNCTION_LIST /end FUNCTION_LIST /begin REF_CHARACTERISTIC /end REF_CHARACTERISTIC /begin REF_MEASUREMENT CDD_HwTq0Meas.HwTq0MeasPrevRollgCntr /end REF_MEASUREMENT /end GROUP
/begin GROUP CDD_HwTq0Meas.HwTq0MsgMissRxCnt "MICROSAR RTE" /begin SUB_GROUP /end SUB_GROUP /begin FUNCTION_LIST /end FUNCTION_LIST /begin REF_CHARACTERISTIC /end REF_CHARACTERISTIC /begin REF_MEASUREMENT CDD_HwTq0Meas.HwTq0MsgMissRxCnt /end REF_MEASUREMENT /end GROUP
/begin GROUP CDD_HwTq0Meas.HwTq0Offs "MICROSAR RTE" /begin SUB_GROUP /end SUB_GROUP /begin FUNCTION_LIST /end FUNCTION_LIST /begin REF_CHARACTERISTIC /end REF_CHARACTERISTIC
 /begin REF_MEASUREMENT CDD_HwTq0Meas.HwTq0Offs.OffsTrim CDD_HwTq0Meas.HwTq0Offs.OffsTrimPrfmdSts /end REF_MEASUREMENT
/end GROUP
/begin GROUP CDD_HwTq0Meas.HwTq0OffsDft "MICROSAR RTE" /begin SUB_GROUP /end SUB_GROUP /begin FUNCTION_LIST /end FUNCTION_LIST
 /begin REF_CHARACTERISTIC CDD_HwTq0Meas.HwTq0OffsDft.OffsTrim CDD_HwTq0Meas.HwTq0OffsDft.OffsTrimPrfmdSts /end REF_CHARACTERISTIC
 /begin REF_MEASUREMENT /end REF_MEASUREMENT
/end GROUP
/begin GROUP CDD_HwTq0Meas.HwTq0Polarity.Val "MICROSAR RTE" /begin SUB_GROUP /end SUB_GROUP /begin FUNCTION_LIST /end FUNCTION_LIST /begin REF_CHARACTERISTIC /end REF_CHARACTERISTIC /begin REF_MEASUREMENT CDD_HwTq0Meas.HwTq0Polarity.Val /end REF_MEASUREMENT /end GROUP
/begin GROUP CDD_HwTq0Meas.HwTq0Qlfr.Val "MICROSAR RTE" /begin SUB_GROUP /end SUB_GROUP /begin FUNCTION_LIST /end FUNCTION_LIST /begin REF_CHARACTERISTIC /end REF_CHARACTERISTIC /begin REF_MEASUREMENT CDD_HwTq0Meas.HwTq0Qlfr.Val /end REF_MEASUREMENT /end GROUP
/begin GROUP CDD_HwTq0Meas.HwTq0RollgCntr.Val "MICROSAR RTE" /begin SUB_GROUP /end SUB_GROUP /begin FUNCTION_LIST /end FUNCTION_LIST /begin REF_CHARACTERISTIC /end REF_CHARACTERISTIC /begin REF_MEASUREMENT CDD_HwTq0Meas.HwTq0RollgCntr.Val /end REF_MEASUREMENT /end GROUP
/begin GROUP CDD_HwTq0Meas.PerInstanceMemories "MICROSAR RTE"
 /begin SUB_GROUP CDD_HwTq0Meas.HwTq0ComStsErrCntr CDD_HwTq0Meas.HwTq0IntSnsrErrCntr CDD_HwTq0Meas.HwTq0MeasPrevHwTq0 CDD_HwTq0Meas.HwTq0MeasPrevRollgCntr CDD_HwTq0Meas.HwTq0MsgMissRxCnt CDD_HwTq0Meas.HwTq0Offs CDD_HwTq0Meas.RackLimrCcwEot0 CDD_HwTq0Meas.RackLimrCwEot0 CDD_HwTq0Meas.RackLimrEot0Avl CDD_HwTq0Meas.RackLimrEot0Data0 CDD_HwTq0Meas.RackLimrEot0Data1 CDD_HwTq0Meas.RackLimrEot0Data2 CDD_HwTq0Meas.RackLimrEot0Id2DataReadCmpl CDD_HwTq0Meas.RackLimrEot0Id3DataReadCmpl CDD_HwTq0Meas.RackLimrEot0Id4DataReadCmpl /end SUB_GROUP
 /begin FUNCTION_LIST /end FUNCTION_LIST
 /begin REF_CHARACTERISTIC /end REF_CHARACTERISTIC
 /begin REF_MEASUREMENT /end REF_MEASUREMENT
/end GROUP
/begin GROUP CDD_HwTq0Meas.RackLimrCcwEot0 "MICROSAR RTE" /begin SUB_GROUP /end SUB_GROUP /begin FUNCTION_LIST /end FUNCTION_LIST /begin REF_CHARACTERISTIC /end REF_CHARACTERISTIC /begin REF_MEASUREMENT CDD_HwTq0Meas.RackLimrCcwEot0 /end REF_MEASUREMENT /end GROUP
/begin GROUP CDD_HwTq0Meas.RackLimrCcwEotSig0.Val "MICROSAR RTE" /begin SUB_GROUP /end SUB_GROUP /begin FUNCTION_LIST /end FUNCTION_LIST /begin REF_CHARACTERISTIC /end REF_CHARACTERISTIC /begin REF_MEASUREMENT CDD_HwTq0Meas.RackLimrCcwEotSig0.Val /end REF_MEASUREMENT /end GROUP
/begin GROUP CDD_HwTq0Meas.RackLimrCwEot0 "MICROSAR RTE" /begin SUB_GROUP /end SUB_GROUP /begin FUNCTION_LIST /end FUNCTION_LIST /begin REF_CHARACTERISTIC /end REF_CHARACTERISTIC /begin REF_MEASUREMENT CDD_HwTq0Meas.RackLimrCwEot0 /end REF_MEASUREMENT /end GROUP
/begin GROUP CDD_HwTq0Meas.RackLimrCwEotSig0.Val "MICROSAR RTE" /begin SUB_GROUP /end SUB_GROUP /begin FUNCTION_LIST /end FUNCTION_LIST /begin REF_CHARACTERISTIC /end REF_CHARACTERISTIC /begin REF_MEASUREMENT CDD_HwTq0Meas.RackLimrCwEotSig0.Val /end REF_MEASUREMENT /end GROUP
/begin GROUP CDD_HwTq0Meas.RackLimrEot0Avl "MICROSAR RTE" /begin SUB_GROUP /end SUB_GROUP /begin FUNCTION_LIST /end FUNCTION_LIST /begin REF_CHARACTERISTIC /end REF_CHARACTERISTIC /begin REF_MEASUREMENT CDD_HwTq0Meas.RackLimrEot0Avl /end REF_MEASUREMENT /end GROUP
/begin GROUP CDD_HwTq0Meas.RackLimrEot0Data0 "MICROSAR RTE" /begin SUB_GROUP /end SUB_GROUP /begin FUNCTION_LIST /end FUNCTION_LIST /begin REF_CHARACTERISTIC /end REF_CHARACTERISTIC /begin REF_MEASUREMENT CDD_HwTq0Meas.RackLimrEot0Data0 /end REF_MEASUREMENT /end GROUP
/begin GROUP CDD_HwTq0Meas.RackLimrEot0Data1 "MICROSAR RTE" /begin SUB_GROUP /end SUB_GROUP /begin FUNCTION_LIST /end FUNCTION_LIST /begin REF_CHARACTERISTIC /end REF_CHARACTERISTIC /begin REF_MEASUREMENT CDD_HwTq0Meas.RackLimrEot0Data1 /end REF_MEASUREMENT /end GROUP
/begin GROUP CDD_HwTq0Meas.RackLimrEot0Data2 "MICROSAR RTE" /begin SUB_GROUP /end SUB_GROUP /begin FUNCTION_LIST /end FUNCTION_LIST /begin REF_CHARACTERISTIC /end REF_CHARACTERISTIC /begin REF_MEASUREMENT CDD_HwTq0Meas.RackLimrEot0Data2 /end REF_MEASUREMENT /end GROUP
/begin GROUP CDD_HwTq0Meas.RackLimrEot0Id2DataReadCmpl "MICROSAR RTE" /begin SUB_GROUP /end SUB_GROUP /begin FUNCTION_LIST /end FUNCTION_LIST /begin REF_CHARACTERISTIC /end REF_CHARACTERISTIC /begin REF_MEASUREMENT CDD_HwTq0Meas.RackLimrEot0Id2DataReadCmpl /end REF_MEASUREMENT /end GROUP
/begin GROUP CDD_HwTq0Meas.RackLimrEot0Id3DataReadCmpl "MICROSAR RTE" /begin SUB_GROUP /end SUB_GROUP /begin FUNCTION_LIST /end FUNCTION_LIST /begin REF_CHARACTERISTIC /end REF_CHARACTERISTIC /begin REF_MEASUREMENT CDD_HwTq0Meas.RackLimrEot0Id3DataReadCmpl /end REF_MEASUREMENT /end GROUP
/begin GROUP CDD_HwTq0Meas.RackLimrEot0Id4DataReadCmpl "MICROSAR RTE" /begin SUB_GROUP /end SUB_GROUP /begin FUNCTION_LIST /end FUNCTION_LIST /begin REF_CHARACTERISTIC /end REF_CHARACTERISTIC /begin REF_MEASUREMENT CDD_HwTq0Meas.RackLimrEot0Id4DataReadCmpl /end REF_MEASUREMENT /end GROUP
/begin GROUP CDD_HwTq0Meas.RackLimrEotSig0Avl.Logl "MICROSAR RTE" /begin SUB_GROUP /end SUB_GROUP /begin FUNCTION_LIST /end FUNCTION_LIST /begin REF_CHARACTERISTIC /end REF_CHARACTERISTIC /begin REF_MEASUREMENT CDD_HwTq0Meas.RackLimrEotSig0Avl.Logl /end REF_MEASUREMENT /end GROUP
/begin GROUP CDD_HwTq0Meas.ReceiverPorts "MICROSAR RTE" /begin SUB_GROUP CDD_HwTq0Meas.HwTq0Polarity.Val /end SUB_GROUP /begin FUNCTION_LIST /end FUNCTION_LIST /begin REF_CHARACTERISTIC /end REF_CHARACTERISTIC /begin REF_MEASUREMENT /end REF_MEASUREMENT /end GROUP
/begin GROUP CDD_HwTq0Meas.SenderPorts "MICROSAR RTE"
 /begin SUB_GROUP CDD_HwTq0Meas.HwTq0.Val CDD_HwTq0Meas.HwTq0Qlfr.Val CDD_HwTq0Meas.HwTq0RollgCntr.Val CDD_HwTq0Meas.RackLimrCcwEotSig0.Val CDD_HwTq0Meas.RackLimrCwEotSig0.Val CDD_HwTq0Meas.RackLimrEotSig0Avl.Logl /end SUB_GROUP
 /begin FUNCTION_LIST /end FUNCTION_LIST
 /begin REF_CHARACTERISTIC /end REF_CHARACTERISTIC
 /begin REF_MEASUREMENT /end REF_MEASUREMENT
/end GROUP
/begin GROUP CDD_HwTq1Meas "MICROSAR RTE"
 /begin SUB_GROUP CDD_HwTq1Meas.CalibrationParameters CDD_HwTq1Meas.CalibrationPorts CDD_HwTq1Meas.PerInstanceMemories CDD_HwTq1Meas.ReceiverPorts CDD_HwTq1Meas.SenderPorts /end SUB_GROUP
 /begin FUNCTION_LIST /end FUNCTION_LIST
 /begin REF_CHARACTERISTIC /end REF_CHARACTERISTIC
 /begin REF_MEASUREMENT /end REF_MEASUREMENT
/end GROUP
/begin GROUP CDD_HwTq1Meas.CalibrationParameters "MICROSAR RTE" /begin SUB_GROUP CDD_HwTq1Meas.HwTq1OffsDft /end SUB_GROUP /begin FUNCTION_LIST /end FUNCTION_LIST /begin REF_CHARACTERISTIC /end REF_CHARACTERISTIC /begin REF_MEASUREMENT /end REF_MEASUREMENT /end GROUP
/begin GROUP CDD_HwTq1Meas.CalibrationPorts "MICROSAR RTE"
 /begin SUB_GROUP CDD_HwTq1Meas.HwTq1MeasHwTq1PrtclFltFailStep.Val CDD_HwTq1Meas.HwTq1MeasHwTq1PrtclFltPassStep.Val /end SUB_GROUP
 /begin FUNCTION_LIST /end FUNCTION_LIST
 /begin REF_CHARACTERISTIC /end REF_CHARACTERISTIC
 /begin REF_MEASUREMENT /end REF_MEASUREMENT
/end GROUP
/begin GROUP CDD_HwTq1Meas.HwTq1.Val "MICROSAR RTE" /begin SUB_GROUP /end SUB_GROUP /begin FUNCTION_LIST /end FUNCTION_LIST /begin REF_CHARACTERISTIC /end REF_CHARACTERISTIC /begin REF_MEASUREMENT CDD_HwTq1Meas.HwTq1.Val /end REF_MEASUREMENT /end GROUP
/begin GROUP CDD_HwTq1Meas.HwTq1ComStsErrCntr "MICROSAR RTE" /begin SUB_GROUP /end SUB_GROUP /begin FUNCTION_LIST /end FUNCTION_LIST /begin REF_CHARACTERISTIC /end REF_CHARACTERISTIC /begin REF_MEASUREMENT CDD_HwTq1Meas.HwTq1ComStsErrCntr /end REF_MEASUREMENT /end GROUP
/begin GROUP CDD_HwTq1Meas.HwTq1IntSnsrErrCntr "MICROSAR RTE" /begin SUB_GROUP /end SUB_GROUP /begin FUNCTION_LIST /end FUNCTION_LIST /begin REF_CHARACTERISTIC /end REF_CHARACTERISTIC /begin REF_MEASUREMENT CDD_HwTq1Meas.HwTq1IntSnsrErrCntr /end REF_MEASUREMENT /end GROUP
/begin GROUP CDD_HwTq1Meas.HwTq1MeasHwTq1PrtclFltFailStep.Val "MICROSAR RTE" /begin SUB_GROUP /end SUB_GROUP /begin FUNCTION_LIST /end FUNCTION_LIST /begin REF_CHARACTERISTIC CDD_HwTq1Meas.HwTq1MeasHwTq1PrtclFltFailStep.Val /end REF_CHARACTERISTIC /begin REF_MEASUREMENT /end REF_MEASUREMENT /end GROUP
/begin GROUP CDD_HwTq1Meas.HwTq1MeasHwTq1PrtclFltPassStep.Val "MICROSAR RTE" /begin SUB_GROUP /end SUB_GROUP /begin FUNCTION_LIST /end FUNCTION_LIST /begin REF_CHARACTERISTIC CDD_HwTq1Meas.HwTq1MeasHwTq1PrtclFltPassStep.Val /end REF_CHARACTERISTIC /begin REF_MEASUREMENT /end REF_MEASUREMENT /end GROUP
/begin GROUP CDD_HwTq1Meas.HwTq1MeasPrevHwTq1 "MICROSAR RTE" /begin SUB_GROUP /end SUB_GROUP /begin FUNCTION_LIST /end FUNCTION_LIST /begin REF_CHARACTERISTIC /end REF_CHARACTERISTIC /begin REF_MEASUREMENT CDD_HwTq1Meas.HwTq1MeasPrevHwTq1 /end REF_MEASUREMENT /end GROUP
/begin GROUP CDD_HwTq1Meas.HwTq1MeasPrevRollgCntr "MICROSAR RTE" /begin SUB_GROUP /end SUB_GROUP /begin FUNCTION_LIST /end FUNCTION_LIST /begin REF_CHARACTERISTIC /end REF_CHARACTERISTIC /begin REF_MEASUREMENT CDD_HwTq1Meas.HwTq1MeasPrevRollgCntr /end REF_MEASUREMENT /end GROUP
/begin GROUP CDD_HwTq1Meas.HwTq1MsgMissRxCnt "MICROSAR RTE" /begin SUB_GROUP /end SUB_GROUP /begin FUNCTION_LIST /end FUNCTION_LIST /begin REF_CHARACTERISTIC /end REF_CHARACTERISTIC /begin REF_MEASUREMENT CDD_HwTq1Meas.HwTq1MsgMissRxCnt /end REF_MEASUREMENT /end GROUP
/begin GROUP CDD_HwTq1Meas.HwTq1Offs "MICROSAR RTE" /begin SUB_GROUP /end SUB_GROUP /begin FUNCTION_LIST /end FUNCTION_LIST /begin REF_CHARACTERISTIC /end REF_CHARACTERISTIC
 /begin REF_MEASUREMENT CDD_HwTq1Meas.HwTq1Offs.OffsTrim CDD_HwTq1Meas.HwTq1Offs.OffsTrimPrfmdSts /end REF_MEASUREMENT
/end GROUP
/begin GROUP CDD_HwTq1Meas.HwTq1OffsDft "MICROSAR RTE" /begin SUB_GROUP /end SUB_GROUP /begin FUNCTION_LIST /end FUNCTION_LIST
 /begin REF_CHARACTERISTIC CDD_HwTq1Meas.HwTq1OffsDft.OffsTrim CDD_HwTq1Meas.HwTq1OffsDft.OffsTrimPrfmdSts /end REF_CHARACTERISTIC
 /begin REF_MEASUREMENT /end REF_MEASUREMENT
/end GROUP
/begin GROUP CDD_HwTq1Meas.HwTq1Polarity.Val "MICROSAR RTE" /begin SUB_GROUP /end SUB_GROUP /begin FUNCTION_LIST /end FUNCTION_LIST /begin REF_CHARACTERISTIC /end REF_CHARACTERISTIC /begin REF_MEASUREMENT CDD_HwTq1Meas.HwTq1Polarity.Val /end REF_MEASUREMENT /end GROUP
/begin GROUP CDD_HwTq1Meas.HwTq1Qlfr.Val "MICROSAR RTE" /begin SUB_GROUP /end SUB_GROUP /begin FUNCTION_LIST /end FUNCTION_LIST /begin REF_CHARACTERISTIC /end REF_CHARACTERISTIC /begin REF_MEASUREMENT CDD_HwTq1Meas.HwTq1Qlfr.Val /end REF_MEASUREMENT /end GROUP
/begin GROUP CDD_HwTq1Meas.HwTq1RollgCntr.Val "MICROSAR RTE" /begin SUB_GROUP /end SUB_GROUP /begin FUNCTION_LIST /end FUNCTION_LIST /begin REF_CHARACTERISTIC /end REF_CHARACTERISTIC /begin REF_MEASUREMENT CDD_HwTq1Meas.HwTq1RollgCntr.Val /end REF_MEASUREMENT /end GROUP
/begin GROUP CDD_HwTq1Meas.PerInstanceMemories "MICROSAR RTE"
 /begin SUB_GROUP CDD_HwTq1Meas.HwTq1ComStsErrCntr CDD_HwTq1Meas.HwTq1IntSnsrErrCntr CDD_HwTq1Meas.HwTq1MeasPrevHwTq1 CDD_HwTq1Meas.HwTq1MeasPrevRollgCntr CDD_HwTq1Meas.HwTq1MsgMissRxCnt CDD_HwTq1Meas.HwTq1Offs CDD_HwTq1Meas.RackLimrCcwEot1 CDD_HwTq1Meas.RackLimrCwEot1 CDD_HwTq1Meas.RackLimrEot1Avl CDD_HwTq1Meas.RackLimrEot1Data0 CDD_HwTq1Meas.RackLimrEot1Data1 CDD_HwTq1Meas.RackLimrEot1Data2 CDD_HwTq1Meas.RackLimrEot1Id2DataReadCmpl CDD_HwTq1Meas.RackLimrEot1Id3DataReadCmpl CDD_HwTq1Meas.RackLimrEot1Id4DataReadCmpl /end SUB_GROUP
 /begin FUNCTION_LIST /end FUNCTION_LIST
 /begin REF_CHARACTERISTIC /end REF_CHARACTERISTIC
 /begin REF_MEASUREMENT /end REF_MEASUREMENT
/end GROUP
/begin GROUP CDD_HwTq1Meas.RackLimrCcwEot1 "MICROSAR RTE" /begin SUB_GROUP /end SUB_GROUP /begin FUNCTION_LIST /end FUNCTION_LIST /begin REF_CHARACTERISTIC /end REF_CHARACTERISTIC /begin REF_MEASUREMENT CDD_HwTq1Meas.RackLimrCcwEot1 /end REF_MEASUREMENT /end GROUP
/begin GROUP CDD_HwTq1Meas.RackLimrCcwEotSig1.Val "MICROSAR RTE" /begin SUB_GROUP /end SUB_GROUP /begin FUNCTION_LIST /end FUNCTION_LIST /begin REF_CHARACTERISTIC /end REF_CHARACTERISTIC /begin REF_MEASUREMENT CDD_HwTq1Meas.RackLimrCcwEotSig1.Val /end REF_MEASUREMENT /end GROUP
/begin GROUP CDD_HwTq1Meas.RackLimrCwEot1 "MICROSAR RTE" /begin SUB_GROUP /end SUB_GROUP /begin FUNCTION_LIST /end FUNCTION_LIST /begin REF_CHARACTERISTIC /end REF_CHARACTERISTIC /begin REF_MEASUREMENT CDD_HwTq1Meas.RackLimrCwEot1 /end REF_MEASUREMENT /end GROUP
/begin GROUP CDD_HwTq1Meas.RackLimrCwEotSig1.Val "MICROSAR RTE" /begin SUB_GROUP /end SUB_GROUP /begin FUNCTION_LIST /end FUNCTION_LIST /begin REF_CHARACTERISTIC /end REF_CHARACTERISTIC /begin REF_MEASUREMENT CDD_HwTq1Meas.RackLimrCwEotSig1.Val /end REF_MEASUREMENT /end GROUP
/begin GROUP CDD_HwTq1Meas.RackLimrEot1Avl "MICROSAR RTE" /begin SUB_GROUP /end SUB_GROUP /begin FUNCTION_LIST /end FUNCTION_LIST /begin REF_CHARACTERISTIC /end REF_CHARACTERISTIC /begin REF_MEASUREMENT CDD_HwTq1Meas.RackLimrEot1Avl /end REF_MEASUREMENT /end GROUP
/begin GROUP CDD_HwTq1Meas.RackLimrEot1Data0 "MICROSAR RTE" /begin SUB_GROUP /end SUB_GROUP /begin FUNCTION_LIST /end FUNCTION_LIST /begin REF_CHARACTERISTIC /end REF_CHARACTERISTIC /begin REF_MEASUREMENT CDD_HwTq1Meas.RackLimrEot1Data0 /end REF_MEASUREMENT /end GROUP
/begin GROUP CDD_HwTq1Meas.RackLimrEot1Data1 "MICROSAR RTE" /begin SUB_GROUP /end SUB_GROUP /begin FUNCTION_LIST /end FUNCTION_LIST /begin REF_CHARACTERISTIC /end REF_CHARACTERISTIC /begin REF_MEASUREMENT CDD_HwTq1Meas.RackLimrEot1Data1 /end REF_MEASUREMENT /end GROUP
/begin GROUP CDD_HwTq1Meas.RackLimrEot1Data2 "MICROSAR RTE" /begin SUB_GROUP /end SUB_GROUP /begin FUNCTION_LIST /end FUNCTION_LIST /begin REF_CHARACTERISTIC /end REF_CHARACTERISTIC /begin REF_MEASUREMENT CDD_HwTq1Meas.RackLimrEot1Data2 /end REF_MEASUREMENT /end GROUP
/begin GROUP CDD_HwTq1Meas.RackLimrEot1Id2DataReadCmpl "MICROSAR RTE" /begin SUB_GROUP /end SUB_GROUP /begin FUNCTION_LIST /end FUNCTION_LIST /begin REF_CHARACTERISTIC /end REF_CHARACTERISTIC /begin REF_MEASUREMENT CDD_HwTq1Meas.RackLimrEot1Id2DataReadCmpl /end REF_MEASUREMENT /end GROUP
/begin GROUP CDD_HwTq1Meas.RackLimrEot1Id3DataReadCmpl "MICROSAR RTE" /begin SUB_GROUP /end SUB_GROUP /begin FUNCTION_LIST /end FUNCTION_LIST /begin REF_CHARACTERISTIC /end REF_CHARACTERISTIC /begin REF_MEASUREMENT CDD_HwTq1Meas.RackLimrEot1Id3DataReadCmpl /end REF_MEASUREMENT /end GROUP
/begin GROUP CDD_HwTq1Meas.RackLimrEot1Id4DataReadCmpl "MICROSAR RTE" /begin SUB_GROUP /end SUB_GROUP /begin FUNCTION_LIST /end FUNCTION_LIST /begin REF_CHARACTERISTIC /end REF_CHARACTERISTIC /begin REF_MEASUREMENT CDD_HwTq1Meas.RackLimrEot1Id4DataReadCmpl /end REF_MEASUREMENT /end GROUP
/begin GROUP CDD_HwTq1Meas.RackLimrEotSig1Avl.Logl "MICROSAR RTE" /begin SUB_GROUP /end SUB_GROUP /begin FUNCTION_LIST /end FUNCTION_LIST /begin REF_CHARACTERISTIC /end REF_CHARACTERISTIC /begin REF_MEASUREMENT CDD_HwTq1Meas.RackLimrEotSig1Avl.Logl /end REF_MEASUREMENT /end GROUP
/begin GROUP CDD_HwTq1Meas.ReceiverPorts "MICROSAR RTE" /begin SUB_GROUP CDD_HwTq1Meas.HwTq1Polarity.Val /end SUB_GROUP /begin FUNCTION_LIST /end FUNCTION_LIST /begin REF_CHARACTERISTIC /end REF_CHARACTERISTIC /begin REF_MEASUREMENT /end REF_MEASUREMENT /end GROUP
/begin GROUP CDD_HwTq1Meas.SenderPorts "MICROSAR RTE"
 /begin SUB_GROUP CDD_HwTq1Meas.HwTq1.Val CDD_HwTq1Meas.HwTq1Qlfr.Val CDD_HwTq1Meas.HwTq1RollgCntr.Val CDD_HwTq1Meas.RackLimrCcwEotSig1.Val CDD_HwTq1Meas.RackLimrCwEotSig1.Val CDD_HwTq1Meas.RackLimrEotSig1Avl.Logl /end SUB_GROUP
 /begin FUNCTION_LIST /end FUNCTION_LIST
 /begin REF_CHARACTERISTIC /end REF_CHARACTERISTIC
 /begin REF_MEASUREMENT /end REF_MEASUREMENT
/end GROUP
/begin GROUP CDD_HwTq2Meas "MICROSAR RTE"
 /begin SUB_GROUP CDD_HwTq2Meas.CalibrationParameters CDD_HwTq2Meas.CalibrationPorts CDD_HwTq2Meas.PerInstanceMemories CDD_HwTq2Meas.ReceiverPorts CDD_HwTq2Meas.SenderPorts /end SUB_GROUP
 /begin FUNCTION_LIST /end FUNCTION_LIST
 /begin REF_CHARACTERISTIC /end REF_CHARACTERISTIC
 /begin REF_MEASUREMENT /end REF_MEASUREMENT
/end GROUP
/begin GROUP CDD_HwTq2Meas.CalibrationParameters "MICROSAR RTE" /begin SUB_GROUP CDD_HwTq2Meas.HwTq2OffsDft /end SUB_GROUP /begin FUNCTION_LIST /end FUNCTION_LIST /begin REF_CHARACTERISTIC /end REF_CHARACTERISTIC /begin REF_MEASUREMENT /end REF_MEASUREMENT /end GROUP
/begin GROUP CDD_HwTq2Meas.CalibrationPorts "MICROSAR RTE"
 /begin SUB_GROUP CDD_HwTq2Meas.HwTq2MeasHwTq2PrtclFltFailStep.Val CDD_HwTq2Meas.HwTq2MeasHwTq2PrtclFltPassStep.Val /end SUB_GROUP
 /begin FUNCTION_LIST /end FUNCTION_LIST
 /begin REF_CHARACTERISTIC /end REF_CHARACTERISTIC
 /begin REF_MEASUREMENT /end REF_MEASUREMENT
/end GROUP
/begin GROUP CDD_HwTq2Meas.GearIdn1.Val "MICROSAR RTE" /begin SUB_GROUP /end SUB_GROUP /begin FUNCTION_LIST /end FUNCTION_LIST /begin REF_CHARACTERISTIC /end REF_CHARACTERISTIC /begin REF_MEASUREMENT CDD_HwTq2Meas.GearIdn1.Val /end REF_MEASUREMENT /end GROUP
/begin GROUP CDD_HwTq2Meas.GearIdn1Avl "MICROSAR RTE" /begin SUB_GROUP /end SUB_GROUP /begin FUNCTION_LIST /end FUNCTION_LIST /begin REF_CHARACTERISTIC /end REF_CHARACTERISTIC /begin REF_MEASUREMENT CDD_HwTq2Meas.GearIdn1Avl /end REF_MEASUREMENT /end GROUP
/begin GROUP CDD_HwTq2Meas.GearIdn1Data "MICROSAR RTE" /begin SUB_GROUP /end SUB_GROUP /begin FUNCTION_LIST /end FUNCTION_LIST /begin REF_CHARACTERISTIC /end REF_CHARACTERISTIC /begin REF_MEASUREMENT CDD_HwTq2Meas.GearIdn1Data /end REF_MEASUREMENT /end GROUP
/begin GROUP CDD_HwTq2Meas.GearIdn1Vld.Logl "MICROSAR RTE" /begin SUB_GROUP /end SUB_GROUP /begin FUNCTION_LIST /end FUNCTION_LIST /begin REF_CHARACTERISTIC /end REF_CHARACTERISTIC /begin REF_MEASUREMENT CDD_HwTq2Meas.GearIdn1Vld.Logl /end REF_MEASUREMENT /end GROUP
/begin GROUP CDD_HwTq2Meas.HwTq2.Val "MICROSAR RTE" /begin SUB_GROUP /end SUB_GROUP /begin FUNCTION_LIST /end FUNCTION_LIST /begin REF_CHARACTERISTIC /end REF_CHARACTERISTIC /begin REF_MEASUREMENT CDD_HwTq2Meas.HwTq2.Val /end REF_MEASUREMENT /end GROUP
/begin GROUP CDD_HwTq2Meas.HwTq2ComStsErrCntr "MICROSAR RTE" /begin SUB_GROUP /end SUB_GROUP /begin FUNCTION_LIST /end FUNCTION_LIST /begin REF_CHARACTERISTIC /end REF_CHARACTERISTIC /begin REF_MEASUREMENT CDD_HwTq2Meas.HwTq2ComStsErrCntr /end REF_MEASUREMENT /end GROUP
/begin GROUP CDD_HwTq2Meas.HwTq2IntSnsrErrCntr "MICROSAR RTE" /begin SUB_GROUP /end SUB_GROUP /begin FUNCTION_LIST /end FUNCTION_LIST /begin REF_CHARACTERISTIC /end REF_CHARACTERISTIC /begin REF_MEASUREMENT CDD_HwTq2Meas.HwTq2IntSnsrErrCntr /end REF_MEASUREMENT /end GROUP
/begin GROUP CDD_HwTq2Meas.HwTq2MeasHwTq2PrtclFltFailStep.Val "MICROSAR RTE" /begin SUB_GROUP /end SUB_GROUP /begin FUNCTION_LIST /end FUNCTION_LIST /begin REF_CHARACTERISTIC CDD_HwTq2Meas.HwTq2MeasHwTq2PrtclFltFailStep.Val /end REF_CHARACTERISTIC /begin REF_MEASUREMENT /end REF_MEASUREMENT /end GROUP
/begin GROUP CDD_HwTq2Meas.HwTq2MeasHwTq2PrtclFltPassStep.Val "MICROSAR RTE" /begin SUB_GROUP /end SUB_GROUP /begin FUNCTION_LIST /end FUNCTION_LIST /begin REF_CHARACTERISTIC CDD_HwTq2Meas.HwTq2MeasHwTq2PrtclFltPassStep.Val /end REF_CHARACTERISTIC /begin REF_MEASUREMENT /end REF_MEASUREMENT /end GROUP
/begin GROUP CDD_HwTq2Meas.HwTq2MeasPrevHwTq2 "MICROSAR RTE" /begin SUB_GROUP /end SUB_GROUP /begin FUNCTION_LIST /end FUNCTION_LIST /begin REF_CHARACTERISTIC /end REF_CHARACTERISTIC /begin REF_MEASUREMENT CDD_HwTq2Meas.HwTq2MeasPrevHwTq2 /end REF_MEASUREMENT /end GROUP
/begin GROUP CDD_HwTq2Meas.HwTq2MeasPrevRollgCntr "MICROSAR RTE" /begin SUB_GROUP /end SUB_GROUP /begin FUNCTION_LIST /end FUNCTION_LIST /begin REF_CHARACTERISTIC /end REF_CHARACTERISTIC /begin REF_MEASUREMENT CDD_HwTq2Meas.HwTq2MeasPrevRollgCntr /end REF_MEASUREMENT /end GROUP
/begin GROUP CDD_HwTq2Meas.HwTq2MsgMissRxCnt "MICROSAR RTE" /begin SUB_GROUP /end SUB_GROUP /begin FUNCTION_LIST /end FUNCTION_LIST /begin REF_CHARACTERISTIC /end REF_CHARACTERISTIC /begin REF_MEASUREMENT CDD_HwTq2Meas.HwTq2MsgMissRxCnt /end REF_MEASUREMENT /end GROUP
/begin GROUP CDD_HwTq2Meas.HwTq2Offs "MICROSAR RTE" /begin SUB_GROUP /end SUB_GROUP /begin FUNCTION_LIST /end FUNCTION_LIST /begin REF_CHARACTERISTIC /end REF_CHARACTERISTIC
 /begin REF_MEASUREMENT CDD_HwTq2Meas.HwTq2Offs.OffsTrim CDD_HwTq2Meas.HwTq2Offs.OffsTrimPrfmdSts /end REF_MEASUREMENT
/end GROUP
/begin GROUP CDD_HwTq2Meas.HwTq2OffsDft "MICROSAR RTE" /begin SUB_GROUP /end SUB_GROUP /begin FUNCTION_LIST /end FUNCTION_LIST
 /begin REF_CHARACTERISTIC CDD_HwTq2Meas.HwTq2OffsDft.OffsTrim CDD_HwTq2Meas.HwTq2OffsDft.OffsTrimPrfmdSts /end REF_CHARACTERISTIC
 /begin REF_MEASUREMENT /end REF_MEASUREMENT
/end GROUP
/begin GROUP CDD_HwTq2Meas.HwTq2Polarity.Val "MICROSAR RTE" /begin SUB_GROUP /end SUB_GROUP /begin FUNCTION_LIST /end FUNCTION_LIST /begin REF_CHARACTERISTIC /end REF_CHARACTERISTIC /begin REF_MEASUREMENT CDD_HwTq2Meas.HwTq2Polarity.Val /end REF_MEASUREMENT /end GROUP
/begin GROUP CDD_HwTq2Meas.HwTq2Qlfr.Val "MICROSAR RTE" /begin SUB_GROUP /end SUB_GROUP /begin FUNCTION_LIST /end FUNCTION_LIST /begin REF_CHARACTERISTIC /end REF_CHARACTERISTIC /begin REF_MEASUREMENT CDD_HwTq2Meas.HwTq2Qlfr.Val /end REF_MEASUREMENT /end GROUP
/begin GROUP CDD_HwTq2Meas.HwTq2RollgCntr.Val "MICROSAR RTE" /begin SUB_GROUP /end SUB_GROUP /begin FUNCTION_LIST /end FUNCTION_LIST /begin REF_CHARACTERISTIC /end REF_CHARACTERISTIC /begin REF_MEASUREMENT CDD_HwTq2Meas.HwTq2RollgCntr.Val /end REF_MEASUREMENT /end GROUP
/begin GROUP CDD_HwTq2Meas.PerInstanceMemories "MICROSAR RTE"
 /begin SUB_GROUP CDD_HwTq2Meas.GearIdn1Avl CDD_HwTq2Meas.GearIdn1Data CDD_HwTq2Meas.HwTq2ComStsErrCntr CDD_HwTq2Meas.HwTq2IntSnsrErrCntr CDD_HwTq2Meas.HwTq2MeasPrevHwTq2 CDD_HwTq2Meas.HwTq2MeasPrevRollgCntr CDD_HwTq2Meas.HwTq2MsgMissRxCnt CDD_HwTq2Meas.HwTq2Offs /end SUB_GROUP
 /begin FUNCTION_LIST /end FUNCTION_LIST
 /begin REF_CHARACTERISTIC /end REF_CHARACTERISTIC
 /begin REF_MEASUREMENT /end REF_MEASUREMENT
/end GROUP
/begin GROUP CDD_HwTq2Meas.ReceiverPorts "MICROSAR RTE" /begin SUB_GROUP CDD_HwTq2Meas.HwTq2Polarity.Val /end SUB_GROUP /begin FUNCTION_LIST /end FUNCTION_LIST /begin REF_CHARACTERISTIC /end REF_CHARACTERISTIC /begin REF_MEASUREMENT /end REF_MEASUREMENT /end GROUP
/begin GROUP CDD_HwTq2Meas.SenderPorts "MICROSAR RTE"
 /begin SUB_GROUP CDD_HwTq2Meas.GearIdn1.Val CDD_HwTq2Meas.GearIdn1Vld.Logl CDD_HwTq2Meas.HwTq2.Val CDD_HwTq2Meas.HwTq2Qlfr.Val CDD_HwTq2Meas.HwTq2RollgCntr.Val /end SUB_GROUP
 /begin FUNCTION_LIST /end FUNCTION_LIST
 /begin REF_CHARACTERISTIC /end REF_CHARACTERISTIC
 /begin REF_MEASUREMENT /end REF_MEASUREMENT
/end GROUP
/begin GROUP CDD_HwTq3Meas "MICROSAR RTE"
 /begin SUB_GROUP CDD_HwTq3Meas.CalibrationParameters CDD_HwTq3Meas.CalibrationPorts CDD_HwTq3Meas.PerInstanceMemories CDD_HwTq3Meas.ReceiverPorts CDD_HwTq3Meas.SenderPorts /end SUB_GROUP
 /begin FUNCTION_LIST /end FUNCTION_LIST
 /begin REF_CHARACTERISTIC /end REF_CHARACTERISTIC
 /begin REF_MEASUREMENT /end REF_MEASUREMENT
/end GROUP
/begin GROUP CDD_HwTq3Meas.CalibrationParameters "MICROSAR RTE" /begin SUB_GROUP CDD_HwTq3Meas.HwTq3OffsDft /end SUB_GROUP /begin FUNCTION_LIST /end FUNCTION_LIST /begin REF_CHARACTERISTIC /end REF_CHARACTERISTIC /begin REF_MEASUREMENT /end REF_MEASUREMENT /end GROUP
/begin GROUP CDD_HwTq3Meas.CalibrationPorts "MICROSAR RTE"
 /begin SUB_GROUP CDD_HwTq3Meas.HwTq3MeasHwTq3PrtclFltFailStep.Val CDD_HwTq3Meas.HwTq3MeasHwTq3PrtclFltPassStep.Val /end SUB_GROUP
 /begin FUNCTION_LIST /end FUNCTION_LIST
 /begin REF_CHARACTERISTIC /end REF_CHARACTERISTIC
 /begin REF_MEASUREMENT /end REF_MEASUREMENT
/end GROUP
/begin GROUP CDD_HwTq3Meas.GearIdn2.Val "MICROSAR RTE" /begin SUB_GROUP /end SUB_GROUP /begin FUNCTION_LIST /end FUNCTION_LIST /begin REF_CHARACTERISTIC /end REF_CHARACTERISTIC /begin REF_MEASUREMENT CDD_HwTq3Meas.GearIdn2.Val /end REF_MEASUREMENT /end GROUP
/begin GROUP CDD_HwTq3Meas.GearIdn2Avl "MICROSAR RTE" /begin SUB_GROUP /end SUB_GROUP /begin FUNCTION_LIST /end FUNCTION_LIST /begin REF_CHARACTERISTIC /end REF_CHARACTERISTIC /begin REF_MEASUREMENT CDD_HwTq3Meas.GearIdn2Avl /end REF_MEASUREMENT /end GROUP
/begin GROUP CDD_HwTq3Meas.GearIdn2Data "MICROSAR RTE" /begin SUB_GROUP /end SUB_GROUP /begin FUNCTION_LIST /end FUNCTION_LIST /begin REF_CHARACTERISTIC /end REF_CHARACTERISTIC /begin REF_MEASUREMENT CDD_HwTq3Meas.GearIdn2Data /end REF_MEASUREMENT /end GROUP
/begin GROUP CDD_HwTq3Meas.GearIdn2Vld.Logl "MICROSAR RTE" /begin SUB_GROUP /end SUB_GROUP /begin FUNCTION_LIST /end FUNCTION_LIST /begin REF_CHARACTERISTIC /end REF_CHARACTERISTIC /begin REF_MEASUREMENT CDD_HwTq3Meas.GearIdn2Vld.Logl /end REF_MEASUREMENT /end GROUP
/begin GROUP CDD_HwTq3Meas.HwTq3.Val "MICROSAR RTE" /begin SUB_GROUP /end SUB_GROUP /begin FUNCTION_LIST /end FUNCTION_LIST /begin REF_CHARACTERISTIC /end REF_CHARACTERISTIC /begin REF_MEASUREMENT CDD_HwTq3Meas.HwTq3.Val /end REF_MEASUREMENT /end GROUP
/begin GROUP CDD_HwTq3Meas.HwTq3ComStsErrCntr "MICROSAR RTE" /begin SUB_GROUP /end SUB_GROUP /begin FUNCTION_LIST /end FUNCTION_LIST /begin REF_CHARACTERISTIC /end REF_CHARACTERISTIC /begin REF_MEASUREMENT CDD_HwTq3Meas.HwTq3ComStsErrCntr /end REF_MEASUREMENT /end GROUP
/begin GROUP CDD_HwTq3Meas.HwTq3IntSnsrErrCntr "MICROSAR RTE" /begin SUB_GROUP /end SUB_GROUP /begin FUNCTION_LIST /end FUNCTION_LIST /begin REF_CHARACTERISTIC /end REF_CHARACTERISTIC /begin REF_MEASUREMENT CDD_HwTq3Meas.HwTq3IntSnsrErrCntr /end REF_MEASUREMENT /end GROUP
/begin GROUP CDD_HwTq3Meas.HwTq3MeasHwTq3PrtclFltFailStep.Val "MICROSAR RTE" /begin SUB_GROUP /end SUB_GROUP /begin FUNCTION_LIST /end FUNCTION_LIST /begin REF_CHARACTERISTIC CDD_HwTq3Meas.HwTq3MeasHwTq3PrtclFltFailStep.Val /end REF_CHARACTERISTIC /begin REF_MEASUREMENT /end REF_MEASUREMENT /end GROUP
/begin GROUP CDD_HwTq3Meas.HwTq3MeasHwTq3PrtclFltPassStep.Val "MICROSAR RTE" /begin SUB_GROUP /end SUB_GROUP /begin FUNCTION_LIST /end FUNCTION_LIST /begin REF_CHARACTERISTIC CDD_HwTq3Meas.HwTq3MeasHwTq3PrtclFltPassStep.Val /end REF_CHARACTERISTIC /begin REF_MEASUREMENT /end REF_MEASUREMENT /end GROUP
/begin GROUP CDD_HwTq3Meas.HwTq3MeasPrevHwTq3 "MICROSAR RTE" /begin SUB_GROUP /end SUB_GROUP /begin FUNCTION_LIST /end FUNCTION_LIST /begin REF_CHARACTERISTIC /end REF_CHARACTERISTIC /begin REF_MEASUREMENT CDD_HwTq3Meas.HwTq3MeasPrevHwTq3 /end REF_MEASUREMENT /end GROUP
/begin GROUP CDD_HwTq3Meas.HwTq3MeasPrevRollgCntr "MICROSAR RTE" /begin SUB_GROUP /end SUB_GROUP /begin FUNCTION_LIST /end FUNCTION_LIST /begin REF_CHARACTERISTIC /end REF_CHARACTERISTIC /begin REF_MEASUREMENT CDD_HwTq3Meas.HwTq3MeasPrevRollgCntr /end REF_MEASUREMENT /end GROUP
/begin GROUP CDD_HwTq3Meas.HwTq3MsgMissRxCnt "MICROSAR RTE" /begin SUB_GROUP /end SUB_GROUP /begin FUNCTION_LIST /end FUNCTION_LIST /begin REF_CHARACTERISTIC /end REF_CHARACTERISTIC /begin REF_MEASUREMENT CDD_HwTq3Meas.HwTq3MsgMissRxCnt /end REF_MEASUREMENT /end GROUP
/begin GROUP CDD_HwTq3Meas.HwTq3Offs "MICROSAR RTE" /begin SUB_GROUP /end SUB_GROUP /begin FUNCTION_LIST /end FUNCTION_LIST /begin REF_CHARACTERISTIC /end REF_CHARACTERISTIC
 /begin REF_MEASUREMENT CDD_HwTq3Meas.HwTq3Offs.OffsTrim CDD_HwTq3Meas.HwTq3Offs.OffsTrimPrfmdSts /end REF_MEASUREMENT
/end GROUP
/begin GROUP CDD_HwTq3Meas.HwTq3OffsDft "MICROSAR RTE" /begin SUB_GROUP /end SUB_GROUP /begin FUNCTION_LIST /end FUNCTION_LIST
 /begin REF_CHARACTERISTIC CDD_HwTq3Meas.HwTq3OffsDft.OffsTrim CDD_HwTq3Meas.HwTq3OffsDft.OffsTrimPrfmdSts /end REF_CHARACTERISTIC
 /begin REF_MEASUREMENT /end REF_MEASUREMENT
/end GROUP
/begin GROUP CDD_HwTq3Meas.HwTq3Polarity.Val "MICROSAR RTE" /begin SUB_GROUP /end SUB_GROUP /begin FUNCTION_LIST /end FUNCTION_LIST /begin REF_CHARACTERISTIC /end REF_CHARACTERISTIC /begin REF_MEASUREMENT CDD_HwTq3Meas.HwTq3Polarity.Val /end REF_MEASUREMENT /end GROUP
/begin GROUP CDD_HwTq3Meas.HwTq3Qlfr.Val "MICROSAR RTE" /begin SUB_GROUP /end SUB_GROUP /begin FUNCTION_LIST /end FUNCTION_LIST /begin REF_CHARACTERISTIC /end REF_CHARACTERISTIC /begin REF_MEASUREMENT CDD_HwTq3Meas.HwTq3Qlfr.Val /end REF_MEASUREMENT /end GROUP
/begin GROUP CDD_HwTq3Meas.HwTq3RollgCntr.Val "MICROSAR RTE" /begin SUB_GROUP /end SUB_GROUP /begin FUNCTION_LIST /end FUNCTION_LIST /begin REF_CHARACTERISTIC /end REF_CHARACTERISTIC /begin REF_MEASUREMENT CDD_HwTq3Meas.HwTq3RollgCntr.Val /end REF_MEASUREMENT /end GROUP
/begin GROUP CDD_HwTq3Meas.PerInstanceMemories "MICROSAR RTE"
 /begin SUB_GROUP CDD_HwTq3Meas.GearIdn2Avl CDD_HwTq3Meas.GearIdn2Data CDD_HwTq3Meas.HwTq3ComStsErrCntr CDD_HwTq3Meas.HwTq3IntSnsrErrCntr CDD_HwTq3Meas.HwTq3MeasPrevHwTq3 CDD_HwTq3Meas.HwTq3MeasPrevRollgCntr CDD_HwTq3Meas.HwTq3MsgMissRxCnt CDD_HwTq3Meas.HwTq3Offs /end SUB_GROUP
 /begin FUNCTION_LIST /end FUNCTION_LIST
 /begin REF_CHARACTERISTIC /end REF_CHARACTERISTIC
 /begin REF_MEASUREMENT /end REF_MEASUREMENT
/end GROUP
/begin GROUP CDD_HwTq3Meas.ReceiverPorts "MICROSAR RTE" /begin SUB_GROUP CDD_HwTq3Meas.HwTq3Polarity.Val /end SUB_GROUP /begin FUNCTION_LIST /end FUNCTION_LIST /begin REF_CHARACTERISTIC /end REF_CHARACTERISTIC /begin REF_MEASUREMENT /end REF_MEASUREMENT /end GROUP
/begin GROUP CDD_HwTq3Meas.SenderPorts "MICROSAR RTE"
 /begin SUB_GROUP CDD_HwTq3Meas.GearIdn2.Val CDD_HwTq3Meas.GearIdn2Vld.Logl CDD_HwTq3Meas.HwTq3.Val CDD_HwTq3Meas.HwTq3Qlfr.Val CDD_HwTq3Meas.HwTq3RollgCntr.Val /end SUB_GROUP
 /begin FUNCTION_LIST /end FUNCTION_LIST
 /begin REF_CHARACTERISTIC /end REF_CHARACTERISTIC
 /begin REF_MEASUREMENT /end REF_MEASUREMENT
/end GROUP
/begin GROUP CDD_McuCoreCfgAndDiagc "MICROSAR RTE" /begin SUB_GROUP CDD_McuCoreCfgAndDiagc.PerInstanceMemories /end SUB_GROUP /begin FUNCTION_LIST /end FUNCTION_LIST /begin REF_CHARACTERISTIC /end REF_CHARACTERISTIC /begin REF_MEASUREMENT /end REF_MEASUREMENT /end GROUP
/begin GROUP CDD_McuCoreCfgAndDiagc.CoreCompTestRegRead "MICROSAR RTE" /begin SUB_GROUP /end SUB_GROUP /begin FUNCTION_LIST /end FUNCTION_LIST /begin REF_CHARACTERISTIC /end REF_CHARACTERISTIC /begin REF_MEASUREMENT CDD_McuCoreCfgAndDiagc.CoreCompTestRegRead /end REF_MEASUREMENT /end GROUP
/begin GROUP CDD_McuCoreCfgAndDiagc.PerInstanceMemories "MICROSAR RTE" /begin SUB_GROUP CDD_McuCoreCfgAndDiagc.CoreCompTestRegRead /end SUB_GROUP /begin FUNCTION_LIST /end FUNCTION_LIST /begin REF_CHARACTERISTIC /end REF_CHARACTERISTIC /begin REF_MEASUREMENT /end REF_MEASUREMENT /end GROUP
/begin GROUP CDD_McuDiagc "MICROSAR RTE"
 /begin SUB_GROUP CDD_McuDiagc.CalibrationPorts CDD_McuDiagc.PerInstanceMemories CDD_McuDiagc.ReceiverPorts CDD_McuDiagc.SenderPorts /end SUB_GROUP
 /begin FUNCTION_LIST /end FUNCTION_LIST
 /begin REF_CHARACTERISTIC /end REF_CHARACTERISTIC
 /begin REF_MEASUREMENT /end REF_MEASUREMENT
/end GROUP
/begin GROUP CDD_McuDiagc.CalibrationPorts "MICROSAR RTE"
 /begin SUB_GROUP CDD_McuDiagc.McuDiagc2MilliSecCntrCompThd.Val CDD_McuDiagc.McuDiagcFltFailStep.Val CDD_McuDiagc.McuDiagcFltPassStep.Val /end SUB_GROUP
 /begin FUNCTION_LIST /end FUNCTION_LIST
 /begin REF_CHARACTERISTIC /end REF_CHARACTERISTIC
 /begin REF_MEASUREMENT /end REF_MEASUREMENT
/end GROUP
/begin GROUP CDD_McuDiagc.FastLoopCntr.Val "MICROSAR RTE" /begin SUB_GROUP /end SUB_GROUP /begin FUNCTION_LIST /end FUNCTION_LIST /begin REF_CHARACTERISTIC /end REF_CHARACTERISTIC /begin REF_MEASUREMENT CDD_McuDiagc.FastLoopCntr.Val /end REF_MEASUREMENT /end GROUP
/begin GROUP CDD_McuDiagc.FastLoopCntrDiagcCfgd "MICROSAR RTE" /begin SUB_GROUP /end SUB_GROUP /begin FUNCTION_LIST /end FUNCTION_LIST /begin REF_CHARACTERISTIC /end REF_CHARACTERISTIC /begin REF_MEASUREMENT CDD_McuDiagc.FastLoopCntrDiagcCfgd /end REF_MEASUREMENT /end GROUP
/begin GROUP CDD_McuDiagc.FastLoopCntrPrev "MICROSAR RTE" /begin SUB_GROUP /end SUB_GROUP /begin FUNCTION_LIST /end FUNCTION_LIST /begin REF_CHARACTERISTIC /end REF_CHARACTERISTIC /begin REF_MEASUREMENT CDD_McuDiagc.FastLoopCntrPrev /end REF_MEASUREMENT /end GROUP
/begin GROUP CDD_McuDiagc.LoopCntr2MilliSec.Val "MICROSAR RTE" /begin SUB_GROUP /end SUB_GROUP /begin FUNCTION_LIST /end FUNCTION_LIST /begin REF_CHARACTERISTIC /end REF_CHARACTERISTIC /begin REF_MEASUREMENT CDD_McuDiagc.LoopCntr2MilliSec.Val /end REF_MEASUREMENT /end GROUP
/begin GROUP CDD_McuDiagc.LoopCntr2MilliSecStore "MICROSAR RTE" /begin SUB_GROUP /end SUB_GROUP /begin FUNCTION_LIST /end FUNCTION_LIST /begin REF_CHARACTERISTIC /end REF_CHARACTERISTIC /begin REF_MEASUREMENT CDD_McuDiagc.LoopCntr2MilliSecStore /end REF_MEASUREMENT /end GROUP
/begin GROUP CDD_McuDiagc.LoopCntrPrev "MICROSAR RTE" /begin SUB_GROUP /end SUB_GROUP /begin FUNCTION_LIST /end FUNCTION_LIST /begin REF_CHARACTERISTIC /end REF_CHARACTERISTIC /begin REF_MEASUREMENT CDD_McuDiagc.LoopCntrPrev /end REF_MEASUREMENT /end GROUP
/begin GROUP CDD_McuDiagc.McuDiagc2MilliSecCntrCompThd.Val "MICROSAR RTE" /begin SUB_GROUP /end SUB_GROUP /begin FUNCTION_LIST /end FUNCTION_LIST /begin REF_CHARACTERISTIC CDD_McuDiagc.McuDiagc2MilliSecCntrCompThd.Val /end REF_CHARACTERISTIC /begin REF_MEASUREMENT /end REF_MEASUREMENT /end GROUP
/begin GROUP CDD_McuDiagc.McuDiagcFltFailStep.Val "MICROSAR RTE" /begin SUB_GROUP /end SUB_GROUP /begin FUNCTION_LIST /end FUNCTION_LIST /begin REF_CHARACTERISTIC CDD_McuDiagc.McuDiagcFltFailStep.Val /end REF_CHARACTERISTIC /begin REF_MEASUREMENT /end REF_MEASUREMENT /end GROUP
/begin GROUP CDD_McuDiagc.McuDiagcFltPassStep.Val "MICROSAR RTE" /begin SUB_GROUP /end SUB_GROUP /begin FUNCTION_LIST /end FUNCTION_LIST /begin REF_CHARACTERISTIC CDD_McuDiagc.McuDiagcFltPassStep.Val /end REF_CHARACTERISTIC /begin REF_MEASUREMENT /end REF_MEASUREMENT /end GROUP
/begin GROUP CDD_McuDiagc.PerInstanceMemories "MICROSAR RTE"
 /begin SUB_GROUP CDD_McuDiagc.FastLoopCntrDiagcCfgd CDD_McuDiagc.FastLoopCntrPrev CDD_McuDiagc.LoopCntr2MilliSecStore CDD_McuDiagc.LoopCntrPrev CDD_McuDiagc.dMcuDiagcFastLoopCntrMax CDD_McuDiagc.dMcuDiagcFastLoopCntrMin CDD_McuDiagc.dMcuDiagcLoopCntr2MilliSecMotCtrlDif /end SUB_GROUP
 /begin FUNCTION_LIST /end FUNCTION_LIST
 /begin REF_CHARACTERISTIC /end REF_CHARACTERISTIC
 /begin REF_MEASUREMENT /end REF_MEASUREMENT
/end GROUP
/begin GROUP CDD_McuDiagc.ReceiverPorts "MICROSAR RTE"
 /begin SUB_GROUP CDD_McuDiagc.FastLoopCntr.Val CDD_McuDiagc.SlowLoopCntr.Val /end SUB_GROUP
 /begin FUNCTION_LIST /end FUNCTION_LIST
 /begin REF_CHARACTERISTIC /end REF_CHARACTERISTIC
 /begin REF_MEASUREMENT /end REF_MEASUREMENT
/end GROUP
/begin GROUP CDD_McuDiagc.SenderPorts "MICROSAR RTE" /begin SUB_GROUP CDD_McuDiagc.LoopCntr2MilliSec.Val /end SUB_GROUP /begin FUNCTION_LIST /end FUNCTION_LIST /begin REF_CHARACTERISTIC /end REF_CHARACTERISTIC /begin REF_MEASUREMENT /end REF_MEASUREMENT /end GROUP
/begin GROUP CDD_McuDiagc.SlowLoopCntr.Val "MICROSAR RTE" /begin SUB_GROUP /end SUB_GROUP /begin FUNCTION_LIST /end FUNCTION_LIST /begin REF_CHARACTERISTIC /end REF_CHARACTERISTIC /begin REF_MEASUREMENT CDD_McuDiagc.SlowLoopCntr.Val /end REF_MEASUREMENT /end GROUP
/begin GROUP CDD_McuDiagc.dMcuDiagcFastLoopCntrMax "MICROSAR RTE" /begin SUB_GROUP /end SUB_GROUP /begin FUNCTION_LIST /end FUNCTION_LIST /begin REF_CHARACTERISTIC /end REF_CHARACTERISTIC /begin REF_MEASUREMENT CDD_McuDiagc.dMcuDiagcFastLoopCntrMax /end REF_MEASUREMENT /end GROUP
/begin GROUP CDD_McuDiagc.dMcuDiagcFastLoopCntrMin "MICROSAR RTE" /begin SUB_GROUP /end SUB_GROUP /begin FUNCTION_LIST /end FUNCTION_LIST /begin REF_CHARACTERISTIC /end REF_CHARACTERISTIC /begin REF_MEASUREMENT CDD_McuDiagc.dMcuDiagcFastLoopCntrMin /end REF_MEASUREMENT /end GROUP
/begin GROUP CDD_McuDiagc.dMcuDiagcLoopCntr2MilliSecMotCtrlDif "MICROSAR RTE" /begin SUB_GROUP /end SUB_GROUP /begin FUNCTION_LIST /end FUNCTION_LIST /begin REF_CHARACTERISTIC /end REF_CHARACTERISTIC /begin REF_MEASUREMENT CDD_McuDiagc.dMcuDiagcLoopCntr2MilliSecMotCtrlDif /end REF_MEASUREMENT /end GROUP
/begin GROUP CDD_MotAg0Meas "MICROSAR RTE"
 /begin SUB_GROUP CDD_MotAg0Meas.CalibrationParameters CDD_MotAg0Meas.PerInstanceMemories CDD_MotAg0Meas.ReceiverPorts CDD_MotAg0Meas.SenderPorts /end SUB_GROUP
 /begin FUNCTION_LIST /end FUNCTION_LIST
 /begin REF_CHARACTERISTIC /end REF_CHARACTERISTIC
 /begin REF_MEASUREMENT /end REF_MEASUREMENT
/end GROUP
/begin GROUP CDD_MotAg0Meas.CalibrationParameters "MICROSAR RTE" /begin SUB_GROUP CDD_MotAg0Meas.MotAg0CoeffTblDft /end SUB_GROUP /begin FUNCTION_LIST /end FUNCTION_LIST /begin REF_CHARACTERISTIC /end REF_CHARACTERISTIC /begin REF_MEASUREMENT /end REF_MEASUREMENT /end GROUP
/begin GROUP CDD_MotAg0Meas.MotAg0CoeffTbl "MICROSAR RTE" /begin SUB_GROUP /end SUB_GROUP /begin FUNCTION_LIST /end FUNCTION_LIST /begin REF_CHARACTERISTIC /end REF_CHARACTERISTIC /begin REF_MEASUREMENT CDD_MotAg0Meas.MotAg0CoeffTbl /end REF_MEASUREMENT /end GROUP
/begin GROUP CDD_MotAg0Meas.MotAg0CoeffTblDft "MICROSAR RTE" /begin SUB_GROUP /end SUB_GROUP /begin FUNCTION_LIST /end FUNCTION_LIST /begin REF_CHARACTERISTIC CDD_MotAg0Meas.MotAg0CoeffTblDft /end REF_CHARACTERISTIC /begin REF_MEASUREMENT /end REF_MEASUREMENT /end GROUP
/begin GROUP CDD_MotAg0Meas.MotAg0CorrnTbl "MICROSAR RTE" /begin SUB_GROUP /end SUB_GROUP /begin FUNCTION_LIST /end FUNCTION_LIST /begin REF_CHARACTERISTIC /end REF_CHARACTERISTIC /begin REF_MEASUREMENT CDD_MotAg0Meas.MotAg0CorrnTbl /end REF_MEASUREMENT /end GROUP
/begin GROUP CDD_MotAg0Meas.MotAg0Diagc "MICROSAR RTE" /begin SUB_GROUP /end SUB_GROUP /begin FUNCTION_LIST /end FUNCTION_LIST /begin REF_CHARACTERISTIC /end REF_CHARACTERISTIC /begin REF_MEASUREMENT CDD_MotAg0Meas.MotAg0Diagc /end REF_MEASUREMENT /end GROUP
/begin GROUP CDD_MotAg0Meas.MotAg0InitOffs "MICROSAR RTE" /begin SUB_GROUP /end SUB_GROUP /begin FUNCTION_LIST /end FUNCTION_LIST /begin REF_CHARACTERISTIC /end REF_CHARACTERISTIC /begin REF_MEASUREMENT CDD_MotAg0Meas.MotAg0InitOffs /end REF_MEASUREMENT /end GROUP
/begin GROUP CDD_MotAg0Meas.MotAg0MeclQlfr.Val "MICROSAR RTE" /begin SUB_GROUP /end SUB_GROUP /begin FUNCTION_LIST /end FUNCTION_LIST /begin REF_CHARACTERISTIC /end REF_CHARACTERISTIC /begin REF_MEASUREMENT CDD_MotAg0Meas.MotAg0MeclQlfr.Val /end REF_MEASUREMENT /end GROUP
/begin GROUP CDD_MotAg0Meas.MotAg0MeclRollgCntr.Val "MICROSAR RTE" /begin SUB_GROUP /end SUB_GROUP /begin FUNCTION_LIST /end FUNCTION_LIST /begin REF_CHARACTERISTIC /end REF_CHARACTERISTIC /begin REF_MEASUREMENT CDD_MotAg0Meas.MotAg0MeclRollgCntr.Val /end REF_MEASUREMENT /end GROUP
/begin GROUP CDD_MotAg0Meas.MotAg0Offs.Val "MICROSAR RTE" /begin SUB_GROUP /end SUB_GROUP /begin FUNCTION_LIST /end FUNCTION_LIST /begin REF_CHARACTERISTIC /end REF_CHARACTERISTIC /begin REF_MEASUREMENT CDD_MotAg0Meas.MotAg0Offs.Val /end REF_MEASUREMENT /end GROUP
/begin GROUP CDD_MotAg0Meas.MotAg0PrevOffs "MICROSAR RTE" /begin SUB_GROUP /end SUB_GROUP /begin FUNCTION_LIST /end FUNCTION_LIST /begin REF_CHARACTERISTIC /end REF_CHARACTERISTIC /begin REF_MEASUREMENT CDD_MotAg0Meas.MotAg0PrevOffs /end REF_MEASUREMENT /end GROUP
/begin GROUP CDD_MotAg0Meas.MotAg0PrevRollgCntr "MICROSAR RTE" /begin SUB_GROUP /end SUB_GROUP /begin FUNCTION_LIST /end FUNCTION_LIST /begin REF_CHARACTERISTIC /end REF_CHARACTERISTIC /begin REF_MEASUREMENT CDD_MotAg0Meas.MotAg0PrevRollgCntr /end REF_MEASUREMENT /end GROUP
/begin GROUP CDD_MotAg0Meas.MotAg0PrevSpiErrFltCntr "MICROSAR RTE" /begin SUB_GROUP /end SUB_GROUP /begin FUNCTION_LIST /end FUNCTION_LIST /begin REF_CHARACTERISTIC /end REF_CHARACTERISTIC /begin REF_MEASUREMENT CDD_MotAg0Meas.MotAg0PrevSpiErrFltCntr /end REF_MEASUREMENT /end GROUP
/begin GROUP CDD_MotAg0Meas.MotAgMecl0Polarity.Val "MICROSAR RTE" /begin SUB_GROUP /end SUB_GROUP /begin FUNCTION_LIST /end FUNCTION_LIST /begin REF_CHARACTERISTIC /end REF_CHARACTERISTIC /begin REF_MEASUREMENT CDD_MotAg0Meas.MotAgMecl0Polarity.Val /end REF_MEASUREMENT /end GROUP
/begin GROUP CDD_MotAg0Meas.PerInstanceMemories "MICROSAR RTE"
 /begin SUB_GROUP CDD_MotAg0Meas.MotAg0CoeffTbl CDD_MotAg0Meas.MotAg0CorrnTbl CDD_MotAg0Meas.MotAg0Diagc CDD_MotAg0Meas.MotAg0InitOffs CDD_MotAg0Meas.MotAg0PrevOffs CDD_MotAg0Meas.MotAg0PrevRollgCntr CDD_MotAg0Meas.MotAg0PrevSpiErrFltCntr CDD_MotAg0Meas.dMotAg0MeasMotAg0Delta CDD_MotAg0Meas.dMotAg0MeasMotAg0RawAgReg CDD_MotAg0Meas.dMotAg0MeasMotAg0RawErrReg CDD_MotAg0Meas.dMotAg0MeasMotAg0RawReg CDD_MotAg0Meas.dMotAg0MeasMotAg0RawTurnCntrReg CDD_MotAg0Meas.dMotAg0MeasMotAg0RtOffs CDD_MotAg0Meas.dMotAg0MeasMotAg0SpiCntrAg CDD_MotAg0Meas.dMotAg0MeasMotAg0SpiMecl CDD_MotAg0Meas.dMotAg0MeasMotAg0TurnCntr CDD_MotAg0Meas.dMotAg0MeasMotCtrlMotAg3Mecl /end SUB_GROUP
 /begin FUNCTION_LIST /end FUNCTION_LIST
 /begin REF_CHARACTERISTIC /end REF_CHARACTERISTIC
 /begin REF_MEASUREMENT /end REF_MEASUREMENT
/end GROUP
/begin GROUP CDD_MotAg0Meas.ReceiverPorts "MICROSAR RTE" /begin SUB_GROUP CDD_MotAg0Meas.MotAgMecl0Polarity.Val /end SUB_GROUP /begin FUNCTION_LIST /end FUNCTION_LIST /begin REF_CHARACTERISTIC /end REF_CHARACTERISTIC /begin REF_MEASUREMENT /end REF_MEASUREMENT /end GROUP
/begin GROUP CDD_MotAg0Meas.SenderPorts "MICROSAR RTE"
 /begin SUB_GROUP CDD_MotAg0Meas.MotAg0MeclQlfr.Val CDD_MotAg0Meas.MotAg0MeclRollgCntr.Val CDD_MotAg0Meas.MotAg0Offs.Val /end SUB_GROUP
 /begin FUNCTION_LIST /end FUNCTION_LIST
 /begin REF_CHARACTERISTIC /end REF_CHARACTERISTIC
 /begin REF_MEASUREMENT /end REF_MEASUREMENT
/end GROUP
/begin GROUP CDD_MotAg0Meas.dMotAg0MeasMotAg0Delta "MICROSAR RTE" /begin SUB_GROUP /end SUB_GROUP /begin FUNCTION_LIST /end FUNCTION_LIST /begin REF_CHARACTERISTIC /end REF_CHARACTERISTIC /begin REF_MEASUREMENT CDD_MotAg0Meas.dMotAg0MeasMotAg0Delta /end REF_MEASUREMENT /end GROUP
/begin GROUP CDD_MotAg0Meas.dMotAg0MeasMotAg0RawAgReg "MICROSAR RTE" /begin SUB_GROUP /end SUB_GROUP /begin FUNCTION_LIST /end FUNCTION_LIST /begin REF_CHARACTERISTIC /end REF_CHARACTERISTIC /begin REF_MEASUREMENT CDD_MotAg0Meas.dMotAg0MeasMotAg0RawAgReg /end REF_MEASUREMENT /end GROUP
/begin GROUP CDD_MotAg0Meas.dMotAg0MeasMotAg0RawErrReg "MICROSAR RTE" /begin SUB_GROUP /end SUB_GROUP /begin FUNCTION_LIST /end FUNCTION_LIST /begin REF_CHARACTERISTIC /end REF_CHARACTERISTIC /begin REF_MEASUREMENT CDD_MotAg0Meas.dMotAg0MeasMotAg0RawErrReg /end REF_MEASUREMENT /end GROUP
/begin GROUP CDD_MotAg0Meas.dMotAg0MeasMotAg0RawReg "MICROSAR RTE" /begin SUB_GROUP /end SUB_GROUP /begin FUNCTION_LIST /end FUNCTION_LIST /begin REF_CHARACTERISTIC /end REF_CHARACTERISTIC /begin REF_MEASUREMENT CDD_MotAg0Meas.dMotAg0MeasMotAg0RawReg /end REF_MEASUREMENT /end GROUP
/begin GROUP CDD_MotAg0Meas.dMotAg0MeasMotAg0RawTurnCntrReg "MICROSAR RTE" /begin SUB_GROUP /end SUB_GROUP /begin FUNCTION_LIST /end FUNCTION_LIST /begin REF_CHARACTERISTIC /end REF_CHARACTERISTIC /begin REF_MEASUREMENT CDD_MotAg0Meas.dMotAg0MeasMotAg0RawTurnCntrReg /end REF_MEASUREMENT /end GROUP
/begin GROUP CDD_MotAg0Meas.dMotAg0MeasMotAg0RtOffs "MICROSAR RTE" /begin SUB_GROUP /end SUB_GROUP /begin FUNCTION_LIST /end FUNCTION_LIST /begin REF_CHARACTERISTIC /end REF_CHARACTERISTIC /begin REF_MEASUREMENT CDD_MotAg0Meas.dMotAg0MeasMotAg0RtOffs /end REF_MEASUREMENT /end GROUP
/begin GROUP CDD_MotAg0Meas.dMotAg0MeasMotAg0SpiCntrAg "MICROSAR RTE" /begin SUB_GROUP /end SUB_GROUP /begin FUNCTION_LIST /end FUNCTION_LIST /begin REF_CHARACTERISTIC /end REF_CHARACTERISTIC /begin REF_MEASUREMENT CDD_MotAg0Meas.dMotAg0MeasMotAg0SpiCntrAg /end REF_MEASUREMENT /end GROUP
/begin GROUP CDD_MotAg0Meas.dMotAg0MeasMotAg0SpiMecl "MICROSAR RTE" /begin SUB_GROUP /end SUB_GROUP /begin FUNCTION_LIST /end FUNCTION_LIST /begin REF_CHARACTERISTIC /end REF_CHARACTERISTIC /begin REF_MEASUREMENT CDD_MotAg0Meas.dMotAg0MeasMotAg0SpiMecl /end REF_MEASUREMENT /end GROUP
/begin GROUP CDD_MotAg0Meas.dMotAg0MeasMotAg0TurnCntr "MICROSAR RTE" /begin SUB_GROUP /end SUB_GROUP /begin FUNCTION_LIST /end FUNCTION_LIST /begin REF_CHARACTERISTIC /end REF_CHARACTERISTIC /begin REF_MEASUREMENT CDD_MotAg0Meas.dMotAg0MeasMotAg0TurnCntr /end REF_MEASUREMENT /end GROUP
/begin GROUP CDD_MotAg0Meas.dMotAg0MeasMotCtrlMotAg3Mecl "MICROSAR RTE" /begin SUB_GROUP /end SUB_GROUP /begin FUNCTION_LIST /end FUNCTION_LIST /begin REF_CHARACTERISTIC /end REF_CHARACTERISTIC /begin REF_MEASUREMENT CDD_MotAg0Meas.dMotAg0MeasMotCtrlMotAg3Mecl /end REF_MEASUREMENT /end GROUP
/begin GROUP CDD_MotAg1Meas "MICROSAR RTE"
 /begin SUB_GROUP CDD_MotAg1Meas.CalibrationParameters CDD_MotAg1Meas.CalibrationPorts CDD_MotAg1Meas.PerInstanceMemories CDD_MotAg1Meas.ReceiverPorts CDD_MotAg1Meas.SenderPorts /end SUB_GROUP
 /begin FUNCTION_LIST /end FUNCTION_LIST
 /begin REF_CHARACTERISTIC /end REF_CHARACTERISTIC
 /begin REF_MEASUREMENT /end REF_MEASUREMENT
/end GROUP
/begin GROUP CDD_MotAg1Meas.CalibrationParameters "MICROSAR RTE" /begin SUB_GROUP CDD_MotAg1Meas.MotAg1CoeffTblDft /end SUB_GROUP /begin FUNCTION_LIST /end FUNCTION_LIST /begin REF_CHARACTERISTIC /end REF_CHARACTERISTIC /begin REF_MEASUREMENT /end REF_MEASUREMENT /end GROUP
/begin GROUP CDD_MotAg1Meas.CalibrationPorts "MICROSAR RTE" /begin SUB_GROUP CDD_MotAg1Meas.MotAg1MeasMotAgOffs.Val /end SUB_GROUP /begin FUNCTION_LIST /end FUNCTION_LIST /begin REF_CHARACTERISTIC /end REF_CHARACTERISTIC /begin REF_MEASUREMENT /end REF_MEASUREMENT /end GROUP
/begin GROUP CDD_MotAg1Meas.MotAg1CoeffTbl "MICROSAR RTE" /begin SUB_GROUP /end SUB_GROUP /begin FUNCTION_LIST /end FUNCTION_LIST /begin REF_CHARACTERISTIC /end REF_CHARACTERISTIC /begin REF_MEASUREMENT CDD_MotAg1Meas.MotAg1CoeffTbl /end REF_MEASUREMENT /end GROUP
/begin GROUP CDD_MotAg1Meas.MotAg1CoeffTblDft "MICROSAR RTE" /begin SUB_GROUP /end SUB_GROUP /begin FUNCTION_LIST /end FUNCTION_LIST /begin REF_CHARACTERISTIC CDD_MotAg1Meas.MotAg1CoeffTblDft /end REF_CHARACTERISTIC /begin REF_MEASUREMENT /end REF_MEASUREMENT /end GROUP
/begin GROUP CDD_MotAg1Meas.MotAg1CorrnTbl "MICROSAR RTE" /begin SUB_GROUP /end SUB_GROUP /begin FUNCTION_LIST /end FUNCTION_LIST /begin REF_CHARACTERISTIC /end REF_CHARACTERISTIC /begin REF_MEASUREMENT CDD_MotAg1Meas.MotAg1CorrnTbl /end REF_MEASUREMENT /end GROUP
/begin GROUP CDD_MotAg1Meas.MotAg1Diagc "MICROSAR RTE" /begin SUB_GROUP /end SUB_GROUP /begin FUNCTION_LIST /end FUNCTION_LIST /begin REF_CHARACTERISTIC /end REF_CHARACTERISTIC /begin REF_MEASUREMENT CDD_MotAg1Meas.MotAg1Diagc /end REF_MEASUREMENT /end GROUP
/begin GROUP CDD_MotAg1Meas.MotAg1InitOffs "MICROSAR RTE" /begin SUB_GROUP /end SUB_GROUP /begin FUNCTION_LIST /end FUNCTION_LIST /begin REF_CHARACTERISTIC /end REF_CHARACTERISTIC /begin REF_MEASUREMENT CDD_MotAg1Meas.MotAg1InitOffs /end REF_MEASUREMENT /end GROUP
/begin GROUP CDD_MotAg1Meas.MotAg1MeasMotAgOffs.Val "MICROSAR RTE" /begin SUB_GROUP /end SUB_GROUP /begin FUNCTION_LIST /end FUNCTION_LIST /begin REF_CHARACTERISTIC CDD_MotAg1Meas.MotAg1MeasMotAgOffs.Val /end REF_CHARACTERISTIC /begin REF_MEASUREMENT /end REF_MEASUREMENT /end GROUP
/begin GROUP CDD_MotAg1Meas.MotAg1MeclQlfr.Val "MICROSAR RTE" /begin SUB_GROUP /end SUB_GROUP /begin FUNCTION_LIST /end FUNCTION_LIST /begin REF_CHARACTERISTIC /end REF_CHARACTERISTIC /begin REF_MEASUREMENT CDD_MotAg1Meas.MotAg1MeclQlfr.Val /end REF_MEASUREMENT /end GROUP
/begin GROUP CDD_MotAg1Meas.MotAg1MeclRollgCntr.Val "MICROSAR RTE" /begin SUB_GROUP /end SUB_GROUP /begin FUNCTION_LIST /end FUNCTION_LIST /begin REF_CHARACTERISTIC /end REF_CHARACTERISTIC /begin REF_MEASUREMENT CDD_MotAg1Meas.MotAg1MeclRollgCntr.Val /end REF_MEASUREMENT /end GROUP
/begin GROUP CDD_MotAg1Meas.MotAg1Offs.Val "MICROSAR RTE" /begin SUB_GROUP /end SUB_GROUP /begin FUNCTION_LIST /end FUNCTION_LIST /begin REF_CHARACTERISTIC /end REF_CHARACTERISTIC /begin REF_MEASUREMENT CDD_MotAg1Meas.MotAg1Offs.Val /end REF_MEASUREMENT /end GROUP
/begin GROUP CDD_MotAg1Meas.MotAg1PrevOffs "MICROSAR RTE" /begin SUB_GROUP /end SUB_GROUP /begin FUNCTION_LIST /end FUNCTION_LIST /begin REF_CHARACTERISTIC /end REF_CHARACTERISTIC /begin REF_MEASUREMENT CDD_MotAg1Meas.MotAg1PrevOffs /end REF_MEASUREMENT /end GROUP
/begin GROUP CDD_MotAg1Meas.MotAg1PrevRollgCntr "MICROSAR RTE" /begin SUB_GROUP /end SUB_GROUP /begin FUNCTION_LIST /end FUNCTION_LIST /begin REF_CHARACTERISTIC /end REF_CHARACTERISTIC /begin REF_MEASUREMENT CDD_MotAg1Meas.MotAg1PrevRollgCntr /end REF_MEASUREMENT /end GROUP
/begin GROUP CDD_MotAg1Meas.MotAg1PrevSpiErrFltCntr "MICROSAR RTE" /begin SUB_GROUP /end SUB_GROUP /begin FUNCTION_LIST /end FUNCTION_LIST /begin REF_CHARACTERISTIC /end REF_CHARACTERISTIC /begin REF_MEASUREMENT CDD_MotAg1Meas.MotAg1PrevSpiErrFltCntr /end REF_MEASUREMENT /end GROUP
/begin GROUP CDD_MotAg1Meas.MotAgMecl1Polarity.Val "MICROSAR RTE" /begin SUB_GROUP /end SUB_GROUP /begin FUNCTION_LIST /end FUNCTION_LIST /begin REF_CHARACTERISTIC /end REF_CHARACTERISTIC /begin REF_MEASUREMENT CDD_MotAg1Meas.MotAgMecl1Polarity.Val /end REF_MEASUREMENT /end GROUP
/begin GROUP CDD_MotAg1Meas.PerInstanceMemories "MICROSAR RTE"
 /begin SUB_GROUP CDD_MotAg1Meas.MotAg1CoeffTbl CDD_MotAg1Meas.MotAg1CorrnTbl CDD_MotAg1Meas.MotAg1Diagc CDD_MotAg1Meas.MotAg1InitOffs CDD_MotAg1Meas.MotAg1PrevOffs CDD_MotAg1Meas.MotAg1PrevRollgCntr CDD_MotAg1Meas.MotAg1PrevSpiErrFltCntr CDD_MotAg1Meas.dMotAg1MeasMotAg1Delta CDD_MotAg1Meas.dMotAg1MeasMotAg1RawAgReg CDD_MotAg1Meas.dMotAg1MeasMotAg1RawErrReg CDD_MotAg1Meas.dMotAg1MeasMotAg1RawReg CDD_MotAg1Meas.dMotAg1MeasMotAg1RawTurnCntrReg CDD_MotAg1Meas.dMotAg1MeasMotAg1RtOffs CDD_MotAg1Meas.dMotAg1MeasMotAg1SpiCntrAg CDD_MotAg1Meas.dMotAg1MeasMotAg1SpiMecl CDD_MotAg1Meas.dMotAg1MeasMotAg1TurnCntr CDD_MotAg1Meas.dMotAg1MeasMotCtrlMotAg4Mecl /end SUB_GROUP
 /begin FUNCTION_LIST /end FUNCTION_LIST
 /begin REF_CHARACTERISTIC /end REF_CHARACTERISTIC
 /begin REF_MEASUREMENT /end REF_MEASUREMENT
/end GROUP
/begin GROUP CDD_MotAg1Meas.ReceiverPorts "MICROSAR RTE" /begin SUB_GROUP CDD_MotAg1Meas.MotAgMecl1Polarity.Val /end SUB_GROUP /begin FUNCTION_LIST /end FUNCTION_LIST /begin REF_CHARACTERISTIC /end REF_CHARACTERISTIC /begin REF_MEASUREMENT /end REF_MEASUREMENT /end GROUP
/begin GROUP CDD_MotAg1Meas.SenderPorts "MICROSAR RTE"
 /begin SUB_GROUP CDD_MotAg1Meas.MotAg1MeclQlfr.Val CDD_MotAg1Meas.MotAg1MeclRollgCntr.Val CDD_MotAg1Meas.MotAg1Offs.Val /end SUB_GROUP
 /begin FUNCTION_LIST /end FUNCTION_LIST
 /begin REF_CHARACTERISTIC /end REF_CHARACTERISTIC
 /begin REF_MEASUREMENT /end REF_MEASUREMENT
/end GROUP
/begin GROUP CDD_MotAg1Meas.dMotAg1MeasMotAg1Delta "MICROSAR RTE" /begin SUB_GROUP /end SUB_GROUP /begin FUNCTION_LIST /end FUNCTION_LIST /begin REF_CHARACTERISTIC /end REF_CHARACTERISTIC /begin REF_MEASUREMENT CDD_MotAg1Meas.dMotAg1MeasMotAg1Delta /end REF_MEASUREMENT /end GROUP
/begin GROUP CDD_MotAg1Meas.dMotAg1MeasMotAg1RawAgReg "MICROSAR RTE" /begin SUB_GROUP /end SUB_GROUP /begin FUNCTION_LIST /end FUNCTION_LIST /begin REF_CHARACTERISTIC /end REF_CHARACTERISTIC /begin REF_MEASUREMENT CDD_MotAg1Meas.dMotAg1MeasMotAg1RawAgReg /end REF_MEASUREMENT /end GROUP
/begin GROUP CDD_MotAg1Meas.dMotAg1MeasMotAg1RawErrReg "MICROSAR RTE" /begin SUB_GROUP /end SUB_GROUP /begin FUNCTION_LIST /end FUNCTION_LIST /begin REF_CHARACTERISTIC /end REF_CHARACTERISTIC /begin REF_MEASUREMENT CDD_MotAg1Meas.dMotAg1MeasMotAg1RawErrReg /end REF_MEASUREMENT /end GROUP
/begin GROUP CDD_MotAg1Meas.dMotAg1MeasMotAg1RawReg "MICROSAR RTE" /begin SUB_GROUP /end SUB_GROUP /begin FUNCTION_LIST /end FUNCTION_LIST /begin REF_CHARACTERISTIC /end REF_CHARACTERISTIC /begin REF_MEASUREMENT CDD_MotAg1Meas.dMotAg1MeasMotAg1RawReg /end REF_MEASUREMENT /end GROUP
/begin GROUP CDD_MotAg1Meas.dMotAg1MeasMotAg1RawTurnCntrReg "MICROSAR RTE" /begin SUB_GROUP /end SUB_GROUP /begin FUNCTION_LIST /end FUNCTION_LIST /begin REF_CHARACTERISTIC /end REF_CHARACTERISTIC /begin REF_MEASUREMENT CDD_MotAg1Meas.dMotAg1MeasMotAg1RawTurnCntrReg /end REF_MEASUREMENT /end GROUP
/begin GROUP CDD_MotAg1Meas.dMotAg1MeasMotAg1RtOffs "MICROSAR RTE" /begin SUB_GROUP /end SUB_GROUP /begin FUNCTION_LIST /end FUNCTION_LIST /begin REF_CHARACTERISTIC /end REF_CHARACTERISTIC /begin REF_MEASUREMENT CDD_MotAg1Meas.dMotAg1MeasMotAg1RtOffs /end REF_MEASUREMENT /end GROUP
/begin GROUP CDD_MotAg1Meas.dMotAg1MeasMotAg1SpiCntrAg "MICROSAR RTE" /begin SUB_GROUP /end SUB_GROUP /begin FUNCTION_LIST /end FUNCTION_LIST /begin REF_CHARACTERISTIC /end REF_CHARACTERISTIC /begin REF_MEASUREMENT CDD_MotAg1Meas.dMotAg1MeasMotAg1SpiCntrAg /end REF_MEASUREMENT /end GROUP
/begin GROUP CDD_MotAg1Meas.dMotAg1MeasMotAg1SpiMecl "MICROSAR RTE" /begin SUB_GROUP /end SUB_GROUP /begin FUNCTION_LIST /end FUNCTION_LIST /begin REF_CHARACTERISTIC /end REF_CHARACTERISTIC /begin REF_MEASUREMENT CDD_MotAg1Meas.dMotAg1MeasMotAg1SpiMecl /end REF_MEASUREMENT /end GROUP
/begin GROUP CDD_MotAg1Meas.dMotAg1MeasMotAg1TurnCntr "MICROSAR RTE" /begin SUB_GROUP /end SUB_GROUP /begin FUNCTION_LIST /end FUNCTION_LIST /begin REF_CHARACTERISTIC /end REF_CHARACTERISTIC /begin REF_MEASUREMENT CDD_MotAg1Meas.dMotAg1MeasMotAg1TurnCntr /end REF_MEASUREMENT /end GROUP
/begin GROUP CDD_MotAg1Meas.dMotAg1MeasMotCtrlMotAg4Mecl "MICROSAR RTE" /begin SUB_GROUP /end SUB_GROUP /begin FUNCTION_LIST /end FUNCTION_LIST /begin REF_CHARACTERISTIC /end REF_CHARACTERISTIC /begin REF_MEASUREMENT CDD_MotAg1Meas.dMotAg1MeasMotCtrlMotAg4Mecl /end REF_MEASUREMENT /end GROUP
/begin GROUP CDD_MotAg3Meas "MICROSAR RTE" /begin SUB_GROUP CDD_MotAg3Meas.ReceiverPorts /end SUB_GROUP /begin FUNCTION_LIST /end FUNCTION_LIST /begin REF_CHARACTERISTIC /end REF_CHARACTERISTIC /begin REF_MEASUREMENT /end REF_MEASUREMENT /end GROUP
/begin GROUP CDD_MotAg3Meas.MotAgMecl3Polarity.Val "MICROSAR RTE" /begin SUB_GROUP /end SUB_GROUP /begin FUNCTION_LIST /end FUNCTION_LIST /begin REF_CHARACTERISTIC /end REF_CHARACTERISTIC /begin REF_MEASUREMENT CDD_MotAg3Meas.MotAgMecl3Polarity.Val /end REF_MEASUREMENT /end GROUP
/begin GROUP CDD_MotAg3Meas.ReceiverPorts "MICROSAR RTE" /begin SUB_GROUP CDD_MotAg3Meas.MotAgMecl3Polarity.Val /end SUB_GROUP /begin FUNCTION_LIST /end FUNCTION_LIST /begin REF_CHARACTERISTIC /end REF_CHARACTERISTIC /begin REF_MEASUREMENT /end REF_MEASUREMENT /end GROUP
/begin GROUP CDD_MotAg4Meas "MICROSAR RTE" /begin SUB_GROUP CDD_MotAg4Meas.ReceiverPorts /end SUB_GROUP /begin FUNCTION_LIST /end FUNCTION_LIST /begin REF_CHARACTERISTIC /end REF_CHARACTERISTIC /begin REF_MEASUREMENT /end REF_MEASUREMENT /end GROUP
/begin GROUP CDD_MotAg4Meas.MotAgMecl4Polarity.Val "MICROSAR RTE" /begin SUB_GROUP /end SUB_GROUP /begin FUNCTION_LIST /end FUNCTION_LIST /begin REF_CHARACTERISTIC /end REF_CHARACTERISTIC /begin REF_MEASUREMENT CDD_MotAg4Meas.MotAgMecl4Polarity.Val /end REF_MEASUREMENT /end GROUP
/begin GROUP CDD_MotAg4Meas.ReceiverPorts "MICROSAR RTE" /begin SUB_GROUP CDD_MotAg4Meas.MotAgMecl4Polarity.Val /end SUB_GROUP /begin FUNCTION_LIST /end FUNCTION_LIST /begin REF_CHARACTERISTIC /end REF_CHARACTERISTIC /begin REF_MEASUREMENT /end REF_MEASUREMENT /end GROUP
/begin GROUP CDD_MotAgArbn "MICROSAR RTE" /begin SUB_GROUP CDD_MotAgArbn.PerInstanceMemories /end SUB_GROUP /begin FUNCTION_LIST /end FUNCTION_LIST /begin REF_CHARACTERISTIC /end REF_CHARACTERISTIC /begin REF_MEASUREMENT /end REF_MEASUREMENT /end GROUP
/begin GROUP CDD_MotAgArbn.MotAgARollgCntPrev "MICROSAR RTE" /begin SUB_GROUP /end SUB_GROUP /begin FUNCTION_LIST /end FUNCTION_LIST /begin REF_CHARACTERISTIC /end REF_CHARACTERISTIC /begin REF_MEASUREMENT CDD_MotAgArbn.MotAgARollgCntPrev /end REF_MEASUREMENT /end GROUP
/begin GROUP CDD_MotAgArbn.MotAgAStallCntPrev "MICROSAR RTE" /begin SUB_GROUP /end SUB_GROUP /begin FUNCTION_LIST /end FUNCTION_LIST /begin REF_CHARACTERISTIC /end REF_CHARACTERISTIC /begin REF_MEASUREMENT CDD_MotAgArbn.MotAgAStallCntPrev /end REF_MEASUREMENT /end GROUP
/begin GROUP CDD_MotAgArbn.MotAgMeclPrev "MICROSAR RTE" /begin SUB_GROUP /end SUB_GROUP /begin FUNCTION_LIST /end FUNCTION_LIST /begin REF_CHARACTERISTIC /end REF_CHARACTERISTIC /begin REF_MEASUREMENT CDD_MotAgArbn.MotAgMeclPrev /end REF_MEASUREMENT /end GROUP
/begin GROUP CDD_MotAgArbn.PerInstanceMemories "MICROSAR RTE"
 /begin SUB_GROUP CDD_MotAgArbn.MotAgARollgCntPrev CDD_MotAgArbn.MotAgAStallCntPrev CDD_MotAgArbn.MotAgMeclPrev /end SUB_GROUP
 /begin FUNCTION_LIST /end FUNCTION_LIST
 /begin REF_CHARACTERISTIC /end REF_CHARACTERISTIC
 /begin REF_MEASUREMENT /end REF_MEASUREMENT
/end GROUP
/begin GROUP CDD_MotAgCmp "MICROSAR RTE"
 /begin SUB_GROUP CDD_MotAgCmp.CalibrationParameters CDD_MotAgCmp.CalibrationPorts CDD_MotAgCmp.PerInstanceMemories CDD_MotAgCmp.ReceiverPorts CDD_MotAgCmp.SenderPorts /end SUB_GROUP
 /begin FUNCTION_LIST /end FUNCTION_LIST
 /begin REF_CHARACTERISTIC /end REF_CHARACTERISTIC
 /begin REF_MEASUREMENT /end REF_MEASUREMENT
/end GROUP
/begin GROUP CDD_MotAgCmp.AssiMechPolarity.Val "MICROSAR RTE" /begin SUB_GROUP /end SUB_GROUP /begin FUNCTION_LIST /end FUNCTION_LIST /begin REF_CHARACTERISTIC /end REF_CHARACTERISTIC /begin REF_MEASUREMENT CDD_MotAgCmp.AssiMechPolarity.Val /end REF_MEASUREMENT /end GROUP
/begin GROUP CDD_MotAgCmp.CalibrationParameters "MICROSAR RTE" /begin SUB_GROUP CDD_MotAgCmp.MotAgCmpMotAgBackEmfDft /end SUB_GROUP /begin FUNCTION_LIST /end FUNCTION_LIST /begin REF_CHARACTERISTIC /end REF_CHARACTERISTIC /begin REF_MEASUREMENT /end REF_MEASUREMENT /end GROUP
/begin GROUP CDD_MotAgCmp.CalibrationPorts "MICROSAR RTE" /begin SUB_GROUP CDD_MotAgCmp.SysGlbPrmMotPoleCnt.Val /end SUB_GROUP /begin FUNCTION_LIST /end FUNCTION_LIST /begin REF_CHARACTERISTIC /end REF_CHARACTERISTIC /begin REF_MEASUREMENT /end REF_MEASUREMENT /end GROUP
/begin GROUP CDD_MotAgCmp.MotAgCmpFirstRunCmpl "MICROSAR RTE" /begin SUB_GROUP /end SUB_GROUP /begin FUNCTION_LIST /end FUNCTION_LIST /begin REF_CHARACTERISTIC /end REF_CHARACTERISTIC /begin REF_MEASUREMENT CDD_MotAgCmp.MotAgCmpFirstRunCmpl /end REF_MEASUREMENT /end GROUP
/begin GROUP CDD_MotAgCmp.MotAgCmpMotAgBackEmf "MICROSAR RTE" /begin SUB_GROUP /end SUB_GROUP /begin FUNCTION_LIST /end FUNCTION_LIST /begin REF_CHARACTERISTIC /end REF_CHARACTERISTIC /begin REF_MEASUREMENT CDD_MotAgCmp.MotAgCmpMotAgBackEmf /end REF_MEASUREMENT /end GROUP
/begin GROUP CDD_MotAgCmp.MotAgCmpMotAgBackEmfDft "MICROSAR RTE" /begin SUB_GROUP /end SUB_GROUP /begin FUNCTION_LIST /end FUNCTION_LIST /begin REF_CHARACTERISTIC CDD_MotAgCmp.MotAgCmpMotAgBackEmfDft /end REF_CHARACTERISTIC /begin REF_MEASUREMENT /end REF_MEASUREMENT /end GROUP
/begin GROUP CDD_MotAgCmp.MotAgCmpMotCtrlMotAgCumvAlgndMrfRevSVPrev "MICROSAR RTE" /begin SUB_GROUP /end SUB_GROUP /begin FUNCTION_LIST /end FUNCTION_LIST /begin REF_CHARACTERISTIC /end REF_CHARACTERISTIC /begin REF_MEASUREMENT CDD_MotAgCmp.MotAgCmpMotCtrlMotAgCumvAlgndMrfRevSVPrev /end REF_MEASUREMENT /end GROUP
/begin GROUP CDD_MotAgCmp.MotAgCmpMotCtrlMotAgMeclPrev "MICROSAR RTE" /begin SUB_GROUP /end SUB_GROUP /begin FUNCTION_LIST /end FUNCTION_LIST /begin REF_CHARACTERISTIC /end REF_CHARACTERISTIC /begin REF_MEASUREMENT CDD_MotAgCmp.MotAgCmpMotCtrlMotAgMeclPrev /end REF_MEASUREMENT /end GROUP
/begin GROUP CDD_MotAgCmp.MotAgCumvAlgndCrf.Val "MICROSAR RTE" /begin SUB_GROUP /end SUB_GROUP /begin FUNCTION_LIST /end FUNCTION_LIST /begin REF_CHARACTERISTIC /end REF_CHARACTERISTIC /begin REF_MEASUREMENT CDD_MotAgCmp.MotAgCumvAlgndCrf.Val /end REF_MEASUREMENT /end GROUP
/begin GROUP CDD_MotAgCmp.MotAgCumvAlgndMrf.Val "MICROSAR RTE" /begin SUB_GROUP /end SUB_GROUP /begin FUNCTION_LIST /end FUNCTION_LIST /begin REF_CHARACTERISTIC /end REF_CHARACTERISTIC /begin REF_MEASUREMENT CDD_MotAgCmp.MotAgCumvAlgndMrf.Val /end REF_MEASUREMENT /end GROUP
/begin GROUP CDD_MotAgCmp.MotAgCumvAlgndMrfRev.Val "MICROSAR RTE" /begin SUB_GROUP /end SUB_GROUP /begin FUNCTION_LIST /end FUNCTION_LIST /begin REF_CHARACTERISTIC /end REF_CHARACTERISTIC /begin REF_MEASUREMENT CDD_MotAgCmp.MotAgCumvAlgndMrfRev.Val /end REF_MEASUREMENT /end GROUP
/begin GROUP CDD_MotAgCmp.PerInstanceMemories "MICROSAR RTE"
 /begin SUB_GROUP CDD_MotAgCmp.MotAgCmpFirstRunCmpl CDD_MotAgCmp.MotAgCmpMotAgBackEmf CDD_MotAgCmp.MotAgCmpMotCtrlMotAgCumvAlgndMrfRevSVPrev CDD_MotAgCmp.MotAgCmpMotCtrlMotAgMeclPrev /end SUB_GROUP
 /begin FUNCTION_LIST /end FUNCTION_LIST
 /begin REF_CHARACTERISTIC /end REF_CHARACTERISTIC
 /begin REF_MEASUREMENT /end REF_MEASUREMENT
/end GROUP
/begin GROUP CDD_MotAgCmp.ReceiverPorts "MICROSAR RTE"
 /begin SUB_GROUP CDD_MotAgCmp.AssiMechPolarity.Val CDD_MotAgCmp.MotAgCumvAlgndMrfRev.Val /end SUB_GROUP
 /begin FUNCTION_LIST /end FUNCTION_LIST
 /begin REF_CHARACTERISTIC /end REF_CHARACTERISTIC
 /begin REF_MEASUREMENT /end REF_MEASUREMENT
/end GROUP
/begin GROUP CDD_MotAgCmp.SenderPorts "MICROSAR RTE"
 /begin SUB_GROUP CDD_MotAgCmp.MotAgCumvAlgndCrf.Val CDD_MotAgCmp.MotAgCumvAlgndMrf.Val /end SUB_GROUP
 /begin FUNCTION_LIST /end FUNCTION_LIST
 /begin REF_CHARACTERISTIC /end REF_CHARACTERISTIC
 /begin REF_MEASUREMENT /end REF_MEASUREMENT
/end GROUP
/begin GROUP CDD_MotAgCmp.SysGlbPrmMotPoleCnt.Val "MICROSAR RTE" /begin SUB_GROUP /end SUB_GROUP /begin FUNCTION_LIST /end FUNCTION_LIST /begin REF_CHARACTERISTIC CDD_MotAgCmp.SysGlbPrmMotPoleCnt.Val /end REF_CHARACTERISTIC /begin REF_MEASUREMENT /end REF_MEASUREMENT /end GROUP
/begin GROUP CDD_MotCtrlMgr "MICROSAR RTE" /begin SUB_GROUP CDD_MotCtrlMgr.ReceiverPorts CDD_MotCtrlMgr.SenderPorts /end SUB_GROUP /begin FUNCTION_LIST /end FUNCTION_LIST /begin REF_CHARACTERISTIC /end REF_CHARACTERISTIC /begin REF_MEASUREMENT /end REF_MEASUREMENT /end GROUP
/begin GROUP CDD_MotCtrlMgr.Adc0ScanGroup2Ref0.Val "MICROSAR RTE" /begin SUB_GROUP /end SUB_GROUP /begin FUNCTION_LIST /end FUNCTION_LIST /begin REF_CHARACTERISTIC /end REF_CHARACTERISTIC /begin REF_MEASUREMENT CDD_MotCtrlMgr.Adc0ScanGroup2Ref0.Val /end REF_MEASUREMENT /end GROUP
/begin GROUP CDD_MotCtrlMgr.Adc0ScanGroup2Ref1.Val "MICROSAR RTE" /begin SUB_GROUP /end SUB_GROUP /begin FUNCTION_LIST /end FUNCTION_LIST /begin REF_CHARACTERISTIC /end REF_CHARACTERISTIC /begin REF_MEASUREMENT CDD_MotCtrlMgr.Adc0ScanGroup2Ref1.Val /end REF_MEASUREMENT /end GROUP
/begin GROUP CDD_MotCtrlMgr.Adc0ScanGroup3Ref0.Val "MICROSAR RTE" /begin SUB_GROUP /end SUB_GROUP /begin FUNCTION_LIST /end FUNCTION_LIST /begin REF_CHARACTERISTIC /end REF_CHARACTERISTIC /begin REF_MEASUREMENT CDD_MotCtrlMgr.Adc0ScanGroup3Ref0.Val /end REF_MEASUREMENT /end GROUP
/begin GROUP CDD_MotCtrlMgr.Adc0ScanGroup3Ref1.Val "MICROSAR RTE" /begin SUB_GROUP /end SUB_GROUP /begin FUNCTION_LIST /end FUNCTION_LIST /begin REF_CHARACTERISTIC /end REF_CHARACTERISTIC /begin REF_MEASUREMENT CDD_MotCtrlMgr.Adc0ScanGroup3Ref1.Val /end REF_MEASUREMENT /end GROUP
/begin GROUP CDD_MotCtrlMgr.Adc0SelfDiag0.Val "MICROSAR RTE" /begin SUB_GROUP /end SUB_GROUP /begin FUNCTION_LIST /end FUNCTION_LIST /begin REF_CHARACTERISTIC /end REF_CHARACTERISTIC /begin REF_MEASUREMENT CDD_MotCtrlMgr.Adc0SelfDiag0.Val /end REF_MEASUREMENT /end GROUP
/begin GROUP CDD_MotCtrlMgr.Adc0SelfDiag2.Val "MICROSAR RTE" /begin SUB_GROUP /end SUB_GROUP /begin FUNCTION_LIST /end FUNCTION_LIST /begin REF_CHARACTERISTIC /end REF_CHARACTERISTIC /begin REF_MEASUREMENT CDD_MotCtrlMgr.Adc0SelfDiag2.Val /end REF_MEASUREMENT /end GROUP
/begin GROUP CDD_MotCtrlMgr.Adc0SelfDiag4.Val "MICROSAR RTE" /begin SUB_GROUP /end SUB_GROUP /begin FUNCTION_LIST /end FUNCTION_LIST /begin REF_CHARACTERISTIC /end REF_CHARACTERISTIC /begin REF_MEASUREMENT CDD_MotCtrlMgr.Adc0SelfDiag4.Val /end REF_MEASUREMENT /end GROUP
/begin GROUP CDD_MotCtrlMgr.AdcDiagcEndPtrOutp.Val "MICROSAR RTE" /begin SUB_GROUP /end SUB_GROUP /begin FUNCTION_LIST /end FUNCTION_LIST /begin REF_CHARACTERISTIC /end REF_CHARACTERISTIC /begin REF_MEASUREMENT CDD_MotCtrlMgr.AdcDiagcEndPtrOutp.Val /end REF_MEASUREMENT /end GROUP
/begin GROUP CDD_MotCtrlMgr.AdcDiagcStrtPtrOutp.Val "MICROSAR RTE" /begin SUB_GROUP /end SUB_GROUP /begin FUNCTION_LIST /end FUNCTION_LIST /begin REF_CHARACTERISTIC /end REF_CHARACTERISTIC /begin REF_MEASUREMENT CDD_MotCtrlMgr.AdcDiagcStrtPtrOutp.Val /end REF_MEASUREMENT /end GROUP
/begin GROUP CDD_MotCtrlMgr.BrdgVltg.Val "MICROSAR RTE" /begin SUB_GROUP /end SUB_GROUP /begin FUNCTION_LIST /end FUNCTION_LIST /begin REF_CHARACTERISTIC /end REF_CHARACTERISTIC /begin REF_MEASUREMENT CDD_MotCtrlMgr.BrdgVltg.Val /end REF_MEASUREMENT /end GROUP
/begin GROUP CDD_MotCtrlMgr.CurrMeasCorrlnSts.Val "MICROSAR RTE" /begin SUB_GROUP /end SUB_GROUP /begin FUNCTION_LIST /end FUNCTION_LIST /begin REF_CHARACTERISTIC /end REF_CHARACTERISTIC /begin REF_MEASUREMENT CDD_MotCtrlMgr.CurrMeasCorrlnSts.Val /end REF_MEASUREMENT /end GROUP
/begin GROUP CDD_MotCtrlMgr.CurrMeasLoaMtgtnEna.Logl "MICROSAR RTE" /begin SUB_GROUP /end SUB_GROUP /begin FUNCTION_LIST /end FUNCTION_LIST /begin REF_CHARACTERISTIC /end REF_CHARACTERISTIC /begin REF_MEASUREMENT CDD_MotCtrlMgr.CurrMeasLoaMtgtnEna.Logl /end REF_MEASUREMENT /end GROUP
/begin GROUP CDD_MotCtrlMgr.CurrMeasWrmIninTestCmpl.Logl "MICROSAR RTE" /begin SUB_GROUP /end SUB_GROUP /begin FUNCTION_LIST /end FUNCTION_LIST /begin REF_CHARACTERISTIC /end REF_CHARACTERISTIC /begin REF_MEASUREMENT CDD_MotCtrlMgr.CurrMeasWrmIninTestCmpl.Logl /end REF_MEASUREMENT /end GROUP
/begin GROUP CDD_MotCtrlMgr.DiagcStsIvtr1Inactv.Logl "MICROSAR RTE" /begin SUB_GROUP /end SUB_GROUP /begin FUNCTION_LIST /end FUNCTION_LIST /begin REF_CHARACTERISTIC /end REF_CHARACTERISTIC /begin REF_MEASUREMENT CDD_MotCtrlMgr.DiagcStsIvtr1Inactv.Logl /end REF_MEASUREMENT /end GROUP
/begin GROUP CDD_MotCtrlMgr.DiagcStsIvtr2Inactv.Logl "MICROSAR RTE" /begin SUB_GROUP /end SUB_GROUP /begin FUNCTION_LIST /end FUNCTION_LIST /begin REF_CHARACTERISTIC /end REF_CHARACTERISTIC /begin REF_MEASUREMENT CDD_MotCtrlMgr.DiagcStsIvtr2Inactv.Logl /end REF_MEASUREMENT /end GROUP
/begin GROUP CDD_MotCtrlMgr.EcuTFild.Val "MICROSAR RTE" /begin SUB_GROUP /end SUB_GROUP /begin FUNCTION_LIST /end FUNCTION_LIST /begin REF_CHARACTERISTIC /end REF_CHARACTERISTIC /begin REF_MEASUREMENT CDD_MotCtrlMgr.EcuTFild.Val /end REF_MEASUREMENT /end GROUP
/begin GROUP CDD_MotCtrlMgr.FastLoopCntr.Val "MICROSAR RTE" /begin SUB_GROUP /end SUB_GROUP /begin FUNCTION_LIST /end FUNCTION_LIST /begin REF_CHARACTERISTIC /end REF_CHARACTERISTIC /begin REF_MEASUREMENT CDD_MotCtrlMgr.FastLoopCntr.Val /end REF_MEASUREMENT /end GROUP
/**********************************************************************************************************************
* RECORD_LAYOUT
*********************************************************************************************************************/
/begin RECORD_LAYOUT RTE_RL_UBYTE FNC_VALUES 1 UBYTE ROW_DIR DIRECT /end RECORD_LAYOUT
/begin RECORD_LAYOUT RTE_RL_UWORD FNC_VALUES 1 UWORD ROW_DIR DIRECT /end RECORD_LAYOUT
/begin RECORD_LAYOUT RTE_RL_FLOAT32_IEEE FNC_VALUES 1 FLOAT32_IEEE ROW_DIR DIRECT /end RECORD_LAYOUT
/begin RECORD_LAYOUT RTE_RL_BOOLEAN FNC_VALUES 1 UBYTE ROW_DIR DIRECT /end RECORD_LAYOUT
/**********************************************************************************************************************
* COMPU_METHOD / COMPU_VTAB_RANGE
*********************************************************************************************************************/
/begin COMPU_METHOD RTE_CM_BOOLEAN "" TAB_VERB "%3.1" "" COMPU_TAB_REF RTE_CM_BOOLEAN /end COMPU_METHOD
/begin COMPU_VTAB_RANGE RTE_CM_BOOLEAN "" 2 0 0 "false" 1 255 "true" /end COMPU_VTAB_RANGE
/begin COMPU_METHOD RTE_CM_ENUM_SysSt1 "" TAB_VERB "%.1" "" COMPU_TAB_REF RTE_CM_ENUM_SysSt1 /end COMPU_METHOD
/begin COMPU_VTAB_RANGE RTE_CM_ENUM_SysSt1 "" 4 0 0 "SYSST_DI" 1 1 "SYSST_OFF" 2 2 "SYSST_ENA" 3 3 "SYSST_WRMININ" /end COMPU_VTAB_RANGE
/begin COMPU_METHOD RTE_CM_ENUM_SigQlfr1 "" TAB_VERB "%.1" "" COMPU_TAB_REF RTE_CM_ENUM_SigQlfr1 /end COMPU_METHOD
/begin COMPU_VTAB_RANGE RTE_CM_ENUM_SigQlfr1 "" 3 0 0 "SIGQLFR_NORES" 1 1 "SIGQLFR_PASSD" 2 2 "SIGQLFR_FAILD" /end COMPU_VTAB_RANGE
/begin COMPU_METHOD RTE_CM_Ag9 "" RAT_FUNC "%.1" "MotRevElec" COEFFS 0 65536 0 0 0 1 /end COMPU_METHOD
/begin COMPU_METHOD RTE_CM_Ag8 "" RAT_FUNC "%.1" "MotRev" COEFFS 0 65536 0 0 0 1 /end COMPU_METHOD
/begin COMPU_METHOD RTE_CM_Ag7 "" RAT_FUNC "%.1" "MotDeg" COEFFS 0 8192 0 0 0 1 /end COMPU_METHOD
