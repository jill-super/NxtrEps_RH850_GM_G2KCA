/begin CHARACTERISTIC CalRegn03CmnGroupB.PullCmpActvLongTermLim.Val "MICROSAR RTE" VALUE 0x0 RTE_RL_FLOAT32_IEEE 0 NO_COMPU_METHOD -3.402823466e+38 3.402823466e+38 SYMBOL_LINK "Rte_CalprmRom_CalRegn03CmnGroupB_DEFAULT_RTE_CALPRM_GROUP.PullCmpActvLongTermLim_Val" 0 DISPLAY_IDENTIFIER CalRegn03CmnGroupB.CalibrationPorts.PullCmpActvLongTermLim.Val /end CHARACTERISTIC
/begin CHARACTERISTIC CalRegn03CmnGroupB.PullCmpActvLrngEnaAgConfMinMgn.Val "MICROSAR RTE" VALUE 0x0 RTE_RL_FLOAT32_IEEE 0 NO_COMPU_METHOD -3.402823466e+38 3.402823466e+38 SYMBOL_LINK "Rte_CalprmRom_CalRegn03CmnGroupB_DEFAULT_RTE_CALPRM_GROUP.PullCmpActvLrngEnaAgConfMinMgn_Val" 0 DISPLAY_IDENTIFIER CalRegn03CmnGroupB.CalibrationPorts.PullCmpActvLrngEnaAgConfMinMgn.Val /end CHARACTERISTIC
/begin CHARACTERISTIC CalRegn03CmnGroupB.PullCmpActvLrngEnaHwAgMaxMgn.Val "MICROSAR RTE" VALUE 0x0 RTE_RL_FLOAT32_IEEE 0 NO_COMPU_METHOD -3.402823466e+38 3.402823466e+38 SYMBOL_LINK "Rte_CalprmRom_CalRegn03CmnGroupB_DEFAULT_RTE_CALPRM_GROUP.PullCmpActvLrngEnaHwAgMaxMgn_Val" 0 DISPLAY_IDENTIFIER CalRegn03CmnGroupB.CalibrationPorts.PullCmpActvLrngEnaHwAgMaxMgn.Val /end CHARACTERISTIC
/begin CHARACTERISTIC CalRegn03CmnGroupB.PullCmpActvLrngEnaHwTqMaxMgn.Val "MICROSAR RTE" VALUE 0x0 RTE_RL_FLOAT32_IEEE 0 NO_COMPU_METHOD -3.402823466e+38 3.402823466e+38 SYMBOL_LINK "Rte_CalprmRom_CalRegn03CmnGroupB_DEFAULT_RTE_CALPRM_GROUP.PullCmpActvLrngEnaHwTqMaxMgn_Val" 0 DISPLAY_IDENTIFIER CalRegn03CmnGroupB.CalibrationPorts.PullCmpActvLrngEnaHwTqMaxMgn.Val /end CHARACTERISTIC
/begin CHARACTERISTIC CalRegn03CmnGroupB.PullCmpActvLrngEnaHwVelMaxMgn.Val "MICROSAR RTE" VALUE 0x0 RTE_RL_FLOAT32_IEEE 0 NO_COMPU_METHOD -3.402823466e+38 3.402823466e+38 SYMBOL_LINK "Rte_CalprmRom_CalRegn03CmnGroupB_DEFAULT_RTE_CALPRM_GROUP.PullCmpActvLrngEnaHwVelMaxMgn_Val" 0 DISPLAY_IDENTIFIER CalRegn03CmnGroupB.CalibrationPorts.PullCmpActvLrngEnaHwVelMaxMgn.Val /end CHARACTERISTIC
/begin CHARACTERISTIC CalRegn03CmnGroupB.PullCmpActvLrngEnaLatAMaxMgn.Val "MICROSAR RTE" VALUE 0x0 RTE_RL_FLOAT32_IEEE 0 NO_COMPU_METHOD -3.402823466e+38 3.402823466e+38 SYMBOL_LINK "Rte_CalprmRom_CalRegn03CmnGroupB_DEFAULT_RTE_CALPRM_GROUP.PullCmpActvLrngEnaLatAMaxMgn_Val" 0 DISPLAY_IDENTIFIER CalRegn03CmnGroupB.CalibrationPorts.PullCmpActvLrngEnaLatAMaxMgn.Val /end CHARACTERISTIC
/begin CHARACTERISTIC CalRegn03CmnGroupB.PullCmpActvLrngEnaTiThd.Val "MICROSAR RTE" VALUE 0x0 RTE_RL_FLOAT32_IEEE 0 NO_COMPU_METHOD -3.402823466e+38 3.402823466e+38 SYMBOL_LINK "Rte_CalprmRom_CalRegn03CmnGroupB_DEFAULT_RTE_CALPRM_GROUP.PullCmpActvLrngEnaTiThd_Val" 0 DISPLAY_IDENTIFIER CalRegn03CmnGroupB.CalibrationPorts.PullCmpActvLrngEnaTiThd.Val /end CHARACTERISTIC
/begin CHARACTERISTIC CalRegn03CmnGroupB.PullCmpActvLrngEnaVehSpdMaxMgn.Val "MICROSAR RTE" VALUE 0x0 RTE_RL_FLOAT32_IEEE 0 NO_COMPU_METHOD -3.402823466e+38 3.402823466e+38 SYMBOL_LINK "Rte_CalprmRom_CalRegn03CmnGroupB_DEFAULT_RTE_CALPRM_GROUP.PullCmpActvLrngEnaVehSpdMaxMgn_Val" 0 DISPLAY_IDENTIFIER CalRegn03CmnGroupB.CalibrationPorts.PullCmpActvLrngEnaVehSpdMaxMgn.Val /end CHARACTERISTIC
/begin CHARACTERISTIC CalRegn03CmnGroupB.PullCmpActvLrngEnaVehSpdMinMgn.Val "MICROSAR RTE" VALUE 0x0 RTE_RL_FLOAT32_IEEE 0 NO_COMPU_METHOD -3.402823466e+38 3.402823466e+38 SYMBOL_LINK "Rte_CalprmRom_CalRegn03CmnGroupB_DEFAULT_RTE_CALPRM_GROUP.PullCmpActvLrngEnaVehSpdMinMgn_Val" 0 DISPLAY_IDENTIFIER CalRegn03CmnGroupB.CalibrationPorts.PullCmpActvLrngEnaVehSpdMinMgn.Val /end CHARACTERISTIC
/begin CHARACTERISTIC CalRegn03CmnGroupB.PullCmpActvLrngEnaVehSpdRateMaxMgn.Val "MICROSAR RTE" VALUE 0x0 RTE_RL_FLOAT32_IEEE 0 NO_COMPU_METHOD -3.402823466e+38 3.402823466e+38 SYMBOL_LINK "Rte_CalprmRom_CalRegn03CmnGroupB_DEFAULT_RTE_CALPRM_GROUP.PullCmpActvLrngEnaVehSpdRateMaxMgn_Val" 0 DISPLAY_IDENTIFIER CalRegn03CmnGroupB.CalibrationPorts.PullCmpActvLrngEnaVehSpdRateMaxMgn.Val /end CHARACTERISTIC
/begin CHARACTERISTIC CalRegn03CmnGroupB.PullCmpActvLrngEnaYawRateMaxMgn.Val "MICROSAR RTE" VALUE 0x0 RTE_RL_FLOAT32_IEEE 0 NO_COMPU_METHOD -3.402823466e+38 3.402823466e+38 SYMBOL_LINK "Rte_CalprmRom_CalRegn03CmnGroupB_DEFAULT_RTE_CALPRM_GROUP.PullCmpActvLrngEnaYawRateMaxMgn_Val" 0 DISPLAY_IDENTIFIER CalRegn03CmnGroupB.CalibrationPorts.PullCmpActvLrngEnaYawRateMaxMgn.Val /end CHARACTERISTIC
/begin CHARACTERISTIC CalRegn03CmnGroupB.PullCmpActvOpstSignTiShoTerm.Val "MICROSAR RTE" VALUE 0x0 RTE_RL_FLOAT32_IEEE 0 NO_COMPU_METHOD -3.402823466e+38 3.402823466e+38 SYMBOL_LINK "Rte_CalprmRom_CalRegn03CmnGroupB_DEFAULT_RTE_CALPRM_GROUP.PullCmpActvOpstSignTiShoTerm_Val" 0 DISPLAY_IDENTIFIER CalRegn03CmnGroupB.CalibrationPorts.PullCmpActvOpstSignTiShoTerm.Val /end CHARACTERISTIC
/begin CHARACTERISTIC CalRegn03CmnGroupB.PullCmpActvOutpMaxRate.Val "MICROSAR RTE" VALUE 0x0 RTE_RL_FLOAT32_IEEE 0 NO_COMPU_METHOD -3.402823466e+38 3.402823466e+38 SYMBOL_LINK "Rte_CalprmRom_CalRegn03CmnGroupB_DEFAULT_RTE_CALPRM_GROUP.PullCmpActvOutpMaxRate_Val" 0 DISPLAY_IDENTIFIER CalRegn03CmnGroupB.CalibrationPorts.PullCmpActvOutpMaxRate.Val /end CHARACTERISTIC
/begin CHARACTERISTIC CalRegn03CmnGroupB.PullCmpActvPullCmpShoTermLim.Val "MICROSAR RTE" VALUE 0x0 RTE_RL_FLOAT32_IEEE 0 NO_COMPU_METHOD -3.402823466e+38 3.402823466e+38 SYMBOL_LINK "Rte_CalprmRom_CalRegn03CmnGroupB_DEFAULT_RTE_CALPRM_GROUP.PullCmpActvPullCmpShoTermLim_Val" 0 DISPLAY_IDENTIFIER CalRegn03CmnGroupB.CalibrationPorts.PullCmpActvPullCmpShoTermLim.Val /end CHARACTERISTIC
/begin CHARACTERISTIC CalRegn03CmnGroupB.PullCmpActvPullCmpTotLim.Val "MICROSAR RTE" VALUE 0x0 RTE_RL_FLOAT32_IEEE 0 NO_COMPU_METHOD -3.402823466e+38 3.402823466e+38 SYMBOL_LINK "Rte_CalprmRom_CalRegn03CmnGroupB_DEFAULT_RTE_CALPRM_GROUP.PullCmpActvPullCmpTotLim_Val" 0 DISPLAY_IDENTIFIER CalRegn03CmnGroupB.CalibrationPorts.PullCmpActvPullCmpTotLim.Val /end CHARACTERISTIC
/begin CHARACTERISTIC CalRegn03CmnGroupB.PullCmpActvPullErrLimLongTerm.Val "MICROSAR RTE" VALUE 0x0 RTE_RL_FLOAT32_IEEE 0 NO_COMPU_METHOD -3.402823466e+38 3.402823466e+38 SYMBOL_LINK "Rte_CalprmRom_CalRegn03CmnGroupB_DEFAULT_RTE_CALPRM_GROUP.PullCmpActvPullErrLimLongTerm_Val" 0 DISPLAY_IDENTIFIER CalRegn03CmnGroupB.CalibrationPorts.PullCmpActvPullErrLimLongTerm.Val /end CHARACTERISTIC
/begin CHARACTERISTIC CalRegn03CmnGroupB.PullCmpActvPullErrMgnThd.Val "MICROSAR RTE" VALUE 0x0 RTE_RL_FLOAT32_IEEE 0 NO_COMPU_METHOD -3.402823466e+38 3.402823466e+38 SYMBOL_LINK "Rte_CalprmRom_CalRegn03CmnGroupB_DEFAULT_RTE_CALPRM_GROUP.PullCmpActvPullErrMgnThd_Val" 0 DISPLAY_IDENTIFIER CalRegn03CmnGroupB.CalibrationPorts.PullCmpActvPullErrMgnThd.Val /end CHARACTERISTIC
/begin CHARACTERISTIC CalRegn03CmnGroupB.PullCmpActvPullErrShoTermLim.Val "MICROSAR RTE" VALUE 0x0 RTE_RL_FLOAT32_IEEE 0 NO_COMPU_METHOD -3.402823466e+38 3.402823466e+38 SYMBOL_LINK "Rte_CalprmRom_CalRegn03CmnGroupB_DEFAULT_RTE_CALPRM_GROUP.PullCmpActvPullErrShoTermLim_Val" 0 DISPLAY_IDENTIFIER CalRegn03CmnGroupB.CalibrationPorts.PullCmpActvPullErrShoTermLim.Val /end CHARACTERISTIC
/begin CHARACTERISTIC CalRegn03CmnGroupB.PullCmpActvShoTermRampTi.Val "MICROSAR RTE" VALUE 0x0 RTE_RL_FLOAT32_IEEE 0 NO_COMPU_METHOD -3.402823466e+38 3.402823466e+38 SYMBOL_LINK "Rte_CalprmRom_CalRegn03CmnGroupB_DEFAULT_RTE_CALPRM_GROUP.PullCmpActvShoTermRampTi_Val" 0 DISPLAY_IDENTIFIER CalRegn03CmnGroupB.CalibrationPorts.PullCmpActvShoTermRampTi.Val /end CHARACTERISTIC
/begin CHARACTERISTIC CalRegn03CmnGroupB.PullCmpActvVehSpdScaTblX.Ary1D "MICROSAR RTE" VAL_BLK 0x0 RTE_RL_UWORD 0 NO_COMPU_METHOD 0 65535 MATRIX_DIM 4 1 1 SYMBOL_LINK "Rte_CalprmRom_CalRegn03CmnGroupB_DEFAULT_RTE_CALPRM_GROUP.PullCmpActvVehSpdScaTblX_Ary1D" 0 DISPLAY_IDENTIFIER CalRegn03CmnGroupB.CalibrationPorts.PullCmpActvVehSpdScaTblX.Ary1D /end CHARACTERISTIC
/begin CHARACTERISTIC CalRegn03CmnGroupB.PullCmpActvVehSpdScaTblY.Ary1D "MICROSAR RTE" VAL_BLK 0x0 RTE_RL_UWORD 0 NO_COMPU_METHOD 0 65535 MATRIX_DIM 4 1 1 SYMBOL_LINK "Rte_CalprmRom_CalRegn03CmnGroupB_DEFAULT_RTE_CALPRM_GROUP.PullCmpActvVehSpdScaTblY_Ary1D" 0 DISPLAY_IDENTIFIER CalRegn03CmnGroupB.CalibrationPorts.PullCmpActvVehSpdScaTblY.Ary1D /end CHARACTERISTIC
/begin CHARACTERISTIC CalRegn03CmnGroupB.WhlImbRejctnAutScaEna.Logl "MICROSAR RTE" VALUE 0x0 RTE_RL_BOOLEAN 0 RTE_CM_BOOLEAN 0 255 SYMBOL_LINK "Rte_CalprmRom_CalRegn03CmnGroupB_DEFAULT_RTE_CALPRM_GROUP.WhlImbRejctnAutScaEna_Logl" 0 DISPLAY_IDENTIFIER CalRegn03CmnGroupB.CalibrationPorts.WhlImbRejctnAutScaEna.Logl /end CHARACTERISTIC
/begin CHARACTERISTIC CalRegn03CmnGroupB.WhlImbRejctnAutScaTar.Val "MICROSAR RTE" VALUE 0x0 RTE_RL_FLOAT32_IEEE 0 NO_COMPU_METHOD -3.402823466e+38 3.402823466e+38 SYMBOL_LINK "Rte_CalprmRom_CalRegn03CmnGroupB_DEFAULT_RTE_CALPRM_GROUP.WhlImbRejctnAutScaTar_Val" 0 DISPLAY_IDENTIFIER CalRegn03CmnGroupB.CalibrationPorts.WhlImbRejctnAutScaTar.Val /end CHARACTERISTIC
/begin CHARACTERISTIC CalRegn03CmnGroupB.WhlImbRejctnRampDwnTi.Val "MICROSAR RTE" VALUE 0x0 RTE_RL_UWORD 0 NO_COMPU_METHOD 0 65535 SYMBOL_LINK "Rte_CalprmRom_CalRegn03CmnGroupB_DEFAULT_RTE_CALPRM_GROUP.WhlImbRejctnRampDwnTi_Val" 0 DISPLAY_IDENTIFIER CalRegn03CmnGroupB.CalibrationPorts.WhlImbRejctnRampDwnTi.Val /end CHARACTERISTIC
/begin CHARACTERISTIC CalRegn03CmnGroupB.WhlImbRejctnScaCncl.Val "MICROSAR RTE" VALUE 0x0 RTE_RL_FLOAT32_IEEE 0 NO_COMPU_METHOD -3.402823466e+38 3.402823466e+38 SYMBOL_LINK "Rte_CalprmRom_CalRegn03CmnGroupB_DEFAULT_RTE_CALPRM_GROUP.WhlImbRejctnScaCncl_Val" 0 DISPLAY_IDENTIFIER CalRegn03CmnGroupB.CalibrationPorts.WhlImbRejctnScaCncl.Val /end CHARACTERISTIC
/begin CHARACTERISTIC CalRegn03CmnGroupB.WhlImbRejctnUgrPoleMgn.Val "MICROSAR RTE" VALUE 0x0 RTE_RL_FLOAT32_IEEE 0 NO_COMPU_METHOD -3.402823466e+38 3.402823466e+38 SYMBOL_LINK "Rte_CalprmRom_CalRegn03CmnGroupB_DEFAULT_RTE_CALPRM_GROUP.WhlImbRejctnUgrPoleMgn_Val" 0 DISPLAY_IDENTIFIER CalRegn03CmnGroupB.CalibrationPorts.WhlImbRejctnUgrPoleMgn.Val /end CHARACTERISTIC
/begin CHARACTERISTIC CalRegn03CmnGroupB.WhlImbRejctnVehSpdEna.Val "MICROSAR RTE" VALUE 0x0 RTE_RL_FLOAT32_IEEE 0 NO_COMPU_METHOD -3.402823466e+38 3.402823466e+38 SYMBOL_LINK "Rte_CalprmRom_CalRegn03CmnGroupB_DEFAULT_RTE_CALPRM_GROUP.WhlImbRejctnVehSpdEna_Val" 0 DISPLAY_IDENTIFIER CalRegn03CmnGroupB.CalibrationPorts.WhlImbRejctnVehSpdEna.Val /end CHARACTERISTIC
/begin CHARACTERISTIC CalRegn03CmnGroupC.GmOvrlStMgrLoaMtgtnHaptcFbOffTi.Val "MICROSAR RTE" VALUE 0x0 RTE_RL_ULONG 0 NO_COMPU_METHOD 0 4294967295 SYMBOL_LINK "Rte_CalprmRom_CalRegn03CmnGroupC_DEFAULT_RTE_CALPRM_GROUP.GmOvrlStMgrLoaMtgtnHaptcFbOffTi_Val" 0 DISPLAY_IDENTIFIER CalRegn03CmnGroupC.CalibrationPorts.GmOvrlStMgrLoaMtgtnHaptcFbOffTi.Val /end CHARACTERISTIC
/begin CHARACTERISTIC CalRegn03CmnGroupC.GmOvrlStMgrLoaMtgtnHaptcFbOnTi.Val "MICROSAR RTE" VALUE 0x0 RTE_RL_ULONG 0 NO_COMPU_METHOD 0 4294967295 SYMBOL_LINK "Rte_CalprmRom_CalRegn03CmnGroupC_DEFAULT_RTE_CALPRM_GROUP.GmOvrlStMgrLoaMtgtnHaptcFbOnTi_Val" 0 DISPLAY_IDENTIFIER CalRegn03CmnGroupC.CalibrationPorts.GmOvrlStMgrLoaMtgtnHaptcFbOnTi.Val /end CHARACTERISTIC
/begin CHARACTERISTIC CalRegn03CmnGroupC.GmOvrlStMgrLoaMtgtnHaptcFbTqMax.Val "MICROSAR RTE" VALUE 0x0 RTE_RL_FLOAT32_IEEE 0 NO_COMPU_METHOD -3.402823466e+38 3.402823466e+38 SYMBOL_LINK "Rte_CalprmRom_CalRegn03CmnGroupC_DEFAULT_RTE_CALPRM_GROUP.GmOvrlStMgrLoaMtgtnHaptcFbTqMax_Val" 0 DISPLAY_IDENTIFIER CalRegn03CmnGroupC.CalibrationPorts.GmOvrlStMgrLoaMtgtnHaptcFbTqMax.Val /end CHARACTERISTIC
/begin CHARACTERISTIC CalRegn03CmnGroupC.GmOvrlStMgrLoaMtgtnHaptcFbTqMin.Val "MICROSAR RTE" VALUE 0x0 RTE_RL_FLOAT32_IEEE 0 NO_COMPU_METHOD -3.402823466e+38 3.402823466e+38 SYMBOL_LINK "Rte_CalprmRom_CalRegn03CmnGroupC_DEFAULT_RTE_CALPRM_GROUP.GmOvrlStMgrLoaMtgtnHaptcFbTqMin_Val" 0 DISPLAY_IDENTIFIER CalRegn03CmnGroupC.CalibrationPorts.GmOvrlStMgrLoaMtgtnHaptcFbTqMin.Val /end CHARACTERISTIC
/begin CHARACTERISTIC CalRegn03CmnGroupC.GmOvrlStMgrLoaMtgtnHaptcFbVehSpdMax.Val "MICROSAR RTE" VALUE 0x0 RTE_RL_FLOAT32_IEEE 0 NO_COMPU_METHOD -3.402823466e+38 3.402823466e+38 SYMBOL_LINK "Rte_CalprmRom_CalRegn03CmnGroupC_DEFAULT_RTE_CALPRM_GROUP.GmOvrlStMgrLoaMtgtnHaptcFbVehSpdMax_Val" 0 DISPLAY_IDENTIFIER CalRegn03CmnGroupC.CalibrationPorts.GmOvrlStMgrLoaMtgtnHaptcFbVehSpdMax.Val /end CHARACTERISTIC
/begin CHARACTERISTIC CalRegn03CmnGroupC.GmOvrlStMgrLoaMtgtnHaptcFbVehSpdMin.Val "MICROSAR RTE" VALUE 0x0 RTE_RL_FLOAT32_IEEE 0 NO_COMPU_METHOD -3.402823466e+38 3.402823466e+38 SYMBOL_LINK "Rte_CalprmRom_CalRegn03CmnGroupC_DEFAULT_RTE_CALPRM_GROUP.GmOvrlStMgrLoaMtgtnHaptcFbVehSpdMin_Val" 0 DISPLAY_IDENTIFIER CalRegn03CmnGroupC.CalibrationPorts.GmOvrlStMgrLoaMtgtnHaptcFbVehSpdMin.Val /end CHARACTERISTIC
/begin CHARACTERISTIC CalRegn03CmnGroupC.GmOvrlStMgrLoaMtgtnHaptcFrq.Val "MICROSAR RTE" VALUE 0x0 RTE_RL_FLOAT32_IEEE 0 NO_COMPU_METHOD -3.402823466e+38 3.402823466e+38 SYMBOL_LINK "Rte_CalprmRom_CalRegn03CmnGroupC_DEFAULT_RTE_CALPRM_GROUP.GmOvrlStMgrLoaMtgtnHaptcFrq_Val" 0 DISPLAY_IDENTIFIER CalRegn03CmnGroupC.CalibrationPorts.GmOvrlStMgrLoaMtgtnHaptcFrq.Val /end CHARACTERISTIC
/begin CHARACTERISTIC CalRegn03CmnGroupC.GmOvrlStMgrLoaMtgtnTqOscnAmpY.Ary1D "MICROSAR RTE" VAL_BLK 0x0 RTE_RL_UWORD 0 NO_COMPU_METHOD 0 65535 MATRIX_DIM 8 1 1 SYMBOL_LINK "Rte_CalprmRom_CalRegn03CmnGroupC_DEFAULT_RTE_CALPRM_GROUP.GmOvrlStMgrLoaMtgtnTqOscnAmpY_Ary1D" 0 DISPLAY_IDENTIFIER CalRegn03CmnGroupC.CalibrationPorts.GmOvrlStMgrLoaMtgtnTqOscnAmpY.Ary1D /end CHARACTERISTIC
/begin CHARACTERISTIC CalRegn03CmnGroupC.GmOvrlStMgrLoaMtgtnVehSpdX.Ary1D "MICROSAR RTE" VAL_BLK 0x0 RTE_RL_UWORD 0 NO_COMPU_METHOD 0 65535 MATRIX_DIM 8 1 1 SYMBOL_LINK "Rte_CalprmRom_CalRegn03CmnGroupC_DEFAULT_RTE_CALPRM_GROUP.GmOvrlStMgrLoaMtgtnVehSpdX_Ary1D" 0 DISPLAY_IDENTIFIER CalRegn03CmnGroupC.CalibrationPorts.GmOvrlStMgrLoaMtgtnVehSpdX.Ary1D /end CHARACTERISTIC
/begin CHARACTERISTIC CalRegn03Inin00.DampgHydAssiLim.Ary1D "MICROSAR RTE" VAL_BLK 0x0 RTE_RL_UWORD 0 RTE_CM_Tq13 0 0 MATRIX_DIM 12 1 1 SYMBOL_LINK "Rte_CalprmRom_CalRegn03Inin00_DEFAULT_RTE_CALPRM_GROUP.DampgHydAssiLim_Ary1D" 0 DISPLAY_IDENTIFIER CalRegn03Inin00.CalibrationPorts.DampgHydAssiLim.Ary1D /end CHARACTERISTIC
/begin CHARACTERISTIC CalRegn03Inin00.DampgHydBasCoeff1.Val "MICROSAR RTE" VALUE 0x0 RTE_RL_FLOAT32_IEEE 0 NO_COMPU_METHOD 0.0 0.1 SYMBOL_LINK "Rte_CalprmRom_CalRegn03Inin00_DEFAULT_RTE_CALPRM_GROUP.DampgHydBasCoeff1_Val" 0 DISPLAY_IDENTIFIER CalRegn03Inin00.CalibrationPorts.DampgHydBasCoeff1.Val /end CHARACTERISTIC
/begin CHARACTERISTIC CalRegn03Inin00.DampgHydBasCoeff2.Val "MICROSAR RTE" VALUE 0x0 RTE_RL_FLOAT32_IEEE 0 NO_COMPU_METHOD 0.0 0.1 SYMBOL_LINK "Rte_CalprmRom_CalRegn03Inin00_DEFAULT_RTE_CALPRM_GROUP.DampgHydBasCoeff2_Val" 0 DISPLAY_IDENTIFIER CalRegn03Inin00.CalibrationPorts.DampgHydBasCoeff2.Val /end CHARACTERISTIC
/begin CHARACTERISTIC CalRegn03Inin00.DampgHydBasCoeff3.Val "MICROSAR RTE" VALUE 0x0 RTE_RL_FLOAT32_IEEE 0 NO_COMPU_METHOD 0.0 0.1 SYMBOL_LINK "Rte_CalprmRom_CalRegn03Inin00_DEFAULT_RTE_CALPRM_GROUP.DampgHydBasCoeff3_Val" 0 DISPLAY_IDENTIFIER CalRegn03Inin00.CalibrationPorts.DampgHydBasCoeff3.Val /end CHARACTERISTIC
/begin CHARACTERISTIC CalRegn03Inin00.DampgHydBasCoeff4.Val "MICROSAR RTE" VALUE 0x0 RTE_RL_FLOAT32_IEEE 0 NO_COMPU_METHOD 0.0 0.1 SYMBOL_LINK "Rte_CalprmRom_CalRegn03Inin00_DEFAULT_RTE_CALPRM_GROUP.DampgHydBasCoeff4_Val" 0 DISPLAY_IDENTIFIER CalRegn03Inin00.CalibrationPorts.DampgHydBasCoeff4.Val /end CHARACTERISTIC
/begin CHARACTERISTIC CalRegn03Inin00.DampgHydOutpLim.Val "MICROSAR RTE" VALUE 0x0 RTE_RL_FLOAT32_IEEE 0 NO_COMPU_METHOD -8.8 8.8 SYMBOL_LINK "Rte_CalprmRom_CalRegn03Inin00_DEFAULT_RTE_CALPRM_GROUP.DampgHydOutpLim_Val" 0 DISPLAY_IDENTIFIER CalRegn03Inin00.CalibrationPorts.DampgHydOutpLim.Val /end CHARACTERISTIC
/begin CHARACTERISTIC CalRegn03Inin00.DampgMotVelLpFilFrq.Val "MICROSAR RTE" VALUE 0x0 RTE_RL_FLOAT32_IEEE 0 NO_COMPU_METHOD 5 100 SYMBOL_LINK "Rte_CalprmRom_CalRegn03Inin00_DEFAULT_RTE_CALPRM_GROUP.DampgMotVelLpFilFrq_Val" 0 DISPLAY_IDENTIFIER CalRegn03Inin00.CalibrationPorts.DampgMotVelLpFilFrq.Val /end CHARACTERISTIC
/begin CHARACTERISTIC CalRegn03Inin00.DampgQuad13Mplr.Val "MICROSAR RTE" VALUE 0x0 RTE_RL_FLOAT32_IEEE 0 NO_COMPU_METHOD 0 2 SYMBOL_LINK "Rte_CalprmRom_CalRegn03Inin00_DEFAULT_RTE_CALPRM_GROUP.DampgQuad13Mplr_Val" 0 DISPLAY_IDENTIFIER CalRegn03Inin00.CalibrationPorts.DampgQuad13Mplr.Val /end CHARACTERISTIC
/begin CHARACTERISTIC CalRegn03Inin00.DampgQuad24Mplr.Val "MICROSAR RTE" VALUE 0x0 RTE_RL_FLOAT32_IEEE 0 NO_COMPU_METHOD 0 2 SYMBOL_LINK "Rte_CalprmRom_CalRegn03Inin00_DEFAULT_RTE_CALPRM_GROUP.DampgQuad24Mplr_Val" 0 DISPLAY_IDENTIFIER CalRegn03Inin00.CalibrationPorts.DampgQuad24Mplr.Val /end CHARACTERISTIC
/begin CHARACTERISTIC CalRegn03Inin00.DampgQuadHwTqLpFilFrq.Val "MICROSAR RTE" VALUE 0x0 RTE_RL_FLOAT32_IEEE 0 NO_COMPU_METHOD 5 31.25 SYMBOL_LINK "Rte_CalprmRom_CalRegn03Inin00_DEFAULT_RTE_CALPRM_GROUP.DampgQuadHwTqLpFilFrq_Val" 0 DISPLAY_IDENTIFIER CalRegn03Inin00.CalibrationPorts.DampgQuadHwTqLpFilFrq.Val /end CHARACTERISTIC
/begin CHARACTERISTIC CalRegn03Inin00.DampgQuadMotVelLpFilFrq.Val "MICROSAR RTE" VALUE 0x0 RTE_RL_FLOAT32_IEEE 0 NO_COMPU_METHOD 5 31.25 SYMBOL_LINK "Rte_CalprmRom_CalRegn03Inin00_DEFAULT_RTE_CALPRM_GROUP.DampgQuadMotVelLpFilFrq_Val" 0 DISPLAY_IDENTIFIER CalRegn03Inin00.CalibrationPorts.DampgQuadMotVelLpFilFrq.Val /end CHARACTERISTIC
/begin CHARACTERISTIC CalRegn03Inin00.DampgQuadScaLpFilFrq.Val "MICROSAR RTE" VALUE 0x0 RTE_RL_FLOAT32_IEEE 0 NO_COMPU_METHOD 0.0039 100 SYMBOL_LINK "Rte_CalprmRom_CalRegn03Inin00_DEFAULT_RTE_CALPRM_GROUP.DampgQuadScaLpFilFrq_Val" 0 DISPLAY_IDENTIFIER CalRegn03Inin00.CalibrationPorts.DampgQuadScaLpFilFrq.Val /end CHARACTERISTIC
/begin CHARACTERISTIC CalRegn03Inin00.EotLrngAuthyStrtLrn.Val "MICROSAR RTE" VALUE 0x0 RTE_RL_FLOAT32_IEEE 0 NO_COMPU_METHOD -3.402823466e+38 3.402823466e+38 SYMBOL_LINK "Rte_CalprmRom_CalRegn03Inin00_DEFAULT_RTE_CALPRM_GROUP.EotLrngAuthyStrtLrn_Val" 0 DISPLAY_IDENTIFIER CalRegn03Inin00.CalibrationPorts.EotLrngAuthyStrtLrn.Val /end CHARACTERISTIC
/begin CHARACTERISTIC CalRegn03Inin00.EotLrngEotLrnTmr.Val "MICROSAR RTE" VALUE 0x0 RTE_RL_UWORD 0 NO_COMPU_METHOD 0 65535 SYMBOL_LINK "Rte_CalprmRom_CalRegn03Inin00_DEFAULT_RTE_CALPRM_GROUP.EotLrngEotLrnTmr_Val" 0 DISPLAY_IDENTIFIER CalRegn03Inin00.CalibrationPorts.EotLrngEotLrnTmr.Val /end CHARACTERISTIC
/begin CHARACTERISTIC CalRegn03Inin00.EotLrngHwTqEotLrn.Val "MICROSAR RTE" VALUE 0x0 RTE_RL_FLOAT32_IEEE 0 NO_COMPU_METHOD -3.402823466e+38 3.402823466e+38 SYMBOL_LINK "Rte_CalprmRom_CalRegn03Inin00_DEFAULT_RTE_CALPRM_GROUP.EotLrngHwTqEotLrn_Val" 0 DISPLAY_IDENTIFIER CalRegn03Inin00.CalibrationPorts.EotLrngHwTqEotLrn.Val /end CHARACTERISTIC
/begin CHARACTERISTIC CalRegn03Inin00.EotLrngMotVelEotLrn.Val "MICROSAR RTE" VALUE 0x0 RTE_RL_FLOAT32_IEEE 0 NO_COMPU_METHOD -3.402823466e+38 3.402823466e+38 SYMBOL_LINK "Rte_CalprmRom_CalRegn03Inin00_DEFAULT_RTE_CALPRM_GROUP.EotLrngMotVelEotLrn_Val" 0 DISPLAY_IDENTIFIER CalRegn03Inin00.CalibrationPorts.EotLrngMotVelEotLrn.Val /end CHARACTERISTIC
/begin CHARACTERISTIC CalRegn03Inin00.EotLrngRackTrvlMax.Val "MICROSAR RTE" VALUE 0x0 RTE_RL_FLOAT32_IEEE 0 NO_COMPU_METHOD -3.402823466e+38 3.402823466e+38 SYMBOL_LINK "Rte_CalprmRom_CalRegn03Inin00_DEFAULT_RTE_CALPRM_GROUP.EotLrngRackTrvlMax_Val" 0 DISPLAY_IDENTIFIER CalRegn03Inin00.CalibrationPorts.EotLrngRackTrvlMax.Val /end CHARACTERISTIC
/begin CHARACTERISTIC CalRegn03Inin00.EotLrngRackTrvlMin.Val "MICROSAR RTE" VALUE 0x0 RTE_RL_FLOAT32_IEEE 0 NO_COMPU_METHOD -3.402823466e+38 3.402823466e+38 SYMBOL_LINK "Rte_CalprmRom_CalRegn03Inin00_DEFAULT_RTE_CALPRM_GROUP.EotLrngRackTrvlMin_Val" 0 DISPLAY_IDENTIFIER CalRegn03Inin00.CalibrationPorts.EotLrngRackTrvlMin.Val /end CHARACTERISTIC
/begin CHARACTERISTIC CalRegn03Inin00.EotLrngRstAuthyMin.Val "MICROSAR RTE" VALUE 0x0 RTE_RL_FLOAT32_IEEE 0 NO_COMPU_METHOD -3.402823466e+38 3.402823466e+38 SYMBOL_LINK "Rte_CalprmRom_CalRegn03Inin00_DEFAULT_RTE_CALPRM_GROUP.EotLrngRstAuthyMin_Val" 0 DISPLAY_IDENTIFIER CalRegn03Inin00.CalibrationPorts.EotLrngRstAuthyMin.Val /end CHARACTERISTIC
/begin CHARACTERISTIC CalRegn03Inin00.EotProtnDftPosn.Val "MICROSAR RTE" VALUE 0x0 RTE_RL_FLOAT32_IEEE 0 NO_COMPU_METHOD -3.402823466e+38 3.402823466e+38 SYMBOL_LINK "Rte_CalprmRom_CalRegn03Inin00_DEFAULT_RTE_CALPRM_GROUP.EotProtnDftPosn_Val" 0 DISPLAY_IDENTIFIER CalRegn03Inin00.CalibrationPorts.EotProtnDftPosn.Val /end CHARACTERISTIC
/begin CHARACTERISTIC CalRegn03Inin00.EotProtnEntrStLpFilFrq.Val "MICROSAR RTE" VALUE 0x0 RTE_RL_FLOAT32_IEEE 0 NO_COMPU_METHOD -3.402823466e+38 3.402823466e+38 SYMBOL_LINK "Rte_CalprmRom_CalRegn03Inin00_DEFAULT_RTE_CALPRM_GROUP.EotProtnEntrStLpFilFrq_Val" 0 DISPLAY_IDENTIFIER CalRegn03Inin00.CalibrationPorts.EotProtnEntrStLpFilFrq.Val /end CHARACTERISTIC
/begin CHARACTERISTIC CalRegn03Inin00.EotProtnExitStLpFilFrq.Val "MICROSAR RTE" VALUE 0x0 RTE_RL_FLOAT32_IEEE 0 NO_COMPU_METHOD -3.402823466e+38 3.402823466e+38 SYMBOL_LINK "Rte_CalprmRom_CalRegn03Inin00_DEFAULT_RTE_CALPRM_GROUP.EotProtnExitStLpFilFrq_Val" 0 DISPLAY_IDENTIFIER CalRegn03Inin00.CalibrationPorts.EotProtnExitStLpFilFrq.Val /end CHARACTERISTIC
/begin CHARACTERISTIC CalRegn03Inin00.EotProtnHwAgMax.Val "MICROSAR RTE" VALUE 0x0 RTE_RL_FLOAT32_IEEE 0 NO_COMPU_METHOD -3.402823466e+38 3.402823466e+38 SYMBOL_LINK "Rte_CalprmRom_CalRegn03Inin00_DEFAULT_RTE_CALPRM_GROUP.EotProtnHwAgMax_Val" 0 DISPLAY_IDENTIFIER CalRegn03Inin00.CalibrationPorts.EotProtnHwAgMax.Val /end CHARACTERISTIC
/begin CHARACTERISTIC CalRegn03Inin00.EotProtnHwAgMin.Val "MICROSAR RTE" VALUE 0x0 RTE_RL_FLOAT32_IEEE 0 NO_COMPU_METHOD -3.402823466e+38 3.402823466e+38 SYMBOL_LINK "Rte_CalprmRom_CalRegn03Inin00_DEFAULT_RTE_CALPRM_GROUP.EotProtnHwAgMin_Val" 0 DISPLAY_IDENTIFIER CalRegn03Inin00.CalibrationPorts.EotProtnHwAgMin.Val /end CHARACTERISTIC
/begin CHARACTERISTIC CalRegn03Inin00.EotProtnHwTqLpFilFrq.Val "MICROSAR RTE" VALUE 0x0 RTE_RL_FLOAT32_IEEE 0 NO_COMPU_METHOD -3.402823466e+38 3.402823466e+38 SYMBOL_LINK "Rte_CalprmRom_CalRegn03Inin00_DEFAULT_RTE_CALPRM_GROUP.EotProtnHwTqLpFilFrq_Val" 0 DISPLAY_IDENTIFIER CalRegn03Inin00.CalibrationPorts.EotProtnHwTqLpFilFrq.Val /end CHARACTERISTIC
/begin CHARACTERISTIC CalRegn03Inin00.EotProtnMotSpdIncptSca.Val "MICROSAR RTE" VALUE 0x0 RTE_RL_FLOAT32_IEEE 0 NO_COMPU_METHOD -3.402823466e+38 3.402823466e+38 SYMBOL_LINK "Rte_CalprmRom_CalRegn03Inin00_DEFAULT_RTE_CALPRM_GROUP.EotProtnMotSpdIncptSca_Val" 0 DISPLAY_IDENTIFIER CalRegn03Inin00.CalibrationPorts.EotProtnMotSpdIncptSca.Val /end CHARACTERISTIC
/begin CHARACTERISTIC CalRegn03Inin00.EotProtnMotSpdIncptX.Ary1D "MICROSAR RTE" VAL_BLK 0x0 RTE_RL_UWORD 0 NO_COMPU_METHOD 0 65535 MATRIX_DIM 2 1 1 SYMBOL_LINK "Rte_CalprmRom_CalRegn03Inin00_DEFAULT_RTE_CALPRM_GROUP.EotProtnMotSpdIncptX_Ary1D" 0 DISPLAY_IDENTIFIER CalRegn03Inin00.CalibrationPorts.EotProtnMotSpdIncptX.Ary1D /end CHARACTERISTIC
/begin CHARACTERISTIC CalRegn03Inin00.EotProtnPosnRampStep.Val "MICROSAR RTE" VALUE 0x0 RTE_RL_FLOAT32_IEEE 0 NO_COMPU_METHOD -3.402823466e+38 3.402823466e+38 SYMBOL_LINK "Rte_CalprmRom_CalRegn03Inin00_DEFAULT_RTE_CALPRM_GROUP.EotProtnPosnRampStep_Val" 0 DISPLAY_IDENTIFIER CalRegn03Inin00.CalibrationPorts.EotProtnPosnRampStep.Val /end CHARACTERISTIC
/begin CHARACTERISTIC CalRegn03Inin00.EotProtnRackTrvlLimrAuthyThd.Val "MICROSAR RTE" VALUE 0x0 RTE_RL_FLOAT32_IEEE 0 NO_COMPU_METHOD -3.402823466e+38 3.402823466e+38 SYMBOL_LINK "Rte_CalprmRom_CalRegn03Inin00_DEFAULT_RTE_CALPRM_GROUP.EotProtnRackTrvlLimrAuthyThd_Val" 0 DISPLAY_IDENTIFIER CalRegn03Inin00.CalibrationPorts.EotProtnRackTrvlLimrAuthyThd.Val /end CHARACTERISTIC
/begin CHARACTERISTIC CalRegn03Inin00.EotProtnRackTrvlLimrAuthyThdLimd.Val "MICROSAR RTE" VALUE 0x0 RTE_RL_FLOAT32_IEEE 0 NO_COMPU_METHOD -3.402823466e+38 3.402823466e+38 SYMBOL_LINK "Rte_CalprmRom_CalRegn03Inin00_DEFAULT_RTE_CALPRM_GROUP.EotProtnRackTrvlLimrAuthyThdLimd_Val" 0 DISPLAY_IDENTIFIER CalRegn03Inin00.CalibrationPorts.EotProtnRackTrvlLimrAuthyThdLimd.Val /end CHARACTERISTIC
/begin CHARACTERISTIC CalRegn03Inin00.EotProtnRackTrvlLimrEna.Logl "MICROSAR RTE" VALUE 0x0 RTE_RL_BOOLEAN 0 RTE_CM_BOOLEAN 0 255 SYMBOL_LINK "Rte_CalprmRom_CalRegn03Inin00_DEFAULT_RTE_CALPRM_GROUP.EotProtnRackTrvlLimrEna_Logl" 0 DISPLAY_IDENTIFIER CalRegn03Inin00.CalibrationPorts.EotProtnRackTrvlLimrEna.Logl /end CHARACTERISTIC
/begin CHARACTERISTIC CalRegn03Inin00.EotProtnRunEotVelImpctAndSoftEndStop.Logl "MICROSAR RTE" VALUE 0x0 RTE_RL_BOOLEAN 0 RTE_CM_BOOLEAN 0 255 SYMBOL_LINK "Rte_CalprmRom_CalRegn03Inin00_DEFAULT_RTE_CALPRM_GROUP.EotProtnRunEotVelImpctAndSoftEndStop_Logl" 0 DISPLAY_IDENTIFIER CalRegn03Inin00.CalibrationPorts.EotProtnRunEotVelImpctAndSoftEndStop.Logl /end CHARACTERISTIC
/begin CHARACTERISTIC CalRegn03Inin00.EotProtnSoftEndStopEna.Logl "MICROSAR RTE" VALUE 0x0 RTE_RL_BOOLEAN 0 RTE_CM_BOOLEAN 0 255 SYMBOL_LINK "Rte_CalprmRom_CalRegn03Inin00_DEFAULT_RTE_CALPRM_GROUP.EotProtnSoftEndStopEna_Logl" 0 DISPLAY_IDENTIFIER CalRegn03Inin00.CalibrationPorts.EotProtnSoftEndStopEna.Logl /end CHARACTERISTIC
/begin CHARACTERISTIC CalRegn03Inin00.GmOvrlStMgrLoaMtgtnHaptcFbStrtOnTi.Val "MICROSAR RTE" VALUE 0x0 RTE_RL_ULONG 0 NO_COMPU_METHOD 0 4294967295 SYMBOL_LINK "Rte_CalprmRom_CalRegn03Inin00_DEFAULT_RTE_CALPRM_GROUP.GmOvrlStMgrLoaMtgtnHaptcFbStrtOnTi_Val" 0 DISPLAY_IDENTIFIER CalRegn03Inin00.CalibrationPorts.GmOvrlStMgrLoaMtgtnHaptcFbStrtOnTi.Val /end CHARACTERISTIC
/begin CHARACTERISTIC CalRegn03Inin00.GmOvrlStMgrLoaMtgtnStrtHaptcAmp.Val "MICROSAR RTE" VALUE 0x0 RTE_RL_FLOAT32_IEEE 0 NO_COMPU_METHOD -3.402823466e+38 3.402823466e+38 SYMBOL_LINK "Rte_CalprmRom_CalRegn03Inin00_DEFAULT_RTE_CALPRM_GROUP.GmOvrlStMgrLoaMtgtnStrtHaptcAmp_Val" 0 DISPLAY_IDENTIFIER CalRegn03Inin00.CalibrationPorts.GmOvrlStMgrLoaMtgtnStrtHaptcAmp.Val /end CHARACTERISTIC
/begin CHARACTERISTIC CalRegn03Inin00.GmOvrlStMgrLoaStIgnCntrThd.Val "MICROSAR RTE" VALUE 0x0 RTE_RL_UWORD 0 NO_COMPU_METHOD 0 65535 SYMBOL_LINK "Rte_CalprmRom_CalRegn03Inin00_DEFAULT_RTE_CALPRM_GROUP.GmOvrlStMgrLoaStIgnCntrThd_Val" 0 DISPLAY_IDENTIFIER CalRegn03Inin00.CalibrationPorts.GmOvrlStMgrLoaStIgnCntrThd.Val /end CHARACTERISTIC
/begin CHARACTERISTIC CalRegn03Inin00.HwAgTrakgServoDftlTermLpFilFrq.Val "MICROSAR RTE" VALUE 0x0 RTE_RL_FLOAT32_IEEE 0 NO_COMPU_METHOD -3.402823466e+38 3.402823466e+38 SYMBOL_LINK "Rte_CalprmRom_CalRegn03Inin00_DEFAULT_RTE_CALPRM_GROUP.HwAgTrakgServoDftlTermLpFilFrq_Val" 0 DISPLAY_IDENTIFIER CalRegn03Inin00.CalibrationPorts.HwAgTrakgServoDftlTermLpFilFrq.Val /end CHARACTERISTIC
/begin CHARACTERISTIC CalRegn03Inin00.HwAgTrakgServoHwAgLpFilFrq.Val "MICROSAR RTE" VALUE 0x0 RTE_RL_FLOAT32_IEEE 0 NO_COMPU_METHOD -3.402823466e+38 3.402823466e+38 SYMBOL_LINK "Rte_CalprmRom_CalRegn03Inin00_DEFAULT_RTE_CALPRM_GROUP.HwAgTrakgServoHwAgLpFilFrq_Val" 0 DISPLAY_IDENTIFIER CalRegn03Inin00.CalibrationPorts.HwAgTrakgServoHwAgLpFilFrq.Val /end CHARACTERISTIC
/begin CHARACTERISTIC CalRegn03Inin00.HwAgTrakgServoHwTqLpFilFrq.Val "MICROSAR RTE" VALUE 0x0 RTE_RL_FLOAT32_IEEE 0 NO_COMPU_METHOD -3.402823466e+38 3.402823466e+38 SYMBOL_LINK "Rte_CalprmRom_CalRegn03Inin00_DEFAULT_RTE_CALPRM_GROUP.HwAgTrakgServoHwTqLpFilFrq_Val" 0 DISPLAY_IDENTIFIER CalRegn03Inin00.CalibrationPorts.HwAgTrakgServoHwTqLpFilFrq.Val /end CHARACTERISTIC
/begin CHARACTERISTIC CalRegn03Inin00.HwAgTrakgServoSmotngY.Ary1D "MICROSAR RTE" VAL_BLK 0x0 RTE_RL_UWORD 0 NO_COMPU_METHOD 0 65535 MATRIX_DIM 10 1 1 SYMBOL_LINK "Rte_CalprmRom_CalRegn03Inin00_DEFAULT_RTE_CALPRM_GROUP.HwAgTrakgServoSmotngY_Ary1D" 0 DISPLAY_IDENTIFIER CalRegn03Inin00.CalibrationPorts.HwAgTrakgServoSmotngY.Ary1D /end CHARACTERISTIC
/begin CHARACTERISTIC CalRegn03Inin00.HysCmpAssiCmdLpFilFrq.Val "MICROSAR RTE" VALUE 0x0 RTE_RL_FLOAT32_IEEE 0 NO_COMPU_METHOD -3.402823466e+38 3.402823466e+38 SYMBOL_LINK "Rte_CalprmRom_CalRegn03Inin00_DEFAULT_RTE_CALPRM_GROUP.HysCmpAssiCmdLpFilFrq_Val" 0 DISPLAY_IDENTIFIER CalRegn03Inin00.CalibrationPorts.HysCmpAssiCmdLpFilFrq.Val /end CHARACTERISTIC
/begin CHARACTERISTIC CalRegn03Inin00.HysCmpFinalOutpLpFilFrq.Val "MICROSAR RTE" VALUE 0x0 RTE_RL_FLOAT32_IEEE 0 NO_COMPU_METHOD -3.402823466e+38 3.402823466e+38 SYMBOL_LINK "Rte_CalprmRom_CalRegn03Inin00_DEFAULT_RTE_CALPRM_GROUP.HysCmpFinalOutpLpFilFrq_Val" 0 DISPLAY_IDENTIFIER CalRegn03Inin00.CalibrationPorts.HysCmpFinalOutpLpFilFrq.Val /end CHARACTERISTIC
/begin CHARACTERISTIC CalRegn03Inin00.HysCmpHwTqLpFilFrq.Val "MICROSAR RTE" VALUE 0x0 RTE_RL_FLOAT32_IEEE 0 NO_COMPU_METHOD -3.402823466e+38 3.402823466e+38 SYMBOL_LINK "Rte_CalprmRom_CalRegn03Inin00_DEFAULT_RTE_CALPRM_GROUP.HysCmpHwTqLpFilFrq_Val" 0 DISPLAY_IDENTIFIER CalRegn03Inin00.CalibrationPorts.HysCmpHwTqLpFilFrq.Val /end CHARACTERISTIC
/begin CHARACTERISTIC CalRegn03Inin00.InertiaCmpVelMotInertia.Val "MICROSAR RTE" VALUE 0x0 RTE_RL_FLOAT32_IEEE 0 NO_COMPU_METHOD -3.402823466e+38 3.402823466e+38 SYMBOL_LINK "Rte_CalprmRom_CalRegn03Inin00_DEFAULT_RTE_CALPRM_GROUP.InertiaCmpVelMotInertia_Val" 0 DISPLAY_IDENTIFIER CalRegn03Inin00.CalibrationPorts.InertiaCmpVelMotInertia.Val /end CHARACTERISTIC
/begin CHARACTERISTIC CalRegn03Inin00.InertiaCmpVelNotchFilStruct.Rec.FilGainA1 "MICROSAR RTE" VALUE 0x0 RTE_RL_FLOAT32_IEEE 0 NO_COMPU_METHOD -3.402823466e+38 3.402823466e+38 SYMBOL_LINK "Rte_CalprmRom_CalRegn03Inin00_DEFAULT_RTE_CALPRM_GROUP.InertiaCmpVelNotchFilStruct_Rec.FilGainA1" 0 DISPLAY_IDENTIFIER CalRegn03Inin00.CalibrationPorts.InertiaCmpVelNotchFilStruct.Rec.FilGainA1 /end CHARACTERISTIC
/begin CHARACTERISTIC CalRegn03Inin00.InertiaCmpVelNotchFilStruct.Rec.FilGainA2 "MICROSAR RTE" VALUE 0x0 RTE_RL_FLOAT32_IEEE 0 NO_COMPU_METHOD -3.402823466e+38 3.402823466e+38 SYMBOL_LINK "Rte_CalprmRom_CalRegn03Inin00_DEFAULT_RTE_CALPRM_GROUP.InertiaCmpVelNotchFilStruct_Rec.FilGainA2" 0 DISPLAY_IDENTIFIER CalRegn03Inin00.CalibrationPorts.InertiaCmpVelNotchFilStruct.Rec.FilGainA2 /end CHARACTERISTIC
/begin CHARACTERISTIC CalRegn03Inin00.InertiaCmpVelNotchFilStruct.Rec.FilGainB0 "MICROSAR RTE" VALUE 0x0 RTE_RL_FLOAT32_IEEE 0 NO_COMPU_METHOD -3.402823466e+38 3.402823466e+38 SYMBOL_LINK "Rte_CalprmRom_CalRegn03Inin00_DEFAULT_RTE_CALPRM_GROUP.InertiaCmpVelNotchFilStruct_Rec.FilGainB0" 0 DISPLAY_IDENTIFIER CalRegn03Inin00.CalibrationPorts.InertiaCmpVelNotchFilStruct.Rec.FilGainB0 /end CHARACTERISTIC
/begin CHARACTERISTIC CalRegn03Inin00.InertiaCmpVelNotchFilStruct.Rec.FilGainB1 "MICROSAR RTE" VALUE 0x0 RTE_RL_FLOAT32_IEEE 0 NO_COMPU_METHOD -3.402823466e+38 3.402823466e+38 SYMBOL_LINK "Rte_CalprmRom_CalRegn03Inin00_DEFAULT_RTE_CALPRM_GROUP.InertiaCmpVelNotchFilStruct_Rec.FilGainB1" 0 DISPLAY_IDENTIFIER CalRegn03Inin00.CalibrationPorts.InertiaCmpVelNotchFilStruct.Rec.FilGainB1 /end CHARACTERISTIC
/begin CHARACTERISTIC CalRegn03Inin00.InertiaCmpVelNotchFilStruct.Rec.FilGainB2 "MICROSAR RTE" VALUE 0x0 RTE_RL_FLOAT32_IEEE 0 NO_COMPU_METHOD -3.402823466e+38 3.402823466e+38 SYMBOL_LINK "Rte_CalprmRom_CalRegn03Inin00_DEFAULT_RTE_CALPRM_GROUP.InertiaCmpVelNotchFilStruct_Rec.FilGainB2" 0 DISPLAY_IDENTIFIER CalRegn03Inin00.CalibrationPorts.InertiaCmpVelNotchFilStruct.Rec.FilGainB2 /end CHARACTERISTIC
/begin CHARACTERISTIC CalRegn03Inin00.InertiaCmpVelTqSnsrVelFilFrq.Val "MICROSAR RTE" VALUE 0x0 RTE_RL_FLOAT32_IEEE 0 NO_COMPU_METHOD -3.402823466e+38 3.402823466e+38 SYMBOL_LINK "Rte_CalprmRom_CalRegn03Inin00_DEFAULT_RTE_CALPRM_GROUP.InertiaCmpVelTqSnsrVelFilFrq_Val" 0 DISPLAY_IDENTIFIER CalRegn03Inin00.CalibrationPorts.InertiaCmpVelTqSnsrVelFilFrq.Val /end CHARACTERISTIC
/begin CHARACTERISTIC CalRegn03Inin00.PullCmpActvYawRateFilFrq.Val "MICROSAR RTE" VALUE 0x0 RTE_RL_FLOAT32_IEEE 0 NO_COMPU_METHOD -3.402823466e+38 3.402823466e+38 SYMBOL_LINK "Rte_CalprmRom_CalRegn03Inin00_DEFAULT_RTE_CALPRM_GROUP.PullCmpActvYawRateFilFrq_Val" 0 DISPLAY_IDENTIFIER CalRegn03Inin00.CalibrationPorts.PullCmpActvYawRateFilFrq.Val /end CHARACTERISTIC
/begin CHARACTERISTIC CalRegn03Inin00.PwrpkCmpbltyChkGearId.Val "MICROSAR RTE" VALUE 0x0 RTE_RL_UBYTE 0 NO_COMPU_METHOD 0 255 SYMBOL_LINK "Rte_CalprmRom_CalRegn03Inin00_DEFAULT_RTE_CALPRM_GROUP.PwrpkCmpbltyChkGearId_Val" 0 DISPLAY_IDENTIFIER CalRegn03Inin00.CalibrationPorts.PwrpkCmpbltyChkGearId.Val /end CHARACTERISTIC
/begin CHARACTERISTIC CalRegn03Inin00.RtnHwAuthyScaX.Ary1D "MICROSAR RTE" VAL_BLK 0x0 RTE_RL_UWORD 0 RTE_CM_Uls17 0 0 MATRIX_DIM 4 1 1 SYMBOL_LINK "Rte_CalprmRom_CalRegn03Inin00_DEFAULT_RTE_CALPRM_GROUP.RtnHwAuthyScaX_Ary1D" 0 DISPLAY_IDENTIFIER CalRegn03Inin00.CalibrationPorts.RtnHwAuthyScaX.Ary1D /end CHARACTERISTIC
/begin CHARACTERISTIC CalRegn03Inin00.RtnHwAuthyScaY.Ary1D "MICROSAR RTE" VAL_BLK 0x0 RTE_RL_UWORD 0 RTE_CM_Uls18 0 0 MATRIX_DIM 4 1 1 SYMBOL_LINK "Rte_CalprmRom_CalRegn03Inin00_DEFAULT_RTE_CALPRM_GROUP.RtnHwAuthyScaY_Ary1D" 0 DISPLAY_IDENTIFIER CalRegn03Inin00.CalibrationPorts.RtnHwAuthyScaY.Ary1D /end CHARACTERISTIC
/begin CHARACTERISTIC CalRegn03Inin00.RtnHwAuthySlew.Val "MICROSAR RTE" VALUE 0x0 RTE_RL_FLOAT32_IEEE 0 NO_COMPU_METHOD 0.1 10.0 SYMBOL_LINK "Rte_CalprmRom_CalRegn03Inin00_DEFAULT_RTE_CALPRM_GROUP.RtnHwAuthySlew_Val" 0 DISPLAY_IDENTIFIER CalRegn03Inin00.CalibrationPorts.RtnHwAuthySlew.Val /end CHARACTERISTIC
/begin CHARACTERISTIC CalRegn03Inin00.RtnOffsRng.Val "MICROSAR RTE" VALUE 0x0 RTE_RL_FLOAT32_IEEE 0 NO_COMPU_METHOD 0.0 20.0 SYMBOL_LINK "Rte_CalprmRom_CalRegn03Inin00_DEFAULT_RTE_CALPRM_GROUP.RtnOffsRng_Val" 0 DISPLAY_IDENTIFIER CalRegn03Inin00.CalibrationPorts.RtnOffsRng.Val /end CHARACTERISTIC
/begin CHARACTERISTIC CalRegn03Inin00.RtnOffsSlew.Val "MICROSAR RTE" VALUE 0x0 RTE_RL_FLOAT32_IEEE 0 NO_COMPU_METHOD 0.0 0.5 SYMBOL_LINK "Rte_CalprmRom_CalRegn03Inin00_DEFAULT_RTE_CALPRM_GROUP.RtnOffsSlew_Val" 0 DISPLAY_IDENTIFIER CalRegn03Inin00.CalibrationPorts.RtnOffsSlew.Val /end CHARACTERISTIC
/begin CHARACTERISTIC CalRegn03Inin00.StabyCmpAssiScaBlndX.Ary1D "MICROSAR RTE" VAL_BLK 0x0 RTE_RL_UWORD 0 NO_COMPU_METHOD 0 65535 MATRIX_DIM 2 1 1 SYMBOL_LINK "Rte_CalprmRom_CalRegn03Inin00_DEFAULT_RTE_CALPRM_GROUP.StabyCmpAssiScaBlndX_Ary1D" 0 DISPLAY_IDENTIFIER CalRegn03Inin00.CalibrationPorts.StabyCmpAssiScaBlndX.Ary1D /end CHARACTERISTIC
/begin CHARACTERISTIC CalRegn03Inin00.StabyCmpAssiScaBlndY.Ary1D "MICROSAR RTE" VAL_BLK 0x0 RTE_RL_UWORD 0 NO_COMPU_METHOD 0 65535 MATRIX_DIM 2 1 1 SYMBOL_LINK "Rte_CalprmRom_CalRegn03Inin00_DEFAULT_RTE_CALPRM_GROUP.StabyCmpAssiScaBlndY_Ary1D" 0 DISPLAY_IDENTIFIER CalRegn03Inin00.CalibrationPorts.StabyCmpAssiScaBlndY.Ary1D /end CHARACTERISTIC
/begin CHARACTERISTIC CalRegn03Inin00.StabyCmpHwTqLpFilFrq.Val "MICROSAR RTE" VALUE 0x0 RTE_RL_FLOAT32_IEEE 0 NO_COMPU_METHOD -3.402823466e+38 3.402823466e+38 SYMBOL_LINK "Rte_CalprmRom_CalRegn03Inin00_DEFAULT_RTE_CALPRM_GROUP.StabyCmpHwTqLpFilFrq_Val" 0 DISPLAY_IDENTIFIER CalRegn03Inin00.CalibrationPorts.StabyCmpHwTqLpFilFrq.Val /end CHARACTERISTIC
/begin CHARACTERISTIC CalRegn03Inin00.StabyCmpNotchFil1Struct.Rec.FilGainA1 "MICROSAR RTE" VALUE 0x0 RTE_RL_FLOAT32_IEEE 0 NO_COMPU_METHOD -3.402823466e+38 3.402823466e+38 SYMBOL_LINK "Rte_CalprmRom_CalRegn03Inin00_DEFAULT_RTE_CALPRM_GROUP.StabyCmpNotchFil1Struct_Rec.FilGainA1" 0 DISPLAY_IDENTIFIER CalRegn03Inin00.CalibrationPorts.StabyCmpNotchFil1Struct.Rec.FilGainA1 /end CHARACTERISTIC
/begin CHARACTERISTIC CalRegn03Inin00.StabyCmpNotchFil1Struct.Rec.FilGainA2 "MICROSAR RTE" VALUE 0x0 RTE_RL_FLOAT32_IEEE 0 NO_COMPU_METHOD -3.402823466e+38 3.402823466e+38 SYMBOL_LINK "Rte_CalprmRom_CalRegn03Inin00_DEFAULT_RTE_CALPRM_GROUP.StabyCmpNotchFil1Struct_Rec.FilGainA2" 0 DISPLAY_IDENTIFIER CalRegn03Inin00.CalibrationPorts.StabyCmpNotchFil1Struct.Rec.FilGainA2 /end CHARACTERISTIC
/begin CHARACTERISTIC CalRegn03Inin00.StabyCmpNotchFil1Struct.Rec.FilGainB0 "MICROSAR RTE" VALUE 0x0 RTE_RL_FLOAT32_IEEE 0 NO_COMPU_METHOD -3.402823466e+38 3.402823466e+38 SYMBOL_LINK "Rte_CalprmRom_CalRegn03Inin00_DEFAULT_RTE_CALPRM_GROUP.StabyCmpNotchFil1Struct_Rec.FilGainB0" 0 DISPLAY_IDENTIFIER CalRegn03Inin00.CalibrationPorts.StabyCmpNotchFil1Struct.Rec.FilGainB0 /end CHARACTERISTIC
/begin CHARACTERISTIC CalRegn03Inin00.StabyCmpNotchFil1Struct.Rec.FilGainB1 "MICROSAR RTE" VALUE 0x0 RTE_RL_FLOAT32_IEEE 0 NO_COMPU_METHOD -3.402823466e+38 3.402823466e+38 SYMBOL_LINK "Rte_CalprmRom_CalRegn03Inin00_DEFAULT_RTE_CALPRM_GROUP.StabyCmpNotchFil1Struct_Rec.FilGainB1" 0 DISPLAY_IDENTIFIER CalRegn03Inin00.CalibrationPorts.StabyCmpNotchFil1Struct.Rec.FilGainB1 /end CHARACTERISTIC
/begin CHARACTERISTIC CalRegn03Inin00.StabyCmpNotchFil1Struct.Rec.FilGainB2 "MICROSAR RTE" VALUE 0x0 RTE_RL_FLOAT32_IEEE 0 NO_COMPU_METHOD -3.402823466e+38 3.402823466e+38 SYMBOL_LINK "Rte_CalprmRom_CalRegn03Inin00_DEFAULT_RTE_CALPRM_GROUP.StabyCmpNotchFil1Struct_Rec.FilGainB2" 0 DISPLAY_IDENTIFIER CalRegn03Inin00.CalibrationPorts.StabyCmpNotchFil1Struct.Rec.FilGainB2 /end CHARACTERISTIC
/begin CHARACTERISTIC CalRegn03Inin00.StabyCmpNotchFil2Struct.Rec.FilGainA1 "MICROSAR RTE" VALUE 0x0 RTE_RL_FLOAT32_IEEE 0 NO_COMPU_METHOD -3.402823466e+38 3.402823466e+38 SYMBOL_LINK "Rte_CalprmRom_CalRegn03Inin00_DEFAULT_RTE_CALPRM_GROUP.StabyCmpNotchFil2Struct_Rec.FilGainA1" 0 DISPLAY_IDENTIFIER CalRegn03Inin00.CalibrationPorts.StabyCmpNotchFil2Struct.Rec.FilGainA1 /end CHARACTERISTIC
/begin CHARACTERISTIC CalRegn03Inin00.StabyCmpNotchFil2Struct.Rec.FilGainA2 "MICROSAR RTE" VALUE 0x0 RTE_RL_FLOAT32_IEEE 0 NO_COMPU_METHOD -3.402823466e+38 3.402823466e+38 SYMBOL_LINK "Rte_CalprmRom_CalRegn03Inin00_DEFAULT_RTE_CALPRM_GROUP.StabyCmpNotchFil2Struct_Rec.FilGainA2" 0 DISPLAY_IDENTIFIER CalRegn03Inin00.CalibrationPorts.StabyCmpNotchFil2Struct.Rec.FilGainA2 /end CHARACTERISTIC
/begin CHARACTERISTIC CalRegn03Inin00.StabyCmpNotchFil2Struct.Rec.FilGainB0 "MICROSAR RTE" VALUE 0x0 RTE_RL_FLOAT32_IEEE 0 NO_COMPU_METHOD -3.402823466e+38 3.402823466e+38 SYMBOL_LINK "Rte_CalprmRom_CalRegn03Inin00_DEFAULT_RTE_CALPRM_GROUP.StabyCmpNotchFil2Struct_Rec.FilGainB0" 0 DISPLAY_IDENTIFIER CalRegn03Inin00.CalibrationPorts.StabyCmpNotchFil2Struct.Rec.FilGainB0 /end CHARACTERISTIC
/begin CHARACTERISTIC CalRegn03Inin00.StabyCmpNotchFil2Struct.Rec.FilGainB1 "MICROSAR RTE" VALUE 0x0 RTE_RL_FLOAT32_IEEE 0 NO_COMPU_METHOD -3.402823466e+38 3.402823466e+38 SYMBOL_LINK "Rte_CalprmRom_CalRegn03Inin00_DEFAULT_RTE_CALPRM_GROUP.StabyCmpNotchFil2Struct_Rec.FilGainB1" 0 DISPLAY_IDENTIFIER CalRegn03Inin00.CalibrationPorts.StabyCmpNotchFil2Struct.Rec.FilGainB1 /end CHARACTERISTIC
/begin CHARACTERISTIC CalRegn03Inin00.StabyCmpNotchFil2Struct.Rec.FilGainB2 "MICROSAR RTE" VALUE 0x0 RTE_RL_FLOAT32_IEEE 0 NO_COMPU_METHOD -3.402823466e+38 3.402823466e+38 SYMBOL_LINK "Rte_CalprmRom_CalRegn03Inin00_DEFAULT_RTE_CALPRM_GROUP.StabyCmpNotchFil2Struct_Rec.FilGainB2" 0 DISPLAY_IDENTIFIER CalRegn03Inin00.CalibrationPorts.StabyCmpNotchFil2Struct.Rec.FilGainB2 /end CHARACTERISTIC
/begin CHARACTERISTIC CalRegn03Inin00.StabyCmpNotchFil3Struct.Rec.FilGainA1 "MICROSAR RTE" VALUE 0x0 RTE_RL_FLOAT32_IEEE 0 NO_COMPU_METHOD -3.402823466e+38 3.402823466e+38 SYMBOL_LINK "Rte_CalprmRom_CalRegn03Inin00_DEFAULT_RTE_CALPRM_GROUP.StabyCmpNotchFil3Struct_Rec.FilGainA1" 0 DISPLAY_IDENTIFIER CalRegn03Inin00.CalibrationPorts.StabyCmpNotchFil3Struct.Rec.FilGainA1 /end CHARACTERISTIC
/begin CHARACTERISTIC CalRegn03Inin00.StabyCmpNotchFil3Struct.Rec.FilGainA2 "MICROSAR RTE" VALUE 0x0 RTE_RL_FLOAT32_IEEE 0 NO_COMPU_METHOD -3.402823466e+38 3.402823466e+38 SYMBOL_LINK "Rte_CalprmRom_CalRegn03Inin00_DEFAULT_RTE_CALPRM_GROUP.StabyCmpNotchFil3Struct_Rec.FilGainA2" 0 DISPLAY_IDENTIFIER CalRegn03Inin00.CalibrationPorts.StabyCmpNotchFil3Struct.Rec.FilGainA2 /end CHARACTERISTIC
/begin CHARACTERISTIC CalRegn03Inin00.StabyCmpNotchFil3Struct.Rec.FilGainB0 "MICROSAR RTE" VALUE 0x0 RTE_RL_FLOAT32_IEEE 0 NO_COMPU_METHOD -3.402823466e+38 3.402823466e+38 SYMBOL_LINK "Rte_CalprmRom_CalRegn03Inin00_DEFAULT_RTE_CALPRM_GROUP.StabyCmpNotchFil3Struct_Rec.FilGainB0" 0 DISPLAY_IDENTIFIER CalRegn03Inin00.CalibrationPorts.StabyCmpNotchFil3Struct.Rec.FilGainB0 /end CHARACTERISTIC
/begin CHARACTERISTIC CalRegn03Inin00.StabyCmpNotchFil3Struct.Rec.FilGainB1 "MICROSAR RTE" VALUE 0x0 RTE_RL_FLOAT32_IEEE 0 NO_COMPU_METHOD -3.402823466e+38 3.402823466e+38 SYMBOL_LINK "Rte_CalprmRom_CalRegn03Inin00_DEFAULT_RTE_CALPRM_GROUP.StabyCmpNotchFil3Struct_Rec.FilGainB1" 0 DISPLAY_IDENTIFIER CalRegn03Inin00.CalibrationPorts.StabyCmpNotchFil3Struct.Rec.FilGainB1 /end CHARACTERISTIC
/begin CHARACTERISTIC CalRegn03Inin00.StabyCmpNotchFil3Struct.Rec.FilGainB2 "MICROSAR RTE" VALUE 0x0 RTE_RL_FLOAT32_IEEE 0 NO_COMPU_METHOD -3.402823466e+38 3.402823466e+38 SYMBOL_LINK "Rte_CalprmRom_CalRegn03Inin00_DEFAULT_RTE_CALPRM_GROUP.StabyCmpNotchFil3Struct_Rec.FilGainB2" 0 DISPLAY_IDENTIFIER CalRegn03Inin00.CalibrationPorts.StabyCmpNotchFil3Struct.Rec.FilGainB2 /end CHARACTERISTIC
/begin CHARACTERISTIC CalRegn03Inin00.StabyCmpNotchFil4Struct.Rec.FilGainA1 "MICROSAR RTE" VALUE 0x0 RTE_RL_FLOAT32_IEEE 0 NO_COMPU_METHOD -3.402823466e+38 3.402823466e+38 SYMBOL_LINK "Rte_CalprmRom_CalRegn03Inin00_DEFAULT_RTE_CALPRM_GROUP.StabyCmpNotchFil4Struct_Rec.FilGainA1" 0 DISPLAY_IDENTIFIER CalRegn03Inin00.CalibrationPorts.StabyCmpNotchFil4Struct.Rec.FilGainA1 /end CHARACTERISTIC
/begin CHARACTERISTIC CalRegn03Inin00.StabyCmpNotchFil4Struct.Rec.FilGainA2 "MICROSAR RTE" VALUE 0x0 RTE_RL_FLOAT32_IEEE 0 NO_COMPU_METHOD -3.402823466e+38 3.402823466e+38 SYMBOL_LINK "Rte_CalprmRom_CalRegn03Inin00_DEFAULT_RTE_CALPRM_GROUP.StabyCmpNotchFil4Struct_Rec.FilGainA2" 0 DISPLAY_IDENTIFIER CalRegn03Inin00.CalibrationPorts.StabyCmpNotchFil4Struct.Rec.FilGainA2 /end CHARACTERISTIC
/begin CHARACTERISTIC CalRegn03Inin00.StabyCmpNotchFil4Struct.Rec.FilGainB0 "MICROSAR RTE" VALUE 0x0 RTE_RL_FLOAT32_IEEE 0 NO_COMPU_METHOD -3.402823466e+38 3.402823466e+38 SYMBOL_LINK "Rte_CalprmRom_CalRegn03Inin00_DEFAULT_RTE_CALPRM_GROUP.StabyCmpNotchFil4Struct_Rec.FilGainB0" 0 DISPLAY_IDENTIFIER CalRegn03Inin00.CalibrationPorts.StabyCmpNotchFil4Struct.Rec.FilGainB0 /end CHARACTERISTIC
/begin CHARACTERISTIC CalRegn03Inin00.StabyCmpNotchFil4Struct.Rec.FilGainB1 "MICROSAR RTE" VALUE 0x0 RTE_RL_FLOAT32_IEEE 0 NO_COMPU_METHOD -3.402823466e+38 3.402823466e+38 SYMBOL_LINK "Rte_CalprmRom_CalRegn03Inin00_DEFAULT_RTE_CALPRM_GROUP.StabyCmpNotchFil4Struct_Rec.FilGainB1" 0 DISPLAY_IDENTIFIER CalRegn03Inin00.CalibrationPorts.StabyCmpNotchFil4Struct.Rec.FilGainB1 /end CHARACTERISTIC
/begin CHARACTERISTIC CalRegn03Inin00.StabyCmpNotchFil4Struct.Rec.FilGainB2 "MICROSAR RTE" VALUE 0x0 RTE_RL_FLOAT32_IEEE 0 NO_COMPU_METHOD -3.402823466e+38 3.402823466e+38 SYMBOL_LINK "Rte_CalprmRom_CalRegn03Inin00_DEFAULT_RTE_CALPRM_GROUP.StabyCmpNotchFil4Struct_Rec.FilGainB2" 0 DISPLAY_IDENTIFIER CalRegn03Inin00.CalibrationPorts.StabyCmpNotchFil4Struct.Rec.FilGainB2 /end CHARACTERISTIC
/begin CHARACTERISTIC CalRegn03Inin00.StabyCmpNotchFilBlnd04Y.Ary2D "MICROSAR RTE" VAL_BLK 0x0 RTE_RL_UWORD 0 NO_COMPU_METHOD 0 65535 MATRIX_DIM 5 6 1 SYMBOL_LINK "Rte_CalprmRom_CalRegn03Inin00_DEFAULT_RTE_CALPRM_GROUP.StabyCmpNotchFilBlnd04Y_Ary2D" 0 DISPLAY_IDENTIFIER CalRegn03Inin00.CalibrationPorts.StabyCmpNotchFilBlnd04Y.Ary2D /end CHARACTERISTIC
/begin CHARACTERISTIC CalRegn03Inin00.StabyCmpNotchFilBlnd34TqX.Ary2D "MICROSAR RTE" VAL_BLK 0x0 RTE_RL_UWORD 0 NO_COMPU_METHOD 0 65535 MATRIX_DIM 5 6 1 SYMBOL_LINK "Rte_CalprmRom_CalRegn03Inin00_DEFAULT_RTE_CALPRM_GROUP.StabyCmpNotchFilBlnd34TqX_Ary2D" 0 DISPLAY_IDENTIFIER CalRegn03Inin00.CalibrationPorts.StabyCmpNotchFilBlnd34TqX.Ary2D /end CHARACTERISTIC
/begin CHARACTERISTIC CalRegn03Inin00.StabyCmpNotchFilBlnd34Y.Ary2D "MICROSAR RTE" VAL_BLK 0x0 RTE_RL_UWORD 0 NO_COMPU_METHOD 0 65535 MATRIX_DIM 5 6 1 SYMBOL_LINK "Rte_CalprmRom_CalRegn03Inin00_DEFAULT_RTE_CALPRM_GROUP.StabyCmpNotchFilBlnd34Y_Ary2D" 0 DISPLAY_IDENTIFIER CalRegn03Inin00.CalibrationPorts.StabyCmpNotchFilBlnd34Y.Ary2D /end CHARACTERISTIC
/begin CHARACTERISTIC CalRegn03Inin00.SysGlbPrmSysKineRat.Val "MICROSAR RTE" VALUE 0x0 RTE_RL_FLOAT32_IEEE 0 NO_COMPU_METHOD 10 40 SYMBOL_LINK "Rte_CalprmRom_CalRegn03Inin00_DEFAULT_RTE_CALPRM_GROUP.SysGlbPrmSysKineRat_Val" 0 DISPLAY_IDENTIFIER CalRegn03Inin00.CalibrationPorts.SysGlbPrmSysKineRat.Val /end CHARACTERISTIC
/begin CHARACTERISTIC CalRegn03Inin00.SysGlbPrmSysTqRat.Val "MICROSAR RTE" VALUE 0x0 RTE_RL_FLOAT32_IEEE 0 NO_COMPU_METHOD -3.402823466e+38 3.402823466e+38 SYMBOL_LINK "Rte_CalprmRom_CalRegn03Inin00_DEFAULT_RTE_CALPRM_GROUP.SysGlbPrmSysTqRat_Val" 0 DISPLAY_IDENTIFIER CalRegn03Inin00.CalibrationPorts.SysGlbPrmSysTqRat.Val /end CHARACTERISTIC
/begin CHARACTERISTIC CalRegn03Inin00.WhlImbRejctnBlndCmdMgnLp1FilFrq.Val "MICROSAR RTE" VALUE 0x0 RTE_RL_FLOAT32_IEEE 0 NO_COMPU_METHOD -3.402823466e+38 3.402823466e+38 SYMBOL_LINK "Rte_CalprmRom_CalRegn03Inin00_DEFAULT_RTE_CALPRM_GROUP.WhlImbRejctnBlndCmdMgnLp1FilFrq_Val" 0 DISPLAY_IDENTIFIER CalRegn03Inin00.CalibrationPorts.WhlImbRejctnBlndCmdMgnLp1FilFrq.Val /end CHARACTERISTIC
/begin CHARACTERISTIC CalRegn03Inin00.WhlImbRejctnBlndCmdMgnLp2FilFrq.Val "MICROSAR RTE" VALUE 0x0 RTE_RL_FLOAT32_IEEE 0 NO_COMPU_METHOD -3.402823466e+38 3.402823466e+38 SYMBOL_LINK "Rte_CalprmRom_CalRegn03Inin00_DEFAULT_RTE_CALPRM_GROUP.WhlImbRejctnBlndCmdMgnLp2FilFrq_Val" 0 DISPLAY_IDENTIFIER CalRegn03Inin00.CalibrationPorts.WhlImbRejctnBlndCmdMgnLp2FilFrq.Val /end CHARACTERISTIC
/begin CHARACTERISTIC CalRegn03Inin00.WhlImbRejctnDistbnMgnLpFil.Val "MICROSAR RTE" VALUE 0x0 RTE_RL_FLOAT32_IEEE 0 NO_COMPU_METHOD -3.402823466e+38 3.402823466e+38 SYMBOL_LINK "Rte_CalprmRom_CalRegn03Inin00_DEFAULT_RTE_CALPRM_GROUP.WhlImbRejctnDistbnMgnLpFil_Val" 0 DISPLAY_IDENTIFIER CalRegn03Inin00.CalibrationPorts.WhlImbRejctnDistbnMgnLpFil.Val /end CHARACTERISTIC
/begin CHARACTERISTIC CalRegn03Inin00.WhlImbRejctnWhlSpdLpFil.Val "MICROSAR RTE" VALUE 0x0 RTE_RL_FLOAT32_IEEE 0 NO_COMPU_METHOD -3.402823466e+38 3.402823466e+38 SYMBOL_LINK "Rte_CalprmRom_CalRegn03Inin00_DEFAULT_RTE_CALPRM_GROUP.WhlImbRejctnWhlSpdLpFil_Val" 0 DISPLAY_IDENTIFIER CalRegn03Inin00.CalibrationPorts.WhlImbRejctnWhlSpdLpFil.Val /end CHARACTERISTIC
/begin CHARACTERISTIC CalRegn03Inin00GroupA.DampgTScaX.Ary1D "MICROSAR RTE" VAL_BLK 0x0 RTE_RL_SWORD 0 RTE_CM_T7 0 0 MATRIX_DIM 14 1 1 SYMBOL_LINK "Rte_CalprmRom_CalRegn03Inin00GroupA_DEFAULT_RTE_CALPRM_GROUP.DampgTScaX_Ary1D" 0 DISPLAY_IDENTIFIER CalRegn03Inin00GroupA.CalibrationPorts.DampgTScaX.Ary1D /end CHARACTERISTIC
/begin CHARACTERISTIC CalRegn03Inin00GroupA.DampgTScaY.Ary1D "MICROSAR RTE" VAL_BLK 0x0 RTE_RL_UWORD 0 RTE_CM_Uls20 0 0 MATRIX_DIM 14 1 1 SYMBOL_LINK "Rte_CalprmRom_CalRegn03Inin00GroupA_DEFAULT_RTE_CALPRM_GROUP.DampgTScaY_Ary1D" 0 DISPLAY_IDENTIFIER CalRegn03Inin00GroupA.CalibrationPorts.DampgTScaY.Ary1D /end CHARACTERISTIC
/begin CHARACTERISTIC CalRegn03Inin00GroupA.HysCmpAssiInpLim.Val "MICROSAR RTE" VALUE 0x0 RTE_RL_UWORD 0 NO_COMPU_METHOD 0 65535 SYMBOL_LINK "Rte_CalprmRom_CalRegn03Inin00GroupA_DEFAULT_RTE_CALPRM_GROUP.HysCmpAssiInpLim_Val" 0 DISPLAY_IDENTIFIER CalRegn03Inin00GroupA.CalibrationPorts.HysCmpAssiInpLim.Val /end CHARACTERISTIC
/begin CHARACTERISTIC CalRegn03Inin00GroupA.HysCmpFricTScaX.Ary1D "MICROSAR RTE" VAL_BLK 0x0 RTE_RL_SWORD 0 NO_COMPU_METHOD -32768 32767 MATRIX_DIM 8 1 1 SYMBOL_LINK "Rte_CalprmRom_CalRegn03Inin00GroupA_DEFAULT_RTE_CALPRM_GROUP.HysCmpFricTScaX_Ary1D" 0 DISPLAY_IDENTIFIER CalRegn03Inin00GroupA.CalibrationPorts.HysCmpFricTScaX.Ary1D /end CHARACTERISTIC
/begin CHARACTERISTIC CalRegn03Inin00GroupA.HysCmpFricTScaY.Ary1D "MICROSAR RTE" VAL_BLK 0x0 RTE_RL_UWORD 0 NO_COMPU_METHOD 0 65535 MATRIX_DIM 8 1 1 SYMBOL_LINK "Rte_CalprmRom_CalRegn03Inin00GroupA_DEFAULT_RTE_CALPRM_GROUP.HysCmpFricTScaY_Ary1D" 0 DISPLAY_IDENTIFIER CalRegn03Inin00GroupA.CalibrationPorts.HysCmpFricTScaY.Ary1D /end CHARACTERISTIC
/begin CHARACTERISTIC CalRegn03Inin00GroupA.InertiaCmpVelCmdScaY.Ary1D "MICROSAR RTE" VAL_BLK 0x0 RTE_RL_UWORD 0 NO_COMPU_METHOD 0 65535 MATRIX_DIM 12 1 1 SYMBOL_LINK "Rte_CalprmRom_CalRegn03Inin00GroupA_DEFAULT_RTE_CALPRM_GROUP.InertiaCmpVelCmdScaY_Ary1D" 0 DISPLAY_IDENTIFIER CalRegn03Inin00GroupA.CalibrationPorts.InertiaCmpVelCmdScaY.Ary1D /end CHARACTERISTIC
/begin CHARACTERISTIC CalRegn03Inin00GroupA.InertiaCmpVelDampgDecelGain.Val "MICROSAR RTE" VALUE 0x0 RTE_RL_FLOAT32_IEEE 0 NO_COMPU_METHOD -3.402823466e+38 3.402823466e+38 SYMBOL_LINK "Rte_CalprmRom_CalRegn03Inin00GroupA_DEFAULT_RTE_CALPRM_GROUP.InertiaCmpVelDampgDecelGain_Val" 0 DISPLAY_IDENTIFIER CalRegn03Inin00GroupA.CalibrationPorts.InertiaCmpVelDampgDecelGain.Val /end CHARACTERISTIC
/begin CHARACTERISTIC CalRegn03Inin00GroupA.InertiaCmpVelDampgDecelGainFallSlew.Val "MICROSAR RTE" VALUE 0x0 RTE_RL_FLOAT32_IEEE 0 NO_COMPU_METHOD -3.402823466e+38 3.402823466e+38 SYMBOL_LINK "Rte_CalprmRom_CalRegn03Inin00GroupA_DEFAULT_RTE_CALPRM_GROUP.InertiaCmpVelDampgDecelGainFallSlew_Val" 0 DISPLAY_IDENTIFIER CalRegn03Inin00GroupA.CalibrationPorts.InertiaCmpVelDampgDecelGainFallSlew.Val /end CHARACTERISTIC
/begin CHARACTERISTIC CalRegn03Inin00GroupA.InertiaCmpVelDampgDecelGainRisngSlewX.Ary1D "MICROSAR RTE" VAL_BLK 0x0 RTE_RL_UWORD 0 NO_COMPU_METHOD 0 65535 MATRIX_DIM 6 1 1 SYMBOL_LINK "Rte_CalprmRom_CalRegn03Inin00GroupA_DEFAULT_RTE_CALPRM_GROUP.InertiaCmpVelDampgDecelGainRisngSlewX_Ary1D" 0 DISPLAY_IDENTIFIER CalRegn03Inin00GroupA.CalibrationPorts.InertiaCmpVelDampgDecelGainRisngSlewX.Ary1D /end CHARACTERISTIC
/begin CHARACTERISTIC CalRegn03Inin00GroupA.InertiaCmpVelDampgDecelGainRisngSlewY.Ary1D "MICROSAR RTE" VAL_BLK 0x0 RTE_RL_UWORD 0 NO_COMPU_METHOD 0 65535 MATRIX_DIM 6 1 1 SYMBOL_LINK "Rte_CalprmRom_CalRegn03Inin00GroupA_DEFAULT_RTE_CALPRM_GROUP.InertiaCmpVelDampgDecelGainRisngSlewY_Ary1D" 0 DISPLAY_IDENTIFIER CalRegn03Inin00GroupA.CalibrationPorts.InertiaCmpVelDampgDecelGainRisngSlewY.Ary1D /end CHARACTERISTIC
/begin CHARACTERISTIC CalRegn03Inin00GroupA.InertiaCmpVelDampgGainOffThd.Val "MICROSAR RTE" VALUE 0x0 RTE_RL_FLOAT32_IEEE 0 NO_COMPU_METHOD -3.402823466e+38 3.402823466e+38 SYMBOL_LINK "Rte_CalprmRom_CalRegn03Inin00GroupA_DEFAULT_RTE_CALPRM_GROUP.InertiaCmpVelDampgGainOffThd_Val" 0 DISPLAY_IDENTIFIER CalRegn03Inin00GroupA.CalibrationPorts.InertiaCmpVelDampgGainOffThd.Val /end CHARACTERISTIC
/begin CHARACTERISTIC CalRegn03Inin00GroupA.InertiaCmpVelDampgGainOnThd.Val "MICROSAR RTE" VALUE 0x0 RTE_RL_FLOAT32_IEEE 0 NO_COMPU_METHOD -3.402823466e+38 3.402823466e+38 SYMBOL_LINK "Rte_CalprmRom_CalRegn03Inin00GroupA_DEFAULT_RTE_CALPRM_GROUP.InertiaCmpVelDampgGainOnThd_Val" 0 DISPLAY_IDENTIFIER CalRegn03Inin00GroupA.CalibrationPorts.InertiaCmpVelDampgGainOnThd.Val /end CHARACTERISTIC
/begin CHARACTERISTIC CalRegn03Inin00GroupA.InertiaCmpVelMotVelBasdOutpScagX.Ary1D "MICROSAR RTE" VAL_BLK 0x0 RTE_RL_UWORD 0 NO_COMPU_METHOD 0 65535 MATRIX_DIM 2 1 1 SYMBOL_LINK "Rte_CalprmRom_CalRegn03Inin00GroupA_DEFAULT_RTE_CALPRM_GROUP.InertiaCmpVelMotVelBasdOutpScagX_Ary1D" 0 DISPLAY_IDENTIFIER CalRegn03Inin00GroupA.CalibrationPorts.InertiaCmpVelMotVelBasdOutpScagX.Ary1D /end CHARACTERISTIC
/begin CHARACTERISTIC CalRegn03Inin00GroupA.InertiaCmpVelMotVelBasdOutpScagY.Ary1D "MICROSAR RTE" VAL_BLK 0x0 RTE_RL_UWORD 0 NO_COMPU_METHOD 0 65535 MATRIX_DIM 2 1 1 SYMBOL_LINK "Rte_CalprmRom_CalRegn03Inin00GroupA_DEFAULT_RTE_CALPRM_GROUP.InertiaCmpVelMotVelBasdOutpScagY_Ary1D" 0 DISPLAY_IDENTIFIER CalRegn03Inin00GroupA.CalibrationPorts.InertiaCmpVelMotVelBasdOutpScagY.Ary1D /end CHARACTERISTIC
/begin CHARACTERISTIC CalRegn03Inin00GroupA.InertiaCmpVelTqSnsrVelSca.Ary1D "MICROSAR RTE" VAL_BLK 0x0 RTE_RL_UWORD 0 NO_COMPU_METHOD 0 65535 MATRIX_DIM 12 1 1 SYMBOL_LINK "Rte_CalprmRom_CalRegn03Inin00GroupA_DEFAULT_RTE_CALPRM_GROUP.InertiaCmpVelTqSnsrVelSca_Ary1D" 0 DISPLAY_IDENTIFIER CalRegn03Inin00GroupA.CalibrationPorts.InertiaCmpVelTqSnsrVelSca.Ary1D /end CHARACTERISTIC
/begin CHARACTERISTIC CalRegn03Inin00GroupA.RtnTScaX.Ary1D "MICROSAR RTE" VAL_BLK 0x0 RTE_RL_SWORD 0 RTE_CM_T6 0 0 MATRIX_DIM 14 1 1 SYMBOL_LINK "Rte_CalprmRom_CalRegn03Inin00GroupA_DEFAULT_RTE_CALPRM_GROUP.RtnTScaX_Ary1D" 0 DISPLAY_IDENTIFIER CalRegn03Inin00GroupA.CalibrationPorts.RtnTScaX.Ary1D /end CHARACTERISTIC
/begin CHARACTERISTIC CalRegn03Inin00GroupA.RtnTScaY.Ary1D "MICROSAR RTE" VAL_BLK 0x0 RTE_RL_UWORD 0 RTE_CM_Uls23 0 0 MATRIX_DIM 14 1 1 SYMBOL_LINK "Rte_CalprmRom_CalRegn03Inin00GroupA_DEFAULT_RTE_CALPRM_GROUP.RtnTScaY_Ary1D" 0 DISPLAY_IDENTIFIER CalRegn03Inin00GroupA.CalibrationPorts.RtnTScaY.Ary1D /end CHARACTERISTIC
/begin CHARACTERISTIC CalRegn03Inin00GroupA.StabyCmpNotchFilBilnrBlndVehSpd.Ary1D "MICROSAR RTE" VAL_BLK 0x0 RTE_RL_UWORD 0 NO_COMPU_METHOD 0 65535 MATRIX_DIM 6 1 1 SYMBOL_LINK "Rte_CalprmRom_CalRegn03Inin00GroupA_DEFAULT_RTE_CALPRM_GROUP.StabyCmpNotchFilBilnrBlndVehSpd_Ary1D" 0 DISPLAY_IDENTIFIER CalRegn03Inin00GroupA.CalibrationPorts.StabyCmpNotchFilBilnrBlndVehSpd.Ary1D /end CHARACTERISTIC
/begin CHARACTERISTIC CalRegn03Inin00GroupA.StabyCmpNotchFilBlnd02Y.Ary2D "MICROSAR RTE" VAL_BLK 0x0 RTE_RL_UWORD 0 NO_COMPU_METHOD 0 65535 MATRIX_DIM 5 6 1 SYMBOL_LINK "Rte_CalprmRom_CalRegn03Inin00GroupA_DEFAULT_RTE_CALPRM_GROUP.StabyCmpNotchFilBlnd02Y_Ary2D" 0 DISPLAY_IDENTIFIER CalRegn03Inin00GroupA.CalibrationPorts.StabyCmpNotchFilBlnd02Y.Ary2D /end CHARACTERISTIC
/begin CHARACTERISTIC CalRegn03Inin00GroupA.StabyCmpNotchFilBlnd12TqX.Ary2D "MICROSAR RTE" VAL_BLK 0x0 RTE_RL_UWORD 0 NO_COMPU_METHOD 0 65535 MATRIX_DIM 5 6 1 SYMBOL_LINK "Rte_CalprmRom_CalRegn03Inin00GroupA_DEFAULT_RTE_CALPRM_GROUP.StabyCmpNotchFilBlnd12TqX_Ary2D" 0 DISPLAY_IDENTIFIER CalRegn03Inin00GroupA.CalibrationPorts.StabyCmpNotchFilBlnd12TqX.Ary2D /end CHARACTERISTIC
/begin CHARACTERISTIC CalRegn03Inin00GroupA.StabyCmpNotchFilBlnd12Y.Ary2D "MICROSAR RTE" VAL_BLK 0x0 RTE_RL_UWORD 0 NO_COMPU_METHOD 0 65535 MATRIX_DIM 5 6 1 SYMBOL_LINK "Rte_CalprmRom_CalRegn03Inin00GroupA_DEFAULT_RTE_CALPRM_GROUP.StabyCmpNotchFilBlnd12Y_Ary2D" 0 DISPLAY_IDENTIFIER CalRegn03Inin00GroupA.CalibrationPorts.StabyCmpNotchFilBlnd12Y.Ary2D /end CHARACTERISTIC
/begin CHARACTERISTIC CalRegn03Inin00GroupB.EotProtnDampgSlew.Val "MICROSAR RTE" VALUE 0x0 RTE_RL_FLOAT32_IEEE 0 NO_COMPU_METHOD -3.402823466e+38 3.402823466e+38 SYMBOL_LINK "Rte_CalprmRom_CalRegn03Inin00GroupB_DEFAULT_RTE_CALPRM_GROUP.EotProtnDampgSlew_Val" 0 DISPLAY_IDENTIFIER CalRegn03Inin00GroupB.CalibrationPorts.EotProtnDampgSlew.Val /end CHARACTERISTIC
/begin CHARACTERISTIC CalRegn03Inin00GroupB.EotProtnHwAgGain.Val "MICROSAR RTE" VALUE 0x0 RTE_RL_FLOAT32_IEEE 0 NO_COMPU_METHOD -3.402823466e+38 3.402823466e+38 SYMBOL_LINK "Rte_CalprmRom_CalRegn03Inin00GroupB_DEFAULT_RTE_CALPRM_GROUP.EotProtnHwAgGain_Val" 0 DISPLAY_IDENTIFIER CalRegn03Inin00GroupB.CalibrationPorts.EotProtnHwAgGain.Val /end CHARACTERISTIC
/begin CHARACTERISTIC CalRegn03Inin00GroupB.EotProtnHwTqScaX.Ary1D "MICROSAR RTE" VAL_BLK 0x0 RTE_RL_UWORD 0 NO_COMPU_METHOD 0 65535 MATRIX_DIM 2 1 1 SYMBOL_LINK "Rte_CalprmRom_CalRegn03Inin00GroupB_DEFAULT_RTE_CALPRM_GROUP.EotProtnHwTqScaX_Ary1D" 0 DISPLAY_IDENTIFIER CalRegn03Inin00GroupB.CalibrationPorts.EotProtnHwTqScaX.Ary1D /end CHARACTERISTIC
/begin CHARACTERISTIC CalRegn03Inin00GroupB.EotProtnMotVelGain.Val "MICROSAR RTE" VALUE 0x0 RTE_RL_FLOAT32_IEEE 0 NO_COMPU_METHOD -3.402823466e+38 3.402823466e+38 SYMBOL_LINK "Rte_CalprmRom_CalRegn03Inin00GroupB_DEFAULT_RTE_CALPRM_GROUP.EotProtnMotVelGain_Val" 0 DISPLAY_IDENTIFIER CalRegn03Inin00GroupB.CalibrationPorts.EotProtnMotVelGain.Val /end CHARACTERISTIC
/begin CHARACTERISTIC CalRegn03Inin00GroupB.EotProtnRackTrvlLimrRng.Val "MICROSAR RTE" VALUE 0x0 RTE_RL_FLOAT32_IEEE 0 NO_COMPU_METHOD -3.402823466e+38 3.402823466e+38 SYMBOL_LINK "Rte_CalprmRom_CalRegn03Inin00GroupB_DEFAULT_RTE_CALPRM_GROUP.EotProtnRackTrvlLimrRng_Val" 0 DISPLAY_IDENTIFIER CalRegn03Inin00GroupB.CalibrationPorts.EotProtnRackTrvlLimrRng.Val /end CHARACTERISTIC
/begin CHARACTERISTIC CalRegn03Inin00GroupB.EotProtnRackTrvlLimrRngLimd.Val "MICROSAR RTE" VALUE 0x0 RTE_RL_FLOAT32_IEEE 0 NO_COMPU_METHOD -3.402823466e+38 3.402823466e+38 SYMBOL_LINK "Rte_CalprmRom_CalRegn03Inin00GroupB_DEFAULT_RTE_CALPRM_GROUP.EotProtnRackTrvlLimrRngLimd_Val" 0 DISPLAY_IDENTIFIER CalRegn03Inin00GroupB.CalibrationPorts.EotProtnRackTrvlLimrRngLimd.Val /end CHARACTERISTIC
/begin CHARACTERISTIC CalRegn03Inin00GroupB.EotProtnRackTrvlLimrVehSpdThd.Val "MICROSAR RTE" VALUE 0x0 RTE_RL_FLOAT32_IEEE 0 NO_COMPU_METHOD -3.402823466e+38 3.402823466e+38 SYMBOL_LINK "Rte_CalprmRom_CalRegn03Inin00GroupB_DEFAULT_RTE_CALPRM_GROUP.EotProtnRackTrvlLimrVehSpdThd_Val" 0 DISPLAY_IDENTIFIER CalRegn03Inin00GroupB.CalibrationPorts.EotProtnRackTrvlLimrVehSpdThd.Val /end CHARACTERISTIC
/begin CHARACTERISTIC CalRegn03Inin00GroupB.EotProtnSoftEndStopVehSpdThd.Val "MICROSAR RTE" VALUE 0x0 RTE_RL_FLOAT32_IEEE 0 NO_COMPU_METHOD -3.402823466e+38 3.402823466e+38 SYMBOL_LINK "Rte_CalprmRom_CalRegn03Inin00GroupB_DEFAULT_RTE_CALPRM_GROUP.EotProtnSoftEndStopVehSpdThd_Val" 0 DISPLAY_IDENTIFIER CalRegn03Inin00GroupB.CalibrationPorts.EotProtnSoftEndStopVehSpdThd.Val /end CHARACTERISTIC
/begin CHARACTERISTIC CalRegn03Inin00GroupB.WhlImbRejctnAdpvFac.Val "MICROSAR RTE" VALUE 0x0 RTE_RL_FLOAT32_IEEE 0 NO_COMPU_METHOD -3.402823466e+38 3.402823466e+38 SYMBOL_LINK "Rte_CalprmRom_CalRegn03Inin00GroupB_DEFAULT_RTE_CALPRM_GROUP.WhlImbRejctnAdpvFac_Val" 0 DISPLAY_IDENTIFIER CalRegn03Inin00GroupB.CalibrationPorts.WhlImbRejctnAdpvFac.Val /end CHARACTERISTIC
/begin CHARACTERISTIC CalRegn03Inin00GroupB.WhlImbRejctnCurrMgnSlewPerLoop.Val "MICROSAR RTE" VALUE 0x0 RTE_RL_FLOAT32_IEEE 0 NO_COMPU_METHOD -3.402823466e+38 3.402823466e+38 SYMBOL_LINK "Rte_CalprmRom_CalRegn03Inin00GroupB_DEFAULT_RTE_CALPRM_GROUP.WhlImbRejctnCurrMgnSlewPerLoop_Val" 0 DISPLAY_IDENTIFIER CalRegn03Inin00GroupB.CalibrationPorts.WhlImbRejctnCurrMgnSlewPerLoop.Val /end CHARACTERISTIC
/begin CHARACTERISTIC CalRegn03Inin00GroupB.WhlImbRejctnDcTrendTh2Tq.Val "MICROSAR RTE" VALUE 0x0 RTE_RL_FLOAT32_IEEE 0 NO_COMPU_METHOD -3.402823466e+38 3.402823466e+38 SYMBOL_LINK "Rte_CalprmRom_CalRegn03Inin00GroupB_DEFAULT_RTE_CALPRM_GROUP.WhlImbRejctnDcTrendTh2Tq_Val" 0 DISPLAY_IDENTIFIER CalRegn03Inin00GroupB.CalibrationPorts.WhlImbRejctnDcTrendTh2Tq.Val /end CHARACTERISTIC
/begin CHARACTERISTIC CalRegn03Inin00GroupB.WhlImbRejctnDcTrendThTq.Val "MICROSAR RTE" VALUE 0x0 RTE_RL_FLOAT32_IEEE 0 NO_COMPU_METHOD -3.402823466e+38 3.402823466e+38 SYMBOL_LINK "Rte_CalprmRom_CalRegn03Inin00GroupB_DEFAULT_RTE_CALPRM_GROUP.WhlImbRejctnDcTrendThTq_Val" 0 DISPLAY_IDENTIFIER CalRegn03Inin00GroupB.CalibrationPorts.WhlImbRejctnDcTrendThTq.Val /end CHARACTERISTIC
/begin CHARACTERISTIC CalRegn03Inin00GroupB.WhlImbRejctnDcTrendTi2Sec.Val "MICROSAR RTE" VALUE 0x0 RTE_RL_FLOAT32_IEEE 0 NO_COMPU_METHOD -3.402823466e+38 3.402823466e+38 SYMBOL_LINK "Rte_CalprmRom_CalRegn03Inin00GroupB_DEFAULT_RTE_CALPRM_GROUP.WhlImbRejctnDcTrendTi2Sec_Val" 0 DISPLAY_IDENTIFIER CalRegn03Inin00GroupB.CalibrationPorts.WhlImbRejctnDcTrendTi2Sec.Val /end CHARACTERISTIC
/begin CHARACTERISTIC CalRegn03Inin00GroupB.WhlImbRejctnDcTrendTiSec.Val "MICROSAR RTE" VALUE 0x0 RTE_RL_FLOAT32_IEEE 0 NO_COMPU_METHOD -3.402823466e+38 3.402823466e+38 SYMBOL_LINK "Rte_CalprmRom_CalRegn03Inin00GroupB_DEFAULT_RTE_CALPRM_GROUP.WhlImbRejctnDcTrendTiSec_Val" 0 DISPLAY_IDENTIFIER CalRegn03Inin00GroupB.CalibrationPorts.WhlImbRejctnDcTrendTiSec.Val /end CHARACTERISTIC
/begin CHARACTERISTIC CalRegn03Inin00GroupB.WhlImbRejctnEnaSlewPerLoop.Val "MICROSAR RTE" VALUE 0x0 RTE_RL_FLOAT32_IEEE 0 NO_COMPU_METHOD -3.402823466e+38 3.402823466e+38 SYMBOL_LINK "Rte_CalprmRom_CalRegn03Inin00GroupB_DEFAULT_RTE_CALPRM_GROUP.WhlImbRejctnEnaSlewPerLoop_Val" 0 DISPLAY_IDENTIFIER CalRegn03Inin00GroupB.CalibrationPorts.WhlImbRejctnEnaSlewPerLoop.Val /end CHARACTERISTIC
/begin CHARACTERISTIC CalRegn03Inin00GroupB.WhlImbRejctnFrqScaTblX.Ary1D "MICROSAR RTE" VAL_BLK 0x0 RTE_RL_UWORD 0 NO_COMPU_METHOD 0 65535 MATRIX_DIM 6 1 1 SYMBOL_LINK "Rte_CalprmRom_CalRegn03Inin00GroupB_DEFAULT_RTE_CALPRM_GROUP.WhlImbRejctnFrqScaTblX_Ary1D" 0 DISPLAY_IDENTIFIER CalRegn03Inin00GroupB.CalibrationPorts.WhlImbRejctnFrqScaTblX.Ary1D /end CHARACTERISTIC
/begin CHARACTERISTIC CalRegn03Inin00GroupB.WhlImbRejctnFrqScaTblY.Ary1D "MICROSAR RTE" VAL_BLK 0x0 RTE_RL_UWORD 0 NO_COMPU_METHOD 0 65535 MATRIX_DIM 6 1 1 SYMBOL_LINK "Rte_CalprmRom_CalRegn03Inin00GroupB_DEFAULT_RTE_CALPRM_GROUP.WhlImbRejctnFrqScaTblY_Ary1D" 0 DISPLAY_IDENTIFIER CalRegn03Inin00GroupB.CalibrationPorts.WhlImbRejctnFrqScaTblY.Ary1D /end CHARACTERISTIC
/begin CHARACTERISTIC CalRegn03Inin00GroupB.WhlImbRejctnMaxDurn.Val "MICROSAR RTE" VALUE 0x0 RTE_RL_UWORD 0 NO_COMPU_METHOD 0 65535 SYMBOL_LINK "Rte_CalprmRom_CalRegn03Inin00GroupB_DEFAULT_RTE_CALPRM_GROUP.WhlImbRejctnMaxDurn_Val" 0 DISPLAY_IDENTIFIER CalRegn03Inin00GroupB.CalibrationPorts.WhlImbRejctnMaxDurn.Val /end CHARACTERISTIC
/begin CHARACTERISTIC CalRegn03Inin00GroupB.WhlImbRejctnMaxMgn.Val "MICROSAR RTE" VALUE 0x0 RTE_RL_FLOAT32_IEEE 0 NO_COMPU_METHOD -3.402823466e+38 3.402823466e+38 SYMBOL_LINK "Rte_CalprmRom_CalRegn03Inin00GroupB_DEFAULT_RTE_CALPRM_GROUP.WhlImbRejctnMaxMgn_Val" 0 DISPLAY_IDENTIFIER CalRegn03Inin00GroupB.CalibrationPorts.WhlImbRejctnMaxMgn.Val /end CHARACTERISTIC
/begin CHARACTERISTIC CalRegn03Inin00GroupB.WhlImbRejctnMgnEstimnDeltaSca.Val "MICROSAR RTE" VALUE 0x0 RTE_RL_FLOAT32_IEEE 0 NO_COMPU_METHOD -3.402823466e+38 3.402823466e+38 SYMBOL_LINK "Rte_CalprmRom_CalRegn03Inin00GroupB_DEFAULT_RTE_CALPRM_GROUP.WhlImbRejctnMgnEstimnDeltaSca_Val" 0 DISPLAY_IDENTIFIER CalRegn03Inin00GroupB.CalibrationPorts.WhlImbRejctnMgnEstimnDeltaSca.Val /end CHARACTERISTIC
/begin CHARACTERISTIC CalRegn03Inin00GroupB.WhlImbRejctnMgnEstimnDiThd.Val "MICROSAR RTE" VALUE 0x0 RTE_RL_FLOAT32_IEEE 0 NO_COMPU_METHOD -3.402823466e+38 3.402823466e+38 SYMBOL_LINK "Rte_CalprmRom_CalRegn03Inin00GroupB_DEFAULT_RTE_CALPRM_GROUP.WhlImbRejctnMgnEstimnDiThd_Val" 0 DISPLAY_IDENTIFIER CalRegn03Inin00GroupB.CalibrationPorts.WhlImbRejctnMgnEstimnDiThd.Val /end CHARACTERISTIC
/begin CHARACTERISTIC CalRegn03Inin00GroupB.WhlImbRejctnMgnEstimnEnaThd.Val "MICROSAR RTE" VALUE 0x0 RTE_RL_FLOAT32_IEEE 0 NO_COMPU_METHOD -3.402823466e+38 3.402823466e+38 SYMBOL_LINK "Rte_CalprmRom_CalRegn03Inin00GroupB_DEFAULT_RTE_CALPRM_GROUP.WhlImbRejctnMgnEstimnEnaThd_Val" 0 DISPLAY_IDENTIFIER CalRegn03Inin00GroupB.CalibrationPorts.WhlImbRejctnMgnEstimnEnaThd.Val /end CHARACTERISTIC
/begin CHARACTERISTIC CalRegn03Inin00GroupB.WhlImbRejctnMgnEstimnFrq.Val "MICROSAR RTE" VALUE 0x0 RTE_RL_FLOAT32_IEEE 0 NO_COMPU_METHOD -3.402823466e+38 3.402823466e+38 SYMBOL_LINK "Rte_CalprmRom_CalRegn03Inin00GroupB_DEFAULT_RTE_CALPRM_GROUP.WhlImbRejctnMgnEstimnFrq_Val" 0 DISPLAY_IDENTIFIER CalRegn03Inin00GroupB.CalibrationPorts.WhlImbRejctnMgnEstimnFrq.Val /end CHARACTERISTIC
/begin CHARACTERISTIC CalRegn03Inin00GroupB.WhlImbRejctnMgnEstimnFrqDelta.Val "MICROSAR RTE" VALUE 0x0 RTE_RL_FLOAT32_IEEE 0 NO_COMPU_METHOD -3.402823466e+38 3.402823466e+38 SYMBOL_LINK "Rte_CalprmRom_CalRegn03Inin00GroupB_DEFAULT_RTE_CALPRM_GROUP.WhlImbRejctnMgnEstimnFrqDelta_Val" 0 DISPLAY_IDENTIFIER CalRegn03Inin00GroupB.CalibrationPorts.WhlImbRejctnMgnEstimnFrqDelta.Val /end CHARACTERISTIC
/begin CHARACTERISTIC CalRegn03Inin00GroupB.WhlImbRejctnMgnEstimnLeak.Val "MICROSAR RTE" VALUE 0x0 RTE_RL_FLOAT32_IEEE 0 NO_COMPU_METHOD -3.402823466e+38 3.402823466e+38 SYMBOL_LINK "Rte_CalprmRom_CalRegn03Inin00GroupB_DEFAULT_RTE_CALPRM_GROUP.WhlImbRejctnMgnEstimnLeak_Val" 0 DISPLAY_IDENTIFIER CalRegn03Inin00GroupB.CalibrationPorts.WhlImbRejctnMgnEstimnLeak.Val /end CHARACTERISTIC
/begin CHARACTERISTIC CalRegn03Inin00GroupB.WhlImbRejctnPhaAdjX.Ary1D "MICROSAR RTE" VAL_BLK 0x0 RTE_RL_UWORD 0 NO_COMPU_METHOD 0 65535 MATRIX_DIM 3 1 1 SYMBOL_LINK "Rte_CalprmRom_CalRegn03Inin00GroupB_DEFAULT_RTE_CALPRM_GROUP.WhlImbRejctnPhaAdjX_Ary1D" 0 DISPLAY_IDENTIFIER CalRegn03Inin00GroupB.CalibrationPorts.WhlImbRejctnPhaAdjX.Ary1D /end CHARACTERISTIC
/begin CHARACTERISTIC CalRegn03Inin00GroupB.WhlImbRejctnPhaAdjY.Ary1D "MICROSAR RTE" VAL_BLK 0x0 RTE_RL_SWORD 0 NO_COMPU_METHOD -32768 32767 MATRIX_DIM 3 1 1 SYMBOL_LINK "Rte_CalprmRom_CalRegn03Inin00GroupB_DEFAULT_RTE_CALPRM_GROUP.WhlImbRejctnPhaAdjY_Ary1D" 0 DISPLAY_IDENTIFIER CalRegn03Inin00GroupB.CalibrationPorts.WhlImbRejctnPhaAdjY.Ary1D /end CHARACTERISTIC
/begin CHARACTERISTIC CalRegn03Inin00GroupB.WhlImbRejctnWhlSpdCorrlnThd.Val "MICROSAR RTE" VALUE 0x0 RTE_RL_FLOAT32_IEEE 0 NO_COMPU_METHOD -3.402823466e+38 3.402823466e+38 SYMBOL_LINK "Rte_CalprmRom_CalRegn03Inin00GroupB_DEFAULT_RTE_CALPRM_GROUP.WhlImbRejctnWhlSpdCorrlnThd_Val" 0 DISPLAY_IDENTIFIER CalRegn03Inin00GroupB.CalibrationPorts.WhlImbRejctnWhlSpdCorrlnThd.Val /end CHARACTERISTIC
/begin CHARACTERISTIC CalRegn03Inin00GroupB.WhlImbRejctnWhlSpdCorrlnTi.Val "MICROSAR RTE" VALUE 0x0 RTE_RL_UWORD 0 NO_COMPU_METHOD 0 65535 SYMBOL_LINK "Rte_CalprmRom_CalRegn03Inin00GroupB_DEFAULT_RTE_CALPRM_GROUP.WhlImbRejctnWhlSpdCorrlnTi_Val" 0 DISPLAY_IDENTIFIER CalRegn03Inin00GroupB.CalibrationPorts.WhlImbRejctnWhlSpdCorrlnTi.Val /end CHARACTERISTIC
/begin CHARACTERISTIC CalRegn03Inin00GroupC.HwAgTrakgServoDampgTqX.Ary1D "MICROSAR RTE" VAL_BLK 0x0 RTE_RL_UWORD 0 NO_COMPU_METHOD 0 65535 MATRIX_DIM 13 1 1 SYMBOL_LINK "Rte_CalprmRom_CalRegn03Inin00GroupC_DEFAULT_RTE_CALPRM_GROUP.HwAgTrakgServoDampgTqX_Ary1D" 0 DISPLAY_IDENTIFIER CalRegn03Inin00GroupC.CalibrationPorts.HwAgTrakgServoDampgTqX.Ary1D /end CHARACTERISTIC
/begin CHARACTERISTIC CalRegn03Inin00GroupC.HwAgTrakgServoDampgTqY.Ary2D "MICROSAR RTE" VAL_BLK 0x0 RTE_RL_UWORD 0 NO_COMPU_METHOD 0 65535 MATRIX_DIM 13 3 1 SYMBOL_LINK "Rte_CalprmRom_CalRegn03Inin00GroupC_DEFAULT_RTE_CALPRM_GROUP.HwAgTrakgServoDampgTqY_Ary2D" 0 DISPLAY_IDENTIFIER CalRegn03Inin00GroupC.CalibrationPorts.HwAgTrakgServoDampgTqY.Ary2D /end CHARACTERISTIC
/begin CHARACTERISTIC CalRegn03Inin00GroupC.HwAgTrakgServoDftlGainY.Ary1D "MICROSAR RTE" VAL_BLK 0x0 RTE_RL_UWORD 0 NO_COMPU_METHOD 0 65535 MATRIX_DIM 3 1 1 SYMBOL_LINK "Rte_CalprmRom_CalRegn03Inin00GroupC_DEFAULT_RTE_CALPRM_GROUP.HwAgTrakgServoDftlGainY_Ary1D" 0 DISPLAY_IDENTIFIER CalRegn03Inin00GroupC.CalibrationPorts.HwAgTrakgServoDftlGainY.Ary1D /end CHARACTERISTIC
/begin CHARACTERISTIC CalRegn03Inin00GroupC.HwAgTrakgServoIntglGainY.Ary1D "MICROSAR RTE" VAL_BLK 0x0 RTE_RL_UWORD 0 NO_COMPU_METHOD 0 65535 MATRIX_DIM 3 1 1 SYMBOL_LINK "Rte_CalprmRom_CalRegn03Inin00GroupC_DEFAULT_RTE_CALPRM_GROUP.HwAgTrakgServoIntglGainY_Ary1D" 0 DISPLAY_IDENTIFIER CalRegn03Inin00GroupC.CalibrationPorts.HwAgTrakgServoIntglGainY.Ary1D /end CHARACTERISTIC
/begin CHARACTERISTIC CalRegn03Inin00GroupC.HwAgTrakgServoIntglTermAntiWdupLimY.Ary1D "MICROSAR RTE" VAL_BLK 0x0 RTE_RL_UWORD 0 NO_COMPU_METHOD 0 65535 MATRIX_DIM 3 1 1 SYMBOL_LINK "Rte_CalprmRom_CalRegn03Inin00GroupC_DEFAULT_RTE_CALPRM_GROUP.HwAgTrakgServoIntglTermAntiWdupLimY_Ary1D" 0 DISPLAY_IDENTIFIER CalRegn03Inin00GroupC.CalibrationPorts.HwAgTrakgServoIntglTermAntiWdupLimY.Ary1D /end CHARACTERISTIC
/begin CHARACTERISTIC CalRegn03Inin00GroupC.HwAgTrakgServoPropGainX.Ary1D "MICROSAR RTE" VAL_BLK 0x0 RTE_RL_UWORD 0 NO_COMPU_METHOD 0 65535 MATRIX_DIM 7 1 1 SYMBOL_LINK "Rte_CalprmRom_CalRegn03Inin00GroupC_DEFAULT_RTE_CALPRM_GROUP.HwAgTrakgServoPropGainX_Ary1D" 0 DISPLAY_IDENTIFIER CalRegn03Inin00GroupC.CalibrationPorts.HwAgTrakgServoPropGainX.Ary1D /end CHARACTERISTIC
/begin CHARACTERISTIC CalRegn03Inin00GroupC.HwAgTrakgServoPropGainY.Ary2D "MICROSAR RTE" VAL_BLK 0x0 RTE_RL_UWORD 0 NO_COMPU_METHOD 0 65535 MATRIX_DIM 7 3 1 SYMBOL_LINK "Rte_CalprmRom_CalRegn03Inin00GroupC_DEFAULT_RTE_CALPRM_GROUP.HwAgTrakgServoPropGainY_Ary2D" 0 DISPLAY_IDENTIFIER CalRegn03Inin00GroupC.CalibrationPorts.HwAgTrakgServoPropGainY.Ary2D /end CHARACTERISTIC
/begin CHARACTERISTIC CalRegn03Inin00GroupC.HwAgTrakgServoSmotngX.Ary1D "MICROSAR RTE" VAL_BLK 0x0 RTE_RL_UWORD 0 NO_COMPU_METHOD 0 65535 MATRIX_DIM 10 1 1 SYMBOL_LINK "Rte_CalprmRom_CalRegn03Inin00GroupC_DEFAULT_RTE_CALPRM_GROUP.HwAgTrakgServoSmotngX_Ary1D" 0 DISPLAY_IDENTIFIER CalRegn03Inin00GroupC.CalibrationPorts.HwAgTrakgServoSmotngX.Ary1D /end CHARACTERISTIC
/begin CHARACTERISTIC CalRegn03Rt00.InertiaCmpVelDampgFilFrq.Ary1D "MICROSAR RTE" VAL_BLK 0x0 RTE_RL_UWORD 0 NO_COMPU_METHOD 0 65535 MATRIX_DIM 12 1 1 SYMBOL_LINK "Rte_CalprmRom_CalRegn03Rt00_DEFAULT_RTE_CALPRM_GROUP.InertiaCmpVelDampgFilFrq_Ary1D" 0 DISPLAY_IDENTIFIER CalRegn03Rt00.CalibrationPorts.InertiaCmpVelDampgFilFrq.Ary1D /end CHARACTERISTIC
/begin CHARACTERISTIC CalRegn03Rt00.InertiaCmpVelDampgFilFrqWhlImbRejctnOn.Ary1D "MICROSAR RTE" VAL_BLK 0x0 RTE_RL_UWORD 0 NO_COMPU_METHOD 0 65535 MATRIX_DIM 12 1 1 SYMBOL_LINK "Rte_CalprmRom_CalRegn03Rt00_DEFAULT_RTE_CALPRM_GROUP.InertiaCmpVelDampgFilFrqWhlImbRejctnOn_Ary1D" 0 DISPLAY_IDENTIFIER CalRegn03Rt00.CalibrationPorts.InertiaCmpVelDampgFilFrqWhlImbRejctnOn.Ary1D /end CHARACTERISTIC
/begin CHARACTERISTIC CalRegn03Rt00GroupA.AssiHiFrqGainY.Ary2D "MICROSAR RTE" VAL_BLK 0x0 RTE_RL_UWORD 0 NO_COMPU_METHOD 0 65535 MATRIX_DIM 13 12 1 SYMBOL_LINK "Rte_CalprmRom_CalRegn03Rt00GroupA_DEFAULT_RTE_CALPRM_GROUP.AssiHiFrqGainY_Ary2D" 0 DISPLAY_IDENTIFIER CalRegn03Rt00GroupA.CalibrationPorts.AssiHiFrqGainY.Ary2D /end CHARACTERISTIC
/begin CHARACTERISTIC CalRegn03Rt00GroupA.AssiHiFrqTqX.Ary2D "MICROSAR RTE" VAL_BLK 0x0 RTE_RL_UWORD 0 NO_COMPU_METHOD 0 65535 MATRIX_DIM 13 12 1 SYMBOL_LINK "Rte_CalprmRom_CalRegn03Rt00GroupA_DEFAULT_RTE_CALPRM_GROUP.AssiHiFrqTqX_Ary2D" 0 DISPLAY_IDENTIFIER CalRegn03Rt00GroupA.CalibrationPorts.AssiHiFrqTqX.Ary2D /end CHARACTERISTIC
/begin CHARACTERISTIC CalRegn03Rt00GroupA.AssiMotTqWhlImbRejctnMinX.Ary2D "MICROSAR RTE" VAL_BLK 0x0 RTE_RL_UWORD 0 RTE_CM_Tq6 0 0 MATRIX_DIM 20 12 1 SYMBOL_LINK "Rte_CalprmRom_CalRegn03Rt00GroupA_DEFAULT_RTE_CALPRM_GROUP.AssiMotTqWhlImbRejctnMinX_Ary2D" 0 DISPLAY_IDENTIFIER CalRegn03Rt00GroupA.CalibrationPorts.AssiMotTqWhlImbRejctnMinX.Ary2D /end CHARACTERISTIC
/begin CHARACTERISTIC CalRegn03Rt00GroupA.AssiMotTqWhlImbRejctnMinY.Ary2D "MICROSAR RTE" VAL_BLK 0x0 RTE_RL_SWORD 0 RTE_CM_Tq11 0 0 MATRIX_DIM 20 12 1 SYMBOL_LINK "Rte_CalprmRom_CalRegn03Rt00GroupA_DEFAULT_RTE_CALPRM_GROUP.AssiMotTqWhlImbRejctnMinY_Ary2D" 0 DISPLAY_IDENTIFIER CalRegn03Rt00GroupA.CalibrationPorts.AssiMotTqWhlImbRejctnMinY.Ary2D /end CHARACTERISTIC
/begin CHARACTERISTIC CalRegn03Rt00GroupA.DampgHydCoeff1ScaY.Ary1D "MICROSAR RTE" VAL_BLK 0x0 RTE_RL_UWORD 0 NO_COMPU_METHOD 0 65535 MATRIX_DIM 12 1 1 SYMBOL_LINK "Rte_CalprmRom_CalRegn03Rt00GroupA_DEFAULT_RTE_CALPRM_GROUP.DampgHydCoeff1ScaY_Ary1D" 0 DISPLAY_IDENTIFIER CalRegn03Rt00GroupA.CalibrationPorts.DampgHydCoeff1ScaY.Ary1D /end CHARACTERISTIC
/begin CHARACTERISTIC CalRegn03Rt00GroupA.DampgHydCoeff2ScaY.Ary1D "MICROSAR RTE" VAL_BLK 0x0 RTE_RL_UWORD 0 NO_COMPU_METHOD 0 65535 MATRIX_DIM 12 1 1 SYMBOL_LINK "Rte_CalprmRom_CalRegn03Rt00GroupA_DEFAULT_RTE_CALPRM_GROUP.DampgHydCoeff2ScaY_Ary1D" 0 DISPLAY_IDENTIFIER CalRegn03Rt00GroupA.CalibrationPorts.DampgHydCoeff2ScaY.Ary1D /end CHARACTERISTIC
/begin CHARACTERISTIC CalRegn03Rt00GroupA.DampgHydCoeff3ScaY.Ary1D "MICROSAR RTE" VAL_BLK 0x0 RTE_RL_UWORD 0 NO_COMPU_METHOD 0 65535 MATRIX_DIM 12 1 1 SYMBOL_LINK "Rte_CalprmRom_CalRegn03Rt00GroupA_DEFAULT_RTE_CALPRM_GROUP.DampgHydCoeff3ScaY_Ary1D" 0 DISPLAY_IDENTIFIER CalRegn03Rt00GroupA.CalibrationPorts.DampgHydCoeff3ScaY.Ary1D /end CHARACTERISTIC
/begin CHARACTERISTIC CalRegn03Rt00GroupA.DampgHydCoeff4ScaY.Ary1D "MICROSAR RTE" VAL_BLK 0x0 RTE_RL_UWORD 0 NO_COMPU_METHOD 0 65535 MATRIX_DIM 12 1 1 SYMBOL_LINK "Rte_CalprmRom_CalRegn03Rt00GroupA_DEFAULT_RTE_CALPRM_GROUP.DampgHydCoeff4ScaY_Ary1D" 0 DISPLAY_IDENTIFIER CalRegn03Rt00GroupA.CalibrationPorts.DampgHydCoeff4ScaY.Ary1D /end CHARACTERISTIC
/begin CHARACTERISTIC CalRegn03Rt00GroupA.DampgMotVelX.Ary2D "MICROSAR RTE" VAL_BLK 0x0 RTE_RL_UWORD 0 NO_COMPU_METHOD 0 65535 MATRIX_DIM 13 12 1 SYMBOL_LINK "Rte_CalprmRom_CalRegn03Rt00GroupA_DEFAULT_RTE_CALPRM_GROUP.DampgMotVelX_Ary2D" 0 DISPLAY_IDENTIFIER CalRegn03Rt00GroupA.CalibrationPorts.DampgMotVelX.Ary2D /end CHARACTERISTIC
/begin CHARACTERISTIC CalRegn03Rt00GroupA.DampgMotVelY.Ary2D "MICROSAR RTE" VAL_BLK 0x0 RTE_RL_UWORD 0 NO_COMPU_METHOD 0 65535 MATRIX_DIM 13 12 1 SYMBOL_LINK "Rte_CalprmRom_CalRegn03Rt00GroupA_DEFAULT_RTE_CALPRM_GROUP.DampgMotVelY_Ary2D" 0 DISPLAY_IDENTIFIER CalRegn03Rt00GroupA.CalibrationPorts.DampgMotVelY.Ary2D /end CHARACTERISTIC
/begin CHARACTERISTIC CalRegn03Rt00GroupA.HysCmpFricWhlImbRejctnBlndX.Ary1D "MICROSAR RTE" VAL_BLK 0x0 RTE_RL_UWORD 0 NO_COMPU_METHOD 0 65535 MATRIX_DIM 6 1 1 SYMBOL_LINK "Rte_CalprmRom_CalRegn03Rt00GroupA_DEFAULT_RTE_CALPRM_GROUP.HysCmpFricWhlImbRejctnBlndX_Ary1D" 0 DISPLAY_IDENTIFIER CalRegn03Rt00GroupA.CalibrationPorts.HysCmpFricWhlImbRejctnBlndX.Ary1D /end CHARACTERISTIC
/begin CHARACTERISTIC CalRegn03Rt00GroupA.HysCmpFricWhlImbRejctnBlndY.Ary1D "MICROSAR RTE" VAL_BLK 0x0 RTE_RL_UWORD 0 NO_COMPU_METHOD 0 65535 MATRIX_DIM 6 1 1 SYMBOL_LINK "Rte_CalprmRom_CalRegn03Rt00GroupA_DEFAULT_RTE_CALPRM_GROUP.HysCmpFricWhlImbRejctnBlndY_Ary1D" 0 DISPLAY_IDENTIFIER CalRegn03Rt00GroupA.CalibrationPorts.HysCmpFricWhlImbRejctnBlndY.Ary1D /end CHARACTERISTIC
/begin CHARACTERISTIC CalRegn03Rt00GroupA.HysCmpFricWhlImbRejctnOffY.Ary1D "MICROSAR RTE" VAL_BLK 0x0 RTE_RL_UWORD 0 NO_COMPU_METHOD 0 65535 MATRIX_DIM 12 1 1 SYMBOL_LINK "Rte_CalprmRom_CalRegn03Rt00GroupA_DEFAULT_RTE_CALPRM_GROUP.HysCmpFricWhlImbRejctnOffY_Ary1D" 0 DISPLAY_IDENTIFIER CalRegn03Rt00GroupA.CalibrationPorts.HysCmpFricWhlImbRejctnOffY.Ary1D /end CHARACTERISTIC
/begin CHARACTERISTIC CalRegn03Rt00GroupA.HysCmpFricWhlImbRejctnOnY.Ary1D "MICROSAR RTE" VAL_BLK 0x0 RTE_RL_UWORD 0 NO_COMPU_METHOD 0 65535 MATRIX_DIM 12 1 1 SYMBOL_LINK "Rte_CalprmRom_CalRegn03Rt00GroupA_DEFAULT_RTE_CALPRM_GROUP.HysCmpFricWhlImbRejctnOnY_Ary1D" 0 DISPLAY_IDENTIFIER CalRegn03Rt00GroupA.CalibrationPorts.HysCmpFricWhlImbRejctnOnY.Ary1D /end CHARACTERISTIC
/begin CHARACTERISTIC CalRegn03Rt00GroupA.InertiaCmpVelAssiBasdDampgCoeffX.Ary1D "MICROSAR RTE" VAL_BLK 0x0 RTE_RL_UWORD 0 NO_COMPU_METHOD 0 65535 MATRIX_DIM 10 1 1 SYMBOL_LINK "Rte_CalprmRom_CalRegn03Rt00GroupA_DEFAULT_RTE_CALPRM_GROUP.InertiaCmpVelAssiBasdDampgCoeffX_Ary1D" 0 DISPLAY_IDENTIFIER CalRegn03Rt00GroupA.CalibrationPorts.InertiaCmpVelAssiBasdDampgCoeffX.Ary1D /end CHARACTERISTIC
/begin CHARACTERISTIC CalRegn03Rt00GroupA.InertiaCmpVelAssiBasdDampgRollgY.Ary1D "MICROSAR RTE" VAL_BLK 0x0 RTE_RL_UWORD 0 NO_COMPU_METHOD 0 65535 MATRIX_DIM 10 1 1 SYMBOL_LINK "Rte_CalprmRom_CalRegn03Rt00GroupA_DEFAULT_RTE_CALPRM_GROUP.InertiaCmpVelAssiBasdDampgRollgY_Ary1D" 0 DISPLAY_IDENTIFIER CalRegn03Rt00GroupA.CalibrationPorts.InertiaCmpVelAssiBasdDampgRollgY.Ary1D /end CHARACTERISTIC
/begin CHARACTERISTIC CalRegn03Rt00GroupA.InertiaCmpVelAssiBasdDampgStatY.Ary1D "MICROSAR RTE" VAL_BLK 0x0 RTE_RL_UWORD 0 NO_COMPU_METHOD 0 65535 MATRIX_DIM 10 1 1 SYMBOL_LINK "Rte_CalprmRom_CalRegn03Rt00GroupA_DEFAULT_RTE_CALPRM_GROUP.InertiaCmpVelAssiBasdDampgStatY_Ary1D" 0 DISPLAY_IDENTIFIER CalRegn03Rt00GroupA.CalibrationPorts.InertiaCmpVelAssiBasdDampgStatY.Ary1D /end CHARACTERISTIC
/begin CHARACTERISTIC CalRegn03Rt00GroupA.InertiaCmpVelDampgSpdBlndY.Ary1D "MICROSAR RTE" VAL_BLK 0x0 RTE_RL_UWORD 0 NO_COMPU_METHOD 0 65535 MATRIX_DIM 12 1 1 SYMBOL_LINK "Rte_CalprmRom_CalRegn03Rt00GroupA_DEFAULT_RTE_CALPRM_GROUP.InertiaCmpVelDampgSpdBlndY_Ary1D" 0 DISPLAY_IDENTIFIER CalRegn03Rt00GroupA.CalibrationPorts.InertiaCmpVelDampgSpdBlndY.Ary1D /end CHARACTERISTIC
/begin CHARACTERISTIC CalRegn03Rt00GroupA.InertiaCmpVelNotchBlndY.Ary1D "MICROSAR RTE" VAL_BLK 0x0 RTE_RL_UWORD 0 NO_COMPU_METHOD 0 65535 MATRIX_DIM 12 1 1 SYMBOL_LINK "Rte_CalprmRom_CalRegn03Rt00GroupA_DEFAULT_RTE_CALPRM_GROUP.InertiaCmpVelNotchBlndY_Ary1D" 0 DISPLAY_IDENTIFIER CalRegn03Rt00GroupA.CalibrationPorts.InertiaCmpVelNotchBlndY.Ary1D /end CHARACTERISTIC
/begin CHARACTERISTIC CalRegn03Rt00GroupA.RtnHwAgOffsCalcdX.Ary2D "MICROSAR RTE" VAL_BLK 0x0 RTE_RL_UWORD 0 NO_COMPU_METHOD 0 65535 MATRIX_DIM 16 9 1 SYMBOL_LINK "Rte_CalprmRom_CalRegn03Rt00GroupA_DEFAULT_RTE_CALPRM_GROUP.RtnHwAgOffsCalcdX_Ary2D" 0 DISPLAY_IDENTIFIER CalRegn03Rt00GroupA.CalibrationPorts.RtnHwAgOffsCalcdX.Ary2D /end CHARACTERISTIC
/begin CHARACTERISTIC CalRegn03Rt00GroupA.RtnHwAgOffsCalcdY.Ary2D "MICROSAR RTE" VAL_BLK 0x0 RTE_RL_UWORD 0 NO_COMPU_METHOD 0 65535 MATRIX_DIM 16 9 1 SYMBOL_LINK "Rte_CalprmRom_CalRegn03Rt00GroupA_DEFAULT_RTE_CALPRM_GROUP.RtnHwAgOffsCalcdY_Ary2D" 0 DISPLAY_IDENTIFIER CalRegn03Rt00GroupA.CalibrationPorts.RtnHwAgOffsCalcdY.Ary2D /end CHARACTERISTIC
/begin CHARACTERISTIC CalRegn03Rt00GroupA.RtnScaTqX.Ary2D "MICROSAR RTE" VAL_BLK 0x0 RTE_RL_UWORD 0 NO_COMPU_METHOD 0 65535 MATRIX_DIM 8 9 1 SYMBOL_LINK "Rte_CalprmRom_CalRegn03Rt00GroupA_DEFAULT_RTE_CALPRM_GROUP.RtnScaTqX_Ary2D" 0 DISPLAY_IDENTIFIER CalRegn03Rt00GroupA.CalibrationPorts.RtnScaTqX.Ary2D /end CHARACTERISTIC
/begin CHARACTERISTIC CalRegn03Rt00GroupA.RtnScaTqY.Ary2D "MICROSAR RTE" VAL_BLK 0x0 RTE_RL_UWORD 0 NO_COMPU_METHOD 0 65535 MATRIX_DIM 8 9 1 SYMBOL_LINK "Rte_CalprmRom_CalRegn03Rt00GroupA_DEFAULT_RTE_CALPRM_GROUP.RtnScaTqY_Ary2D" 0 DISPLAY_IDENTIFIER CalRegn03Rt00GroupA.CalibrationPorts.RtnScaTqY.Ary2D /end CHARACTERISTIC
/begin CHARACTERISTIC CalRegn03Rt00GroupA.RtnScaVelX.Ary2D "MICROSAR RTE" VAL_BLK 0x0 RTE_RL_UWORD 0 NO_COMPU_METHOD 0 65535 MATRIX_DIM 4 9 1 SYMBOL_LINK "Rte_CalprmRom_CalRegn03Rt00GroupA_DEFAULT_RTE_CALPRM_GROUP.RtnScaVelX_Ary2D" 0 DISPLAY_IDENTIFIER CalRegn03Rt00GroupA.CalibrationPorts.RtnScaVelX.Ary2D /end CHARACTERISTIC
/begin CHARACTERISTIC CalRegn03Rt00GroupA.RtnScaVelY.Ary2D "MICROSAR RTE" VAL_BLK 0x0 RTE_RL_UWORD 0 NO_COMPU_METHOD 0 65535 MATRIX_DIM 4 9 1 SYMBOL_LINK "Rte_CalprmRom_CalRegn03Rt00GroupA_DEFAULT_RTE_CALPRM_GROUP.RtnScaVelY_Ary2D" 0 DISPLAY_IDENTIFIER CalRegn03Rt00GroupA.CalibrationPorts.RtnScaVelY.Ary2D /end CHARACTERISTIC
/begin CHARACTERISTIC CalRegn03Rt00GroupB.AssiHiFrqTqWhlImbRejctnTqX.Ary2D "MICROSAR RTE" VAL_BLK 0x0 RTE_RL_UWORD 0 NO_COMPU_METHOD 0 65535 MATRIX_DIM 13 12 1 SYMBOL_LINK "Rte_CalprmRom_CalRegn03Rt00GroupB_DEFAULT_RTE_CALPRM_GROUP.AssiHiFrqTqWhlImbRejctnTqX_Ary2D" 0 DISPLAY_IDENTIFIER CalRegn03Rt00GroupB.CalibrationPorts.AssiHiFrqTqWhlImbRejctnTqX.Ary2D /end CHARACTERISTIC
/begin CHARACTERISTIC CalRegn03Rt00GroupB.AssiHiFrqWhlImbRejctnGainY.Ary2D "MICROSAR RTE" VAL_BLK 0x0 RTE_RL_UWORD 0 NO_COMPU_METHOD 0 65535 MATRIX_DIM 13 12 1 SYMBOL_LINK "Rte_CalprmRom_CalRegn03Rt00GroupB_DEFAULT_RTE_CALPRM_GROUP.AssiHiFrqWhlImbRejctnGainY_Ary2D" 0 DISPLAY_IDENTIFIER CalRegn03Rt00GroupB.CalibrationPorts.AssiHiFrqWhlImbRejctnGainY.Ary2D /end CHARACTERISTIC
/begin CHARACTERISTIC CalRegn03Rt00GroupB.AssiHiFrqWhlImbRejtcnBlndX.Ary2D "MICROSAR RTE" VAL_BLK 0x0 RTE_RL_UWORD 0 NO_COMPU_METHOD 0 65535 MATRIX_DIM 5 12 1 SYMBOL_LINK "Rte_CalprmRom_CalRegn03Rt00GroupB_DEFAULT_RTE_CALPRM_GROUP.AssiHiFrqWhlImbRejtcnBlndX_Ary2D" 0 DISPLAY_IDENTIFIER CalRegn03Rt00GroupB.CalibrationPorts.AssiHiFrqWhlImbRejtcnBlndX.Ary2D /end CHARACTERISTIC
/begin CHARACTERISTIC CalRegn03Rt00GroupB.AssiHiFrqWhlImbRejtcnBlndY.Ary2D "MICROSAR RTE" VAL_BLK 0x0 RTE_RL_UWORD 0 NO_COMPU_METHOD 0 65535 MATRIX_DIM 5 12 1 SYMBOL_LINK "Rte_CalprmRom_CalRegn03Rt00GroupB_DEFAULT_RTE_CALPRM_GROUP.AssiHiFrqWhlImbRejtcnBlndY_Ary2D" 0 DISPLAY_IDENTIFIER CalRegn03Rt00GroupB.CalibrationPorts.AssiHiFrqWhlImbRejtcnBlndY.Ary2D /end CHARACTERISTIC
/begin CHARACTERISTIC CalRegn03Rt00GroupB.AssiMotTqWhlImbRejctnMaxX.Ary2D "MICROSAR RTE" VAL_BLK 0x0 RTE_RL_UWORD 0 RTE_CM_Tq6 0 0 MATRIX_DIM 20 12 1 SYMBOL_LINK "Rte_CalprmRom_CalRegn03Rt00GroupB_DEFAULT_RTE_CALPRM_GROUP.AssiMotTqWhlImbRejctnMaxX_Ary2D" 0 DISPLAY_IDENTIFIER CalRegn03Rt00GroupB.CalibrationPorts.AssiMotTqWhlImbRejctnMaxX.Ary2D /end CHARACTERISTIC
/begin CHARACTERISTIC CalRegn03Rt00GroupB.AssiMotTqWhlImbRejctnMaxY.Ary2D "MICROSAR RTE" VAL_BLK 0x0 RTE_RL_SWORD 0 RTE_CM_Tq11 0 0 MATRIX_DIM 20 12 1 SYMBOL_LINK "Rte_CalprmRom_CalRegn03Rt00GroupB_DEFAULT_RTE_CALPRM_GROUP.AssiMotTqWhlImbRejctnMaxY_Ary2D" 0 DISPLAY_IDENTIFIER CalRegn03Rt00GroupB.CalibrationPorts.AssiMotTqWhlImbRejctnMaxY.Ary2D /end CHARACTERISTIC
/begin CHARACTERISTIC CalRegn03Rt00GroupB.AssiWhlImbRejctnBlndScaX.Ary2D "MICROSAR RTE" VAL_BLK 0x0 RTE_RL_UWORD 0 RTE_CM_Tq12 0 0 MATRIX_DIM 5 12 1 SYMBOL_LINK "Rte_CalprmRom_CalRegn03Rt00GroupB_DEFAULT_RTE_CALPRM_GROUP.AssiWhlImbRejctnBlndScaX_Ary2D" 0 DISPLAY_IDENTIFIER CalRegn03Rt00GroupB.CalibrationPorts.AssiWhlImbRejctnBlndScaX.Ary2D /end CHARACTERISTIC
/begin CHARACTERISTIC CalRegn03Rt00GroupB.AssiWhlImbRejctnBlndScaY.Ary2D "MICROSAR RTE" VAL_BLK 0x0 RTE_RL_UWORD 0 RTE_CM_Uls4 0 0 MATRIX_DIM 5 12 1 SYMBOL_LINK "Rte_CalprmRom_CalRegn03Rt00GroupB_DEFAULT_RTE_CALPRM_GROUP.AssiWhlImbRejctnBlndScaY_Ary2D" 0 DISPLAY_IDENTIFIER CalRegn03Rt00GroupB.CalibrationPorts.AssiWhlImbRejctnBlndScaY.Ary2D /end CHARACTERISTIC
/begin CHARACTERISTIC CalRegn03Rt00GroupB.EotProtnDampgVehSpdTbl.Ary1D "MICROSAR RTE" VAL_BLK 0x0 RTE_RL_UWORD 0 NO_COMPU_METHOD 0 65535 MATRIX_DIM 4 1 1 SYMBOL_LINK "Rte_CalprmRom_CalRegn03Rt00GroupB_DEFAULT_RTE_CALPRM_GROUP.EotProtnDampgVehSpdTbl_Ary1D" 0 DISPLAY_IDENTIFIER CalRegn03Rt00GroupB.CalibrationPorts.EotProtnDampgVehSpdTbl.Ary1D /end CHARACTERISTIC
/begin CHARACTERISTIC CalRegn03Rt00GroupB.EotProtnEntrGainVehSpdTbl.Ary1D "MICROSAR RTE" VAL_BLK 0x0 RTE_RL_UWORD 0 NO_COMPU_METHOD 0 65535 MATRIX_DIM 5 1 1 SYMBOL_LINK "Rte_CalprmRom_CalRegn03Rt00GroupB_DEFAULT_RTE_CALPRM_GROUP.EotProtnEntrGainVehSpdTbl_Ary1D" 0 DISPLAY_IDENTIFIER CalRegn03Rt00GroupB.CalibrationPorts.EotProtnEntrGainVehSpdTbl.Ary1D /end CHARACTERISTIC
/begin CHARACTERISTIC CalRegn03Rt00GroupB.EotProtnEntrGainX.Ary2D "MICROSAR RTE" VAL_BLK 0x0 RTE_RL_UWORD 0 NO_COMPU_METHOD 0 65535 MATRIX_DIM 4 5 1 SYMBOL_LINK "Rte_CalprmRom_CalRegn03Rt00GroupB_DEFAULT_RTE_CALPRM_GROUP.EotProtnEntrGainX_Ary2D" 0 DISPLAY_IDENTIFIER CalRegn03Rt00GroupB.CalibrationPorts.EotProtnEntrGainX.Ary2D /end CHARACTERISTIC
/begin CHARACTERISTIC CalRegn03Rt00GroupB.EotProtnEntrGainY.Ary2D "MICROSAR RTE" VAL_BLK 0x0 RTE_RL_UWORD 0 NO_COMPU_METHOD 0 65535 MATRIX_DIM 4 5 1 SYMBOL_LINK "Rte_CalprmRom_CalRegn03Rt00GroupB_DEFAULT_RTE_CALPRM_GROUP.EotProtnEntrGainY_Ary2D" 0 DISPLAY_IDENTIFIER CalRegn03Rt00GroupB.CalibrationPorts.EotProtnEntrGainY.Ary2D /end CHARACTERISTIC
/begin CHARACTERISTIC CalRegn03Rt00GroupB.EotProtnExitDampgY.Ary2D "MICROSAR RTE" VAL_BLK 0x0 RTE_RL_UWORD 0 NO_COMPU_METHOD 0 65535 MATRIX_DIM 2 4 1 SYMBOL_LINK "Rte_CalprmRom_CalRegn03Rt00GroupB_DEFAULT_RTE_CALPRM_GROUP.EotProtnExitDampgY_Ary2D" 0 DISPLAY_IDENTIFIER CalRegn03Rt00GroupB.CalibrationPorts.EotProtnExitDampgY.Ary2D /end CHARACTERISTIC
/begin CHARACTERISTIC CalRegn03Rt00GroupB.EotProtnHwDegDampgX.Ary2D "MICROSAR RTE" VAL_BLK 0x0 RTE_RL_UWORD 0 NO_COMPU_METHOD 0 65535 MATRIX_DIM 2 4 1 SYMBOL_LINK "Rte_CalprmRom_CalRegn03Rt00GroupB_DEFAULT_RTE_CALPRM_GROUP.EotProtnHwDegDampgX_Ary2D" 0 DISPLAY_IDENTIFIER CalRegn03Rt00GroupB.CalibrationPorts.EotProtnHwDegDampgX.Ary2D /end CHARACTERISTIC
/begin CHARACTERISTIC CalRegn03Rt00GroupB.EotProtnNormDampgY.Ary2D "MICROSAR RTE" VAL_BLK 0x0 RTE_RL_UWORD 0 NO_COMPU_METHOD 0 65535 MATRIX_DIM 2 4 1 SYMBOL_LINK "Rte_CalprmRom_CalRegn03Rt00GroupB_DEFAULT_RTE_CALPRM_GROUP.EotProtnNormDampgY_Ary2D" 0 DISPLAY_IDENTIFIER CalRegn03Rt00GroupB.CalibrationPorts.EotProtnNormDampgY.Ary2D /end CHARACTERISTIC
/begin CHARACTERISTIC CalRegn03Rt00GroupB.InertiaCmpVelAssiBasdDampgRollgWhlImbRejctnOnY.Ary1D "MICROSAR RTE" VAL_BLK 0x0 RTE_RL_UWORD 0 NO_COMPU_METHOD 0 65535 MATRIX_DIM 10 1 1 SYMBOL_LINK "Rte_CalprmRom_CalRegn03Rt00GroupB_DEFAULT_RTE_CALPRM_GROUP.InertiaCmpVelAssiBasdDampgRollgWhlImbRejctnOnY_Ary1D" 0 DISPLAY_IDENTIFIER CalRegn03Rt00GroupB.CalibrationPorts.InertiaCmpVelAssiBasdDampgRollgWhlImbRejctnOnY.Ary1D /end CHARACTERISTIC
/begin CHARACTERISTIC CalRegn03Rt01.InertiaCmpVelDampgFilFrq.Ary1D "MICROSAR RTE" VAL_BLK 0x0 RTE_RL_UWORD 0 NO_COMPU_METHOD 0 65535 MATRIX_DIM 12 1 1 SYMBOL_LINK "Rte_CalprmRom_CalRegn03Rt01_DEFAULT_RTE_CALPRM_GROUP.InertiaCmpVelDampgFilFrq_Ary1D" 0 DISPLAY_IDENTIFIER CalRegn03Rt01.CalibrationPorts.InertiaCmpVelDampgFilFrq.Ary1D /end CHARACTERISTIC
/begin CHARACTERISTIC CalRegn03Rt01.InertiaCmpVelDampgFilFrqWhlImbRejctnOn.Ary1D "MICROSAR RTE" VAL_BLK 0x0 RTE_RL_UWORD 0 NO_COMPU_METHOD 0 65535 MATRIX_DIM 12 1 1 SYMBOL_LINK "Rte_CalprmRom_CalRegn03Rt01_DEFAULT_RTE_CALPRM_GROUP.InertiaCmpVelDampgFilFrqWhlImbRejctnOn_Ary1D" 0 DISPLAY_IDENTIFIER CalRegn03Rt01.CalibrationPorts.InertiaCmpVelDampgFilFrqWhlImbRejctnOn.Ary1D /end CHARACTERISTIC
/begin CHARACTERISTIC CalRegn03Rt01GroupA.AssiHiFrqGainY.Ary2D "MICROSAR RTE" VAL_BLK 0x0 RTE_RL_UWORD 0 NO_COMPU_METHOD 0 65535 MATRIX_DIM 13 12 1 SYMBOL_LINK "Rte_CalprmRom_CalRegn03Rt01GroupA_DEFAULT_RTE_CALPRM_GROUP.AssiHiFrqGainY_Ary2D" 0 DISPLAY_IDENTIFIER CalRegn03Rt01GroupA.CalibrationPorts.AssiHiFrqGainY.Ary2D /end CHARACTERISTIC
/begin CHARACTERISTIC CalRegn03Rt01GroupA.AssiHiFrqTqX.Ary2D "MICROSAR RTE" VAL_BLK 0x0 RTE_RL_UWORD 0 NO_COMPU_METHOD 0 65535 MATRIX_DIM 13 12 1 SYMBOL_LINK "Rte_CalprmRom_CalRegn03Rt01GroupA_DEFAULT_RTE_CALPRM_GROUP.AssiHiFrqTqX_Ary2D" 0 DISPLAY_IDENTIFIER CalRegn03Rt01GroupA.CalibrationPorts.AssiHiFrqTqX.Ary2D /end CHARACTERISTIC
/begin CHARACTERISTIC CalRegn03Rt01GroupA.AssiMotTqWhlImbRejctnMinX.Ary2D "MICROSAR RTE" VAL_BLK 0x0 RTE_RL_UWORD 0 NO_COMPU_METHOD 0 65535 MATRIX_DIM 20 12 1 SYMBOL_LINK "Rte_CalprmRom_CalRegn03Rt01GroupA_DEFAULT_RTE_CALPRM_GROUP.AssiMotTqWhlImbRejctnMinX_Ary2D" 0 DISPLAY_IDENTIFIER CalRegn03Rt01GroupA.CalibrationPorts.AssiMotTqWhlImbRejctnMinX.Ary2D /end CHARACTERISTIC
/begin CHARACTERISTIC CalRegn03Rt01GroupA.AssiMotTqWhlImbRejctnMinY.Ary2D "MICROSAR RTE" VAL_BLK 0x0 RTE_RL_SWORD 0 NO_COMPU_METHOD -32768 32767 MATRIX_DIM 20 12 1 SYMBOL_LINK "Rte_CalprmRom_CalRegn03Rt01GroupA_DEFAULT_RTE_CALPRM_GROUP.AssiMotTqWhlImbRejctnMinY_Ary2D" 0 DISPLAY_IDENTIFIER CalRegn03Rt01GroupA.CalibrationPorts.AssiMotTqWhlImbRejctnMinY.Ary2D /end CHARACTERISTIC
/begin CHARACTERISTIC CalRegn03Rt01GroupA.DampgHydCoeff1ScaY.Ary1D "MICROSAR RTE" VAL_BLK 0x0 RTE_RL_UWORD 0 NO_COMPU_METHOD 0 65535 MATRIX_DIM 12 1 1 SYMBOL_LINK "Rte_CalprmRom_CalRegn03Rt01GroupA_DEFAULT_RTE_CALPRM_GROUP.DampgHydCoeff1ScaY_Ary1D" 0 DISPLAY_IDENTIFIER CalRegn03Rt01GroupA.CalibrationPorts.DampgHydCoeff1ScaY.Ary1D /end CHARACTERISTIC
/begin CHARACTERISTIC CalRegn03Rt01GroupA.DampgHydCoeff2ScaY.Ary1D "MICROSAR RTE" VAL_BLK 0x0 RTE_RL_UWORD 0 NO_COMPU_METHOD 0 65535 MATRIX_DIM 12 1 1 SYMBOL_LINK "Rte_CalprmRom_CalRegn03Rt01GroupA_DEFAULT_RTE_CALPRM_GROUP.DampgHydCoeff2ScaY_Ary1D" 0 DISPLAY_IDENTIFIER CalRegn03Rt01GroupA.CalibrationPorts.DampgHydCoeff2ScaY.Ary1D /end CHARACTERISTIC
/begin CHARACTERISTIC CalRegn03Rt01GroupA.DampgHydCoeff3ScaY.Ary1D "MICROSAR RTE" VAL_BLK 0x0 RTE_RL_UWORD 0 NO_COMPU_METHOD 0 65535 MATRIX_DIM 12 1 1 SYMBOL_LINK "Rte_CalprmRom_CalRegn03Rt01GroupA_DEFAULT_RTE_CALPRM_GROUP.DampgHydCoeff3ScaY_Ary1D" 0 DISPLAY_IDENTIFIER CalRegn03Rt01GroupA.CalibrationPorts.DampgHydCoeff3ScaY.Ary1D /end CHARACTERISTIC
/begin CHARACTERISTIC CalRegn03Rt01GroupA.DampgHydCoeff4ScaY.Ary1D "MICROSAR RTE" VAL_BLK 0x0 RTE_RL_UWORD 0 NO_COMPU_METHOD 0 65535 MATRIX_DIM 12 1 1 SYMBOL_LINK "Rte_CalprmRom_CalRegn03Rt01GroupA_DEFAULT_RTE_CALPRM_GROUP.DampgHydCoeff4ScaY_Ary1D" 0 DISPLAY_IDENTIFIER CalRegn03Rt01GroupA.CalibrationPorts.DampgHydCoeff4ScaY.Ary1D /end CHARACTERISTIC
/begin CHARACTERISTIC CalRegn03Rt01GroupA.DampgMotVelX.Ary2D "MICROSAR RTE" VAL_BLK 0x0 RTE_RL_UWORD 0 NO_COMPU_METHOD 0 65535 MATRIX_DIM 13 12 1 SYMBOL_LINK "Rte_CalprmRom_CalRegn03Rt01GroupA_DEFAULT_RTE_CALPRM_GROUP.DampgMotVelX_Ary2D" 0 DISPLAY_IDENTIFIER CalRegn03Rt01GroupA.CalibrationPorts.DampgMotVelX.Ary2D /end CHARACTERISTIC
/begin CHARACTERISTIC CalRegn03Rt01GroupA.DampgMotVelY.Ary2D "MICROSAR RTE" VAL_BLK 0x0 RTE_RL_UWORD 0 NO_COMPU_METHOD 0 65535 MATRIX_DIM 13 12 1 SYMBOL_LINK "Rte_CalprmRom_CalRegn03Rt01GroupA_DEFAULT_RTE_CALPRM_GROUP.DampgMotVelY_Ary2D" 0 DISPLAY_IDENTIFIER CalRegn03Rt01GroupA.CalibrationPorts.DampgMotVelY.Ary2D /end CHARACTERISTIC
/begin CHARACTERISTIC CalRegn03Rt01GroupA.HysCmpFricWhlImbRejctnBlndX.Ary1D "MICROSAR RTE" VAL_BLK 0x0 RTE_RL_UWORD 0 NO_COMPU_METHOD 0 65535 MATRIX_DIM 6 1 1 SYMBOL_LINK "Rte_CalprmRom_CalRegn03Rt01GroupA_DEFAULT_RTE_CALPRM_GROUP.HysCmpFricWhlImbRejctnBlndX_Ary1D" 0 DISPLAY_IDENTIFIER CalRegn03Rt01GroupA.CalibrationPorts.HysCmpFricWhlImbRejctnBlndX.Ary1D /end CHARACTERISTIC
/begin CHARACTERISTIC CalRegn03Rt01GroupA.HysCmpFricWhlImbRejctnBlndY.Ary1D "MICROSAR RTE" VAL_BLK 0x0 RTE_RL_UWORD 0 NO_COMPU_METHOD 0 65535 MATRIX_DIM 6 1 1 SYMBOL_LINK "Rte_CalprmRom_CalRegn03Rt01GroupA_DEFAULT_RTE_CALPRM_GROUP.HysCmpFricWhlImbRejctnBlndY_Ary1D" 0 DISPLAY_IDENTIFIER CalRegn03Rt01GroupA.CalibrationPorts.HysCmpFricWhlImbRejctnBlndY.Ary1D /end CHARACTERISTIC
/begin CHARACTERISTIC CalRegn03Rt01GroupA.HysCmpFricWhlImbRejctnOffY.Ary1D "MICROSAR RTE" VAL_BLK 0x0 RTE_RL_UWORD 0 NO_COMPU_METHOD 0 65535 MATRIX_DIM 12 1 1 SYMBOL_LINK "Rte_CalprmRom_CalRegn03Rt01GroupA_DEFAULT_RTE_CALPRM_GROUP.HysCmpFricWhlImbRejctnOffY_Ary1D" 0 DISPLAY_IDENTIFIER CalRegn03Rt01GroupA.CalibrationPorts.HysCmpFricWhlImbRejctnOffY.Ary1D /end CHARACTERISTIC
/begin CHARACTERISTIC CalRegn03Rt01GroupA.HysCmpFricWhlImbRejctnOnY.Ary1D "MICROSAR RTE" VAL_BLK 0x0 RTE_RL_UWORD 0 NO_COMPU_METHOD 0 65535 MATRIX_DIM 12 1 1 SYMBOL_LINK "Rte_CalprmRom_CalRegn03Rt01GroupA_DEFAULT_RTE_CALPRM_GROUP.HysCmpFricWhlImbRejctnOnY_Ary1D" 0 DISPLAY_IDENTIFIER CalRegn03Rt01GroupA.CalibrationPorts.HysCmpFricWhlImbRejctnOnY.Ary1D /end CHARACTERISTIC
/begin CHARACTERISTIC CalRegn03Rt01GroupA.InertiaCmpVelAssiBasdDampgCoeffX.Ary1D "MICROSAR RTE" VAL_BLK 0x0 RTE_RL_UWORD 0 NO_COMPU_METHOD 0 65535 MATRIX_DIM 10 1 1 SYMBOL_LINK "Rte_CalprmRom_CalRegn03Rt01GroupA_DEFAULT_RTE_CALPRM_GROUP.InertiaCmpVelAssiBasdDampgCoeffX_Ary1D" 0 DISPLAY_IDENTIFIER CalRegn03Rt01GroupA.CalibrationPorts.InertiaCmpVelAssiBasdDampgCoeffX.Ary1D /end CHARACTERISTIC
/begin CHARACTERISTIC CalRegn03Rt01GroupA.InertiaCmpVelAssiBasdDampgRollgY.Ary1D "MICROSAR RTE" VAL_BLK 0x0 RTE_RL_UWORD 0 NO_COMPU_METHOD 0 65535 MATRIX_DIM 10 1 1 SYMBOL_LINK "Rte_CalprmRom_CalRegn03Rt01GroupA_DEFAULT_RTE_CALPRM_GROUP.InertiaCmpVelAssiBasdDampgRollgY_Ary1D" 0 DISPLAY_IDENTIFIER CalRegn03Rt01GroupA.CalibrationPorts.InertiaCmpVelAssiBasdDampgRollgY.Ary1D /end CHARACTERISTIC
/begin CHARACTERISTIC CalRegn03Rt01GroupA.InertiaCmpVelAssiBasdDampgStatY.Ary1D "MICROSAR RTE" VAL_BLK 0x0 RTE_RL_UWORD 0 NO_COMPU_METHOD 0 65535 MATRIX_DIM 10 1 1 SYMBOL_LINK "Rte_CalprmRom_CalRegn03Rt01GroupA_DEFAULT_RTE_CALPRM_GROUP.InertiaCmpVelAssiBasdDampgStatY_Ary1D" 0 DISPLAY_IDENTIFIER CalRegn03Rt01GroupA.CalibrationPorts.InertiaCmpVelAssiBasdDampgStatY.Ary1D /end CHARACTERISTIC
/begin CHARACTERISTIC CalRegn03Rt01GroupA.InertiaCmpVelDampgSpdBlndY.Ary1D "MICROSAR RTE" VAL_BLK 0x0 RTE_RL_UWORD 0 NO_COMPU_METHOD 0 65535 MATRIX_DIM 12 1 1 SYMBOL_LINK "Rte_CalprmRom_CalRegn03Rt01GroupA_DEFAULT_RTE_CALPRM_GROUP.InertiaCmpVelDampgSpdBlndY_Ary1D" 0 DISPLAY_IDENTIFIER CalRegn03Rt01GroupA.CalibrationPorts.InertiaCmpVelDampgSpdBlndY.Ary1D /end CHARACTERISTIC
/begin CHARACTERISTIC CalRegn03Rt01GroupA.InertiaCmpVelNotchBlndY.Ary1D "MICROSAR RTE" VAL_BLK 0x0 RTE_RL_UWORD 0 NO_COMPU_METHOD 0 65535 MATRIX_DIM 12 1 1 SYMBOL_LINK "Rte_CalprmRom_CalRegn03Rt01GroupA_DEFAULT_RTE_CALPRM_GROUP.InertiaCmpVelNotchBlndY_Ary1D" 0 DISPLAY_IDENTIFIER CalRegn03Rt01GroupA.CalibrationPorts.InertiaCmpVelNotchBlndY.Ary1D /end CHARACTERISTIC
/begin CHARACTERISTIC CalRegn03Rt01GroupA.RtnHwAgOffsCalcdX.Ary2D "MICROSAR RTE" VAL_BLK 0x0 RTE_RL_UWORD 0 NO_COMPU_METHOD 0 65535 MATRIX_DIM 16 9 1 SYMBOL_LINK "Rte_CalprmRom_CalRegn03Rt01GroupA_DEFAULT_RTE_CALPRM_GROUP.RtnHwAgOffsCalcdX_Ary2D" 0 DISPLAY_IDENTIFIER CalRegn03Rt01GroupA.CalibrationPorts.RtnHwAgOffsCalcdX.Ary2D /end CHARACTERISTIC
/begin CHARACTERISTIC CalRegn03Rt01GroupA.RtnHwAgOffsCalcdY.Ary2D "MICROSAR RTE" VAL_BLK 0x0 RTE_RL_UWORD 0 NO_COMPU_METHOD 0 65535 MATRIX_DIM 16 9 1 SYMBOL_LINK "Rte_CalprmRom_CalRegn03Rt01GroupA_DEFAULT_RTE_CALPRM_GROUP.RtnHwAgOffsCalcdY_Ary2D" 0 DISPLAY_IDENTIFIER CalRegn03Rt01GroupA.CalibrationPorts.RtnHwAgOffsCalcdY.Ary2D /end CHARACTERISTIC
/begin CHARACTERISTIC CalRegn03Rt01GroupA.RtnScaTqX.Ary2D "MICROSAR RTE" VAL_BLK 0x0 RTE_RL_UWORD 0 NO_COMPU_METHOD 0 65535 MATRIX_DIM 8 9 1 SYMBOL_LINK "Rte_CalprmRom_CalRegn03Rt01GroupA_DEFAULT_RTE_CALPRM_GROUP.RtnScaTqX_Ary2D" 0 DISPLAY_IDENTIFIER CalRegn03Rt01GroupA.CalibrationPorts.RtnScaTqX.Ary2D /end CHARACTERISTIC
/begin CHARACTERISTIC CalRegn03Rt01GroupA.RtnScaTqY.Ary2D "MICROSAR RTE" VAL_BLK 0x0 RTE_RL_UWORD 0 NO_COMPU_METHOD 0 65535 MATRIX_DIM 8 9 1 SYMBOL_LINK "Rte_CalprmRom_CalRegn03Rt01GroupA_DEFAULT_RTE_CALPRM_GROUP.RtnScaTqY_Ary2D" 0 DISPLAY_IDENTIFIER CalRegn03Rt01GroupA.CalibrationPorts.RtnScaTqY.Ary2D /end CHARACTERISTIC
/begin CHARACTERISTIC CalRegn03Rt01GroupA.RtnScaVelX.Ary2D "MICROSAR RTE" VAL_BLK 0x0 RTE_RL_UWORD 0 NO_COMPU_METHOD 0 65535 MATRIX_DIM 4 9 1 SYMBOL_LINK "Rte_CalprmRom_CalRegn03Rt01GroupA_DEFAULT_RTE_CALPRM_GROUP.RtnScaVelX_Ary2D" 0 DISPLAY_IDENTIFIER CalRegn03Rt01GroupA.CalibrationPorts.RtnScaVelX.Ary2D /end CHARACTERISTIC
/begin CHARACTERISTIC CalRegn03Rt01GroupA.RtnScaVelY.Ary2D "MICROSAR RTE" VAL_BLK 0x0 RTE_RL_UWORD 0 NO_COMPU_METHOD 0 65535 MATRIX_DIM 4 9 1 SYMBOL_LINK "Rte_CalprmRom_CalRegn03Rt01GroupA_DEFAULT_RTE_CALPRM_GROUP.RtnScaVelY_Ary2D" 0 DISPLAY_IDENTIFIER CalRegn03Rt01GroupA.CalibrationPorts.RtnScaVelY.Ary2D /end CHARACTERISTIC
/begin CHARACTERISTIC CalRegn03Rt01GroupA_Dummy.AssiHiFrqGainY.Ary2D "MICROSAR RTE" VAL_BLK 0x0 RTE_RL_UWORD 0 NO_COMPU_METHOD 0 65535 MATRIX_DIM 13 12 1 SYMBOL_LINK "Rte_CalprmRom_CalRegn03Rt01GroupA_DEFAULT_RTE_CALPRM_GROUP.AssiHiFrqGainY_Ary2D" 0 DISPLAY_IDENTIFIER CalRegn03Rt01GroupA_Dummy.CalibrationPorts.AssiHiFrqGainY.Ary2D /end CHARACTERISTIC
/begin CHARACTERISTIC CalRegn03Rt01GroupA_Dummy.AssiHiFrqTqX.Ary2D "MICROSAR RTE" VAL_BLK 0x0 RTE_RL_UWORD 0 NO_COMPU_METHOD 0 65535 MATRIX_DIM 13 12 1 SYMBOL_LINK "Rte_CalprmRom_CalRegn03Rt01GroupA_DEFAULT_RTE_CALPRM_GROUP.AssiHiFrqTqX_Ary2D" 0 DISPLAY_IDENTIFIER CalRegn03Rt01GroupA_Dummy.CalibrationPorts.AssiHiFrqTqX.Ary2D /end CHARACTERISTIC
/begin CHARACTERISTIC CalRegn03Rt01GroupA_Dummy.AssiMotTqWhlImbRejctnMinX.Ary2D "MICROSAR RTE" VAL_BLK 0x0 RTE_RL_UWORD 0 NO_COMPU_METHOD 0 65535 MATRIX_DIM 20 12 1 SYMBOL_LINK "Rte_CalprmRom_CalRegn03Rt01GroupA_DEFAULT_RTE_CALPRM_GROUP.AssiMotTqWhlImbRejctnMinX_Ary2D" 0 DISPLAY_IDENTIFIER CalRegn03Rt01GroupA_Dummy.CalibrationPorts.AssiMotTqWhlImbRejctnMinX.Ary2D /end CHARACTERISTIC
/begin CHARACTERISTIC CalRegn03Rt01GroupA_Dummy.AssiMotTqWhlImbRejctnMinY.Ary2D "MICROSAR RTE" VAL_BLK 0x0 RTE_RL_SWORD 0 NO_COMPU_METHOD -32768 32767 MATRIX_DIM 20 12 1 SYMBOL_LINK "Rte_CalprmRom_CalRegn03Rt01GroupA_DEFAULT_RTE_CALPRM_GROUP.AssiMotTqWhlImbRejctnMinY_Ary2D" 0 DISPLAY_IDENTIFIER CalRegn03Rt01GroupA_Dummy.CalibrationPorts.AssiMotTqWhlImbRejctnMinY.Ary2D /end CHARACTERISTIC
/begin CHARACTERISTIC CalRegn03Rt01GroupA_Dummy.DampgHydCoeff1ScaY.Ary1D "MICROSAR RTE" VAL_BLK 0x0 RTE_RL_UWORD 0 NO_COMPU_METHOD 0 65535 MATRIX_DIM 12 1 1 SYMBOL_LINK "Rte_CalprmRom_CalRegn03Rt01GroupA_DEFAULT_RTE_CALPRM_GROUP.DampgHydCoeff1ScaY_Ary1D" 0 DISPLAY_IDENTIFIER CalRegn03Rt01GroupA_Dummy.CalibrationPorts.DampgHydCoeff1ScaY.Ary1D /end CHARACTERISTIC
/begin CHARACTERISTIC CalRegn03Rt01GroupA_Dummy.DampgHydCoeff2ScaY.Ary1D "MICROSAR RTE" VAL_BLK 0x0 RTE_RL_UWORD 0 NO_COMPU_METHOD 0 65535 MATRIX_DIM 12 1 1 SYMBOL_LINK "Rte_CalprmRom_CalRegn03Rt01GroupA_DEFAULT_RTE_CALPRM_GROUP.DampgHydCoeff2ScaY_Ary1D" 0 DISPLAY_IDENTIFIER CalRegn03Rt01GroupA_Dummy.CalibrationPorts.DampgHydCoeff2ScaY.Ary1D /end CHARACTERISTIC
/begin GROUP CalRegn03CmnGroupB.PullCmpActvLongTermLim.Val "MICROSAR RTE" /begin SUB_GROUP /end SUB_GROUP /begin FUNCTION_LIST /end FUNCTION_LIST /begin REF_CHARACTERISTIC CalRegn03CmnGroupB.PullCmpActvLongTermLim.Val /end REF_CHARACTERISTIC /begin REF_MEASUREMENT /end REF_MEASUREMENT /end GROUP
/begin GROUP CalRegn03CmnGroupB.PullCmpActvLrngEnaAgConfMinMgn.Val "MICROSAR RTE" /begin SUB_GROUP /end SUB_GROUP /begin FUNCTION_LIST /end FUNCTION_LIST /begin REF_CHARACTERISTIC CalRegn03CmnGroupB.PullCmpActvLrngEnaAgConfMinMgn.Val /end REF_CHARACTERISTIC /begin REF_MEASUREMENT /end REF_MEASUREMENT /end GROUP
/begin GROUP CalRegn03CmnGroupB.PullCmpActvLrngEnaHwAgMaxMgn.Val "MICROSAR RTE" /begin SUB_GROUP /end SUB_GROUP /begin FUNCTION_LIST /end FUNCTION_LIST /begin REF_CHARACTERISTIC CalRegn03CmnGroupB.PullCmpActvLrngEnaHwAgMaxMgn.Val /end REF_CHARACTERISTIC /begin REF_MEASUREMENT /end REF_MEASUREMENT /end GROUP
/begin GROUP CalRegn03CmnGroupB.PullCmpActvLrngEnaHwTqMaxMgn.Val "MICROSAR RTE" /begin SUB_GROUP /end SUB_GROUP /begin FUNCTION_LIST /end FUNCTION_LIST /begin REF_CHARACTERISTIC CalRegn03CmnGroupB.PullCmpActvLrngEnaHwTqMaxMgn.Val /end REF_CHARACTERISTIC /begin REF_MEASUREMENT /end REF_MEASUREMENT /end GROUP
/begin GROUP CalRegn03CmnGroupB.PullCmpActvLrngEnaHwVelMaxMgn.Val "MICROSAR RTE" /begin SUB_GROUP /end SUB_GROUP /begin FUNCTION_LIST /end FUNCTION_LIST /begin REF_CHARACTERISTIC CalRegn03CmnGroupB.PullCmpActvLrngEnaHwVelMaxMgn.Val /end REF_CHARACTERISTIC /begin REF_MEASUREMENT /end REF_MEASUREMENT /end GROUP
/begin GROUP CalRegn03CmnGroupB.PullCmpActvLrngEnaLatAMaxMgn.Val "MICROSAR RTE" /begin SUB_GROUP /end SUB_GROUP /begin FUNCTION_LIST /end FUNCTION_LIST /begin REF_CHARACTERISTIC CalRegn03CmnGroupB.PullCmpActvLrngEnaLatAMaxMgn.Val /end REF_CHARACTERISTIC /begin REF_MEASUREMENT /end REF_MEASUREMENT /end GROUP
/begin GROUP CalRegn03CmnGroupB.PullCmpActvLrngEnaTiThd.Val "MICROSAR RTE" /begin SUB_GROUP /end SUB_GROUP /begin FUNCTION_LIST /end FUNCTION_LIST /begin REF_CHARACTERISTIC CalRegn03CmnGroupB.PullCmpActvLrngEnaTiThd.Val /end REF_CHARACTERISTIC /begin REF_MEASUREMENT /end REF_MEASUREMENT /end GROUP
/begin GROUP CalRegn03CmnGroupB.PullCmpActvLrngEnaVehSpdMaxMgn.Val "MICROSAR RTE" /begin SUB_GROUP /end SUB_GROUP /begin FUNCTION_LIST /end FUNCTION_LIST /begin REF_CHARACTERISTIC CalRegn03CmnGroupB.PullCmpActvLrngEnaVehSpdMaxMgn.Val /end REF_CHARACTERISTIC /begin REF_MEASUREMENT /end REF_MEASUREMENT /end GROUP
/begin GROUP CalRegn03CmnGroupB.PullCmpActvLrngEnaVehSpdMinMgn.Val "MICROSAR RTE" /begin SUB_GROUP /end SUB_GROUP /begin FUNCTION_LIST /end FUNCTION_LIST /begin REF_CHARACTERISTIC CalRegn03CmnGroupB.PullCmpActvLrngEnaVehSpdMinMgn.Val /end REF_CHARACTERISTIC /begin REF_MEASUREMENT /end REF_MEASUREMENT /end GROUP
/begin GROUP CalRegn03CmnGroupB.PullCmpActvLrngEnaVehSpdRateMaxMgn.Val "MICROSAR RTE" /begin SUB_GROUP /end SUB_GROUP /begin FUNCTION_LIST /end FUNCTION_LIST /begin REF_CHARACTERISTIC CalRegn03CmnGroupB.PullCmpActvLrngEnaVehSpdRateMaxMgn.Val /end REF_CHARACTERISTIC /begin REF_MEASUREMENT /end REF_MEASUREMENT /end GROUP
/begin GROUP CalRegn03CmnGroupB.PullCmpActvLrngEnaYawRateMaxMgn.Val "MICROSAR RTE" /begin SUB_GROUP /end SUB_GROUP /begin FUNCTION_LIST /end FUNCTION_LIST /begin REF_CHARACTERISTIC CalRegn03CmnGroupB.PullCmpActvLrngEnaYawRateMaxMgn.Val /end REF_CHARACTERISTIC /begin REF_MEASUREMENT /end REF_MEASUREMENT /end GROUP
/begin GROUP CalRegn03CmnGroupB.PullCmpActvOpstSignTiShoTerm.Val "MICROSAR RTE" /begin SUB_GROUP /end SUB_GROUP /begin FUNCTION_LIST /end FUNCTION_LIST /begin REF_CHARACTERISTIC CalRegn03CmnGroupB.PullCmpActvOpstSignTiShoTerm.Val /end REF_CHARACTERISTIC /begin REF_MEASUREMENT /end REF_MEASUREMENT /end GROUP
/begin GROUP CalRegn03CmnGroupB.PullCmpActvOutpMaxRate.Val "MICROSAR RTE" /begin SUB_GROUP /end SUB_GROUP /begin FUNCTION_LIST /end FUNCTION_LIST /begin REF_CHARACTERISTIC CalRegn03CmnGroupB.PullCmpActvOutpMaxRate.Val /end REF_CHARACTERISTIC /begin REF_MEASUREMENT /end REF_MEASUREMENT /end GROUP
/begin GROUP CalRegn03CmnGroupB.PullCmpActvPullCmpShoTermLim.Val "MICROSAR RTE" /begin SUB_GROUP /end SUB_GROUP /begin FUNCTION_LIST /end FUNCTION_LIST /begin REF_CHARACTERISTIC CalRegn03CmnGroupB.PullCmpActvPullCmpShoTermLim.Val /end REF_CHARACTERISTIC /begin REF_MEASUREMENT /end REF_MEASUREMENT /end GROUP
/begin GROUP CalRegn03CmnGroupB.PullCmpActvPullCmpTotLim.Val "MICROSAR RTE" /begin SUB_GROUP /end SUB_GROUP /begin FUNCTION_LIST /end FUNCTION_LIST /begin REF_CHARACTERISTIC CalRegn03CmnGroupB.PullCmpActvPullCmpTotLim.Val /end REF_CHARACTERISTIC /begin REF_MEASUREMENT /end REF_MEASUREMENT /end GROUP
/begin GROUP CalRegn03CmnGroupB.PullCmpActvPullErrLimLongTerm.Val "MICROSAR RTE" /begin SUB_GROUP /end SUB_GROUP /begin FUNCTION_LIST /end FUNCTION_LIST /begin REF_CHARACTERISTIC CalRegn03CmnGroupB.PullCmpActvPullErrLimLongTerm.Val /end REF_CHARACTERISTIC /begin REF_MEASUREMENT /end REF_MEASUREMENT /end GROUP
/begin GROUP CalRegn03CmnGroupB.PullCmpActvPullErrMgnThd.Val "MICROSAR RTE" /begin SUB_GROUP /end SUB_GROUP /begin FUNCTION_LIST /end FUNCTION_LIST /begin REF_CHARACTERISTIC CalRegn03CmnGroupB.PullCmpActvPullErrMgnThd.Val /end REF_CHARACTERISTIC /begin REF_MEASUREMENT /end REF_MEASUREMENT /end GROUP
/begin GROUP CalRegn03CmnGroupB.PullCmpActvPullErrShoTermLim.Val "MICROSAR RTE" /begin SUB_GROUP /end SUB_GROUP /begin FUNCTION_LIST /end FUNCTION_LIST /begin REF_CHARACTERISTIC CalRegn03CmnGroupB.PullCmpActvPullErrShoTermLim.Val /end REF_CHARACTERISTIC /begin REF_MEASUREMENT /end REF_MEASUREMENT /end GROUP
/begin GROUP CalRegn03CmnGroupB.PullCmpActvShoTermRampTi.Val "MICROSAR RTE" /begin SUB_GROUP /end SUB_GROUP /begin FUNCTION_LIST /end FUNCTION_LIST /begin REF_CHARACTERISTIC CalRegn03CmnGroupB.PullCmpActvShoTermRampTi.Val /end REF_CHARACTERISTIC /begin REF_MEASUREMENT /end REF_MEASUREMENT /end GROUP
/begin GROUP CalRegn03CmnGroupB.PullCmpActvVehSpdScaTblX.Ary1D "MICROSAR RTE" /begin SUB_GROUP /end SUB_GROUP /begin FUNCTION_LIST /end FUNCTION_LIST /begin REF_CHARACTERISTIC CalRegn03CmnGroupB.PullCmpActvVehSpdScaTblX.Ary1D /end REF_CHARACTERISTIC /begin REF_MEASUREMENT /end REF_MEASUREMENT /end GROUP
/begin GROUP CalRegn03CmnGroupB.PullCmpActvVehSpdScaTblY.Ary1D "MICROSAR RTE" /begin SUB_GROUP /end SUB_GROUP /begin FUNCTION_LIST /end FUNCTION_LIST /begin REF_CHARACTERISTIC CalRegn03CmnGroupB.PullCmpActvVehSpdScaTblY.Ary1D /end REF_CHARACTERISTIC /begin REF_MEASUREMENT /end REF_MEASUREMENT /end GROUP
/begin GROUP CalRegn03CmnGroupB.WhlImbRejctnAutScaEna.Logl "MICROSAR RTE" /begin SUB_GROUP /end SUB_GROUP /begin FUNCTION_LIST /end FUNCTION_LIST /begin REF_CHARACTERISTIC CalRegn03CmnGroupB.WhlImbRejctnAutScaEna.Logl /end REF_CHARACTERISTIC /begin REF_MEASUREMENT /end REF_MEASUREMENT /end GROUP
/begin GROUP CalRegn03CmnGroupB.WhlImbRejctnAutScaTar.Val "MICROSAR RTE" /begin SUB_GROUP /end SUB_GROUP /begin FUNCTION_LIST /end FUNCTION_LIST /begin REF_CHARACTERISTIC CalRegn03CmnGroupB.WhlImbRejctnAutScaTar.Val /end REF_CHARACTERISTIC /begin REF_MEASUREMENT /end REF_MEASUREMENT /end GROUP
/begin GROUP CalRegn03CmnGroupB.WhlImbRejctnRampDwnTi.Val "MICROSAR RTE" /begin SUB_GROUP /end SUB_GROUP /begin FUNCTION_LIST /end FUNCTION_LIST /begin REF_CHARACTERISTIC CalRegn03CmnGroupB.WhlImbRejctnRampDwnTi.Val /end REF_CHARACTERISTIC /begin REF_MEASUREMENT /end REF_MEASUREMENT /end GROUP
/begin GROUP CalRegn03CmnGroupB.WhlImbRejctnScaCncl.Val "MICROSAR RTE" /begin SUB_GROUP /end SUB_GROUP /begin FUNCTION_LIST /end FUNCTION_LIST /begin REF_CHARACTERISTIC CalRegn03CmnGroupB.WhlImbRejctnScaCncl.Val /end REF_CHARACTERISTIC /begin REF_MEASUREMENT /end REF_MEASUREMENT /end GROUP
/begin GROUP CalRegn03CmnGroupB.WhlImbRejctnUgrPoleMgn.Val "MICROSAR RTE" /begin SUB_GROUP /end SUB_GROUP /begin FUNCTION_LIST /end FUNCTION_LIST /begin REF_CHARACTERISTIC CalRegn03CmnGroupB.WhlImbRejctnUgrPoleMgn.Val /end REF_CHARACTERISTIC /begin REF_MEASUREMENT /end REF_MEASUREMENT /end GROUP
/begin GROUP CalRegn03CmnGroupB.WhlImbRejctnVehSpdEna.Val "MICROSAR RTE" /begin SUB_GROUP /end SUB_GROUP /begin FUNCTION_LIST /end FUNCTION_LIST /begin REF_CHARACTERISTIC CalRegn03CmnGroupB.WhlImbRejctnVehSpdEna.Val /end REF_CHARACTERISTIC /begin REF_MEASUREMENT /end REF_MEASUREMENT /end GROUP
/begin GROUP CalRegn03CmnGroupC "MICROSAR RTE" /begin SUB_GROUP CalRegn03CmnGroupC.CalibrationPorts /end SUB_GROUP /begin FUNCTION_LIST /end FUNCTION_LIST /begin REF_CHARACTERISTIC /end REF_CHARACTERISTIC /begin REF_MEASUREMENT /end REF_MEASUREMENT /end GROUP
/begin GROUP CalRegn03CmnGroupC.CalibrationPorts "MICROSAR RTE"
 /begin SUB_GROUP CalRegn03CmnGroupC.GmOvrlStMgrLoaMtgtnHaptcFbOffTi.Val CalRegn03CmnGroupC.GmOvrlStMgrLoaMtgtnHaptcFbOnTi.Val CalRegn03CmnGroupC.GmOvrlStMgrLoaMtgtnHaptcFbTqMax.Val CalRegn03CmnGroupC.GmOvrlStMgrLoaMtgtnHaptcFbTqMin.Val CalRegn03CmnGroupC.GmOvrlStMgrLoaMtgtnHaptcFbVehSpdMax.Val CalRegn03CmnGroupC.GmOvrlStMgrLoaMtgtnHaptcFbVehSpdMin.Val CalRegn03CmnGroupC.GmOvrlStMgrLoaMtgtnHaptcFrq.Val CalRegn03CmnGroupC.GmOvrlStMgrLoaMtgtnTqOscnAmpY.Ary1D CalRegn03CmnGroupC.GmOvrlStMgrLoaMtgtnVehSpdX.Ary1D /end SUB_GROUP
 /begin FUNCTION_LIST /end FUNCTION_LIST
 /begin REF_CHARACTERISTIC /end REF_CHARACTERISTIC
 /begin REF_MEASUREMENT /end REF_MEASUREMENT
/end GROUP
/begin GROUP CalRegn03CmnGroupC.GmOvrlStMgrLoaMtgtnHaptcFbOffTi.Val "MICROSAR RTE" /begin SUB_GROUP /end SUB_GROUP /begin FUNCTION_LIST /end FUNCTION_LIST /begin REF_CHARACTERISTIC CalRegn03CmnGroupC.GmOvrlStMgrLoaMtgtnHaptcFbOffTi.Val /end REF_CHARACTERISTIC /begin REF_MEASUREMENT /end REF_MEASUREMENT /end GROUP
/begin GROUP CalRegn03CmnGroupC.GmOvrlStMgrLoaMtgtnHaptcFbOnTi.Val "MICROSAR RTE" /begin SUB_GROUP /end SUB_GROUP /begin FUNCTION_LIST /end FUNCTION_LIST /begin REF_CHARACTERISTIC CalRegn03CmnGroupC.GmOvrlStMgrLoaMtgtnHaptcFbOnTi.Val /end REF_CHARACTERISTIC /begin REF_MEASUREMENT /end REF_MEASUREMENT /end GROUP
/begin GROUP CalRegn03CmnGroupC.GmOvrlStMgrLoaMtgtnHaptcFbTqMax.Val "MICROSAR RTE" /begin SUB_GROUP /end SUB_GROUP /begin FUNCTION_LIST /end FUNCTION_LIST /begin REF_CHARACTERISTIC CalRegn03CmnGroupC.GmOvrlStMgrLoaMtgtnHaptcFbTqMax.Val /end REF_CHARACTERISTIC /begin REF_MEASUREMENT /end REF_MEASUREMENT /end GROUP
/begin GROUP CalRegn03CmnGroupC.GmOvrlStMgrLoaMtgtnHaptcFbTqMin.Val "MICROSAR RTE" /begin SUB_GROUP /end SUB_GROUP /begin FUNCTION_LIST /end FUNCTION_LIST /begin REF_CHARACTERISTIC CalRegn03CmnGroupC.GmOvrlStMgrLoaMtgtnHaptcFbTqMin.Val /end REF_CHARACTERISTIC /begin REF_MEASUREMENT /end REF_MEASUREMENT /end GROUP
/begin GROUP CalRegn03CmnGroupC.GmOvrlStMgrLoaMtgtnHaptcFbVehSpdMax.Val "MICROSAR RTE" /begin SUB_GROUP /end SUB_GROUP /begin FUNCTION_LIST /end FUNCTION_LIST /begin REF_CHARACTERISTIC CalRegn03CmnGroupC.GmOvrlStMgrLoaMtgtnHaptcFbVehSpdMax.Val /end REF_CHARACTERISTIC /begin REF_MEASUREMENT /end REF_MEASUREMENT /end GROUP
/begin GROUP CalRegn03CmnGroupC.GmOvrlStMgrLoaMtgtnHaptcFbVehSpdMin.Val "MICROSAR RTE" /begin SUB_GROUP /end SUB_GROUP /begin FUNCTION_LIST /end FUNCTION_LIST /begin REF_CHARACTERISTIC CalRegn03CmnGroupC.GmOvrlStMgrLoaMtgtnHaptcFbVehSpdMin.Val /end REF_CHARACTERISTIC /begin REF_MEASUREMENT /end REF_MEASUREMENT /end GROUP
/begin GROUP CalRegn03CmnGroupC.GmOvrlStMgrLoaMtgtnHaptcFrq.Val "MICROSAR RTE" /begin SUB_GROUP /end SUB_GROUP /begin FUNCTION_LIST /end FUNCTION_LIST /begin REF_CHARACTERISTIC CalRegn03CmnGroupC.GmOvrlStMgrLoaMtgtnHaptcFrq.Val /end REF_CHARACTERISTIC /begin REF_MEASUREMENT /end REF_MEASUREMENT /end GROUP
/begin GROUP CalRegn03CmnGroupC.GmOvrlStMgrLoaMtgtnTqOscnAmpY.Ary1D "MICROSAR RTE" /begin SUB_GROUP /end SUB_GROUP /begin FUNCTION_LIST /end FUNCTION_LIST /begin REF_CHARACTERISTIC CalRegn03CmnGroupC.GmOvrlStMgrLoaMtgtnTqOscnAmpY.Ary1D /end REF_CHARACTERISTIC /begin REF_MEASUREMENT /end REF_MEASUREMENT /end GROUP
/begin GROUP CalRegn03CmnGroupC.GmOvrlStMgrLoaMtgtnVehSpdX.Ary1D "MICROSAR RTE" /begin SUB_GROUP /end SUB_GROUP /begin FUNCTION_LIST /end FUNCTION_LIST /begin REF_CHARACTERISTIC CalRegn03CmnGroupC.GmOvrlStMgrLoaMtgtnVehSpdX.Ary1D /end REF_CHARACTERISTIC /begin REF_MEASUREMENT /end REF_MEASUREMENT /end GROUP
/begin GROUP CalRegn03Inin00 "MICROSAR RTE" /begin SUB_GROUP CalRegn03Inin00.CalibrationPorts /end SUB_GROUP /begin FUNCTION_LIST /end FUNCTION_LIST /begin REF_CHARACTERISTIC /end REF_CHARACTERISTIC /begin REF_MEASUREMENT /end REF_MEASUREMENT /end GROUP
/begin GROUP CalRegn03Inin00.CalibrationPorts "MICROSAR RTE"
 /begin SUB_GROUP CalRegn03Inin00.DampgHydAssiLim.Ary1D CalRegn03Inin00.DampgHydBasCoeff1.Val CalRegn03Inin00.DampgHydBasCoeff2.Val CalRegn03Inin00.DampgHydBasCoeff3.Val CalRegn03Inin00.DampgHydBasCoeff4.Val CalRegn03Inin00.DampgHydOutpLim.Val CalRegn03Inin00.DampgMotVelLpFilFrq.Val CalRegn03Inin00.DampgQuad13Mplr.Val CalRegn03Inin00.DampgQuad24Mplr.Val CalRegn03Inin00.DampgQuadHwTqLpFilFrq.Val CalRegn03Inin00.DampgQuadMotVelLpFilFrq.Val CalRegn03Inin00.DampgQuadScaLpFilFrq.Val CalRegn03Inin00.EotLrngAuthyStrtLrn.Val CalRegn03Inin00.EotLrngEotLrnTmr.Val CalRegn03Inin00.EotLrngHwTqEotLrn.Val CalRegn03Inin00.EotLrngMotVelEotLrn.Val CalRegn03Inin00.EotLrngRackTrvlMax.Val CalRegn03Inin00.EotLrngRackTrvlMin.Val CalRegn03Inin00.EotLrngRstAuthyMin.Val CalRegn03Inin00.EotProtnDftPosn.Val CalRegn03Inin00.EotProtnEntrStLpFilFrq.Val CalRegn03Inin00.EotProtnExitStLpFilFrq.Val CalRegn03Inin00.EotProtnHwAgMax.Val CalRegn03Inin00.EotProtnHwAgMin.Val CalRegn03Inin00.EotProtnHwTqLpFilFrq.Val CalRegn03Inin00.EotProtnMotSpdIncptSca.Val CalRegn03Inin00.EotProtnMotSpdIncptX.Ary1D CalRegn03Inin00.EotProtnPosnRampStep.Val CalRegn03Inin00.EotProtnRackTrvlLimrAuthyThd.Val CalRegn03Inin00.EotProtnRackTrvlLimrAuthyThdLimd.Val CalRegn03Inin00.EotProtnRackTrvlLimrEna.Logl CalRegn03Inin00.EotProtnRunEotVelImpctAndSoftEndStop.Logl CalRegn03Inin00.EotProtnSoftEndStopEna.Logl CalRegn03Inin00.GmOvrlStMgrLoaMtgtnHaptcFbStrtOnTi.Val CalRegn03Inin00.GmOvrlStMgrLoaMtgtnStrtHaptcAmp.Val CalRegn03Inin00.GmOvrlStMgrLoaStIgnCntrThd.Val CalRegn03Inin00.HwAgTrakgServoDftlTermLpFilFrq.Val CalRegn03Inin00.HwAgTrakgServoHwAgLpFilFrq.Val CalRegn03Inin00.HwAgTrakgServoHwTqLpFilFrq.Val CalRegn03Inin00.HwAgTrakgServoSmotngY.Ary1D CalRegn03Inin00.HysCmpAssiCmdLpFilFrq.Val CalRegn03Inin00.HysCmpFinalOutpLpFilFrq.Val CalRegn03Inin00.HysCmpHwTqLpFilFrq.Val CalRegn03Inin00.InertiaCmpVelMotInertia.Val CalRegn03Inin00.InertiaCmpVelNotchFilStruct.Rec CalRegn03Inin00.InertiaCmpVelTqSnsrVelFilFrq.Val CalRegn03Inin00.PullCmpActvYawRateFilFrq.Val CalRegn03Inin00.PwrpkCmpbltyChkGearId.Val CalRegn03Inin00.RtnHwAuthyScaX.Ary1D CalRegn03Inin00.RtnHwAuthyScaY.Ary1D CalRegn03Inin00.RtnHwAuthySlew.Val CalRegn03Inin00.RtnOffsRng.Val CalRegn03Inin00.RtnOffsSlew.Val CalRegn03Inin00.StabyCmpAssiScaBlndX.Ary1D CalRegn03Inin00.StabyCmpAssiScaBlndY.Ary1D CalRegn03Inin00.StabyCmpHwTqLpFilFrq.Val CalRegn03Inin00.StabyCmpNotchFil1Struct.Rec CalRegn03Inin00.StabyCmpNotchFil2Struct.Rec CalRegn03Inin00.StabyCmpNotchFil3Struct.Rec CalRegn03Inin00.StabyCmpNotchFil4Struct.Rec CalRegn03Inin00.StabyCmpNotchFilBlnd04Y.Ary2D CalRegn03Inin00.StabyCmpNotchFilBlnd34TqX.Ary2D CalRegn03Inin00.StabyCmpNotchFilBlnd34Y.Ary2D CalRegn03Inin00.SysGlbPrmSysKineRat.Val CalRegn03Inin00.SysGlbPrmSysTqRat.Val CalRegn03Inin00.WhlImbRejctnBlndCmdMgnLp1FilFrq.Val CalRegn03Inin00.WhlImbRejctnBlndCmdMgnLp2FilFrq.Val CalRegn03Inin00.WhlImbRejctnDistbnMgnLpFil.Val CalRegn03Inin00.WhlImbRejctnWhlSpdLpFil.Val /end SUB_GROUP
 /begin FUNCTION_LIST /end FUNCTION_LIST
 /begin REF_CHARACTERISTIC /end REF_CHARACTERISTIC
 /begin REF_MEASUREMENT /end REF_MEASUREMENT
/end GROUP
/begin GROUP CalRegn03Inin00.DampgHydAssiLim.Ary1D "MICROSAR RTE" /begin SUB_GROUP /end SUB_GROUP /begin FUNCTION_LIST /end FUNCTION_LIST /begin REF_CHARACTERISTIC CalRegn03Inin00.DampgHydAssiLim.Ary1D /end REF_CHARACTERISTIC /begin REF_MEASUREMENT /end REF_MEASUREMENT /end GROUP
/begin GROUP CalRegn03Inin00.DampgHydBasCoeff1.Val "MICROSAR RTE" /begin SUB_GROUP /end SUB_GROUP /begin FUNCTION_LIST /end FUNCTION_LIST /begin REF_CHARACTERISTIC CalRegn03Inin00.DampgHydBasCoeff1.Val /end REF_CHARACTERISTIC /begin REF_MEASUREMENT /end REF_MEASUREMENT /end GROUP
/begin GROUP CalRegn03Inin00.DampgHydBasCoeff2.Val "MICROSAR RTE" /begin SUB_GROUP /end SUB_GROUP /begin FUNCTION_LIST /end FUNCTION_LIST /begin REF_CHARACTERISTIC CalRegn03Inin00.DampgHydBasCoeff2.Val /end REF_CHARACTERISTIC /begin REF_MEASUREMENT /end REF_MEASUREMENT /end GROUP
/begin GROUP CalRegn03Inin00.DampgHydBasCoeff3.Val "MICROSAR RTE" /begin SUB_GROUP /end SUB_GROUP /begin FUNCTION_LIST /end FUNCTION_LIST /begin REF_CHARACTERISTIC CalRegn03Inin00.DampgHydBasCoeff3.Val /end REF_CHARACTERISTIC /begin REF_MEASUREMENT /end REF_MEASUREMENT /end GROUP
/begin GROUP CalRegn03Inin00.DampgHydBasCoeff4.Val "MICROSAR RTE" /begin SUB_GROUP /end SUB_GROUP /begin FUNCTION_LIST /end FUNCTION_LIST /begin REF_CHARACTERISTIC CalRegn03Inin00.DampgHydBasCoeff4.Val /end REF_CHARACTERISTIC /begin REF_MEASUREMENT /end REF_MEASUREMENT /end GROUP
/begin GROUP CalRegn03Inin00.DampgHydOutpLim.Val "MICROSAR RTE" /begin SUB_GROUP /end SUB_GROUP /begin FUNCTION_LIST /end FUNCTION_LIST /begin REF_CHARACTERISTIC CalRegn03Inin00.DampgHydOutpLim.Val /end REF_CHARACTERISTIC /begin REF_MEASUREMENT /end REF_MEASUREMENT /end GROUP
/begin GROUP CalRegn03Inin00.DampgMotVelLpFilFrq.Val "MICROSAR RTE" /begin SUB_GROUP /end SUB_GROUP /begin FUNCTION_LIST /end FUNCTION_LIST /begin REF_CHARACTERISTIC CalRegn03Inin00.DampgMotVelLpFilFrq.Val /end REF_CHARACTERISTIC /begin REF_MEASUREMENT /end REF_MEASUREMENT /end GROUP
/begin GROUP CalRegn03Inin00.DampgQuad13Mplr.Val "MICROSAR RTE" /begin SUB_GROUP /end SUB_GROUP /begin FUNCTION_LIST /end FUNCTION_LIST /begin REF_CHARACTERISTIC CalRegn03Inin00.DampgQuad13Mplr.Val /end REF_CHARACTERISTIC /begin REF_MEASUREMENT /end REF_MEASUREMENT /end GROUP
/begin GROUP CalRegn03Inin00.DampgQuad24Mplr.Val "MICROSAR RTE" /begin SUB_GROUP /end SUB_GROUP /begin FUNCTION_LIST /end FUNCTION_LIST /begin REF_CHARACTERISTIC CalRegn03Inin00.DampgQuad24Mplr.Val /end REF_CHARACTERISTIC /begin REF_MEASUREMENT /end REF_MEASUREMENT /end GROUP
/begin GROUP CalRegn03Inin00.DampgQuadHwTqLpFilFrq.Val "MICROSAR RTE" /begin SUB_GROUP /end SUB_GROUP /begin FUNCTION_LIST /end FUNCTION_LIST /begin REF_CHARACTERISTIC CalRegn03Inin00.DampgQuadHwTqLpFilFrq.Val /end REF_CHARACTERISTIC /begin REF_MEASUREMENT /end REF_MEASUREMENT /end GROUP
/begin GROUP CalRegn03Inin00.DampgQuadMotVelLpFilFrq.Val "MICROSAR RTE" /begin SUB_GROUP /end SUB_GROUP /begin FUNCTION_LIST /end FUNCTION_LIST /begin REF_CHARACTERISTIC CalRegn03Inin00.DampgQuadMotVelLpFilFrq.Val /end REF_CHARACTERISTIC /begin REF_MEASUREMENT /end REF_MEASUREMENT /end GROUP
/begin GROUP CalRegn03Inin00.DampgQuadScaLpFilFrq.Val "MICROSAR RTE" /begin SUB_GROUP /end SUB_GROUP /begin FUNCTION_LIST /end FUNCTION_LIST /begin REF_CHARACTERISTIC CalRegn03Inin00.DampgQuadScaLpFilFrq.Val /end REF_CHARACTERISTIC /begin REF_MEASUREMENT /end REF_MEASUREMENT /end GROUP
/begin GROUP CalRegn03Inin00.EotLrngAuthyStrtLrn.Val "MICROSAR RTE" /begin SUB_GROUP /end SUB_GROUP /begin FUNCTION_LIST /end FUNCTION_LIST /begin REF_CHARACTERISTIC CalRegn03Inin00.EotLrngAuthyStrtLrn.Val /end REF_CHARACTERISTIC /begin REF_MEASUREMENT /end REF_MEASUREMENT /end GROUP
/begin GROUP CalRegn03Inin00.EotLrngEotLrnTmr.Val "MICROSAR RTE" /begin SUB_GROUP /end SUB_GROUP /begin FUNCTION_LIST /end FUNCTION_LIST /begin REF_CHARACTERISTIC CalRegn03Inin00.EotLrngEotLrnTmr.Val /end REF_CHARACTERISTIC /begin REF_MEASUREMENT /end REF_MEASUREMENT /end GROUP
/begin GROUP CalRegn03Inin00.EotLrngHwTqEotLrn.Val "MICROSAR RTE" /begin SUB_GROUP /end SUB_GROUP /begin FUNCTION_LIST /end FUNCTION_LIST /begin REF_CHARACTERISTIC CalRegn03Inin00.EotLrngHwTqEotLrn.Val /end REF_CHARACTERISTIC /begin REF_MEASUREMENT /end REF_MEASUREMENT /end GROUP
/begin GROUP CalRegn03Inin00.EotLrngMotVelEotLrn.Val "MICROSAR RTE" /begin SUB_GROUP /end SUB_GROUP /begin FUNCTION_LIST /end FUNCTION_LIST /begin REF_CHARACTERISTIC CalRegn03Inin00.EotLrngMotVelEotLrn.Val /end REF_CHARACTERISTIC /begin REF_MEASUREMENT /end REF_MEASUREMENT /end GROUP
/begin GROUP CalRegn03Inin00.EotLrngRackTrvlMax.Val "MICROSAR RTE" /begin SUB_GROUP /end SUB_GROUP /begin FUNCTION_LIST /end FUNCTION_LIST /begin REF_CHARACTERISTIC CalRegn03Inin00.EotLrngRackTrvlMax.Val /end REF_CHARACTERISTIC /begin REF_MEASUREMENT /end REF_MEASUREMENT /end GROUP
/begin GROUP CalRegn03Inin00.EotLrngRackTrvlMin.Val "MICROSAR RTE" /begin SUB_GROUP /end SUB_GROUP /begin FUNCTION_LIST /end FUNCTION_LIST /begin REF_CHARACTERISTIC CalRegn03Inin00.EotLrngRackTrvlMin.Val /end REF_CHARACTERISTIC /begin REF_MEASUREMENT /end REF_MEASUREMENT /end GROUP
/begin GROUP CalRegn03Inin00.EotLrngRstAuthyMin.Val "MICROSAR RTE" /begin SUB_GROUP /end SUB_GROUP /begin FUNCTION_LIST /end FUNCTION_LIST /begin REF_CHARACTERISTIC CalRegn03Inin00.EotLrngRstAuthyMin.Val /end REF_CHARACTERISTIC /begin REF_MEASUREMENT /end REF_MEASUREMENT /end GROUP
/begin GROUP CalRegn03Inin00.EotProtnDftPosn.Val "MICROSAR RTE" /begin SUB_GROUP /end SUB_GROUP /begin FUNCTION_LIST /end FUNCTION_LIST /begin REF_CHARACTERISTIC CalRegn03Inin00.EotProtnDftPosn.Val /end REF_CHARACTERISTIC /begin REF_MEASUREMENT /end REF_MEASUREMENT /end GROUP
/begin GROUP CalRegn03Inin00.EotProtnEntrStLpFilFrq.Val "MICROSAR RTE" /begin SUB_GROUP /end SUB_GROUP /begin FUNCTION_LIST /end FUNCTION_LIST /begin REF_CHARACTERISTIC CalRegn03Inin00.EotProtnEntrStLpFilFrq.Val /end REF_CHARACTERISTIC /begin REF_MEASUREMENT /end REF_MEASUREMENT /end GROUP
/begin GROUP CalRegn03Inin00.EotProtnExitStLpFilFrq.Val "MICROSAR RTE" /begin SUB_GROUP /end SUB_GROUP /begin FUNCTION_LIST /end FUNCTION_LIST /begin REF_CHARACTERISTIC CalRegn03Inin00.EotProtnExitStLpFilFrq.Val /end REF_CHARACTERISTIC /begin REF_MEASUREMENT /end REF_MEASUREMENT /end GROUP
/begin GROUP CalRegn03Inin00.EotProtnHwAgMax.Val "MICROSAR RTE" /begin SUB_GROUP /end SUB_GROUP /begin FUNCTION_LIST /end FUNCTION_LIST /begin REF_CHARACTERISTIC CalRegn03Inin00.EotProtnHwAgMax.Val /end REF_CHARACTERISTIC /begin REF_MEASUREMENT /end REF_MEASUREMENT /end GROUP
/begin GROUP CalRegn03Inin00.EotProtnHwAgMin.Val "MICROSAR RTE" /begin SUB_GROUP /end SUB_GROUP /begin FUNCTION_LIST /end FUNCTION_LIST /begin REF_CHARACTERISTIC CalRegn03Inin00.EotProtnHwAgMin.Val /end REF_CHARACTERISTIC /begin REF_MEASUREMENT /end REF_MEASUREMENT /end GROUP
/begin GROUP CalRegn03Inin00.EotProtnHwTqLpFilFrq.Val "MICROSAR RTE" /begin SUB_GROUP /end SUB_GROUP /begin FUNCTION_LIST /end FUNCTION_LIST /begin REF_CHARACTERISTIC CalRegn03Inin00.EotProtnHwTqLpFilFrq.Val /end REF_CHARACTERISTIC /begin REF_MEASUREMENT /end REF_MEASUREMENT /end GROUP
/begin GROUP CalRegn03Inin00.EotProtnMotSpdIncptSca.Val "MICROSAR RTE" /begin SUB_GROUP /end SUB_GROUP /begin FUNCTION_LIST /end FUNCTION_LIST /begin REF_CHARACTERISTIC CalRegn03Inin00.EotProtnMotSpdIncptSca.Val /end REF_CHARACTERISTIC /begin REF_MEASUREMENT /end REF_MEASUREMENT /end GROUP
/begin GROUP CalRegn03Inin00.EotProtnMotSpdIncptX.Ary1D "MICROSAR RTE" /begin SUB_GROUP /end SUB_GROUP /begin FUNCTION_LIST /end FUNCTION_LIST /begin REF_CHARACTERISTIC CalRegn03Inin00.EotProtnMotSpdIncptX.Ary1D /end REF_CHARACTERISTIC /begin REF_MEASUREMENT /end REF_MEASUREMENT /end GROUP
/begin GROUP CalRegn03Inin00.EotProtnPosnRampStep.Val "MICROSAR RTE" /begin SUB_GROUP /end SUB_GROUP /begin FUNCTION_LIST /end FUNCTION_LIST /begin REF_CHARACTERISTIC CalRegn03Inin00.EotProtnPosnRampStep.Val /end REF_CHARACTERISTIC /begin REF_MEASUREMENT /end REF_MEASUREMENT /end GROUP
/begin GROUP CalRegn03Inin00.EotProtnRackTrvlLimrAuthyThd.Val "MICROSAR RTE" /begin SUB_GROUP /end SUB_GROUP /begin FUNCTION_LIST /end FUNCTION_LIST /begin REF_CHARACTERISTIC CalRegn03Inin00.EotProtnRackTrvlLimrAuthyThd.Val /end REF_CHARACTERISTIC /begin REF_MEASUREMENT /end REF_MEASUREMENT /end GROUP
/begin GROUP CalRegn03Inin00.EotProtnRackTrvlLimrAuthyThdLimd.Val "MICROSAR RTE" /begin SUB_GROUP /end SUB_GROUP /begin FUNCTION_LIST /end FUNCTION_LIST /begin REF_CHARACTERISTIC CalRegn03Inin00.EotProtnRackTrvlLimrAuthyThdLimd.Val /end REF_CHARACTERISTIC /begin REF_MEASUREMENT /end REF_MEASUREMENT /end GROUP
/begin GROUP CalRegn03Inin00.EotProtnRackTrvlLimrEna.Logl "MICROSAR RTE" /begin SUB_GROUP /end SUB_GROUP /begin FUNCTION_LIST /end FUNCTION_LIST /begin REF_CHARACTERISTIC CalRegn03Inin00.EotProtnRackTrvlLimrEna.Logl /end REF_CHARACTERISTIC /begin REF_MEASUREMENT /end REF_MEASUREMENT /end GROUP
/begin GROUP CalRegn03Inin00.EotProtnRunEotVelImpctAndSoftEndStop.Logl "MICROSAR RTE" /begin SUB_GROUP /end SUB_GROUP /begin FUNCTION_LIST /end FUNCTION_LIST /begin REF_CHARACTERISTIC CalRegn03Inin00.EotProtnRunEotVelImpctAndSoftEndStop.Logl /end REF_CHARACTERISTIC /begin REF_MEASUREMENT /end REF_MEASUREMENT /end GROUP
/begin GROUP CalRegn03Inin00.EotProtnSoftEndStopEna.Logl "MICROSAR RTE" /begin SUB_GROUP /end SUB_GROUP /begin FUNCTION_LIST /end FUNCTION_LIST /begin REF_CHARACTERISTIC CalRegn03Inin00.EotProtnSoftEndStopEna.Logl /end REF_CHARACTERISTIC /begin REF_MEASUREMENT /end REF_MEASUREMENT /end GROUP
/begin GROUP CalRegn03Inin00.GmOvrlStMgrLoaMtgtnHaptcFbStrtOnTi.Val "MICROSAR RTE" /begin SUB_GROUP /end SUB_GROUP /begin FUNCTION_LIST /end FUNCTION_LIST /begin REF_CHARACTERISTIC CalRegn03Inin00.GmOvrlStMgrLoaMtgtnHaptcFbStrtOnTi.Val /end REF_CHARACTERISTIC /begin REF_MEASUREMENT /end REF_MEASUREMENT /end GROUP
/begin GROUP CalRegn03Inin00.GmOvrlStMgrLoaMtgtnStrtHaptcAmp.Val "MICROSAR RTE" /begin SUB_GROUP /end SUB_GROUP /begin FUNCTION_LIST /end FUNCTION_LIST /begin REF_CHARACTERISTIC CalRegn03Inin00.GmOvrlStMgrLoaMtgtnStrtHaptcAmp.Val /end REF_CHARACTERISTIC /begin REF_MEASUREMENT /end REF_MEASUREMENT /end GROUP
/begin GROUP CalRegn03Inin00.GmOvrlStMgrLoaStIgnCntrThd.Val "MICROSAR RTE" /begin SUB_GROUP /end SUB_GROUP /begin FUNCTION_LIST /end FUNCTION_LIST /begin REF_CHARACTERISTIC CalRegn03Inin00.GmOvrlStMgrLoaStIgnCntrThd.Val /end REF_CHARACTERISTIC /begin REF_MEASUREMENT /end REF_MEASUREMENT /end GROUP
/begin GROUP CalRegn03Inin00.HwAgTrakgServoDftlTermLpFilFrq.Val "MICROSAR RTE" /begin SUB_GROUP /end SUB_GROUP /begin FUNCTION_LIST /end FUNCTION_LIST /begin REF_CHARACTERISTIC CalRegn03Inin00.HwAgTrakgServoDftlTermLpFilFrq.Val /end REF_CHARACTERISTIC /begin REF_MEASUREMENT /end REF_MEASUREMENT /end GROUP
/begin GROUP CalRegn03Inin00.HwAgTrakgServoHwAgLpFilFrq.Val "MICROSAR RTE" /begin SUB_GROUP /end SUB_GROUP /begin FUNCTION_LIST /end FUNCTION_LIST /begin REF_CHARACTERISTIC CalRegn03Inin00.HwAgTrakgServoHwAgLpFilFrq.Val /end REF_CHARACTERISTIC /begin REF_MEASUREMENT /end REF_MEASUREMENT /end GROUP
/begin GROUP CalRegn03Inin00.HwAgTrakgServoHwTqLpFilFrq.Val "MICROSAR RTE" /begin SUB_GROUP /end SUB_GROUP /begin FUNCTION_LIST /end FUNCTION_LIST /begin REF_CHARACTERISTIC CalRegn03Inin00.HwAgTrakgServoHwTqLpFilFrq.Val /end REF_CHARACTERISTIC /begin REF_MEASUREMENT /end REF_MEASUREMENT /end GROUP
/begin GROUP CalRegn03Inin00.HwAgTrakgServoSmotngY.Ary1D "MICROSAR RTE" /begin SUB_GROUP /end SUB_GROUP /begin FUNCTION_LIST /end FUNCTION_LIST /begin REF_CHARACTERISTIC CalRegn03Inin00.HwAgTrakgServoSmotngY.Ary1D /end REF_CHARACTERISTIC /begin REF_MEASUREMENT /end REF_MEASUREMENT /end GROUP
/begin GROUP CalRegn03Inin00.HysCmpAssiCmdLpFilFrq.Val "MICROSAR RTE" /begin SUB_GROUP /end SUB_GROUP /begin FUNCTION_LIST /end FUNCTION_LIST /begin REF_CHARACTERISTIC CalRegn03Inin00.HysCmpAssiCmdLpFilFrq.Val /end REF_CHARACTERISTIC /begin REF_MEASUREMENT /end REF_MEASUREMENT /end GROUP
/begin GROUP CalRegn03Inin00.HysCmpFinalOutpLpFilFrq.Val "MICROSAR RTE" /begin SUB_GROUP /end SUB_GROUP /begin FUNCTION_LIST /end FUNCTION_LIST /begin REF_CHARACTERISTIC CalRegn03Inin00.HysCmpFinalOutpLpFilFrq.Val /end REF_CHARACTERISTIC /begin REF_MEASUREMENT /end REF_MEASUREMENT /end GROUP
/begin GROUP CalRegn03Inin00.HysCmpHwTqLpFilFrq.Val "MICROSAR RTE" /begin SUB_GROUP /end SUB_GROUP /begin FUNCTION_LIST /end FUNCTION_LIST /begin REF_CHARACTERISTIC CalRegn03Inin00.HysCmpHwTqLpFilFrq.Val /end REF_CHARACTERISTIC /begin REF_MEASUREMENT /end REF_MEASUREMENT /end GROUP
/begin GROUP CalRegn03Inin00.InertiaCmpVelMotInertia.Val "MICROSAR RTE" /begin SUB_GROUP /end SUB_GROUP /begin FUNCTION_LIST /end FUNCTION_LIST /begin REF_CHARACTERISTIC CalRegn03Inin00.InertiaCmpVelMotInertia.Val /end REF_CHARACTERISTIC /begin REF_MEASUREMENT /end REF_MEASUREMENT /end GROUP
/begin GROUP CalRegn03Inin00.InertiaCmpVelNotchFilStruct.Rec "MICROSAR RTE" /begin SUB_GROUP /end SUB_GROUP /begin FUNCTION_LIST /end FUNCTION_LIST
 /begin REF_CHARACTERISTIC CalRegn03Inin00.InertiaCmpVelNotchFilStruct.Rec.FilGainA1 CalRegn03Inin00.InertiaCmpVelNotchFilStruct.Rec.FilGainA2 CalRegn03Inin00.InertiaCmpVelNotchFilStruct.Rec.FilGainB0 CalRegn03Inin00.InertiaCmpVelNotchFilStruct.Rec.FilGainB1 CalRegn03Inin00.InertiaCmpVelNotchFilStruct.Rec.FilGainB2 /end REF_CHARACTERISTIC
 /begin REF_MEASUREMENT /end REF_MEASUREMENT
/end GROUP
/begin GROUP CalRegn03Inin00.InertiaCmpVelTqSnsrVelFilFrq.Val "MICROSAR RTE" /begin SUB_GROUP /end SUB_GROUP /begin FUNCTION_LIST /end FUNCTION_LIST /begin REF_CHARACTERISTIC CalRegn03Inin00.InertiaCmpVelTqSnsrVelFilFrq.Val /end REF_CHARACTERISTIC /begin REF_MEASUREMENT /end REF_MEASUREMENT /end GROUP
/begin GROUP CalRegn03Inin00.PullCmpActvYawRateFilFrq.Val "MICROSAR RTE" /begin SUB_GROUP /end SUB_GROUP /begin FUNCTION_LIST /end FUNCTION_LIST /begin REF_CHARACTERISTIC CalRegn03Inin00.PullCmpActvYawRateFilFrq.Val /end REF_CHARACTERISTIC /begin REF_MEASUREMENT /end REF_MEASUREMENT /end GROUP
/begin GROUP CalRegn03Inin00.PwrpkCmpbltyChkGearId.Val "MICROSAR RTE" /begin SUB_GROUP /end SUB_GROUP /begin FUNCTION_LIST /end FUNCTION_LIST /begin REF_CHARACTERISTIC CalRegn03Inin00.PwrpkCmpbltyChkGearId.Val /end REF_CHARACTERISTIC /begin REF_MEASUREMENT /end REF_MEASUREMENT /end GROUP
/begin GROUP CalRegn03Inin00.RtnHwAuthyScaX.Ary1D "MICROSAR RTE" /begin SUB_GROUP /end SUB_GROUP /begin FUNCTION_LIST /end FUNCTION_LIST /begin REF_CHARACTERISTIC CalRegn03Inin00.RtnHwAuthyScaX.Ary1D /end REF_CHARACTERISTIC /begin REF_MEASUREMENT /end REF_MEASUREMENT /end GROUP
/begin GROUP CalRegn03Inin00.RtnHwAuthyScaY.Ary1D "MICROSAR RTE" /begin SUB_GROUP /end SUB_GROUP /begin FUNCTION_LIST /end FUNCTION_LIST /begin REF_CHARACTERISTIC CalRegn03Inin00.RtnHwAuthyScaY.Ary1D /end REF_CHARACTERISTIC /begin REF_MEASUREMENT /end REF_MEASUREMENT /end GROUP
/begin GROUP CalRegn03Inin00.RtnHwAuthySlew.Val "MICROSAR RTE" /begin SUB_GROUP /end SUB_GROUP /begin FUNCTION_LIST /end FUNCTION_LIST /begin REF_CHARACTERISTIC CalRegn03Inin00.RtnHwAuthySlew.Val /end REF_CHARACTERISTIC /begin REF_MEASUREMENT /end REF_MEASUREMENT /end GROUP
/begin GROUP CalRegn03Inin00.RtnOffsRng.Val "MICROSAR RTE" /begin SUB_GROUP /end SUB_GROUP /begin FUNCTION_LIST /end FUNCTION_LIST /begin REF_CHARACTERISTIC CalRegn03Inin00.RtnOffsRng.Val /end REF_CHARACTERISTIC /begin REF_MEASUREMENT /end REF_MEASUREMENT /end GROUP
/begin GROUP CalRegn03Inin00.RtnOffsSlew.Val "MICROSAR RTE" /begin SUB_GROUP /end SUB_GROUP /begin FUNCTION_LIST /end FUNCTION_LIST /begin REF_CHARACTERISTIC CalRegn03Inin00.RtnOffsSlew.Val /end REF_CHARACTERISTIC /begin REF_MEASUREMENT /end REF_MEASUREMENT /end GROUP
/begin GROUP CalRegn03Inin00.StabyCmpAssiScaBlndX.Ary1D "MICROSAR RTE" /begin SUB_GROUP /end SUB_GROUP /begin FUNCTION_LIST /end FUNCTION_LIST /begin REF_CHARACTERISTIC CalRegn03Inin00.StabyCmpAssiScaBlndX.Ary1D /end REF_CHARACTERISTIC /begin REF_MEASUREMENT /end REF_MEASUREMENT /end GROUP
/begin GROUP CalRegn03Inin00.StabyCmpAssiScaBlndY.Ary1D "MICROSAR RTE" /begin SUB_GROUP /end SUB_GROUP /begin FUNCTION_LIST /end FUNCTION_LIST /begin REF_CHARACTERISTIC CalRegn03Inin00.StabyCmpAssiScaBlndY.Ary1D /end REF_CHARACTERISTIC /begin REF_MEASUREMENT /end REF_MEASUREMENT /end GROUP
/begin GROUP CalRegn03Inin00.StabyCmpHwTqLpFilFrq.Val "MICROSAR RTE" /begin SUB_GROUP /end SUB_GROUP /begin FUNCTION_LIST /end FUNCTION_LIST /begin REF_CHARACTERISTIC CalRegn03Inin00.StabyCmpHwTqLpFilFrq.Val /end REF_CHARACTERISTIC /begin REF_MEASUREMENT /end REF_MEASUREMENT /end GROUP
/begin GROUP CalRegn03Inin00.StabyCmpNotchFil1Struct.Rec "MICROSAR RTE" /begin SUB_GROUP /end SUB_GROUP /begin FUNCTION_LIST /end FUNCTION_LIST
 /begin REF_CHARACTERISTIC CalRegn03Inin00.StabyCmpNotchFil1Struct.Rec.FilGainA1 CalRegn03Inin00.StabyCmpNotchFil1Struct.Rec.FilGainA2 CalRegn03Inin00.StabyCmpNotchFil1Struct.Rec.FilGainB0 CalRegn03Inin00.StabyCmpNotchFil1Struct.Rec.FilGainB1 CalRegn03Inin00.StabyCmpNotchFil1Struct.Rec.FilGainB2 /end REF_CHARACTERISTIC
 /begin REF_MEASUREMENT /end REF_MEASUREMENT
/end GROUP
/begin GROUP CalRegn03Inin00.StabyCmpNotchFil2Struct.Rec "MICROSAR RTE" /begin SUB_GROUP /end SUB_GROUP /begin FUNCTION_LIST /end FUNCTION_LIST
 /begin REF_CHARACTERISTIC CalRegn03Inin00.StabyCmpNotchFil2Struct.Rec.FilGainA1 CalRegn03Inin00.StabyCmpNotchFil2Struct.Rec.FilGainA2 CalRegn03Inin00.StabyCmpNotchFil2Struct.Rec.FilGainB0 CalRegn03Inin00.StabyCmpNotchFil2Struct.Rec.FilGainB1 CalRegn03Inin00.StabyCmpNotchFil2Struct.Rec.FilGainB2 /end REF_CHARACTERISTIC
 /begin REF_MEASUREMENT /end REF_MEASUREMENT
/end GROUP
/begin GROUP CalRegn03Inin00.StabyCmpNotchFil3Struct.Rec "MICROSAR RTE" /begin SUB_GROUP /end SUB_GROUP /begin FUNCTION_LIST /end FUNCTION_LIST
 /begin REF_CHARACTERISTIC CalRegn03Inin00.StabyCmpNotchFil3Struct.Rec.FilGainA1 CalRegn03Inin00.StabyCmpNotchFil3Struct.Rec.FilGainA2 CalRegn03Inin00.StabyCmpNotchFil3Struct.Rec.FilGainB0 CalRegn03Inin00.StabyCmpNotchFil3Struct.Rec.FilGainB1 CalRegn03Inin00.StabyCmpNotchFil3Struct.Rec.FilGainB2 /end REF_CHARACTERISTIC
 /begin REF_MEASUREMENT /end REF_MEASUREMENT
/end GROUP
/begin GROUP CalRegn03Inin00.StabyCmpNotchFil4Struct.Rec "MICROSAR RTE" /begin SUB_GROUP /end SUB_GROUP /begin FUNCTION_LIST /end FUNCTION_LIST
 /begin REF_CHARACTERISTIC CalRegn03Inin00.StabyCmpNotchFil4Struct.Rec.FilGainA1 CalRegn03Inin00.StabyCmpNotchFil4Struct.Rec.FilGainA2 CalRegn03Inin00.StabyCmpNotchFil4Struct.Rec.FilGainB0 CalRegn03Inin00.StabyCmpNotchFil4Struct.Rec.FilGainB1 CalRegn03Inin00.StabyCmpNotchFil4Struct.Rec.FilGainB2 /end REF_CHARACTERISTIC
 /begin REF_MEASUREMENT /end REF_MEASUREMENT
/end GROUP
/begin GROUP CalRegn03Inin00.StabyCmpNotchFilBlnd04Y.Ary2D "MICROSAR RTE" /begin SUB_GROUP /end SUB_GROUP /begin FUNCTION_LIST /end FUNCTION_LIST /begin REF_CHARACTERISTIC CalRegn03Inin00.StabyCmpNotchFilBlnd04Y.Ary2D /end REF_CHARACTERISTIC /begin REF_MEASUREMENT /end REF_MEASUREMENT /end GROUP
/begin GROUP CalRegn03Inin00.StabyCmpNotchFilBlnd34TqX.Ary2D "MICROSAR RTE" /begin SUB_GROUP /end SUB_GROUP /begin FUNCTION_LIST /end FUNCTION_LIST /begin REF_CHARACTERISTIC CalRegn03Inin00.StabyCmpNotchFilBlnd34TqX.Ary2D /end REF_CHARACTERISTIC /begin REF_MEASUREMENT /end REF_MEASUREMENT /end GROUP
/begin GROUP CalRegn03Inin00.StabyCmpNotchFilBlnd34Y.Ary2D "MICROSAR RTE" /begin SUB_GROUP /end SUB_GROUP /begin FUNCTION_LIST /end FUNCTION_LIST /begin REF_CHARACTERISTIC CalRegn03Inin00.StabyCmpNotchFilBlnd34Y.Ary2D /end REF_CHARACTERISTIC /begin REF_MEASUREMENT /end REF_MEASUREMENT /end GROUP
/begin GROUP CalRegn03Inin00.SysGlbPrmSysKineRat.Val "MICROSAR RTE" /begin SUB_GROUP /end SUB_GROUP /begin FUNCTION_LIST /end FUNCTION_LIST /begin REF_CHARACTERISTIC CalRegn03Inin00.SysGlbPrmSysKineRat.Val /end REF_CHARACTERISTIC /begin REF_MEASUREMENT /end REF_MEASUREMENT /end GROUP
/begin GROUP CalRegn03Inin00.SysGlbPrmSysTqRat.Val "MICROSAR RTE" /begin SUB_GROUP /end SUB_GROUP /begin FUNCTION_LIST /end FUNCTION_LIST /begin REF_CHARACTERISTIC CalRegn03Inin00.SysGlbPrmSysTqRat.Val /end REF_CHARACTERISTIC /begin REF_MEASUREMENT /end REF_MEASUREMENT /end GROUP
/begin GROUP CalRegn03Inin00.WhlImbRejctnBlndCmdMgnLp1FilFrq.Val "MICROSAR RTE" /begin SUB_GROUP /end SUB_GROUP /begin FUNCTION_LIST /end FUNCTION_LIST /begin REF_CHARACTERISTIC CalRegn03Inin00.WhlImbRejctnBlndCmdMgnLp1FilFrq.Val /end REF_CHARACTERISTIC /begin REF_MEASUREMENT /end REF_MEASUREMENT /end GROUP
/begin GROUP CalRegn03Inin00.WhlImbRejctnBlndCmdMgnLp2FilFrq.Val "MICROSAR RTE" /begin SUB_GROUP /end SUB_GROUP /begin FUNCTION_LIST /end FUNCTION_LIST /begin REF_CHARACTERISTIC CalRegn03Inin00.WhlImbRejctnBlndCmdMgnLp2FilFrq.Val /end REF_CHARACTERISTIC /begin REF_MEASUREMENT /end REF_MEASUREMENT /end GROUP
/begin GROUP CalRegn03Inin00.WhlImbRejctnDistbnMgnLpFil.Val "MICROSAR RTE" /begin SUB_GROUP /end SUB_GROUP /begin FUNCTION_LIST /end FUNCTION_LIST /begin REF_CHARACTERISTIC CalRegn03Inin00.WhlImbRejctnDistbnMgnLpFil.Val /end REF_CHARACTERISTIC /begin REF_MEASUREMENT /end REF_MEASUREMENT /end GROUP
/begin GROUP CalRegn03Inin00.WhlImbRejctnWhlSpdLpFil.Val "MICROSAR RTE" /begin SUB_GROUP /end SUB_GROUP /begin FUNCTION_LIST /end FUNCTION_LIST /begin REF_CHARACTERISTIC CalRegn03Inin00.WhlImbRejctnWhlSpdLpFil.Val /end REF_CHARACTERISTIC /begin REF_MEASUREMENT /end REF_MEASUREMENT /end GROUP
/begin GROUP CalRegn03Inin00GroupA "MICROSAR RTE" /begin SUB_GROUP CalRegn03Inin00GroupA.CalibrationPorts /end SUB_GROUP /begin FUNCTION_LIST /end FUNCTION_LIST /begin REF_CHARACTERISTIC /end REF_CHARACTERISTIC /begin REF_MEASUREMENT /end REF_MEASUREMENT /end GROUP
/begin GROUP CalRegn03Inin00GroupA.CalibrationPorts "MICROSAR RTE"
 /begin SUB_GROUP CalRegn03Inin00GroupA.DampgTScaX.Ary1D CalRegn03Inin00GroupA.DampgTScaY.Ary1D CalRegn03Inin00GroupA.HysCmpAssiInpLim.Val CalRegn03Inin00GroupA.HysCmpFricTScaX.Ary1D CalRegn03Inin00GroupA.HysCmpFricTScaY.Ary1D CalRegn03Inin00GroupA.InertiaCmpVelCmdScaY.Ary1D CalRegn03Inin00GroupA.InertiaCmpVelDampgDecelGain.Val CalRegn03Inin00GroupA.InertiaCmpVelDampgDecelGainFallSlew.Val CalRegn03Inin00GroupA.InertiaCmpVelDampgDecelGainRisngSlewX.Ary1D CalRegn03Inin00GroupA.InertiaCmpVelDampgDecelGainRisngSlewY.Ary1D CalRegn03Inin00GroupA.InertiaCmpVelDampgGainOffThd.Val CalRegn03Inin00GroupA.InertiaCmpVelDampgGainOnThd.Val CalRegn03Inin00GroupA.InertiaCmpVelMotVelBasdOutpScagX.Ary1D CalRegn03Inin00GroupA.InertiaCmpVelMotVelBasdOutpScagY.Ary1D CalRegn03Inin00GroupA.InertiaCmpVelTqSnsrVelSca.Ary1D CalRegn03Inin00GroupA.RtnTScaX.Ary1D CalRegn03Inin00GroupA.RtnTScaY.Ary1D CalRegn03Inin00GroupA.StabyCmpNotchFilBilnrBlndVehSpd.Ary1D CalRegn03Inin00GroupA.StabyCmpNotchFilBlnd02Y.Ary2D CalRegn03Inin00GroupA.StabyCmpNotchFilBlnd12TqX.Ary2D CalRegn03Inin00GroupA.StabyCmpNotchFilBlnd12Y.Ary2D /end SUB_GROUP
 /begin FUNCTION_LIST /end FUNCTION_LIST
 /begin REF_CHARACTERISTIC /end REF_CHARACTERISTIC
 /begin REF_MEASUREMENT /end REF_MEASUREMENT
/end GROUP
/begin GROUP CalRegn03Inin00GroupA.DampgTScaX.Ary1D "MICROSAR RTE" /begin SUB_GROUP /end SUB_GROUP /begin FUNCTION_LIST /end FUNCTION_LIST /begin REF_CHARACTERISTIC CalRegn03Inin00GroupA.DampgTScaX.Ary1D /end REF_CHARACTERISTIC /begin REF_MEASUREMENT /end REF_MEASUREMENT /end GROUP
/begin GROUP CalRegn03Inin00GroupA.DampgTScaY.Ary1D "MICROSAR RTE" /begin SUB_GROUP /end SUB_GROUP /begin FUNCTION_LIST /end FUNCTION_LIST /begin REF_CHARACTERISTIC CalRegn03Inin00GroupA.DampgTScaY.Ary1D /end REF_CHARACTERISTIC /begin REF_MEASUREMENT /end REF_MEASUREMENT /end GROUP
/begin GROUP CalRegn03Inin00GroupA.HysCmpAssiInpLim.Val "MICROSAR RTE" /begin SUB_GROUP /end SUB_GROUP /begin FUNCTION_LIST /end FUNCTION_LIST /begin REF_CHARACTERISTIC CalRegn03Inin00GroupA.HysCmpAssiInpLim.Val /end REF_CHARACTERISTIC /begin REF_MEASUREMENT /end REF_MEASUREMENT /end GROUP
/begin GROUP CalRegn03Inin00GroupA.HysCmpFricTScaX.Ary1D "MICROSAR RTE" /begin SUB_GROUP /end SUB_GROUP /begin FUNCTION_LIST /end FUNCTION_LIST /begin REF_CHARACTERISTIC CalRegn03Inin00GroupA.HysCmpFricTScaX.Ary1D /end REF_CHARACTERISTIC /begin REF_MEASUREMENT /end REF_MEASUREMENT /end GROUP
/begin GROUP CalRegn03Inin00GroupA.HysCmpFricTScaY.Ary1D "MICROSAR RTE" /begin SUB_GROUP /end SUB_GROUP /begin FUNCTION_LIST /end FUNCTION_LIST /begin REF_CHARACTERISTIC CalRegn03Inin00GroupA.HysCmpFricTScaY.Ary1D /end REF_CHARACTERISTIC /begin REF_MEASUREMENT /end REF_MEASUREMENT /end GROUP
/begin GROUP CalRegn03Inin00GroupA.InertiaCmpVelCmdScaY.Ary1D "MICROSAR RTE" /begin SUB_GROUP /end SUB_GROUP /begin FUNCTION_LIST /end FUNCTION_LIST /begin REF_CHARACTERISTIC CalRegn03Inin00GroupA.InertiaCmpVelCmdScaY.Ary1D /end REF_CHARACTERISTIC /begin REF_MEASUREMENT /end REF_MEASUREMENT /end GROUP
/begin GROUP CalRegn03Inin00GroupA.InertiaCmpVelDampgDecelGain.Val "MICROSAR RTE" /begin SUB_GROUP /end SUB_GROUP /begin FUNCTION_LIST /end FUNCTION_LIST /begin REF_CHARACTERISTIC CalRegn03Inin00GroupA.InertiaCmpVelDampgDecelGain.Val /end REF_CHARACTERISTIC /begin REF_MEASUREMENT /end REF_MEASUREMENT /end GROUP
/begin GROUP CalRegn03Inin00GroupA.InertiaCmpVelDampgDecelGainFallSlew.Val "MICROSAR RTE" /begin SUB_GROUP /end SUB_GROUP /begin FUNCTION_LIST /end FUNCTION_LIST
 /begin REF_CHARACTERISTIC CalRegn03Inin00GroupA.InertiaCmpVelDampgDecelGainFallSlew.Val /end REF_CHARACTERISTIC
 /begin REF_MEASUREMENT /end REF_MEASUREMENT
/end GROUP
/begin GROUP CalRegn03Inin00GroupA.InertiaCmpVelDampgDecelGainRisngSlewX.Ary1D "MICROSAR RTE" /begin SUB_GROUP /end SUB_GROUP /begin FUNCTION_LIST /end FUNCTION_LIST
 /begin REF_CHARACTERISTIC CalRegn03Inin00GroupA.InertiaCmpVelDampgDecelGainRisngSlewX.Ary1D /end REF_CHARACTERISTIC
 /begin REF_MEASUREMENT /end REF_MEASUREMENT
/end GROUP
/begin GROUP CalRegn03Inin00GroupA.InertiaCmpVelDampgDecelGainRisngSlewY.Ary1D "MICROSAR RTE" /begin SUB_GROUP /end SUB_GROUP /begin FUNCTION_LIST /end FUNCTION_LIST
 /begin REF_CHARACTERISTIC CalRegn03Inin00GroupA.InertiaCmpVelDampgDecelGainRisngSlewY.Ary1D /end REF_CHARACTERISTIC
 /begin REF_MEASUREMENT /end REF_MEASUREMENT
/end GROUP
/begin GROUP CalRegn03Inin00GroupA.InertiaCmpVelDampgGainOffThd.Val "MICROSAR RTE" /begin SUB_GROUP /end SUB_GROUP /begin FUNCTION_LIST /end FUNCTION_LIST /begin REF_CHARACTERISTIC CalRegn03Inin00GroupA.InertiaCmpVelDampgGainOffThd.Val /end REF_CHARACTERISTIC /begin REF_MEASUREMENT /end REF_MEASUREMENT /end GROUP
/begin GROUP CalRegn03Inin00GroupA.InertiaCmpVelDampgGainOnThd.Val "MICROSAR RTE" /begin SUB_GROUP /end SUB_GROUP /begin FUNCTION_LIST /end FUNCTION_LIST /begin REF_CHARACTERISTIC CalRegn03Inin00GroupA.InertiaCmpVelDampgGainOnThd.Val /end REF_CHARACTERISTIC /begin REF_MEASUREMENT /end REF_MEASUREMENT /end GROUP
/begin GROUP CalRegn03Inin00GroupA.InertiaCmpVelMotVelBasdOutpScagX.Ary1D "MICROSAR RTE" /begin SUB_GROUP /end SUB_GROUP /begin FUNCTION_LIST /end FUNCTION_LIST
 /begin REF_CHARACTERISTIC CalRegn03Inin00GroupA.InertiaCmpVelMotVelBasdOutpScagX.Ary1D /end REF_CHARACTERISTIC
 /begin REF_MEASUREMENT /end REF_MEASUREMENT
/end GROUP
/begin GROUP CalRegn03Inin00GroupA.InertiaCmpVelMotVelBasdOutpScagY.Ary1D "MICROSAR RTE" /begin SUB_GROUP /end SUB_GROUP /begin FUNCTION_LIST /end FUNCTION_LIST
 /begin REF_CHARACTERISTIC CalRegn03Inin00GroupA.InertiaCmpVelMotVelBasdOutpScagY.Ary1D /end REF_CHARACTERISTIC
 /begin REF_MEASUREMENT /end REF_MEASUREMENT
/end GROUP
/begin GROUP CalRegn03Inin00GroupA.InertiaCmpVelTqSnsrVelSca.Ary1D "MICROSAR RTE" /begin SUB_GROUP /end SUB_GROUP /begin FUNCTION_LIST /end FUNCTION_LIST /begin REF_CHARACTERISTIC CalRegn03Inin00GroupA.InertiaCmpVelTqSnsrVelSca.Ary1D /end REF_CHARACTERISTIC /begin REF_MEASUREMENT /end REF_MEASUREMENT /end GROUP
/begin GROUP CalRegn03Inin00GroupA.RtnTScaX.Ary1D "MICROSAR RTE" /begin SUB_GROUP /end SUB_GROUP /begin FUNCTION_LIST /end FUNCTION_LIST /begin REF_CHARACTERISTIC CalRegn03Inin00GroupA.RtnTScaX.Ary1D /end REF_CHARACTERISTIC /begin REF_MEASUREMENT /end REF_MEASUREMENT /end GROUP
/begin GROUP CalRegn03Inin00GroupA.RtnTScaY.Ary1D "MICROSAR RTE" /begin SUB_GROUP /end SUB_GROUP /begin FUNCTION_LIST /end FUNCTION_LIST /begin REF_CHARACTERISTIC CalRegn03Inin00GroupA.RtnTScaY.Ary1D /end REF_CHARACTERISTIC /begin REF_MEASUREMENT /end REF_MEASUREMENT /end GROUP
/begin GROUP CalRegn03Inin00GroupA.StabyCmpNotchFilBilnrBlndVehSpd.Ary1D "MICROSAR RTE" /begin SUB_GROUP /end SUB_GROUP /begin FUNCTION_LIST /end FUNCTION_LIST
 /begin REF_CHARACTERISTIC CalRegn03Inin00GroupA.StabyCmpNotchFilBilnrBlndVehSpd.Ary1D /end REF_CHARACTERISTIC
 /begin REF_MEASUREMENT /end REF_MEASUREMENT
/end GROUP
/begin GROUP CalRegn03Inin00GroupA.StabyCmpNotchFilBlnd02Y.Ary2D "MICROSAR RTE" /begin SUB_GROUP /end SUB_GROUP /begin FUNCTION_LIST /end FUNCTION_LIST /begin REF_CHARACTERISTIC CalRegn03Inin00GroupA.StabyCmpNotchFilBlnd02Y.Ary2D /end REF_CHARACTERISTIC /begin REF_MEASUREMENT /end REF_MEASUREMENT /end GROUP
/begin GROUP CalRegn03Inin00GroupA.StabyCmpNotchFilBlnd12TqX.Ary2D "MICROSAR RTE" /begin SUB_GROUP /end SUB_GROUP /begin FUNCTION_LIST /end FUNCTION_LIST /begin REF_CHARACTERISTIC CalRegn03Inin00GroupA.StabyCmpNotchFilBlnd12TqX.Ary2D /end REF_CHARACTERISTIC /begin REF_MEASUREMENT /end REF_MEASUREMENT /end GROUP
/begin GROUP CalRegn03Inin00GroupA.StabyCmpNotchFilBlnd12Y.Ary2D "MICROSAR RTE" /begin SUB_GROUP /end SUB_GROUP /begin FUNCTION_LIST /end FUNCTION_LIST /begin REF_CHARACTERISTIC CalRegn03Inin00GroupA.StabyCmpNotchFilBlnd12Y.Ary2D /end REF_CHARACTERISTIC /begin REF_MEASUREMENT /end REF_MEASUREMENT /end GROUP
/begin GROUP CalRegn03Inin00GroupB "MICROSAR RTE" /begin SUB_GROUP CalRegn03Inin00GroupB.CalibrationPorts /end SUB_GROUP /begin FUNCTION_LIST /end FUNCTION_LIST /begin REF_CHARACTERISTIC /end REF_CHARACTERISTIC /begin REF_MEASUREMENT /end REF_MEASUREMENT /end GROUP
/begin GROUP CalRegn03Inin00GroupB.CalibrationPorts "MICROSAR RTE"
 /begin SUB_GROUP CalRegn03Inin00GroupB.EotProtnDampgSlew.Val CalRegn03Inin00GroupB.EotProtnHwAgGain.Val CalRegn03Inin00GroupB.EotProtnHwTqScaX.Ary1D CalRegn03Inin00GroupB.EotProtnMotVelGain.Val CalRegn03Inin00GroupB.EotProtnRackTrvlLimrRng.Val CalRegn03Inin00GroupB.EotProtnRackTrvlLimrRngLimd.Val CalRegn03Inin00GroupB.EotProtnRackTrvlLimrVehSpdThd.Val CalRegn03Inin00GroupB.EotProtnSoftEndStopVehSpdThd.Val CalRegn03Inin00GroupB.WhlImbRejctnAdpvFac.Val CalRegn03Inin00GroupB.WhlImbRejctnCurrMgnSlewPerLoop.Val CalRegn03Inin00GroupB.WhlImbRejctnDcTrendTh2Tq.Val CalRegn03Inin00GroupB.WhlImbRejctnDcTrendThTq.Val CalRegn03Inin00GroupB.WhlImbRejctnDcTrendTi2Sec.Val CalRegn03Inin00GroupB.WhlImbRejctnDcTrendTiSec.Val CalRegn03Inin00GroupB.WhlImbRejctnEnaSlewPerLoop.Val CalRegn03Inin00GroupB.WhlImbRejctnFrqScaTblX.Ary1D CalRegn03Inin00GroupB.WhlImbRejctnFrqScaTblY.Ary1D CalRegn03Inin00GroupB.WhlImbRejctnMaxDurn.Val CalRegn03Inin00GroupB.WhlImbRejctnMaxMgn.Val CalRegn03Inin00GroupB.WhlImbRejctnMgnEstimnDeltaSca.Val CalRegn03Inin00GroupB.WhlImbRejctnMgnEstimnDiThd.Val CalRegn03Inin00GroupB.WhlImbRejctnMgnEstimnEnaThd.Val CalRegn03Inin00GroupB.WhlImbRejctnMgnEstimnFrq.Val CalRegn03Inin00GroupB.WhlImbRejctnMgnEstimnFrqDelta.Val CalRegn03Inin00GroupB.WhlImbRejctnMgnEstimnLeak.Val CalRegn03Inin00GroupB.WhlImbRejctnPhaAdjX.Ary1D CalRegn03Inin00GroupB.WhlImbRejctnPhaAdjY.Ary1D CalRegn03Inin00GroupB.WhlImbRejctnWhlSpdCorrlnThd.Val CalRegn03Inin00GroupB.WhlImbRejctnWhlSpdCorrlnTi.Val /end SUB_GROUP
 /begin FUNCTION_LIST /end FUNCTION_LIST
 /begin REF_CHARACTERISTIC /end REF_CHARACTERISTIC
 /begin REF_MEASUREMENT /end REF_MEASUREMENT
/end GROUP
/begin GROUP CalRegn03Inin00GroupB.EotProtnDampgSlew.Val "MICROSAR RTE" /begin SUB_GROUP /end SUB_GROUP /begin FUNCTION_LIST /end FUNCTION_LIST /begin REF_CHARACTERISTIC CalRegn03Inin00GroupB.EotProtnDampgSlew.Val /end REF_CHARACTERISTIC /begin REF_MEASUREMENT /end REF_MEASUREMENT /end GROUP
/begin GROUP CalRegn03Inin00GroupB.EotProtnHwAgGain.Val "MICROSAR RTE" /begin SUB_GROUP /end SUB_GROUP /begin FUNCTION_LIST /end FUNCTION_LIST /begin REF_CHARACTERISTIC CalRegn03Inin00GroupB.EotProtnHwAgGain.Val /end REF_CHARACTERISTIC /begin REF_MEASUREMENT /end REF_MEASUREMENT /end GROUP
/begin GROUP CalRegn03Inin00GroupB.EotProtnHwTqScaX.Ary1D "MICROSAR RTE" /begin SUB_GROUP /end SUB_GROUP /begin FUNCTION_LIST /end FUNCTION_LIST /begin REF_CHARACTERISTIC CalRegn03Inin00GroupB.EotProtnHwTqScaX.Ary1D /end REF_CHARACTERISTIC /begin REF_MEASUREMENT /end REF_MEASUREMENT /end GROUP
/begin GROUP CalRegn03Inin00GroupB.EotProtnMotVelGain.Val "MICROSAR RTE" /begin SUB_GROUP /end SUB_GROUP /begin FUNCTION_LIST /end FUNCTION_LIST /begin REF_CHARACTERISTIC CalRegn03Inin00GroupB.EotProtnMotVelGain.Val /end REF_CHARACTERISTIC /begin REF_MEASUREMENT /end REF_MEASUREMENT /end GROUP
/begin GROUP CalRegn03Inin00GroupB.EotProtnRackTrvlLimrRng.Val "MICROSAR RTE" /begin SUB_GROUP /end SUB_GROUP /begin FUNCTION_LIST /end FUNCTION_LIST /begin REF_CHARACTERISTIC CalRegn03Inin00GroupB.EotProtnRackTrvlLimrRng.Val /end REF_CHARACTERISTIC /begin REF_MEASUREMENT /end REF_MEASUREMENT /end GROUP
/begin GROUP CalRegn03Inin00GroupB.EotProtnRackTrvlLimrRngLimd.Val "MICROSAR RTE" /begin SUB_GROUP /end SUB_GROUP /begin FUNCTION_LIST /end FUNCTION_LIST /begin REF_CHARACTERISTIC CalRegn03Inin00GroupB.EotProtnRackTrvlLimrRngLimd.Val /end REF_CHARACTERISTIC /begin REF_MEASUREMENT /end REF_MEASUREMENT /end GROUP
/begin GROUP CalRegn03Inin00GroupB.EotProtnRackTrvlLimrVehSpdThd.Val "MICROSAR RTE" /begin SUB_GROUP /end SUB_GROUP /begin FUNCTION_LIST /end FUNCTION_LIST /begin REF_CHARACTERISTIC CalRegn03Inin00GroupB.EotProtnRackTrvlLimrVehSpdThd.Val /end REF_CHARACTERISTIC /begin REF_MEASUREMENT /end REF_MEASUREMENT /end GROUP
/begin GROUP CalRegn03Inin00GroupB.EotProtnSoftEndStopVehSpdThd.Val "MICROSAR RTE" /begin SUB_GROUP /end SUB_GROUP /begin FUNCTION_LIST /end FUNCTION_LIST /begin REF_CHARACTERISTIC CalRegn03Inin00GroupB.EotProtnSoftEndStopVehSpdThd.Val /end REF_CHARACTERISTIC /begin REF_MEASUREMENT /end REF_MEASUREMENT /end GROUP
/begin GROUP CalRegn03Inin00GroupB.WhlImbRejctnAdpvFac.Val "MICROSAR RTE" /begin SUB_GROUP /end SUB_GROUP /begin FUNCTION_LIST /end FUNCTION_LIST /begin REF_CHARACTERISTIC CalRegn03Inin00GroupB.WhlImbRejctnAdpvFac.Val /end REF_CHARACTERISTIC /begin REF_MEASUREMENT /end REF_MEASUREMENT /end GROUP
/begin GROUP CalRegn03Inin00GroupB.WhlImbRejctnCurrMgnSlewPerLoop.Val "MICROSAR RTE" /begin SUB_GROUP /end SUB_GROUP /begin FUNCTION_LIST /end FUNCTION_LIST /begin REF_CHARACTERISTIC CalRegn03Inin00GroupB.WhlImbRejctnCurrMgnSlewPerLoop.Val /end REF_CHARACTERISTIC /begin REF_MEASUREMENT /end REF_MEASUREMENT /end GROUP
/begin GROUP CalRegn03Inin00GroupB.WhlImbRejctnDcTrendTh2Tq.Val "MICROSAR RTE" /begin SUB_GROUP /end SUB_GROUP /begin FUNCTION_LIST /end FUNCTION_LIST /begin REF_CHARACTERISTIC CalRegn03Inin00GroupB.WhlImbRejctnDcTrendTh2Tq.Val /end REF_CHARACTERISTIC /begin REF_MEASUREMENT /end REF_MEASUREMENT /end GROUP
/begin GROUP CalRegn03Inin00GroupB.WhlImbRejctnDcTrendThTq.Val "MICROSAR RTE" /begin SUB_GROUP /end SUB_GROUP /begin FUNCTION_LIST /end FUNCTION_LIST /begin REF_CHARACTERISTIC CalRegn03Inin00GroupB.WhlImbRejctnDcTrendThTq.Val /end REF_CHARACTERISTIC /begin REF_MEASUREMENT /end REF_MEASUREMENT /end GROUP
/begin GROUP CalRegn03Inin00GroupB.WhlImbRejctnDcTrendTi2Sec.Val "MICROSAR RTE" /begin SUB_GROUP /end SUB_GROUP /begin FUNCTION_LIST /end FUNCTION_LIST /begin REF_CHARACTERISTIC CalRegn03Inin00GroupB.WhlImbRejctnDcTrendTi2Sec.Val /end REF_CHARACTERISTIC /begin REF_MEASUREMENT /end REF_MEASUREMENT /end GROUP
/begin GROUP CalRegn03Inin00GroupB.WhlImbRejctnDcTrendTiSec.Val "MICROSAR RTE" /begin SUB_GROUP /end SUB_GROUP /begin FUNCTION_LIST /end FUNCTION_LIST /begin REF_CHARACTERISTIC CalRegn03Inin00GroupB.WhlImbRejctnDcTrendTiSec.Val /end REF_CHARACTERISTIC /begin REF_MEASUREMENT /end REF_MEASUREMENT /end GROUP
/begin GROUP CalRegn03Inin00GroupB.WhlImbRejctnEnaSlewPerLoop.Val "MICROSAR RTE" /begin SUB_GROUP /end SUB_GROUP /begin FUNCTION_LIST /end FUNCTION_LIST /begin REF_CHARACTERISTIC CalRegn03Inin00GroupB.WhlImbRejctnEnaSlewPerLoop.Val /end REF_CHARACTERISTIC /begin REF_MEASUREMENT /end REF_MEASUREMENT /end GROUP
/begin GROUP CalRegn03Inin00GroupB.WhlImbRejctnFrqScaTblX.Ary1D "MICROSAR RTE" /begin SUB_GROUP /end SUB_GROUP /begin FUNCTION_LIST /end FUNCTION_LIST /begin REF_CHARACTERISTIC CalRegn03Inin00GroupB.WhlImbRejctnFrqScaTblX.Ary1D /end REF_CHARACTERISTIC /begin REF_MEASUREMENT /end REF_MEASUREMENT /end GROUP
/begin GROUP CalRegn03Inin00GroupB.WhlImbRejctnFrqScaTblY.Ary1D "MICROSAR RTE" /begin SUB_GROUP /end SUB_GROUP /begin FUNCTION_LIST /end FUNCTION_LIST /begin REF_CHARACTERISTIC CalRegn03Inin00GroupB.WhlImbRejctnFrqScaTblY.Ary1D /end REF_CHARACTERISTIC /begin REF_MEASUREMENT /end REF_MEASUREMENT /end GROUP
/begin GROUP CalRegn03Inin00GroupB.WhlImbRejctnMaxDurn.Val "MICROSAR RTE" /begin SUB_GROUP /end SUB_GROUP /begin FUNCTION_LIST /end FUNCTION_LIST /begin REF_CHARACTERISTIC CalRegn03Inin00GroupB.WhlImbRejctnMaxDurn.Val /end REF_CHARACTERISTIC /begin REF_MEASUREMENT /end REF_MEASUREMENT /end GROUP
/begin GROUP CalRegn03Inin00GroupB.WhlImbRejctnMaxMgn.Val "MICROSAR RTE" /begin SUB_GROUP /end SUB_GROUP /begin FUNCTION_LIST /end FUNCTION_LIST /begin REF_CHARACTERISTIC CalRegn03Inin00GroupB.WhlImbRejctnMaxMgn.Val /end REF_CHARACTERISTIC /begin REF_MEASUREMENT /end REF_MEASUREMENT /end GROUP
/begin GROUP CalRegn03Inin00GroupB.WhlImbRejctnMgnEstimnDeltaSca.Val "MICROSAR RTE" /begin SUB_GROUP /end SUB_GROUP /begin FUNCTION_LIST /end FUNCTION_LIST /begin REF_CHARACTERISTIC CalRegn03Inin00GroupB.WhlImbRejctnMgnEstimnDeltaSca.Val /end REF_CHARACTERISTIC /begin REF_MEASUREMENT /end REF_MEASUREMENT /end GROUP
/begin GROUP CalRegn03Inin00GroupB.WhlImbRejctnMgnEstimnDiThd.Val "MICROSAR RTE" /begin SUB_GROUP /end SUB_GROUP /begin FUNCTION_LIST /end FUNCTION_LIST /begin REF_CHARACTERISTIC CalRegn03Inin00GroupB.WhlImbRejctnMgnEstimnDiThd.Val /end REF_CHARACTERISTIC /begin REF_MEASUREMENT /end REF_MEASUREMENT /end GROUP
/begin GROUP CalRegn03Inin00GroupB.WhlImbRejctnMgnEstimnEnaThd.Val "MICROSAR RTE" /begin SUB_GROUP /end SUB_GROUP /begin FUNCTION_LIST /end FUNCTION_LIST /begin REF_CHARACTERISTIC CalRegn03Inin00GroupB.WhlImbRejctnMgnEstimnEnaThd.Val /end REF_CHARACTERISTIC /begin REF_MEASUREMENT /end REF_MEASUREMENT /end GROUP
/begin GROUP CalRegn03Inin00GroupB.WhlImbRejctnMgnEstimnFrq.Val "MICROSAR RTE" /begin SUB_GROUP /end SUB_GROUP /begin FUNCTION_LIST /end FUNCTION_LIST /begin REF_CHARACTERISTIC CalRegn03Inin00GroupB.WhlImbRejctnMgnEstimnFrq.Val /end REF_CHARACTERISTIC /begin REF_MEASUREMENT /end REF_MEASUREMENT /end GROUP
/begin GROUP CalRegn03Inin00GroupB.WhlImbRejctnMgnEstimnFrqDelta.Val "MICROSAR RTE" /begin SUB_GROUP /end SUB_GROUP /begin FUNCTION_LIST /end FUNCTION_LIST /begin REF_CHARACTERISTIC CalRegn03Inin00GroupB.WhlImbRejctnMgnEstimnFrqDelta.Val /end REF_CHARACTERISTIC /begin REF_MEASUREMENT /end REF_MEASUREMENT /end GROUP
/begin GROUP CalRegn03Inin00GroupB.WhlImbRejctnMgnEstimnLeak.Val "MICROSAR RTE" /begin SUB_GROUP /end SUB_GROUP /begin FUNCTION_LIST /end FUNCTION_LIST /begin REF_CHARACTERISTIC CalRegn03Inin00GroupB.WhlImbRejctnMgnEstimnLeak.Val /end REF_CHARACTERISTIC /begin REF_MEASUREMENT /end REF_MEASUREMENT /end GROUP
/begin GROUP CalRegn03Inin00GroupB.WhlImbRejctnPhaAdjX.Ary1D "MICROSAR RTE" /begin SUB_GROUP /end SUB_GROUP /begin FUNCTION_LIST /end FUNCTION_LIST /begin REF_CHARACTERISTIC CalRegn03Inin00GroupB.WhlImbRejctnPhaAdjX.Ary1D /end REF_CHARACTERISTIC /begin REF_MEASUREMENT /end REF_MEASUREMENT /end GROUP
/begin GROUP CalRegn03Inin00GroupB.WhlImbRejctnPhaAdjY.Ary1D "MICROSAR RTE" /begin SUB_GROUP /end SUB_GROUP /begin FUNCTION_LIST /end FUNCTION_LIST /begin REF_CHARACTERISTIC CalRegn03Inin00GroupB.WhlImbRejctnPhaAdjY.Ary1D /end REF_CHARACTERISTIC /begin REF_MEASUREMENT /end REF_MEASUREMENT /end GROUP
/begin GROUP CalRegn03Inin00GroupB.WhlImbRejctnWhlSpdCorrlnThd.Val "MICROSAR RTE" /begin SUB_GROUP /end SUB_GROUP /begin FUNCTION_LIST /end FUNCTION_LIST /begin REF_CHARACTERISTIC CalRegn03Inin00GroupB.WhlImbRejctnWhlSpdCorrlnThd.Val /end REF_CHARACTERISTIC /begin REF_MEASUREMENT /end REF_MEASUREMENT /end GROUP
/begin GROUP CalRegn03Inin00GroupB.WhlImbRejctnWhlSpdCorrlnTi.Val "MICROSAR RTE" /begin SUB_GROUP /end SUB_GROUP /begin FUNCTION_LIST /end FUNCTION_LIST /begin REF_CHARACTERISTIC CalRegn03Inin00GroupB.WhlImbRejctnWhlSpdCorrlnTi.Val /end REF_CHARACTERISTIC /begin REF_MEASUREMENT /end REF_MEASUREMENT /end GROUP
/begin GROUP CalRegn03Inin00GroupC "MICROSAR RTE" /begin SUB_GROUP CalRegn03Inin00GroupC.CalibrationPorts /end SUB_GROUP /begin FUNCTION_LIST /end FUNCTION_LIST /begin REF_CHARACTERISTIC /end REF_CHARACTERISTIC /begin REF_MEASUREMENT /end REF_MEASUREMENT /end GROUP
/begin GROUP CalRegn03Inin00GroupC.CalibrationPorts "MICROSAR RTE"
 /begin SUB_GROUP CalRegn03Inin00GroupC.HwAgTrakgServoDampgTqX.Ary1D CalRegn03Inin00GroupC.HwAgTrakgServoDampgTqY.Ary2D CalRegn03Inin00GroupC.HwAgTrakgServoDftlGainY.Ary1D CalRegn03Inin00GroupC.HwAgTrakgServoIntglGainY.Ary1D CalRegn03Inin00GroupC.HwAgTrakgServoIntglTermAntiWdupLimY.Ary1D CalRegn03Inin00GroupC.HwAgTrakgServoPropGainX.Ary1D CalRegn03Inin00GroupC.HwAgTrakgServoPropGainY.Ary2D CalRegn03Inin00GroupC.HwAgTrakgServoSmotngX.Ary1D /end SUB_GROUP
 /begin FUNCTION_LIST /end FUNCTION_LIST
 /begin REF_CHARACTERISTIC /end REF_CHARACTERISTIC
 /begin REF_MEASUREMENT /end REF_MEASUREMENT
/end GROUP
/begin GROUP CalRegn03Inin00GroupC.HwAgTrakgServoDampgTqX.Ary1D "MICROSAR RTE" /begin SUB_GROUP /end SUB_GROUP /begin FUNCTION_LIST /end FUNCTION_LIST /begin REF_CHARACTERISTIC CalRegn03Inin00GroupC.HwAgTrakgServoDampgTqX.Ary1D /end REF_CHARACTERISTIC /begin REF_MEASUREMENT /end REF_MEASUREMENT /end GROUP
/begin GROUP CalRegn03Inin00GroupC.HwAgTrakgServoDampgTqY.Ary2D "MICROSAR RTE" /begin SUB_GROUP /end SUB_GROUP /begin FUNCTION_LIST /end FUNCTION_LIST /begin REF_CHARACTERISTIC CalRegn03Inin00GroupC.HwAgTrakgServoDampgTqY.Ary2D /end REF_CHARACTERISTIC /begin REF_MEASUREMENT /end REF_MEASUREMENT /end GROUP
/begin GROUP CalRegn03Inin00GroupC.HwAgTrakgServoDftlGainY.Ary1D "MICROSAR RTE" /begin SUB_GROUP /end SUB_GROUP /begin FUNCTION_LIST /end FUNCTION_LIST /begin REF_CHARACTERISTIC CalRegn03Inin00GroupC.HwAgTrakgServoDftlGainY.Ary1D /end REF_CHARACTERISTIC /begin REF_MEASUREMENT /end REF_MEASUREMENT /end GROUP
/begin GROUP CalRegn03Inin00GroupC.HwAgTrakgServoIntglGainY.Ary1D "MICROSAR RTE" /begin SUB_GROUP /end SUB_GROUP /begin FUNCTION_LIST /end FUNCTION_LIST /begin REF_CHARACTERISTIC CalRegn03Inin00GroupC.HwAgTrakgServoIntglGainY.Ary1D /end REF_CHARACTERISTIC /begin REF_MEASUREMENT /end REF_MEASUREMENT /end GROUP
/begin GROUP CalRegn03Inin00GroupC.HwAgTrakgServoIntglTermAntiWdupLimY.Ary1D "MICROSAR RTE" /begin SUB_GROUP /end SUB_GROUP /begin FUNCTION_LIST /end FUNCTION_LIST
 /begin REF_CHARACTERISTIC CalRegn03Inin00GroupC.HwAgTrakgServoIntglTermAntiWdupLimY.Ary1D /end REF_CHARACTERISTIC
 /begin REF_MEASUREMENT /end REF_MEASUREMENT
/end GROUP
/begin GROUP CalRegn03Inin00GroupC.HwAgTrakgServoPropGainX.Ary1D "MICROSAR RTE" /begin SUB_GROUP /end SUB_GROUP /begin FUNCTION_LIST /end FUNCTION_LIST /begin REF_CHARACTERISTIC CalRegn03Inin00GroupC.HwAgTrakgServoPropGainX.Ary1D /end REF_CHARACTERISTIC /begin REF_MEASUREMENT /end REF_MEASUREMENT /end GROUP
/begin GROUP CalRegn03Inin00GroupC.HwAgTrakgServoPropGainY.Ary2D "MICROSAR RTE" /begin SUB_GROUP /end SUB_GROUP /begin FUNCTION_LIST /end FUNCTION_LIST /begin REF_CHARACTERISTIC CalRegn03Inin00GroupC.HwAgTrakgServoPropGainY.Ary2D /end REF_CHARACTERISTIC /begin REF_MEASUREMENT /end REF_MEASUREMENT /end GROUP
/begin GROUP CalRegn03Inin00GroupC.HwAgTrakgServoSmotngX.Ary1D "MICROSAR RTE" /begin SUB_GROUP /end SUB_GROUP /begin FUNCTION_LIST /end FUNCTION_LIST /begin REF_CHARACTERISTIC CalRegn03Inin00GroupC.HwAgTrakgServoSmotngX.Ary1D /end REF_CHARACTERISTIC /begin REF_MEASUREMENT /end REF_MEASUREMENT /end GROUP
/begin GROUP CalRegn03Rt00 "MICROSAR RTE" /begin SUB_GROUP CalRegn03Rt00.CalibrationPorts /end SUB_GROUP /begin FUNCTION_LIST /end FUNCTION_LIST /begin REF_CHARACTERISTIC /end REF_CHARACTERISTIC /begin REF_MEASUREMENT /end REF_MEASUREMENT /end GROUP
/begin GROUP CalRegn03Rt00.CalibrationPorts "MICROSAR RTE"
 /begin SUB_GROUP CalRegn03Rt00.InertiaCmpVelDampgFilFrq.Ary1D CalRegn03Rt00.InertiaCmpVelDampgFilFrqWhlImbRejctnOn.Ary1D /end SUB_GROUP
 /begin FUNCTION_LIST /end FUNCTION_LIST
 /begin REF_CHARACTERISTIC /end REF_CHARACTERISTIC
 /begin REF_MEASUREMENT /end REF_MEASUREMENT
/end GROUP
/begin GROUP CalRegn03Rt00.InertiaCmpVelDampgFilFrq.Ary1D "MICROSAR RTE" /begin SUB_GROUP /end SUB_GROUP /begin FUNCTION_LIST /end FUNCTION_LIST /begin REF_CHARACTERISTIC CalRegn03Rt00.InertiaCmpVelDampgFilFrq.Ary1D /end REF_CHARACTERISTIC /begin REF_MEASUREMENT /end REF_MEASUREMENT /end GROUP
/begin GROUP CalRegn03Rt00.InertiaCmpVelDampgFilFrqWhlImbRejctnOn.Ary1D "MICROSAR RTE" /begin SUB_GROUP /end SUB_GROUP /begin FUNCTION_LIST /end FUNCTION_LIST /begin REF_CHARACTERISTIC CalRegn03Rt00.InertiaCmpVelDampgFilFrqWhlImbRejctnOn.Ary1D /end REF_CHARACTERISTIC /begin REF_MEASUREMENT /end REF_MEASUREMENT /end GROUP
/begin GROUP CalRegn03Rt00GroupA "MICROSAR RTE" /begin SUB_GROUP CalRegn03Rt00GroupA.CalibrationPorts /end SUB_GROUP /begin FUNCTION_LIST /end FUNCTION_LIST /begin REF_CHARACTERISTIC /end REF_CHARACTERISTIC /begin REF_MEASUREMENT /end REF_MEASUREMENT /end GROUP
/begin GROUP CalRegn03Rt00GroupA.AssiHiFrqGainY.Ary2D "MICROSAR RTE" /begin SUB_GROUP /end SUB_GROUP /begin FUNCTION_LIST /end FUNCTION_LIST /begin REF_CHARACTERISTIC CalRegn03Rt00GroupA.AssiHiFrqGainY.Ary2D /end REF_CHARACTERISTIC /begin REF_MEASUREMENT /end REF_MEASUREMENT /end GROUP
/begin GROUP CalRegn03Rt00GroupA.AssiHiFrqTqX.Ary2D "MICROSAR RTE" /begin SUB_GROUP /end SUB_GROUP /begin FUNCTION_LIST /end FUNCTION_LIST /begin REF_CHARACTERISTIC CalRegn03Rt00GroupA.AssiHiFrqTqX.Ary2D /end REF_CHARACTERISTIC /begin REF_MEASUREMENT /end REF_MEASUREMENT /end GROUP
/begin GROUP CalRegn03Rt00GroupA.AssiMotTqWhlImbRejctnMinX.Ary2D "MICROSAR RTE" /begin SUB_GROUP /end SUB_GROUP /begin FUNCTION_LIST /end FUNCTION_LIST /begin REF_CHARACTERISTIC CalRegn03Rt00GroupA.AssiMotTqWhlImbRejctnMinX.Ary2D /end REF_CHARACTERISTIC /begin REF_MEASUREMENT /end REF_MEASUREMENT /end GROUP
/begin GROUP CalRegn03Rt00GroupA.AssiMotTqWhlImbRejctnMinY.Ary2D "MICROSAR RTE" /begin SUB_GROUP /end SUB_GROUP /begin FUNCTION_LIST /end FUNCTION_LIST /begin REF_CHARACTERISTIC CalRegn03Rt00GroupA.AssiMotTqWhlImbRejctnMinY.Ary2D /end REF_CHARACTERISTIC /begin REF_MEASUREMENT /end REF_MEASUREMENT /end GROUP
/begin GROUP CalRegn03Rt00GroupA.CalibrationPorts "MICROSAR RTE"
 /begin SUB_GROUP CalRegn03Rt00GroupA.AssiHiFrqGainY.Ary2D CalRegn03Rt00GroupA.AssiHiFrqTqX.Ary2D CalRegn03Rt00GroupA.AssiMotTqWhlImbRejctnMinX.Ary2D CalRegn03Rt00GroupA.AssiMotTqWhlImbRejctnMinY.Ary2D CalRegn03Rt00GroupA.DampgHydCoeff1ScaY.Ary1D CalRegn03Rt00GroupA.DampgHydCoeff2ScaY.Ary1D CalRegn03Rt00GroupA.DampgHydCoeff3ScaY.Ary1D CalRegn03Rt00GroupA.DampgHydCoeff4ScaY.Ary1D CalRegn03Rt00GroupA.DampgMotVelX.Ary2D CalRegn03Rt00GroupA.DampgMotVelY.Ary2D CalRegn03Rt00GroupA.HysCmpFricWhlImbRejctnBlndX.Ary1D CalRegn03Rt00GroupA.HysCmpFricWhlImbRejctnBlndY.Ary1D CalRegn03Rt00GroupA.HysCmpFricWhlImbRejctnOffY.Ary1D CalRegn03Rt00GroupA.HysCmpFricWhlImbRejctnOnY.Ary1D CalRegn03Rt00GroupA.InertiaCmpVelAssiBasdDampgCoeffX.Ary1D CalRegn03Rt00GroupA.InertiaCmpVelAssiBasdDampgRollgY.Ary1D CalRegn03Rt00GroupA.InertiaCmpVelAssiBasdDampgStatY.Ary1D CalRegn03Rt00GroupA.InertiaCmpVelDampgSpdBlndY.Ary1D CalRegn03Rt00GroupA.InertiaCmpVelNotchBlndY.Ary1D CalRegn03Rt00GroupA.RtnHwAgOffsCalcdX.Ary2D CalRegn03Rt00GroupA.RtnHwAgOffsCalcdY.Ary2D CalRegn03Rt00GroupA.RtnScaTqX.Ary2D CalRegn03Rt00GroupA.RtnScaTqY.Ary2D CalRegn03Rt00GroupA.RtnScaVelX.Ary2D CalRegn03Rt00GroupA.RtnScaVelY.Ary2D /end SUB_GROUP
 /begin FUNCTION_LIST /end FUNCTION_LIST
 /begin REF_CHARACTERISTIC /end REF_CHARACTERISTIC
 /begin REF_MEASUREMENT /end REF_MEASUREMENT
/end GROUP
/begin GROUP CalRegn03Rt00GroupA.DampgHydCoeff1ScaY.Ary1D "MICROSAR RTE" /begin SUB_GROUP /end SUB_GROUP /begin FUNCTION_LIST /end FUNCTION_LIST /begin REF_CHARACTERISTIC CalRegn03Rt00GroupA.DampgHydCoeff1ScaY.Ary1D /end REF_CHARACTERISTIC /begin REF_MEASUREMENT /end REF_MEASUREMENT /end GROUP
/begin GROUP CalRegn03Rt00GroupA.DampgHydCoeff2ScaY.Ary1D "MICROSAR RTE" /begin SUB_GROUP /end SUB_GROUP /begin FUNCTION_LIST /end FUNCTION_LIST /begin REF_CHARACTERISTIC CalRegn03Rt00GroupA.DampgHydCoeff2ScaY.Ary1D /end REF_CHARACTERISTIC /begin REF_MEASUREMENT /end REF_MEASUREMENT /end GROUP
/begin GROUP CalRegn03Rt00GroupA.DampgHydCoeff3ScaY.Ary1D "MICROSAR RTE" /begin SUB_GROUP /end SUB_GROUP /begin FUNCTION_LIST /end FUNCTION_LIST /begin REF_CHARACTERISTIC CalRegn03Rt00GroupA.DampgHydCoeff3ScaY.Ary1D /end REF_CHARACTERISTIC /begin REF_MEASUREMENT /end REF_MEASUREMENT /end GROUP
/begin GROUP CalRegn03Rt00GroupA.DampgHydCoeff4ScaY.Ary1D "MICROSAR RTE" /begin SUB_GROUP /end SUB_GROUP /begin FUNCTION_LIST /end FUNCTION_LIST /begin REF_CHARACTERISTIC CalRegn03Rt00GroupA.DampgHydCoeff4ScaY.Ary1D /end REF_CHARACTERISTIC /begin REF_MEASUREMENT /end REF_MEASUREMENT /end GROUP
/begin GROUP CalRegn03Rt00GroupA.DampgMotVelX.Ary2D "MICROSAR RTE" /begin SUB_GROUP /end SUB_GROUP /begin FUNCTION_LIST /end FUNCTION_LIST /begin REF_CHARACTERISTIC CalRegn03Rt00GroupA.DampgMotVelX.Ary2D /end REF_CHARACTERISTIC /begin REF_MEASUREMENT /end REF_MEASUREMENT /end GROUP
/begin GROUP CalRegn03Rt00GroupA.DampgMotVelY.Ary2D "MICROSAR RTE" /begin SUB_GROUP /end SUB_GROUP /begin FUNCTION_LIST /end FUNCTION_LIST /begin REF_CHARACTERISTIC CalRegn03Rt00GroupA.DampgMotVelY.Ary2D /end REF_CHARACTERISTIC /begin REF_MEASUREMENT /end REF_MEASUREMENT /end GROUP
/begin GROUP CalRegn03Rt00GroupA.HysCmpFricWhlImbRejctnBlndX.Ary1D "MICROSAR RTE" /begin SUB_GROUP /end SUB_GROUP /begin FUNCTION_LIST /end FUNCTION_LIST /begin REF_CHARACTERISTIC CalRegn03Rt00GroupA.HysCmpFricWhlImbRejctnBlndX.Ary1D /end REF_CHARACTERISTIC /begin REF_MEASUREMENT /end REF_MEASUREMENT /end GROUP
/begin GROUP CalRegn03Rt00GroupA.HysCmpFricWhlImbRejctnBlndY.Ary1D "MICROSAR RTE" /begin SUB_GROUP /end SUB_GROUP /begin FUNCTION_LIST /end FUNCTION_LIST /begin REF_CHARACTERISTIC CalRegn03Rt00GroupA.HysCmpFricWhlImbRejctnBlndY.Ary1D /end REF_CHARACTERISTIC /begin REF_MEASUREMENT /end REF_MEASUREMENT /end GROUP
/begin GROUP CalRegn03Rt00GroupA.HysCmpFricWhlImbRejctnOffY.Ary1D "MICROSAR RTE" /begin SUB_GROUP /end SUB_GROUP /begin FUNCTION_LIST /end FUNCTION_LIST /begin REF_CHARACTERISTIC CalRegn03Rt00GroupA.HysCmpFricWhlImbRejctnOffY.Ary1D /end REF_CHARACTERISTIC /begin REF_MEASUREMENT /end REF_MEASUREMENT /end GROUP
/begin GROUP CalRegn03Rt00GroupA.HysCmpFricWhlImbRejctnOnY.Ary1D "MICROSAR RTE" /begin SUB_GROUP /end SUB_GROUP /begin FUNCTION_LIST /end FUNCTION_LIST /begin REF_CHARACTERISTIC CalRegn03Rt00GroupA.HysCmpFricWhlImbRejctnOnY.Ary1D /end REF_CHARACTERISTIC /begin REF_MEASUREMENT /end REF_MEASUREMENT /end GROUP
/begin GROUP CalRegn03Rt00GroupA.InertiaCmpVelAssiBasdDampgCoeffX.Ary1D "MICROSAR RTE" /begin SUB_GROUP /end SUB_GROUP /begin FUNCTION_LIST /end FUNCTION_LIST /begin REF_CHARACTERISTIC CalRegn03Rt00GroupA.InertiaCmpVelAssiBasdDampgCoeffX.Ary1D /end REF_CHARACTERISTIC /begin REF_MEASUREMENT /end REF_MEASUREMENT /end GROUP
/begin GROUP CalRegn03Rt00GroupA.InertiaCmpVelAssiBasdDampgRollgY.Ary1D "MICROSAR RTE" /begin SUB_GROUP /end SUB_GROUP /begin FUNCTION_LIST /end FUNCTION_LIST /begin REF_CHARACTERISTIC CalRegn03Rt00GroupA.InertiaCmpVelAssiBasdDampgRollgY.Ary1D /end REF_CHARACTERISTIC /begin REF_MEASUREMENT /end REF_MEASUREMENT /end GROUP
/begin GROUP CalRegn03Rt00GroupA.InertiaCmpVelAssiBasdDampgStatY.Ary1D "MICROSAR RTE" /begin SUB_GROUP /end SUB_GROUP /begin FUNCTION_LIST /end FUNCTION_LIST /begin REF_CHARACTERISTIC CalRegn03Rt00GroupA.InertiaCmpVelAssiBasdDampgStatY.Ary1D /end REF_CHARACTERISTIC /begin REF_MEASUREMENT /end REF_MEASUREMENT /end GROUP
/begin GROUP CalRegn03Rt00GroupA.InertiaCmpVelDampgSpdBlndY.Ary1D "MICROSAR RTE" /begin SUB_GROUP /end SUB_GROUP /begin FUNCTION_LIST /end FUNCTION_LIST /begin REF_CHARACTERISTIC CalRegn03Rt00GroupA.InertiaCmpVelDampgSpdBlndY.Ary1D /end REF_CHARACTERISTIC /begin REF_MEASUREMENT /end REF_MEASUREMENT /end GROUP
/begin GROUP CalRegn03Rt00GroupA.InertiaCmpVelNotchBlndY.Ary1D "MICROSAR RTE" /begin SUB_GROUP /end SUB_GROUP /begin FUNCTION_LIST /end FUNCTION_LIST /begin REF_CHARACTERISTIC CalRegn03Rt00GroupA.InertiaCmpVelNotchBlndY.Ary1D /end REF_CHARACTERISTIC /begin REF_MEASUREMENT /end REF_MEASUREMENT /end GROUP
/begin GROUP CalRegn03Rt00GroupA.RtnHwAgOffsCalcdX.Ary2D "MICROSAR RTE" /begin SUB_GROUP /end SUB_GROUP /begin FUNCTION_LIST /end FUNCTION_LIST /begin REF_CHARACTERISTIC CalRegn03Rt00GroupA.RtnHwAgOffsCalcdX.Ary2D /end REF_CHARACTERISTIC /begin REF_MEASUREMENT /end REF_MEASUREMENT /end GROUP
/begin GROUP CalRegn03Rt00GroupA.RtnHwAgOffsCalcdY.Ary2D "MICROSAR RTE" /begin SUB_GROUP /end SUB_GROUP /begin FUNCTION_LIST /end FUNCTION_LIST /begin REF_CHARACTERISTIC CalRegn03Rt00GroupA.RtnHwAgOffsCalcdY.Ary2D /end REF_CHARACTERISTIC /begin REF_MEASUREMENT /end REF_MEASUREMENT /end GROUP
/begin GROUP CalRegn03Rt00GroupA.RtnScaTqX.Ary2D "MICROSAR RTE" /begin SUB_GROUP /end SUB_GROUP /begin FUNCTION_LIST /end FUNCTION_LIST /begin REF_CHARACTERISTIC CalRegn03Rt00GroupA.RtnScaTqX.Ary2D /end REF_CHARACTERISTIC /begin REF_MEASUREMENT /end REF_MEASUREMENT /end GROUP
/begin GROUP CalRegn03Rt00GroupA.RtnScaTqY.Ary2D "MICROSAR RTE" /begin SUB_GROUP /end SUB_GROUP /begin FUNCTION_LIST /end FUNCTION_LIST /begin REF_CHARACTERISTIC CalRegn03Rt00GroupA.RtnScaTqY.Ary2D /end REF_CHARACTERISTIC /begin REF_MEASUREMENT /end REF_MEASUREMENT /end GROUP
/begin GROUP CalRegn03Rt00GroupA.RtnScaVelX.Ary2D "MICROSAR RTE" /begin SUB_GROUP /end SUB_GROUP /begin FUNCTION_LIST /end FUNCTION_LIST /begin REF_CHARACTERISTIC CalRegn03Rt00GroupA.RtnScaVelX.Ary2D /end REF_CHARACTERISTIC /begin REF_MEASUREMENT /end REF_MEASUREMENT /end GROUP
/begin GROUP CalRegn03Rt00GroupA.RtnScaVelY.Ary2D "MICROSAR RTE" /begin SUB_GROUP /end SUB_GROUP /begin FUNCTION_LIST /end FUNCTION_LIST /begin REF_CHARACTERISTIC CalRegn03Rt00GroupA.RtnScaVelY.Ary2D /end REF_CHARACTERISTIC /begin REF_MEASUREMENT /end REF_MEASUREMENT /end GROUP
/begin GROUP CalRegn03Rt00GroupB "MICROSAR RTE" /begin SUB_GROUP CalRegn03Rt00GroupB.CalibrationPorts /end SUB_GROUP /begin FUNCTION_LIST /end FUNCTION_LIST /begin REF_CHARACTERISTIC /end REF_CHARACTERISTIC /begin REF_MEASUREMENT /end REF_MEASUREMENT /end GROUP
/begin GROUP CalRegn03Rt00GroupB.AssiHiFrqTqWhlImbRejctnTqX.Ary2D "MICROSAR RTE" /begin SUB_GROUP /end SUB_GROUP /begin FUNCTION_LIST /end FUNCTION_LIST /begin REF_CHARACTERISTIC CalRegn03Rt00GroupB.AssiHiFrqTqWhlImbRejctnTqX.Ary2D /end REF_CHARACTERISTIC /begin REF_MEASUREMENT /end REF_MEASUREMENT /end GROUP
/begin GROUP CalRegn03Rt00GroupB.AssiHiFrqWhlImbRejctnGainY.Ary2D "MICROSAR RTE" /begin SUB_GROUP /end SUB_GROUP /begin FUNCTION_LIST /end FUNCTION_LIST /begin REF_CHARACTERISTIC CalRegn03Rt00GroupB.AssiHiFrqWhlImbRejctnGainY.Ary2D /end REF_CHARACTERISTIC /begin REF_MEASUREMENT /end REF_MEASUREMENT /end GROUP
/begin GROUP CalRegn03Rt00GroupB.AssiHiFrqWhlImbRejtcnBlndX.Ary2D "MICROSAR RTE" /begin SUB_GROUP /end SUB_GROUP /begin FUNCTION_LIST /end FUNCTION_LIST /begin REF_CHARACTERISTIC CalRegn03Rt00GroupB.AssiHiFrqWhlImbRejtcnBlndX.Ary2D /end REF_CHARACTERISTIC /begin REF_MEASUREMENT /end REF_MEASUREMENT /end GROUP
/begin GROUP CalRegn03Rt00GroupB.AssiHiFrqWhlImbRejtcnBlndY.Ary2D "MICROSAR RTE" /begin SUB_GROUP /end SUB_GROUP /begin FUNCTION_LIST /end FUNCTION_LIST /begin REF_CHARACTERISTIC CalRegn03Rt00GroupB.AssiHiFrqWhlImbRejtcnBlndY.Ary2D /end REF_CHARACTERISTIC /begin REF_MEASUREMENT /end REF_MEASUREMENT /end GROUP
/begin GROUP CalRegn03Rt00GroupB.AssiMotTqWhlImbRejctnMaxX.Ary2D "MICROSAR RTE" /begin SUB_GROUP /end SUB_GROUP /begin FUNCTION_LIST /end FUNCTION_LIST /begin REF_CHARACTERISTIC CalRegn03Rt00GroupB.AssiMotTqWhlImbRejctnMaxX.Ary2D /end REF_CHARACTERISTIC /begin REF_MEASUREMENT /end REF_MEASUREMENT /end GROUP
/begin GROUP CalRegn03Rt00GroupB.AssiMotTqWhlImbRejctnMaxY.Ary2D "MICROSAR RTE" /begin SUB_GROUP /end SUB_GROUP /begin FUNCTION_LIST /end FUNCTION_LIST /begin REF_CHARACTERISTIC CalRegn03Rt00GroupB.AssiMotTqWhlImbRejctnMaxY.Ary2D /end REF_CHARACTERISTIC /begin REF_MEASUREMENT /end REF_MEASUREMENT /end GROUP
/begin GROUP CalRegn03Rt00GroupB.AssiWhlImbRejctnBlndScaX.Ary2D "MICROSAR RTE" /begin SUB_GROUP /end SUB_GROUP /begin FUNCTION_LIST /end FUNCTION_LIST /begin REF_CHARACTERISTIC CalRegn03Rt00GroupB.AssiWhlImbRejctnBlndScaX.Ary2D /end REF_CHARACTERISTIC /begin REF_MEASUREMENT /end REF_MEASUREMENT /end GROUP
/begin GROUP CalRegn03Rt00GroupB.AssiWhlImbRejctnBlndScaY.Ary2D "MICROSAR RTE" /begin SUB_GROUP /end SUB_GROUP /begin FUNCTION_LIST /end FUNCTION_LIST /begin REF_CHARACTERISTIC CalRegn03Rt00GroupB.AssiWhlImbRejctnBlndScaY.Ary2D /end REF_CHARACTERISTIC /begin REF_MEASUREMENT /end REF_MEASUREMENT /end GROUP
/begin GROUP CalRegn03Rt00GroupB.CalibrationPorts "MICROSAR RTE"
 /begin SUB_GROUP CalRegn03Rt00GroupB.AssiHiFrqTqWhlImbRejctnTqX.Ary2D CalRegn03Rt00GroupB.AssiHiFrqWhlImbRejctnGainY.Ary2D CalRegn03Rt00GroupB.AssiHiFrqWhlImbRejtcnBlndX.Ary2D CalRegn03Rt00GroupB.AssiHiFrqWhlImbRejtcnBlndY.Ary2D CalRegn03Rt00GroupB.AssiMotTqWhlImbRejctnMaxX.Ary2D CalRegn03Rt00GroupB.AssiMotTqWhlImbRejctnMaxY.Ary2D CalRegn03Rt00GroupB.AssiWhlImbRejctnBlndScaX.Ary2D CalRegn03Rt00GroupB.AssiWhlImbRejctnBlndScaY.Ary2D CalRegn03Rt00GroupB.EotProtnDampgVehSpdTbl.Ary1D CalRegn03Rt00GroupB.EotProtnEntrGainVehSpdTbl.Ary1D CalRegn03Rt00GroupB.EotProtnEntrGainX.Ary2D CalRegn03Rt00GroupB.EotProtnEntrGainY.Ary2D CalRegn03Rt00GroupB.EotProtnExitDampgY.Ary2D CalRegn03Rt00GroupB.EotProtnHwDegDampgX.Ary2D CalRegn03Rt00GroupB.EotProtnNormDampgY.Ary2D CalRegn03Rt00GroupB.InertiaCmpVelAssiBasdDampgRollgWhlImbRejctnOnY.Ary1D /end SUB_GROUP
 /begin FUNCTION_LIST /end FUNCTION_LIST
 /begin REF_CHARACTERISTIC /end REF_CHARACTERISTIC
 /begin REF_MEASUREMENT /end REF_MEASUREMENT
/end GROUP
/begin GROUP CalRegn03Rt00GroupB.EotProtnDampgVehSpdTbl.Ary1D "MICROSAR RTE" /begin SUB_GROUP /end SUB_GROUP /begin FUNCTION_LIST /end FUNCTION_LIST /begin REF_CHARACTERISTIC CalRegn03Rt00GroupB.EotProtnDampgVehSpdTbl.Ary1D /end REF_CHARACTERISTIC /begin REF_MEASUREMENT /end REF_MEASUREMENT /end GROUP
/begin GROUP CalRegn03Rt00GroupB.EotProtnEntrGainVehSpdTbl.Ary1D "MICROSAR RTE" /begin SUB_GROUP /end SUB_GROUP /begin FUNCTION_LIST /end FUNCTION_LIST /begin REF_CHARACTERISTIC CalRegn03Rt00GroupB.EotProtnEntrGainVehSpdTbl.Ary1D /end REF_CHARACTERISTIC /begin REF_MEASUREMENT /end REF_MEASUREMENT /end GROUP
/begin GROUP CalRegn03Rt00GroupB.EotProtnEntrGainX.Ary2D "MICROSAR RTE" /begin SUB_GROUP /end SUB_GROUP /begin FUNCTION_LIST /end FUNCTION_LIST /begin REF_CHARACTERISTIC CalRegn03Rt00GroupB.EotProtnEntrGainX.Ary2D /end REF_CHARACTERISTIC /begin REF_MEASUREMENT /end REF_MEASUREMENT /end GROUP
/begin GROUP CalRegn03Rt00GroupB.EotProtnEntrGainY.Ary2D "MICROSAR RTE" /begin SUB_GROUP /end SUB_GROUP /begin FUNCTION_LIST /end FUNCTION_LIST /begin REF_CHARACTERISTIC CalRegn03Rt00GroupB.EotProtnEntrGainY.Ary2D /end REF_CHARACTERISTIC /begin REF_MEASUREMENT /end REF_MEASUREMENT /end GROUP
/begin GROUP CalRegn03Rt00GroupB.EotProtnExitDampgY.Ary2D "MICROSAR RTE" /begin SUB_GROUP /end SUB_GROUP /begin FUNCTION_LIST /end FUNCTION_LIST /begin REF_CHARACTERISTIC CalRegn03Rt00GroupB.EotProtnExitDampgY.Ary2D /end REF_CHARACTERISTIC /begin REF_MEASUREMENT /end REF_MEASUREMENT /end GROUP
/begin GROUP CalRegn03Rt00GroupB.EotProtnHwDegDampgX.Ary2D "MICROSAR RTE" /begin SUB_GROUP /end SUB_GROUP /begin FUNCTION_LIST /end FUNCTION_LIST /begin REF_CHARACTERISTIC CalRegn03Rt00GroupB.EotProtnHwDegDampgX.Ary2D /end REF_CHARACTERISTIC /begin REF_MEASUREMENT /end REF_MEASUREMENT /end GROUP
/begin GROUP CalRegn03Rt00GroupB.EotProtnNormDampgY.Ary2D "MICROSAR RTE" /begin SUB_GROUP /end SUB_GROUP /begin FUNCTION_LIST /end FUNCTION_LIST /begin REF_CHARACTERISTIC CalRegn03Rt00GroupB.EotProtnNormDampgY.Ary2D /end REF_CHARACTERISTIC /begin REF_MEASUREMENT /end REF_MEASUREMENT /end GROUP
/begin GROUP CalRegn03Rt00GroupB.InertiaCmpVelAssiBasdDampgRollgWhlImbRejctnOnY.Ary1D "MICROSAR RTE" /begin SUB_GROUP /end SUB_GROUP /begin FUNCTION_LIST /end FUNCTION_LIST
 /begin REF_CHARACTERISTIC CalRegn03Rt00GroupB.InertiaCmpVelAssiBasdDampgRollgWhlImbRejctnOnY.Ary1D /end REF_CHARACTERISTIC
 /begin REF_MEASUREMENT /end REF_MEASUREMENT
/end GROUP
/begin GROUP CalRegn03Rt01 "MICROSAR RTE" /begin SUB_GROUP CalRegn03Rt01.CalibrationPorts /end SUB_GROUP /begin FUNCTION_LIST /end FUNCTION_LIST /begin REF_CHARACTERISTIC /end REF_CHARACTERISTIC /begin REF_MEASUREMENT /end REF_MEASUREMENT /end GROUP
/begin GROUP CalRegn03Rt01.CalibrationPorts "MICROSAR RTE"
 /begin SUB_GROUP CalRegn03Rt01.InertiaCmpVelDampgFilFrq.Ary1D CalRegn03Rt01.InertiaCmpVelDampgFilFrqWhlImbRejctnOn.Ary1D /end SUB_GROUP
 /begin FUNCTION_LIST /end FUNCTION_LIST
 /begin REF_CHARACTERISTIC /end REF_CHARACTERISTIC
 /begin REF_MEASUREMENT /end REF_MEASUREMENT
/end GROUP
/begin GROUP CalRegn03Rt01.InertiaCmpVelDampgFilFrq.Ary1D "MICROSAR RTE" /begin SUB_GROUP /end SUB_GROUP /begin FUNCTION_LIST /end FUNCTION_LIST /begin REF_CHARACTERISTIC CalRegn03Rt01.InertiaCmpVelDampgFilFrq.Ary1D /end REF_CHARACTERISTIC /begin REF_MEASUREMENT /end REF_MEASUREMENT /end GROUP
/begin GROUP CalRegn03Rt01.InertiaCmpVelDampgFilFrqWhlImbRejctnOn.Ary1D "MICROSAR RTE" /begin SUB_GROUP /end SUB_GROUP /begin FUNCTION_LIST /end FUNCTION_LIST /begin REF_CHARACTERISTIC CalRegn03Rt01.InertiaCmpVelDampgFilFrqWhlImbRejctnOn.Ary1D /end REF_CHARACTERISTIC /begin REF_MEASUREMENT /end REF_MEASUREMENT /end GROUP
/begin GROUP CalRegn03Rt01GroupA "MICROSAR RTE" /begin SUB_GROUP CalRegn03Rt01GroupA.CalibrationPorts /end SUB_GROUP /begin FUNCTION_LIST /end FUNCTION_LIST /begin REF_CHARACTERISTIC /end REF_CHARACTERISTIC /begin REF_MEASUREMENT /end REF_MEASUREMENT /end GROUP
/begin GROUP CalRegn03Rt01GroupA.AssiHiFrqGainY.Ary2D "MICROSAR RTE" /begin SUB_GROUP /end SUB_GROUP /begin FUNCTION_LIST /end FUNCTION_LIST /begin REF_CHARACTERISTIC CalRegn03Rt01GroupA.AssiHiFrqGainY.Ary2D /end REF_CHARACTERISTIC /begin REF_MEASUREMENT /end REF_MEASUREMENT /end GROUP
/begin GROUP CalRegn03Rt01GroupA.AssiHiFrqTqX.Ary2D "MICROSAR RTE" /begin SUB_GROUP /end SUB_GROUP /begin FUNCTION_LIST /end FUNCTION_LIST /begin REF_CHARACTERISTIC CalRegn03Rt01GroupA.AssiHiFrqTqX.Ary2D /end REF_CHARACTERISTIC /begin REF_MEASUREMENT /end REF_MEASUREMENT /end GROUP
/begin GROUP CalRegn03Rt01GroupA.AssiMotTqWhlImbRejctnMinX.Ary2D "MICROSAR RTE" /begin SUB_GROUP /end SUB_GROUP /begin FUNCTION_LIST /end FUNCTION_LIST /begin REF_CHARACTERISTIC CalRegn03Rt01GroupA.AssiMotTqWhlImbRejctnMinX.Ary2D /end REF_CHARACTERISTIC /begin REF_MEASUREMENT /end REF_MEASUREMENT /end GROUP
/begin GROUP CalRegn03Rt01GroupA.AssiMotTqWhlImbRejctnMinY.Ary2D "MICROSAR RTE" /begin SUB_GROUP /end SUB_GROUP /begin FUNCTION_LIST /end FUNCTION_LIST /begin REF_CHARACTERISTIC CalRegn03Rt01GroupA.AssiMotTqWhlImbRejctnMinY.Ary2D /end REF_CHARACTERISTIC /begin REF_MEASUREMENT /end REF_MEASUREMENT /end GROUP
/begin GROUP CalRegn03Rt01GroupA.CalibrationPorts "MICROSAR RTE"
 /begin SUB_GROUP CalRegn03Rt01GroupA.AssiHiFrqGainY.Ary2D CalRegn03Rt01GroupA.AssiHiFrqTqX.Ary2D CalRegn03Rt01GroupA.AssiMotTqWhlImbRejctnMinX.Ary2D CalRegn03Rt01GroupA.AssiMotTqWhlImbRejctnMinY.Ary2D CalRegn03Rt01GroupA.DampgHydCoeff1ScaY.Ary1D CalRegn03Rt01GroupA.DampgHydCoeff2ScaY.Ary1D CalRegn03Rt01GroupA.DampgHydCoeff3ScaY.Ary1D CalRegn03Rt01GroupA.DampgHydCoeff4ScaY.Ary1D CalRegn03Rt01GroupA.DampgMotVelX.Ary2D CalRegn03Rt01GroupA.DampgMotVelY.Ary2D CalRegn03Rt01GroupA.HysCmpFricWhlImbRejctnBlndX.Ary1D CalRegn03Rt01GroupA.HysCmpFricWhlImbRejctnBlndY.Ary1D CalRegn03Rt01GroupA.HysCmpFricWhlImbRejctnOffY.Ary1D CalRegn03Rt01GroupA.HysCmpFricWhlImbRejctnOnY.Ary1D CalRegn03Rt01GroupA.InertiaCmpVelAssiBasdDampgCoeffX.Ary1D CalRegn03Rt01GroupA.InertiaCmpVelAssiBasdDampgRollgY.Ary1D CalRegn03Rt01GroupA.InertiaCmpVelAssiBasdDampgStatY.Ary1D CalRegn03Rt01GroupA.InertiaCmpVelDampgSpdBlndY.Ary1D CalRegn03Rt01GroupA.InertiaCmpVelNotchBlndY.Ary1D CalRegn03Rt01GroupA.RtnHwAgOffsCalcdX.Ary2D CalRegn03Rt01GroupA.RtnHwAgOffsCalcdY.Ary2D CalRegn03Rt01GroupA.RtnScaTqX.Ary2D CalRegn03Rt01GroupA.RtnScaTqY.Ary2D CalRegn03Rt01GroupA.RtnScaVelX.Ary2D CalRegn03Rt01GroupA.RtnScaVelY.Ary2D /end SUB_GROUP
 /begin FUNCTION_LIST /end FUNCTION_LIST
 /begin REF_CHARACTERISTIC /end REF_CHARACTERISTIC
 /begin REF_MEASUREMENT /end REF_MEASUREMENT
/end GROUP
/begin GROUP CalRegn03Rt01GroupA.DampgHydCoeff1ScaY.Ary1D "MICROSAR RTE" /begin SUB_GROUP /end SUB_GROUP /begin FUNCTION_LIST /end FUNCTION_LIST /begin REF_CHARACTERISTIC CalRegn03Rt01GroupA.DampgHydCoeff1ScaY.Ary1D /end REF_CHARACTERISTIC /begin REF_MEASUREMENT /end REF_MEASUREMENT /end GROUP
/begin GROUP CalRegn03Rt01GroupA.DampgHydCoeff2ScaY.Ary1D "MICROSAR RTE" /begin SUB_GROUP /end SUB_GROUP /begin FUNCTION_LIST /end FUNCTION_LIST /begin REF_CHARACTERISTIC CalRegn03Rt01GroupA.DampgHydCoeff2ScaY.Ary1D /end REF_CHARACTERISTIC /begin REF_MEASUREMENT /end REF_MEASUREMENT /end GROUP
/begin GROUP CalRegn03Rt01GroupA.DampgHydCoeff3ScaY.Ary1D "MICROSAR RTE" /begin SUB_GROUP /end SUB_GROUP /begin FUNCTION_LIST /end FUNCTION_LIST /begin REF_CHARACTERISTIC CalRegn03Rt01GroupA.DampgHydCoeff3ScaY.Ary1D /end REF_CHARACTERISTIC /begin REF_MEASUREMENT /end REF_MEASUREMENT /end GROUP
/begin GROUP CalRegn03Rt01GroupA.DampgHydCoeff4ScaY.Ary1D "MICROSAR RTE" /begin SUB_GROUP /end SUB_GROUP /begin FUNCTION_LIST /end FUNCTION_LIST /begin REF_CHARACTERISTIC CalRegn03Rt01GroupA.DampgHydCoeff4ScaY.Ary1D /end REF_CHARACTERISTIC /begin REF_MEASUREMENT /end REF_MEASUREMENT /end GROUP
/begin GROUP CalRegn03Rt01GroupA.DampgMotVelX.Ary2D "MICROSAR RTE" /begin SUB_GROUP /end SUB_GROUP /begin FUNCTION_LIST /end FUNCTION_LIST /begin REF_CHARACTERISTIC CalRegn03Rt01GroupA.DampgMotVelX.Ary2D /end REF_CHARACTERISTIC /begin REF_MEASUREMENT /end REF_MEASUREMENT /end GROUP
/begin GROUP CalRegn03Rt01GroupA.DampgMotVelY.Ary2D "MICROSAR RTE" /begin SUB_GROUP /end SUB_GROUP /begin FUNCTION_LIST /end FUNCTION_LIST /begin REF_CHARACTERISTIC CalRegn03Rt01GroupA.DampgMotVelY.Ary2D /end REF_CHARACTERISTIC /begin REF_MEASUREMENT /end REF_MEASUREMENT /end GROUP
/begin GROUP CalRegn03Rt01GroupA.HysCmpFricWhlImbRejctnBlndX.Ary1D "MICROSAR RTE" /begin SUB_GROUP /end SUB_GROUP /begin FUNCTION_LIST /end FUNCTION_LIST /begin REF_CHARACTERISTIC CalRegn03Rt01GroupA.HysCmpFricWhlImbRejctnBlndX.Ary1D /end REF_CHARACTERISTIC /begin REF_MEASUREMENT /end REF_MEASUREMENT /end GROUP
/begin GROUP CalRegn03Rt01GroupA.HysCmpFricWhlImbRejctnBlndY.Ary1D "MICROSAR RTE" /begin SUB_GROUP /end SUB_GROUP /begin FUNCTION_LIST /end FUNCTION_LIST /begin REF_CHARACTERISTIC CalRegn03Rt01GroupA.HysCmpFricWhlImbRejctnBlndY.Ary1D /end REF_CHARACTERISTIC /begin REF_MEASUREMENT /end REF_MEASUREMENT /end GROUP
/begin GROUP CalRegn03Rt01GroupA.HysCmpFricWhlImbRejctnOffY.Ary1D "MICROSAR RTE" /begin SUB_GROUP /end SUB_GROUP /begin FUNCTION_LIST /end FUNCTION_LIST /begin REF_CHARACTERISTIC CalRegn03Rt01GroupA.HysCmpFricWhlImbRejctnOffY.Ary1D /end REF_CHARACTERISTIC /begin REF_MEASUREMENT /end REF_MEASUREMENT /end GROUP
/begin GROUP CalRegn03Rt01GroupA.HysCmpFricWhlImbRejctnOnY.Ary1D "MICROSAR RTE" /begin SUB_GROUP /end SUB_GROUP /begin FUNCTION_LIST /end FUNCTION_LIST /begin REF_CHARACTERISTIC CalRegn03Rt01GroupA.HysCmpFricWhlImbRejctnOnY.Ary1D /end REF_CHARACTERISTIC /begin REF_MEASUREMENT /end REF_MEASUREMENT /end GROUP
/begin GROUP CalRegn03Rt01GroupA.InertiaCmpVelAssiBasdDampgCoeffX.Ary1D "MICROSAR RTE" /begin SUB_GROUP /end SUB_GROUP /begin FUNCTION_LIST /end FUNCTION_LIST /begin REF_CHARACTERISTIC CalRegn03Rt01GroupA.InertiaCmpVelAssiBasdDampgCoeffX.Ary1D /end REF_CHARACTERISTIC /begin REF_MEASUREMENT /end REF_MEASUREMENT /end GROUP
/begin GROUP CalRegn03Rt01GroupA.InertiaCmpVelAssiBasdDampgRollgY.Ary1D "MICROSAR RTE" /begin SUB_GROUP /end SUB_GROUP /begin FUNCTION_LIST /end FUNCTION_LIST /begin REF_CHARACTERISTIC CalRegn03Rt01GroupA.InertiaCmpVelAssiBasdDampgRollgY.Ary1D /end REF_CHARACTERISTIC /begin REF_MEASUREMENT /end REF_MEASUREMENT /end GROUP
/begin GROUP CalRegn03Rt01GroupA.InertiaCmpVelAssiBasdDampgStatY.Ary1D "MICROSAR RTE" /begin SUB_GROUP /end SUB_GROUP /begin FUNCTION_LIST /end FUNCTION_LIST /begin REF_CHARACTERISTIC CalRegn03Rt01GroupA.InertiaCmpVelAssiBasdDampgStatY.Ary1D /end REF_CHARACTERISTIC /begin REF_MEASUREMENT /end REF_MEASUREMENT /end GROUP
/begin GROUP CalRegn03Rt01GroupA.InertiaCmpVelDampgSpdBlndY.Ary1D "MICROSAR RTE" /begin SUB_GROUP /end SUB_GROUP /begin FUNCTION_LIST /end FUNCTION_LIST /begin REF_CHARACTERISTIC CalRegn03Rt01GroupA.InertiaCmpVelDampgSpdBlndY.Ary1D /end REF_CHARACTERISTIC /begin REF_MEASUREMENT /end REF_MEASUREMENT /end GROUP
/begin GROUP CalRegn03Rt01GroupA.InertiaCmpVelNotchBlndY.Ary1D "MICROSAR RTE" /begin SUB_GROUP /end SUB_GROUP /begin FUNCTION_LIST /end FUNCTION_LIST /begin REF_CHARACTERISTIC CalRegn03Rt01GroupA.InertiaCmpVelNotchBlndY.Ary1D /end REF_CHARACTERISTIC /begin REF_MEASUREMENT /end REF_MEASUREMENT /end GROUP
/begin GROUP CalRegn03Rt01GroupA.RtnHwAgOffsCalcdX.Ary2D "MICROSAR RTE" /begin SUB_GROUP /end SUB_GROUP /begin FUNCTION_LIST /end FUNCTION_LIST /begin REF_CHARACTERISTIC CalRegn03Rt01GroupA.RtnHwAgOffsCalcdX.Ary2D /end REF_CHARACTERISTIC /begin REF_MEASUREMENT /end REF_MEASUREMENT /end GROUP
/begin GROUP CalRegn03Rt01GroupA.RtnHwAgOffsCalcdY.Ary2D "MICROSAR RTE" /begin SUB_GROUP /end SUB_GROUP /begin FUNCTION_LIST /end FUNCTION_LIST /begin REF_CHARACTERISTIC CalRegn03Rt01GroupA.RtnHwAgOffsCalcdY.Ary2D /end REF_CHARACTERISTIC /begin REF_MEASUREMENT /end REF_MEASUREMENT /end GROUP
/begin GROUP CalRegn03Rt01GroupA.RtnScaTqX.Ary2D "MICROSAR RTE" /begin SUB_GROUP /end SUB_GROUP /begin FUNCTION_LIST /end FUNCTION_LIST /begin REF_CHARACTERISTIC CalRegn03Rt01GroupA.RtnScaTqX.Ary2D /end REF_CHARACTERISTIC /begin REF_MEASUREMENT /end REF_MEASUREMENT /end GROUP
/begin GROUP CalRegn03Rt01GroupA.RtnScaTqY.Ary2D "MICROSAR RTE" /begin SUB_GROUP /end SUB_GROUP /begin FUNCTION_LIST /end FUNCTION_LIST /begin REF_CHARACTERISTIC CalRegn03Rt01GroupA.RtnScaTqY.Ary2D /end REF_CHARACTERISTIC /begin REF_MEASUREMENT /end REF_MEASUREMENT /end GROUP
/begin GROUP CalRegn03Rt01GroupA.RtnScaVelX.Ary2D "MICROSAR RTE" /begin SUB_GROUP /end SUB_GROUP /begin FUNCTION_LIST /end FUNCTION_LIST /begin REF_CHARACTERISTIC CalRegn03Rt01GroupA.RtnScaVelX.Ary2D /end REF_CHARACTERISTIC /begin REF_MEASUREMENT /end REF_MEASUREMENT /end GROUP
/begin GROUP CalRegn03Rt01GroupA.RtnScaVelY.Ary2D "MICROSAR RTE" /begin SUB_GROUP /end SUB_GROUP /begin FUNCTION_LIST /end FUNCTION_LIST /begin REF_CHARACTERISTIC CalRegn03Rt01GroupA.RtnScaVelY.Ary2D /end REF_CHARACTERISTIC /begin REF_MEASUREMENT /end REF_MEASUREMENT /end GROUP
/begin GROUP CalRegn03Rt01GroupA_Dummy "MICROSAR RTE" /begin SUB_GROUP CalRegn03Rt01GroupA_Dummy.CalibrationPorts /end SUB_GROUP /begin FUNCTION_LIST /end FUNCTION_LIST /begin REF_CHARACTERISTIC /end REF_CHARACTERISTIC /begin REF_MEASUREMENT /end REF_MEASUREMENT /end GROUP
/begin GROUP CalRegn03Rt01GroupA_Dummy.AssiHiFrqGainY.Ary2D "MICROSAR RTE" /begin SUB_GROUP /end SUB_GROUP /begin FUNCTION_LIST /end FUNCTION_LIST /begin REF_CHARACTERISTIC CalRegn03Rt01GroupA_Dummy.AssiHiFrqGainY.Ary2D /end REF_CHARACTERISTIC /begin REF_MEASUREMENT /end REF_MEASUREMENT /end GROUP
/begin GROUP CalRegn03Rt01GroupA_Dummy.AssiHiFrqTqX.Ary2D "MICROSAR RTE" /begin SUB_GROUP /end SUB_GROUP /begin FUNCTION_LIST /end FUNCTION_LIST /begin REF_CHARACTERISTIC CalRegn03Rt01GroupA_Dummy.AssiHiFrqTqX.Ary2D /end REF_CHARACTERISTIC /begin REF_MEASUREMENT /end REF_MEASUREMENT /end GROUP
/begin GROUP CalRegn03Rt01GroupA_Dummy.AssiMotTqWhlImbRejctnMinX.Ary2D "MICROSAR RTE" /begin SUB_GROUP /end SUB_GROUP /begin FUNCTION_LIST /end FUNCTION_LIST /begin REF_CHARACTERISTIC CalRegn03Rt01GroupA_Dummy.AssiMotTqWhlImbRejctnMinX.Ary2D /end REF_CHARACTERISTIC /begin REF_MEASUREMENT /end REF_MEASUREMENT /end GROUP
/begin GROUP CalRegn03Rt01GroupA_Dummy.AssiMotTqWhlImbRejctnMinY.Ary2D "MICROSAR RTE" /begin SUB_GROUP /end SUB_GROUP /begin FUNCTION_LIST /end FUNCTION_LIST /begin REF_CHARACTERISTIC CalRegn03Rt01GroupA_Dummy.AssiMotTqWhlImbRejctnMinY.Ary2D /end REF_CHARACTERISTIC /begin REF_MEASUREMENT /end REF_MEASUREMENT /end GROUP
/begin GROUP CalRegn03Rt01GroupA_Dummy.CalibrationPorts "MICROSAR RTE"
 /begin SUB_GROUP CalRegn03Rt01GroupA_Dummy.AssiHiFrqGainY.Ary2D CalRegn03Rt01GroupA_Dummy.AssiHiFrqTqX.Ary2D CalRegn03Rt01GroupA_Dummy.AssiMotTqWhlImbRejctnMinX.Ary2D CalRegn03Rt01GroupA_Dummy.AssiMotTqWhlImbRejctnMinY.Ary2D CalRegn03Rt01GroupA_Dummy.DampgHydCoeff1ScaY.Ary1D CalRegn03Rt01GroupA_Dummy.DampgHydCoeff2ScaY.Ary1D CalRegn03Rt01GroupA_Dummy.DampgHydCoeff3ScaY.Ary1D CalRegn03Rt01GroupA_Dummy.DampgHydCoeff4ScaY.Ary1D CalRegn03Rt01GroupA_Dummy.DampgMotVelX.Ary2D CalRegn03Rt01GroupA_Dummy.DampgMotVelY.Ary2D CalRegn03Rt01GroupA_Dummy.HysCmpFricWhlImbRejctnBlndX.Ary1D CalRegn03Rt01GroupA_Dummy.HysCmpFricWhlImbRejctnBlndY.Ary1D CalRegn03Rt01GroupA_Dummy.HysCmpFricWhlImbRejctnOffY.Ary1D CalRegn03Rt01GroupA_Dummy.HysCmpFricWhlImbRejctnOnY.Ary1D CalRegn03Rt01GroupA_Dummy.InertiaCmpVelAssiBasdDampgCoeffX.Ary1D CalRegn03Rt01GroupA_Dummy.InertiaCmpVelAssiBasdDampgRollgY.Ary1D CalRegn03Rt01GroupA_Dummy.InertiaCmpVelAssiBasdDampgStatY.Ary1D CalRegn03Rt01GroupA_Dummy.InertiaCmpVelDampgSpdBlndY.Ary1D CalRegn03Rt01GroupA_Dummy.InertiaCmpVelNotchBlndY.Ary1D CalRegn03Rt01GroupA_Dummy.RtnHwAgOffsCalcdX.Ary2D CalRegn03Rt01GroupA_Dummy.RtnHwAgOffsCalcdY.Ary2D CalRegn03Rt01GroupA_Dummy.RtnScaTqX.Ary2D CalRegn03Rt01GroupA_Dummy.RtnScaTqY.Ary2D CalRegn03Rt01GroupA_Dummy.RtnScaVelX.Ary2D CalRegn03Rt01GroupA_Dummy.RtnScaVelY.Ary2D /end SUB_GROUP
 /begin FUNCTION_LIST /end FUNCTION_LIST
 /begin REF_CHARACTERISTIC /end REF_CHARACTERISTIC
 /begin REF_MEASUREMENT /end REF_MEASUREMENT
/end GROUP
/begin GROUP CalRegn03Rt01GroupA_Dummy.DampgHydCoeff1ScaY.Ary1D "MICROSAR RTE" /begin SUB_GROUP /end SUB_GROUP /begin FUNCTION_LIST /end FUNCTION_LIST /begin REF_CHARACTERISTIC CalRegn03Rt01GroupA_Dummy.DampgHydCoeff1ScaY.Ary1D /end REF_CHARACTERISTIC /begin REF_MEASUREMENT /end REF_MEASUREMENT /end GROUP
/begin GROUP CalRegn03Rt01GroupA_Dummy.DampgHydCoeff2ScaY.Ary1D "MICROSAR RTE" /begin SUB_GROUP /end SUB_GROUP /begin FUNCTION_LIST /end FUNCTION_LIST /begin REF_CHARACTERISTIC CalRegn03Rt01GroupA_Dummy.DampgHydCoeff2ScaY.Ary1D /end REF_CHARACTERISTIC /begin REF_MEASUREMENT /end REF_MEASUREMENT /end GROUP
/**********************************************************************************************************************
* RECORD_LAYOUT
*********************************************************************************************************************/
/begin RECORD_LAYOUT RTE_RL_UBYTE FNC_VALUES 1 UBYTE ROW_DIR DIRECT /end RECORD_LAYOUT
/begin RECORD_LAYOUT RTE_RL_UWORD FNC_VALUES 1 UWORD ROW_DIR DIRECT /end RECORD_LAYOUT
/begin RECORD_LAYOUT RTE_RL_ULONG FNC_VALUES 1 ULONG ROW_DIR DIRECT /end RECORD_LAYOUT
/begin RECORD_LAYOUT RTE_RL_SWORD FNC_VALUES 1 SWORD ROW_DIR DIRECT /end RECORD_LAYOUT
/begin RECORD_LAYOUT RTE_RL_FLOAT32_IEEE FNC_VALUES 1 FLOAT32_IEEE ROW_DIR DIRECT /end RECORD_LAYOUT
/begin RECORD_LAYOUT RTE_RL_BOOLEAN FNC_VALUES 1 UBYTE ROW_DIR DIRECT /end RECORD_LAYOUT
/**********************************************************************************************************************
* COMPU_METHOD / COMPU_VTAB_RANGE
*********************************************************************************************************************/
/begin COMPU_METHOD RTE_CM_BOOLEAN "" TAB_VERB "%3.1" "" COMPU_TAB_REF RTE_CM_BOOLEAN /end COMPU_METHOD
/begin COMPU_VTAB_RANGE RTE_CM_BOOLEAN "" 2 0 0 "false" 1 255 "true" /end COMPU_VTAB_RANGE
/begin COMPU_METHOD RTE_CM_Tq6 "" RAT_FUNC "%.1" "HwNm" COEFFS 0 256 0 0 0 1 /end COMPU_METHOD
/begin COMPU_METHOD RTE_CM_Tq11 "" RAT_FUNC "%.1" "MotNm" COEFFS 0 2048 0 0 0 1 /end COMPU_METHOD
/begin COMPU_METHOD RTE_CM_Uls4 "" RAT_FUNC "%.1" "Uls" COEFFS 0 16384 0 0 0 1 /end COMPU_METHOD
/begin COMPU_METHOD RTE_CM_Tq12 "" RAT_FUNC "%.1" "MotNm" COEFFS 0 2048 0 0 0 1 /end COMPU_METHOD
/begin COMPU_METHOD RTE_CM_Tq13 "" RAT_FUNC "%.1" "MotNm" COEFFS 0 0.000244140625 0 0 0 1 /end COMPU_METHOD
/begin COMPU_METHOD RTE_CM_Uls17 "" RAT_FUNC "%.1" "Uls" COEFFS 0 256 0 0 0 1 /end COMPU_METHOD
/begin COMPU_METHOD RTE_CM_Uls18 "" RAT_FUNC "%.1" "Uls" COEFFS 0 128 0 0 0 1 /end COMPU_METHOD
/begin COMPU_METHOD RTE_CM_T7 "" RAT_FUNC "%.1" "degC" COEFFS 0 128 0 0 0 1 /end COMPU_METHOD
/begin COMPU_METHOD RTE_CM_Uls20 "" RAT_FUNC "%.1" "Uls" COEFFS 0 0.000244140625 0 0 0 1 /end COMPU_METHOD
/begin COMPU_METHOD RTE_CM_T6 "" RAT_FUNC "%.1" "degC" COEFFS 0 0.0625 0 0 0 1 /end COMPU_METHOD
/begin COMPU_METHOD RTE_CM_Uls23 "" RAT_FUNC "%.1" "Uls" COEFFS 0 256 0 0 0 1 /end COMPU_METHOD
