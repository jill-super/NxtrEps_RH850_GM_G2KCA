/begin CHARACTERISTIC GmRoadWhlInQlfr.GmRoadWhlInQlfrMaxAllwblFrq.Val "MICROSAR RTE" VALUE 0x0 RTE_RL_FLOAT32_IEEE 0 NO_COMPU_METHOD -3.402823466e+38 3.402823466e+38 SYMBOL_LINK "Rte_CalprmRom_CalRegn01Inin00GroupB_DEFAULT_RTE_CALPRM_GROUP.GmRoadWhlInQlfrMaxAllwblFrq_Val" 0 DISPLAY_IDENTIFIER GmRoadWhlInQlfr.CalibrationPorts.GmRoadWhlInQlfrMaxAllwblFrq.Val /end CHARACTERISTIC
/begin CHARACTERISTIC GmRoadWhlInQlfr.GmRoadWhlInQlfrMaxFrqChg.Val "MICROSAR RTE" VALUE 0x0 RTE_RL_FLOAT32_IEEE 0 NO_COMPU_METHOD -3.402823466e+38 3.402823466e+38 SYMBOL_LINK "Rte_CalprmRom_CalRegn01Inin00GroupB_DEFAULT_RTE_CALPRM_GROUP.GmRoadWhlInQlfrMaxFrqChg_Val" 0 DISPLAY_IDENTIFIER GmRoadWhlInQlfr.CalibrationPorts.GmRoadWhlInQlfrMaxFrqChg.Val /end CHARACTERISTIC
/begin CHARACTERISTIC GmStrtStop.GmStrtStopEna.Logl "MICROSAR RTE" VALUE 0x0 RTE_RL_BOOLEAN 0 RTE_CM_BOOLEAN 0 255 SYMBOL_LINK "Rte_CalprmRom_CalRegn02Inin00_DEFAULT_RTE_CALPRM_GROUP.GmStrtStopEna_Logl" 0 DISPLAY_IDENTIFIER GmStrtStop.CalibrationPorts.GmStrtStopEna.Logl /end CHARACTERISTIC
/begin CHARACTERISTIC GmStrtStop.GmStrtStopFltRateLim.Val "MICROSAR RTE" VALUE 0x0 RTE_RL_FLOAT32_IEEE 0 NO_COMPU_METHOD -3.402823466e+38 3.402823466e+38 SYMBOL_LINK "Rte_CalprmRom_CalRegn02Inin00GroupC_DEFAULT_RTE_CALPRM_GROUP.GmStrtStopFltRateLim_Val" 0 DISPLAY_IDENTIFIER GmStrtStop.CalibrationPorts.GmStrtStopFltRateLim.Val /end CHARACTERISTIC
/begin CHARACTERISTIC GmStrtStop.GmStrtStopMod1EngTranThd.Val "MICROSAR RTE" VALUE 0x0 RTE_RL_FLOAT32_IEEE 0 NO_COMPU_METHOD -3.402823466e+38 3.402823466e+38 SYMBOL_LINK "Rte_CalprmRom_CalRegn02Inin00GroupC_DEFAULT_RTE_CALPRM_GROUP.GmStrtStopMod1EngTranThd_Val" 0 DISPLAY_IDENTIFIER GmStrtStop.CalibrationPorts.GmStrtStopMod1EngTranThd.Val /end CHARACTERISTIC
/begin CHARACTERISTIC GmStrtStop.GmStrtStopMod1Sca.Val "MICROSAR RTE" VALUE 0x0 RTE_RL_FLOAT32_IEEE 0 NO_COMPU_METHOD -3.402823466e+38 3.402823466e+38 SYMBOL_LINK "Rte_CalprmRom_CalRegn02Inin00GroupC_DEFAULT_RTE_CALPRM_GROUP.GmStrtStopMod1Sca_Val" 0 DISPLAY_IDENTIFIER GmStrtStop.CalibrationPorts.GmStrtStopMod1Sca.Val /end CHARACTERISTIC
/begin CHARACTERISTIC GmStrtStop.GmStrtStopMod1ToStopRateLim.Val "MICROSAR RTE" VALUE 0x0 RTE_RL_FLOAT32_IEEE 0 NO_COMPU_METHOD -3.402823466e+38 3.402823466e+38 SYMBOL_LINK "Rte_CalprmRom_CalRegn02Inin00GroupC_DEFAULT_RTE_CALPRM_GROUP.GmStrtStopMod1ToStopRateLim_Val" 0 DISPLAY_IDENTIFIER GmStrtStop.CalibrationPorts.GmStrtStopMod1ToStopRateLim.Val /end CHARACTERISTIC
/begin CHARACTERISTIC GmStrtStop.GmStrtStopMod1VehSpdTranThd.Val "MICROSAR RTE" VALUE 0x0 RTE_RL_FLOAT32_IEEE 0 NO_COMPU_METHOD -3.402823466e+38 3.402823466e+38 SYMBOL_LINK "Rte_CalprmRom_CalRegn02Inin00GroupC_DEFAULT_RTE_CALPRM_GROUP.GmStrtStopMod1VehSpdTranThd_Val" 0 DISPLAY_IDENTIFIER GmStrtStop.CalibrationPorts.GmStrtStopMod1VehSpdTranThd.Val /end CHARACTERISTIC
/begin CHARACTERISTIC GmStrtStop.GmStrtStopMod2Sca.Val "MICROSAR RTE" VALUE 0x0 RTE_RL_FLOAT32_IEEE 0 NO_COMPU_METHOD -3.402823466e+38 3.402823466e+38 SYMBOL_LINK "Rte_CalprmRom_CalRegn02Inin00GroupC_DEFAULT_RTE_CALPRM_GROUP.GmStrtStopMod2Sca_Val" 0 DISPLAY_IDENTIFIER GmStrtStop.CalibrationPorts.GmStrtStopMod2Sca.Val /end CHARACTERISTIC
/begin CHARACTERISTIC GmStrtStop.GmStrtStopNormModEngTranThd.Val "MICROSAR RTE" VALUE 0x0 RTE_RL_FLOAT32_IEEE 0 NO_COMPU_METHOD -3.402823466e+38 3.402823466e+38 SYMBOL_LINK "Rte_CalprmRom_CalRegn02Inin00GroupC_DEFAULT_RTE_CALPRM_GROUP.GmStrtStopNormModEngTranThd_Val" 0 DISPLAY_IDENTIFIER GmStrtStop.CalibrationPorts.GmStrtStopNormModEngTranThd.Val /end CHARACTERISTIC
/begin CHARACTERISTIC GmStrtStop.GmStrtStopNormModVehSpdTranThd.Val "MICROSAR RTE" VALUE 0x0 RTE_RL_FLOAT32_IEEE 0 NO_COMPU_METHOD -3.402823466e+38 3.402823466e+38 SYMBOL_LINK "Rte_CalprmRom_CalRegn02Inin00GroupC_DEFAULT_RTE_CALPRM_GROUP.GmStrtStopNormModVehSpdTranThd_Val" 0 DISPLAY_IDENTIFIER GmStrtStop.CalibrationPorts.GmStrtStopNormModVehSpdTranThd.Val /end CHARACTERISTIC
/begin CHARACTERISTIC GmStrtStop.GmStrtStopNormRateLim.Val "MICROSAR RTE" VALUE 0x0 RTE_RL_FLOAT32_IEEE 0 NO_COMPU_METHOD -3.402823466e+38 3.402823466e+38 SYMBOL_LINK "Rte_CalprmRom_CalRegn02Inin00GroupC_DEFAULT_RTE_CALPRM_GROUP.GmStrtStopNormRateLim_Val" 0 DISPLAY_IDENTIFIER GmStrtStop.CalibrationPorts.GmStrtStopNormRateLim.Val /end CHARACTERISTIC
/begin CHARACTERISTIC GmStrtStop.GmStrtStopNormToMod1RateLim.Val "MICROSAR RTE" VALUE 0x0 RTE_RL_FLOAT32_IEEE 0 NO_COMPU_METHOD -3.402823466e+38 3.402823466e+38 SYMBOL_LINK "Rte_CalprmRom_CalRegn02Inin00GroupC_DEFAULT_RTE_CALPRM_GROUP.GmStrtStopNormToMod1RateLim_Val" 0 DISPLAY_IDENTIFIER GmStrtStop.CalibrationPorts.GmStrtStopNormToMod1RateLim.Val /end CHARACTERISTIC
/begin CHARACTERISTIC GmStrtStop.GmStrtStopStopAndMod2RateLim.Val "MICROSAR RTE" VALUE 0x0 RTE_RL_FLOAT32_IEEE 0 NO_COMPU_METHOD -3.402823466e+38 3.402823466e+38 SYMBOL_LINK "Rte_CalprmRom_CalRegn02Inin00GroupC_DEFAULT_RTE_CALPRM_GROUP.GmStrtStopStopAndMod2RateLim_Val" 0 DISPLAY_IDENTIFIER GmStrtStop.CalibrationPorts.GmStrtStopStopAndMod2RateLim.Val /end CHARACTERISTIC
/begin CHARACTERISTIC GmStrtStop.GmStrtStopStopMod1HwTqTranThd.Val "MICROSAR RTE" VALUE 0x0 RTE_RL_FLOAT32_IEEE 0 NO_COMPU_METHOD -3.402823466e+38 3.402823466e+38 SYMBOL_LINK "Rte_CalprmRom_CalRegn02Inin00GroupC_DEFAULT_RTE_CALPRM_GROUP.GmStrtStopStopMod1HwTqTranThd_Val" 0 DISPLAY_IDENTIFIER GmStrtStop.CalibrationPorts.GmStrtStopStopMod1HwTqTranThd.Val /end CHARACTERISTIC
/begin CHARACTERISTIC GmStrtStop.GmStrtStopStopMod1HwVelTranThd.Val "MICROSAR RTE" VALUE 0x0 RTE_RL_FLOAT32_IEEE 0 NO_COMPU_METHOD -3.402823466e+38 3.402823466e+38 SYMBOL_LINK "Rte_CalprmRom_CalRegn02Inin00GroupC_DEFAULT_RTE_CALPRM_GROUP.GmStrtStopStopMod1HwVelTranThd_Val" 0 DISPLAY_IDENTIFIER GmStrtStop.CalibrationPorts.GmStrtStopStopMod1HwVelTranThd.Val /end CHARACTERISTIC
/begin CHARACTERISTIC GmStrtStop.GmStrtStopStopMod1Tmr.Val "MICROSAR RTE" VALUE 0x0 RTE_RL_FLOAT32_IEEE 0 NO_COMPU_METHOD -3.402823466e+38 3.402823466e+38 SYMBOL_LINK "Rte_CalprmRom_CalRegn02Inin00GroupC_DEFAULT_RTE_CALPRM_GROUP.GmStrtStopStopMod1Tmr_Val" 0 DISPLAY_IDENTIFIER GmStrtStop.CalibrationPorts.GmStrtStopStopMod1Tmr.Val /end CHARACTERISTIC
/begin CHARACTERISTIC GmStrtStop.GmStrtStopStopMod1VehSpdTranThd.Val "MICROSAR RTE" VALUE 0x0 RTE_RL_FLOAT32_IEEE 0 NO_COMPU_METHOD -3.402823466e+38 3.402823466e+38 SYMBOL_LINK "Rte_CalprmRom_CalRegn02Inin00GroupC_DEFAULT_RTE_CALPRM_GROUP.GmStrtStopStopMod1VehSpdTranThd_Val" 0 DISPLAY_IDENTIFIER GmStrtStop.CalibrationPorts.GmStrtStopStopMod1VehSpdTranThd.Val /end CHARACTERISTIC
/begin CHARACTERISTIC GmStrtStop.GmStrtStopStopMod2HwTqTranThd.Val "MICROSAR RTE" VALUE 0x0 RTE_RL_FLOAT32_IEEE 0 NO_COMPU_METHOD -3.402823466e+38 3.402823466e+38 SYMBOL_LINK "Rte_CalprmRom_CalRegn02Inin00GroupC_DEFAULT_RTE_CALPRM_GROUP.GmStrtStopStopMod2HwTqTranThd_Val" 0 DISPLAY_IDENTIFIER GmStrtStop.CalibrationPorts.GmStrtStopStopMod2HwTqTranThd.Val /end CHARACTERISTIC
/begin CHARACTERISTIC GmStrtStop.GmStrtStopStopMod2HwVelTranThd.Val "MICROSAR RTE" VALUE 0x0 RTE_RL_FLOAT32_IEEE 0 NO_COMPU_METHOD -3.402823466e+38 3.402823466e+38 SYMBOL_LINK "Rte_CalprmRom_CalRegn02Inin00GroupC_DEFAULT_RTE_CALPRM_GROUP.GmStrtStopStopMod2HwVelTranThd_Val" 0 DISPLAY_IDENTIFIER GmStrtStop.CalibrationPorts.GmStrtStopStopMod2HwVelTranThd.Val /end CHARACTERISTIC
/begin CHARACTERISTIC GmStrtStop.GmStrtStopStopMod2Tmr.Val "MICROSAR RTE" VALUE 0x0 RTE_RL_FLOAT32_IEEE 0 NO_COMPU_METHOD -3.402823466e+38 3.402823466e+38 SYMBOL_LINK "Rte_CalprmRom_CalRegn02Inin00GroupC_DEFAULT_RTE_CALPRM_GROUP.GmStrtStopStopMod2Tmr_Val" 0 DISPLAY_IDENTIFIER GmStrtStop.CalibrationPorts.GmStrtStopStopMod2Tmr.Val /end CHARACTERISTIC
/begin CHARACTERISTIC GmStrtStop.GmStrtStopStopMod2VehSpdTranThd.Val "MICROSAR RTE" VALUE 0x0 RTE_RL_FLOAT32_IEEE 0 NO_COMPU_METHOD -3.402823466e+38 3.402823466e+38 SYMBOL_LINK "Rte_CalprmRom_CalRegn02Inin00GroupC_DEFAULT_RTE_CALPRM_GROUP.GmStrtStopStopMod2VehSpdTranThd_Val" 0 DISPLAY_IDENTIFIER GmStrtStop.CalibrationPorts.GmStrtStopStopMod2VehSpdTranThd.Val /end CHARACTERISTIC
/begin CHARACTERISTIC GmStrtStop.GmStrtStopStopModSca.Val "MICROSAR RTE" VALUE 0x0 RTE_RL_FLOAT32_IEEE 0 NO_COMPU_METHOD -3.402823466e+38 3.402823466e+38 SYMBOL_LINK "Rte_CalprmRom_CalRegn02Inin00GroupC_DEFAULT_RTE_CALPRM_GROUP.GmStrtStopStopModSca_Val" 0 DISPLAY_IDENTIFIER GmStrtStop.CalibrationPorts.GmStrtStopStopModSca.Val /end CHARACTERISTIC
/begin CHARACTERISTIC GmTqArbn.GmTqArbnApaAssiScaEna.Logl "MICROSAR RTE" VALUE 0x0 RTE_RL_BOOLEAN 0 RTE_CM_BOOLEAN 0 255 SYMBOL_LINK "Rte_CalprmRom_CalRegn02Inin00_DEFAULT_RTE_CALPRM_GROUP.GmTqArbnApaAssiScaEna_Logl" 0 DISPLAY_IDENTIFIER GmTqArbn.CalibrationPorts.GmTqArbnApaAssiScaEna.Logl /end CHARACTERISTIC
/begin CHARACTERISTIC GmTqArbn.GmTqArbnApaDampgScaEna.Logl "MICROSAR RTE" VALUE 0x0 RTE_RL_BOOLEAN 0 RTE_CM_BOOLEAN 0 255 SYMBOL_LINK "Rte_CalprmRom_CalRegn02Inin00_DEFAULT_RTE_CALPRM_GROUP.GmTqArbnApaDampgScaEna_Logl" 0 DISPLAY_IDENTIFIER GmTqArbn.CalibrationPorts.GmTqArbnApaDampgScaEna.Logl /end CHARACTERISTIC
/begin CHARACTERISTIC GmTqArbn.GmTqArbnApaDiRateX.Ary1D "MICROSAR RTE" VAL_BLK 0x0 RTE_RL_UWORD 0 NO_COMPU_METHOD 0 65535 MATRIX_DIM 6 1 1 SYMBOL_LINK "Rte_CalprmRom_CalRegn02Inin00GroupC_DEFAULT_RTE_CALPRM_GROUP.GmTqArbnApaDiRateX_Ary1D" 0 DISPLAY_IDENTIFIER GmTqArbn.CalibrationPorts.GmTqArbnApaDiRateX.Ary1D /end CHARACTERISTIC
/begin CHARACTERISTIC GmTqArbn.GmTqArbnApaDiRateY.Ary1D "MICROSAR RTE" VAL_BLK 0x0 RTE_RL_UWORD 0 NO_COMPU_METHOD 0 65535 MATRIX_DIM 6 1 1 SYMBOL_LINK "Rte_CalprmRom_CalRegn02Rt00GroupC_DEFAULT_RTE_CALPRM_GROUP.GmTqArbnApaDiRateY_Ary1D" 0 DISPLAY_IDENTIFIER GmTqArbn.CalibrationPorts.GmTqArbnApaDiRateY.Ary1D /end CHARACTERISTIC
/begin CHARACTERISTIC GmTqArbn.GmTqArbnApaEnaRate.Val "MICROSAR RTE" VALUE 0x0 RTE_RL_FLOAT32_IEEE 0 NO_COMPU_METHOD -3.402823466e+38 3.402823466e+38 SYMBOL_LINK "Rte_CalprmRom_CalRegn02Rt00GroupC_DEFAULT_RTE_CALPRM_GROUP.GmTqArbnApaEnaRate_Val" 0 DISPLAY_IDENTIFIER GmTqArbn.CalibrationPorts.GmTqArbnApaEnaRate.Val /end CHARACTERISTIC
/begin CHARACTERISTIC GmTqArbn.GmTqArbnApaRtnScaEna.Logl "MICROSAR RTE" VALUE 0x0 RTE_RL_BOOLEAN 0 RTE_CM_BOOLEAN 0 255 SYMBOL_LINK "Rte_CalprmRom_CalRegn02Inin00_DEFAULT_RTE_CALPRM_GROUP.GmTqArbnApaRtnScaEna_Logl" 0 DISPLAY_IDENTIFIER GmTqArbn.CalibrationPorts.GmTqArbnApaRtnScaEna.Logl /end CHARACTERISTIC
/begin CHARACTERISTIC GmTqArbn.GmTqArbnApaSmotngHwTqLpFilFrq.Val "MICROSAR RTE" VALUE 0x0 RTE_RL_FLOAT32_IEEE 0 NO_COMPU_METHOD -3.402823466e+38 3.402823466e+38 SYMBOL_LINK "Rte_CalprmRom_CalRegn02Rt00GroupC_DEFAULT_RTE_CALPRM_GROUP.GmTqArbnApaSmotngHwTqLpFilFrq_Val" 0 DISPLAY_IDENTIFIER GmTqArbn.CalibrationPorts.GmTqArbnApaSmotngHwTqLpFilFrq.Val /end CHARACTERISTIC
/begin CHARACTERISTIC GmTqArbn.GmTqArbnApaSmotngX.Ary1D "MICROSAR RTE" VAL_BLK 0x0 RTE_RL_UWORD 0 NO_COMPU_METHOD 0 65535 MATRIX_DIM 10 1 1 SYMBOL_LINK "Rte_CalprmRom_CalRegn02Rt00GroupC_DEFAULT_RTE_CALPRM_GROUP.GmTqArbnApaSmotngX_Ary1D" 0 DISPLAY_IDENTIFIER GmTqArbn.CalibrationPorts.GmTqArbnApaSmotngX.Ary1D /end CHARACTERISTIC
/begin CHARACTERISTIC GmTqArbn.GmTqArbnApaSmotngY.Ary1D "MICROSAR RTE" VAL_BLK 0x0 RTE_RL_UWORD 0 NO_COMPU_METHOD 0 65535 MATRIX_DIM 10 1 1 SYMBOL_LINK "Rte_CalprmRom_CalRegn02Rt00GroupC_DEFAULT_RTE_CALPRM_GROUP.GmTqArbnApaSmotngY_Ary1D" 0 DISPLAY_IDENTIFIER GmTqArbn.CalibrationPorts.GmTqArbnApaSmotngY.Ary1D /end CHARACTERISTIC
/begin CHARACTERISTIC GmTqArbn.GmTqArbnEscMaxTq.Val "MICROSAR RTE" VALUE 0x0 RTE_RL_FLOAT32_IEEE 0 NO_COMPU_METHOD -3.402823466e+38 3.402823466e+38 SYMBOL_LINK "Rte_CalprmRom_CalRegn02Inin00_DEFAULT_RTE_CALPRM_GROUP.GmTqArbnEscMaxTq_Val" 0 DISPLAY_IDENTIFIER GmTqArbn.CalibrationPorts.GmTqArbnEscMaxTq.Val /end CHARACTERISTIC
/begin CHARACTERISTIC GmTqArbn.GmTqArbnLkaSlewEna.Logl "MICROSAR RTE" VALUE 0x0 RTE_RL_BOOLEAN 0 RTE_CM_BOOLEAN 0 255 SYMBOL_LINK "Rte_CalprmRom_CalRegn02Inin00GroupC_DEFAULT_RTE_CALPRM_GROUP.GmTqArbnLkaSlewEna_Logl" 0 DISPLAY_IDENTIFIER GmTqArbn.CalibrationPorts.GmTqArbnLkaSlewEna.Logl /end CHARACTERISTIC
/begin CHARACTERISTIC GmTqArbn.GmTqArbnLkaSlewX.Ary1D "MICROSAR RTE" VAL_BLK 0x0 RTE_RL_UWORD 0 NO_COMPU_METHOD 0 65535 MATRIX_DIM 6 1 1 SYMBOL_LINK "Rte_CalprmRom_CalRegn02Rt00GroupC_DEFAULT_RTE_CALPRM_GROUP.GmTqArbnLkaSlewX_Ary1D" 0 DISPLAY_IDENTIFIER GmTqArbn.CalibrationPorts.GmTqArbnLkaSlewX.Ary1D /end CHARACTERISTIC
/begin CHARACTERISTIC GmTqArbn.GmTqArbnLkaSlewY.Ary1D "MICROSAR RTE" VAL_BLK 0x0 RTE_RL_UWORD 0 NO_COMPU_METHOD 0 65535 MATRIX_DIM 6 1 1 SYMBOL_LINK "Rte_CalprmRom_CalRegn02Rt00GroupC_DEFAULT_RTE_CALPRM_GROUP.GmTqArbnLkaSlewY_Ary1D" 0 DISPLAY_IDENTIFIER GmTqArbn.CalibrationPorts.GmTqArbnLkaSlewY.Ary1D /end CHARACTERISTIC
/begin CHARACTERISTIC GmVehPwrMod.GmVehPwrModHwTqMinKeepAssi.Val "MICROSAR RTE" VALUE 0x0 RTE_RL_FLOAT32_IEEE 0 NO_COMPU_METHOD -3.402823466e+38 3.402823466e+38 SYMBOL_LINK "Rte_CalprmRom_CalRegn01Inin00GroupC_DEFAULT_RTE_CALPRM_GROUP.GmVehPwrModHwTqMinKeepAssi_Val" 0 DISPLAY_IDENTIFIER GmVehPwrMod.CalibrationPorts.GmVehPwrModHwTqMinKeepAssi.Val /end CHARACTERISTIC
/begin CHARACTERISTIC GmVehPwrMod.GmVehPwrModHwTqMinKeepTmr.Val "MICROSAR RTE" VALUE 0x0 RTE_RL_ULONG 0 NO_COMPU_METHOD 0 4294967295 SYMBOL_LINK "Rte_CalprmRom_CalRegn01Inin00GroupC_DEFAULT_RTE_CALPRM_GROUP.GmVehPwrModHwTqMinKeepTmr_Val" 0 DISPLAY_IDENTIFIER GmVehPwrMod.CalibrationPorts.GmVehPwrModHwTqMinKeepTmr.Val /end CHARACTERISTIC
/begin CHARACTERISTIC GmVehPwrMod.GmVehPwrModOperRampRate.Val "MICROSAR RTE" VALUE 0x0 RTE_RL_FLOAT32_IEEE 0 NO_COMPU_METHOD -3.402823466e+38 3.402823466e+38 SYMBOL_LINK "Rte_CalprmRom_CalRegn01Inin00_DEFAULT_RTE_CALPRM_GROUP.GmVehPwrModOperRampRate_Val" 0 DISPLAY_IDENTIFIER GmVehPwrMod.CalibrationPorts.GmVehPwrModOperRampRate.Val /end CHARACTERISTIC
/begin CHARACTERISTIC GmVehPwrMod.GmVehPwrModVehSpdAssiOnMin.Val "MICROSAR RTE" VALUE 0x0 RTE_RL_FLOAT32_IEEE 0 NO_COMPU_METHOD -3.402823466e+38 3.402823466e+38 SYMBOL_LINK "Rte_CalprmRom_CalRegn01Inin00GroupC_DEFAULT_RTE_CALPRM_GROUP.GmVehPwrModVehSpdAssiOnMin_Val" 0 DISPLAY_IDENTIFIER GmVehPwrMod.CalibrationPorts.GmVehPwrModVehSpdAssiOnMin.Val /end CHARACTERISTIC
/begin CHARACTERISTIC GmVehPwrMod.GmVehPwrModVehSpdMinKeepAssi.Val "MICROSAR RTE" VALUE 0x0 RTE_RL_FLOAT32_IEEE 0 NO_COMPU_METHOD -3.402823466e+38 3.402823466e+38 SYMBOL_LINK "Rte_CalprmRom_CalRegn01Inin00GroupC_DEFAULT_RTE_CALPRM_GROUP.GmVehPwrModVehSpdMinKeepAssi_Val" 0 DISPLAY_IDENTIFIER GmVehPwrMod.CalibrationPorts.GmVehPwrModVehSpdMinKeepAssi.Val /end CHARACTERISTIC
/begin CHARACTERISTIC HiLoadStallLimr.HiLoadStallLimrMotTqCmdFilFrq.Val "MICROSAR RTE" VALUE 0x0 RTE_RL_FLOAT32_IEEE 0 NO_COMPU_METHOD -3.402823466e+38 3.402823466e+38 SYMBOL_LINK "Rte_CalprmRom_CalRegn01Inin00_DEFAULT_RTE_CALPRM_GROUP.HiLoadStallLimrMotTqCmdFilFrq_Val" 0 DISPLAY_IDENTIFIER HiLoadStallLimr.CalibrationPorts.HiLoadStallLimrMotTqCmdFilFrq.Val /end CHARACTERISTIC
/begin CHARACTERISTIC HiLoadStallLimr.HiLoadStallLimrMotVelMgnThd.Val "MICROSAR RTE" VALUE 0x0 RTE_RL_FLOAT32_IEEE 0 NO_COMPU_METHOD -3.402823466e+38 3.402823466e+38 SYMBOL_LINK "Rte_CalprmRom_CalRegn01Inin00_DEFAULT_RTE_CALPRM_GROUP.HiLoadStallLimrMotVelMgnThd_Val" 0 DISPLAY_IDENTIFIER HiLoadStallLimr.CalibrationPorts.HiLoadStallLimrMotVelMgnThd.Val /end CHARACTERISTIC
/begin CHARACTERISTIC HiLoadStallLimr.HiLoadStallLimrStallMotTqCmdLimX.Ary1D "MICROSAR RTE" VAL_BLK 0x0 RTE_RL_UWORD 0 NO_COMPU_METHOD 0 65535 MATRIX_DIM 6 1 1 SYMBOL_LINK "Rte_CalprmRom_CalRegn01Inin00_DEFAULT_RTE_CALPRM_GROUP.HiLoadStallLimrStallMotTqCmdLimX_Ary1D" 0 DISPLAY_IDENTIFIER HiLoadStallLimr.CalibrationPorts.HiLoadStallLimrStallMotTqCmdLimX.Ary1D /end CHARACTERISTIC
/begin CHARACTERISTIC HiLoadStallLimr.HiLoadStallLimrStallMotTqCmdLimY.Ary1D "MICROSAR RTE" VAL_BLK 0x0 RTE_RL_UWORD 0 NO_COMPU_METHOD 0 65535 MATRIX_DIM 6 1 1 SYMBOL_LINK "Rte_CalprmRom_CalRegn01Inin00_DEFAULT_RTE_CALPRM_GROUP.HiLoadStallLimrStallMotTqCmdLimY_Ary1D" 0 DISPLAY_IDENTIFIER HiLoadStallLimr.CalibrationPorts.HiLoadStallLimrStallMotTqCmdLimY.Ary1D /end CHARACTERISTIC
/begin CHARACTERISTIC HiLoadStallLimr.HiLoadStallLimrStallMotTqLimSlewRate.Val "MICROSAR RTE" VALUE 0x0 RTE_RL_FLOAT32_IEEE 0 NO_COMPU_METHOD -3.402823466e+38 3.402823466e+38 SYMBOL_LINK "Rte_CalprmRom_CalRegn01Inin00_DEFAULT_RTE_CALPRM_GROUP.HiLoadStallLimrStallMotTqLimSlewRate_Val" 0 DISPLAY_IDENTIFIER HiLoadStallLimr.CalibrationPorts.HiLoadStallLimrStallMotTqLimSlewRate.Val /end CHARACTERISTIC
/begin CHARACTERISTIC HowDetn.HowDetnEstimLpFilFrq.Val "MICROSAR RTE" VALUE 0x0 RTE_RL_FLOAT32_IEEE 0 NO_COMPU_METHOD -3.402823466e+38 3.402823466e+38 SYMBOL_LINK "Rte_CalprmRom_CalRegn02Inin00_DEFAULT_RTE_CALPRM_GROUP.HowDetnEstimLpFilFrq_Val" 0 DISPLAY_IDENTIFIER HowDetn.CalibrationPorts.HowDetnEstimLpFilFrq.Val /end CHARACTERISTIC
/begin CHARACTERISTIC HowDetn.HowDetnHiFrqGainY.Ary1D "MICROSAR RTE" VAL_BLK 0x0 RTE_RL_UWORD 0 NO_COMPU_METHOD 0 65535 MATRIX_DIM 9 1 1 SYMBOL_LINK "Rte_CalprmRom_CalRegn02CmnGroupC_DEFAULT_RTE_CALPRM_GROUP.HowDetnHiFrqGainY_Ary1D" 0 DISPLAY_IDENTIFIER HowDetn.CalibrationPorts.HowDetnHiFrqGainY.Ary1D /end CHARACTERISTIC
/begin CHARACTERISTIC HowDetn.HowDetnHiFrqRateX.Ary2D "MICROSAR RTE" VAL_BLK 0x0 RTE_RL_UWORD 0 NO_COMPU_METHOD 0 65535 MATRIX_DIM 6 3 1 SYMBOL_LINK "Rte_CalprmRom_CalRegn02CmnGroupC_DEFAULT_RTE_CALPRM_GROUP.HowDetnHiFrqRateX_Ary2D" 0 DISPLAY_IDENTIFIER HowDetn.CalibrationPorts.HowDetnHiFrqRateX.Ary2D /end CHARACTERISTIC
/begin CHARACTERISTIC HowDetn.HowDetnHiFrqRateY.Ary2D "MICROSAR RTE" VAL_BLK 0x0 RTE_RL_SWORD 0 NO_COMPU_METHOD -32768 32767 MATRIX_DIM 6 3 1 SYMBOL_LINK "Rte_CalprmRom_CalRegn02CmnGroupC_DEFAULT_RTE_CALPRM_GROUP.HowDetnHiFrqRateY_Ary2D" 0 DISPLAY_IDENTIFIER HowDetn.CalibrationPorts.HowDetnHiFrqRateY.Ary2D /end CHARACTERISTIC
/begin CHARACTERISTIC HowDetn.HowDetnLoFrqRateX.Ary2D "MICROSAR RTE" VAL_BLK 0x0 RTE_RL_UWORD 0 NO_COMPU_METHOD 0 65535 MATRIX_DIM 5 3 1 SYMBOL_LINK "Rte_CalprmRom_CalRegn02CmnGroupC_DEFAULT_RTE_CALPRM_GROUP.HowDetnLoFrqRateX_Ary2D" 0 DISPLAY_IDENTIFIER HowDetn.CalibrationPorts.HowDetnLoFrqRateX.Ary2D /end CHARACTERISTIC
/begin CHARACTERISTIC HowDetn.HowDetnLoFrqRateY.Ary2D "MICROSAR RTE" VAL_BLK 0x0 RTE_RL_SWORD 0 NO_COMPU_METHOD -32768 32767 MATRIX_DIM 5 3 1 SYMBOL_LINK "Rte_CalprmRom_CalRegn02CmnGroupC_DEFAULT_RTE_CALPRM_GROUP.HowDetnLoFrqRateY_Ary2D" 0 DISPLAY_IDENTIFIER HowDetn.CalibrationPorts.HowDetnLoFrqRateY.Ary2D /end CHARACTERISTIC
/begin CHARACTERISTIC HowDetn.HowDetnMinVehSpd.Val "MICROSAR RTE" VALUE 0x0 RTE_RL_FLOAT32_IEEE 0 NO_COMPU_METHOD -3.402823466e+38 3.402823466e+38 SYMBOL_LINK "Rte_CalprmRom_CalRegn02CmnGroupC_DEFAULT_RTE_CALPRM_GROUP.HowDetnMinVehSpd_Val" 0 DISPLAY_IDENTIFIER HowDetn.CalibrationPorts.HowDetnMinVehSpd.Val /end CHARACTERISTIC
/begin CHARACTERISTIC HowDetn.HowDetnPercOfPrevHowEstim.Val "MICROSAR RTE" VALUE 0x0 RTE_RL_FLOAT32_IEEE 0 NO_COMPU_METHOD -3.402823466e+38 3.402823466e+38 SYMBOL_LINK "Rte_CalprmRom_CalRegn02CmnGroupC_DEFAULT_RTE_CALPRM_GROUP.HowDetnPercOfPrevHowEstim_Val" 0 DISPLAY_IDENTIFIER HowDetn.CalibrationPorts.HowDetnPercOfPrevHowEstim.Val /end CHARACTERISTIC
/begin CHARACTERISTIC HowDetn.HowDetnSlewRate.Val "MICROSAR RTE" VALUE 0x0 RTE_RL_FLOAT32_IEEE 0 NO_COMPU_METHOD -3.402823466e+38 3.402823466e+38 SYMBOL_LINK "Rte_CalprmRom_CalRegn02CmnGroupC_DEFAULT_RTE_CALPRM_GROUP.HowDetnSlewRate_Val" 0 DISPLAY_IDENTIFIER HowDetn.CalibrationPorts.HowDetnSlewRate.Val /end CHARACTERISTIC
/begin CHARACTERISTIC HowDetn.HowDetnStLpFilFrq.Val "MICROSAR RTE" VALUE 0x0 RTE_RL_FLOAT32_IEEE 0 NO_COMPU_METHOD -3.402823466e+38 3.402823466e+38 SYMBOL_LINK "Rte_CalprmRom_CalRegn02Inin00_DEFAULT_RTE_CALPRM_GROUP.HowDetnStLpFilFrq_Val" 0 DISPLAY_IDENTIFIER HowDetn.CalibrationPorts.HowDetnStLpFilFrq.Val /end CHARACTERISTIC
/begin CHARACTERISTIC HowDetn.HowDetnStThdX.Ary1D "MICROSAR RTE" VAL_BLK 0x0 RTE_RL_UWORD 0 NO_COMPU_METHOD 0 65535 MATRIX_DIM 7 1 1 SYMBOL_LINK "Rte_CalprmRom_CalRegn02CmnGroupC_DEFAULT_RTE_CALPRM_GROUP.HowDetnStThdX_Ary1D" 0 DISPLAY_IDENTIFIER HowDetn.CalibrationPorts.HowDetnStThdX.Ary1D /end CHARACTERISTIC
/begin CHARACTERISTIC HowDetn.HowDetnTqFinalLpFilFrq.Val "MICROSAR RTE" VALUE 0x0 RTE_RL_FLOAT32_IEEE 0 NO_COMPU_METHOD -3.402823466e+38 3.402823466e+38 SYMBOL_LINK "Rte_CalprmRom_CalRegn02Inin00_DEFAULT_RTE_CALPRM_GROUP.HowDetnTqFinalLpFilFrq_Val" 0 DISPLAY_IDENTIFIER HowDetn.CalibrationPorts.HowDetnTqFinalLpFilFrq.Val /end CHARACTERISTIC
/begin CHARACTERISTIC HowDetn.HowDetnTqHpFilFrq.Val "MICROSAR RTE" VALUE 0x0 RTE_RL_FLOAT32_IEEE 0 NO_COMPU_METHOD -3.402823466e+38 3.402823466e+38 SYMBOL_LINK "Rte_CalprmRom_CalRegn02CmnGroupC_DEFAULT_RTE_CALPRM_GROUP.HowDetnTqHpFilFrq_Val" 0 DISPLAY_IDENTIFIER HowDetn.CalibrationPorts.HowDetnTqHpFilFrq.Val /end CHARACTERISTIC
/begin CHARACTERISTIC HowDetn.HowDetnTqInitLpFilFrq.Val "MICROSAR RTE" VALUE 0x0 RTE_RL_FLOAT32_IEEE 0 NO_COMPU_METHOD -3.402823466e+38 3.402823466e+38 SYMBOL_LINK "Rte_CalprmRom_CalRegn02Inin00_DEFAULT_RTE_CALPRM_GROUP.HowDetnTqInitLpFilFrq_Val" 0 DISPLAY_IDENTIFIER HowDetn.CalibrationPorts.HowDetnTqInitLpFilFrq.Val /end CHARACTERISTIC
/begin CHARACTERISTIC HowDetn.HowDetnVehSpd.Ary1D "MICROSAR RTE" VAL_BLK 0x0 RTE_RL_UWORD 0 NO_COMPU_METHOD 0 65535 MATRIX_DIM 9 1 1 SYMBOL_LINK "Rte_CalprmRom_CalRegn02CmnGroupC_DEFAULT_RTE_CALPRM_GROUP.HowDetnVehSpd_Ary1D" 0 DISPLAY_IDENTIFIER HowDetn.CalibrationPorts.HowDetnVehSpd.Ary1D /end CHARACTERISTIC
/begin CHARACTERISTIC HwAg0Meas.HwAg0MeasHwAg0IfFltFailStep.Val "MICROSAR RTE" VALUE 0x0 RTE_RL_UWORD 0 NO_COMPU_METHOD 0 65535 SYMBOL_LINK "Rte_CalprmRom_CalRegn01Inin00_DEFAULT_RTE_CALPRM_GROUP.HwAg0MeasHwAg0IfFltFailStep_Val" 0 DISPLAY_IDENTIFIER HwAg0Meas.CalibrationPorts.HwAg0MeasHwAg0IfFltFailStep.Val /end CHARACTERISTIC
/begin CHARACTERISTIC HwAg0Meas.HwAg0MeasHwAg0IfFltPassStep.Val "MICROSAR RTE" VALUE 0x0 RTE_RL_UWORD 0 NO_COMPU_METHOD 0 65535 SYMBOL_LINK "Rte_CalprmRom_CalRegn01Inin00_DEFAULT_RTE_CALPRM_GROUP.HwAg0MeasHwAg0IfFltPassStep_Val" 0 DISPLAY_IDENTIFIER HwAg0Meas.CalibrationPorts.HwAg0MeasHwAg0IfFltPassStep.Val /end CHARACTERISTIC
/begin CHARACTERISTIC HwAg0Meas.HwAg0MeasHwAg0Snsr0PrtclFltFailStep.Val "MICROSAR RTE" VALUE 0x0 RTE_RL_UWORD 0 NO_COMPU_METHOD 0 65535 SYMBOL_LINK "Rte_CalprmRom_CalRegn01Inin00_DEFAULT_RTE_CALPRM_GROUP.HwAg0MeasHwAg0Snsr0PrtclFltFailStep_Val" 0 DISPLAY_IDENTIFIER HwAg0Meas.CalibrationPorts.HwAg0MeasHwAg0Snsr0PrtclFltFailStep.Val /end CHARACTERISTIC
/begin CHARACTERISTIC HwAg0Meas.HwAg0MeasHwAg0Snsr0PrtclFltPassStep.Val "MICROSAR RTE" VALUE 0x0 RTE_RL_UWORD 0 NO_COMPU_METHOD 0 65535 SYMBOL_LINK "Rte_CalprmRom_CalRegn01Inin00_DEFAULT_RTE_CALPRM_GROUP.HwAg0MeasHwAg0Snsr0PrtclFltPassStep_Val" 0 DISPLAY_IDENTIFIER HwAg0Meas.CalibrationPorts.HwAg0MeasHwAg0Snsr0PrtclFltPassStep.Val /end CHARACTERISTIC
/begin CHARACTERISTIC HwAg0Meas.HwAg0MeasHwAg0Snsr1PrtclFltFailStep.Val "MICROSAR RTE" VALUE 0x0 RTE_RL_UWORD 0 NO_COMPU_METHOD 0 65535 SYMBOL_LINK "Rte_CalprmRom_CalRegn01Inin00_DEFAULT_RTE_CALPRM_GROUP.HwAg0MeasHwAg0Snsr1PrtclFltFailStep_Val" 0 DISPLAY_IDENTIFIER HwAg0Meas.CalibrationPorts.HwAg0MeasHwAg0Snsr1PrtclFltFailStep.Val /end CHARACTERISTIC
/begin CHARACTERISTIC HwAg0Meas.HwAg0MeasHwAg0Snsr1PrtclFltPassStep.Val "MICROSAR RTE" VALUE 0x0 RTE_RL_UWORD 0 NO_COMPU_METHOD 0 65535 SYMBOL_LINK "Rte_CalprmRom_CalRegn01Inin00_DEFAULT_RTE_CALPRM_GROUP.HwAg0MeasHwAg0Snsr1PrtclFltPassStep_Val" 0 DISPLAY_IDENTIFIER HwAg0Meas.CalibrationPorts.HwAg0MeasHwAg0Snsr1PrtclFltPassStep.Val /end CHARACTERISTIC
/begin CHARACTERISTIC HwAg0Meas.HwAg0MeasSnsr0Rev.Ary1D "MICROSAR RTE" VAL_BLK 0x0 RTE_RL_UBYTE 0 NO_COMPU_METHOD 0.0 255.0 MATRIX_DIM 22 1 1 SYMBOL_LINK "Rte_CalprmRom_CalRegn01Inin00_DEFAULT_RTE_CALPRM_GROUP.HwAg0MeasSnsr0Rev_Ary1D" 0 DISPLAY_IDENTIFIER HwAg0Meas.CalibrationPorts.HwAg0MeasSnsr0Rev.Ary1D /end CHARACTERISTIC
/begin CHARACTERISTIC HwAg0Meas.HwAg0MeasSnsr1Rev.Ary1D "MICROSAR RTE" VAL_BLK 0x0 RTE_RL_UBYTE 0 NO_COMPU_METHOD 0.0 255.0 MATRIX_DIM 22 1 1 SYMBOL_LINK "Rte_CalprmRom_CalRegn01Inin00_DEFAULT_RTE_CALPRM_GROUP.HwAg0MeasSnsr1Rev_Ary1D" 0 DISPLAY_IDENTIFIER HwAg0Meas.CalibrationPorts.HwAg0MeasSnsr1Rev.Ary1D /end CHARACTERISTIC
/begin CHARACTERISTIC HwAg0Meas.HwAg0MeasStep.Ary1D "MICROSAR RTE" VAL_BLK 0x0 RTE_RL_SWORD 0 NO_COMPU_METHOD -500.0 500.0 MATRIX_DIM 22 1 1 SYMBOL_LINK "Rte_CalprmRom_CalRegn01Inin00_DEFAULT_RTE_CALPRM_GROUP.HwAg0MeasStep_Ary1D" 0 DISPLAY_IDENTIFIER HwAg0Meas.CalibrationPorts.HwAg0MeasStep.Ary1D /end CHARACTERISTIC
/begin MEASUREMENT GmOvrlStMgr.HwOscnEna.Logl "MICROSAR RTE" UBYTE RTE_CM_BOOLEAN 0 0 0 255 ECU_ADDRESS 0 SYMBOL_LINK "Rte_GmOvrlStMgr_HwOscnEna_Logl" 0 DISPLAY_IDENTIFIER GmOvrlStMgr.SenderPorts.HwOscnEna.Logl /end MEASUREMENT
/begin MEASUREMENT GmOvrlStMgr.HwOscnFrq.Val "MICROSAR RTE" FLOAT32_IEEE NO_COMPU_METHOD 0 0 -3.402823466e+38 3.402823466e+38 ECU_ADDRESS 0 SYMBOL_LINK "Rte_GmOvrlStMgr_HwOscnFrq_Val" 0 DISPLAY_IDENTIFIER GmOvrlStMgr.SenderPorts.HwOscnFrq.Val /end MEASUREMENT
/begin MEASUREMENT GmOvrlStMgr.HwOscnMotAmp.Val "MICROSAR RTE" FLOAT32_IEEE NO_COMPU_METHOD 0 0 -3.402823466e+38 3.402823466e+38 ECU_ADDRESS 0 SYMBOL_LINK "Rte_GmOvrlStMgr_HwOscnMotAmp_Val" 0 DISPLAY_IDENTIFIER GmOvrlStMgr.SenderPorts.HwOscnMotAmp.Val /end MEASUREMENT
/begin MEASUREMENT GmOvrlStMgr.HwTq.Val "MICROSAR RTE" FLOAT32_IEEE NO_COMPU_METHOD 0 0 -3.402823466e+38 3.402823466e+38 ECU_ADDRESS 0 SYMBOL_LINK "Rte_Swp_HwTqSwp_Val" 0 DISPLAY_IDENTIFIER GmOvrlStMgr.ReceiverPorts.HwTq.Val /end MEASUREMENT
/begin MEASUREMENT GmOvrlStMgr.HwTqLkaLpFil.FilGain "MICROSAR RTE" FLOAT32_IEEE NO_COMPU_METHOD 0 0 -3.402823466e+38 3.402823466e+38 ECU_ADDRESS 0 SYMBOL_LINK "Rte_GmOvrlStMgr_HwTqLkaLpFil.FilGain" 0 DISPLAY_IDENTIFIER GmOvrlStMgr.PerInstanceMemories.HwTqLkaLpFil.FilGain /end MEASUREMENT
/begin MEASUREMENT GmOvrlStMgr.HwTqLkaLpFil.FilSt "MICROSAR RTE" FLOAT32_IEEE NO_COMPU_METHOD 0 0 -3.402823466e+38 3.402823466e+38 ECU_ADDRESS 0 SYMBOL_LINK "Rte_GmOvrlStMgr_HwTqLkaLpFil.FilSt" 0 DISPLAY_IDENTIFIER GmOvrlStMgr.PerInstanceMemories.HwTqLkaLpFil.FilSt /end MEASUREMENT
/begin MEASUREMENT GmOvrlStMgr.HwTqLpFil.FilGain "MICROSAR RTE" FLOAT32_IEEE NO_COMPU_METHOD 0 0 -3.402823466e+38 3.402823466e+38 ECU_ADDRESS 0 SYMBOL_LINK "Rte_GmOvrlStMgr_HwTqLpFil.FilGain" 0 DISPLAY_IDENTIFIER GmOvrlStMgr.PerInstanceMemories.HwTqLpFil.FilGain /end MEASUREMENT
/begin MEASUREMENT GmOvrlStMgr.HwTqLpFil.FilSt "MICROSAR RTE" FLOAT32_IEEE NO_COMPU_METHOD 0 0 -3.402823466e+38 3.402823466e+38 ECU_ADDRESS 0 SYMBOL_LINK "Rte_GmOvrlStMgr_HwTqLpFil.FilSt" 0 DISPLAY_IDENTIFIER GmOvrlStMgr.PerInstanceMemories.HwTqLpFil.FilSt /end MEASUREMENT
/begin MEASUREMENT GmOvrlStMgr.HwTqOscSt.Val "MICROSAR RTE" UBYTE NO_COMPU_METHOD 0 0 0 255 ECU_ADDRESS 0 SYMBOL_LINK "Rte_GmOvrlStMgr_HwTqOscSt_Val" 0 DISPLAY_IDENTIFIER GmOvrlStMgr.SenderPorts.HwTqOscSt.Val /end MEASUREMENT
/begin MEASUREMENT GmOvrlStMgr.HwTqOscnLpFil.FilGain "MICROSAR RTE" FLOAT32_IEEE NO_COMPU_METHOD 0 0 -3.402823466e+38 3.402823466e+38 ECU_ADDRESS 0 SYMBOL_LINK "Rte_GmOvrlStMgr_HwTqOscnLpFil.FilGain" 0 DISPLAY_IDENTIFIER GmOvrlStMgr.PerInstanceMemories.HwTqOscnLpFil.FilGain /end MEASUREMENT
/begin MEASUREMENT GmOvrlStMgr.HwTqOscnLpFil.FilSt "MICROSAR RTE" FLOAT32_IEEE NO_COMPU_METHOD 0 0 -3.402823466e+38 3.402823466e+38 ECU_ADDRESS 0 SYMBOL_LINK "Rte_GmOvrlStMgr_HwTqOscnLpFil.FilSt" 0 DISPLAY_IDENTIFIER GmOvrlStMgr.PerInstanceMemories.HwTqOscnLpFil.FilSt /end MEASUREMENT
/begin MEASUREMENT GmOvrlStMgr.IgnCntrUpd "MICROSAR RTE" UBYTE RTE_CM_BOOLEAN 0 0 0 255 ECU_ADDRESS 0 SYMBOL_LINK "Rte_GmOvrlStMgr_IgnCntrUpd" 0 DISPLAY_IDENTIFIER GmOvrlStMgr.PerInstanceMemories.IgnCntrUpd /end MEASUREMENT
/begin MEASUREMENT GmOvrlStMgr.LkaEna.Logl "MICROSAR RTE" UBYTE RTE_CM_BOOLEAN 0 0 0 255 ECU_ADDRESS 0 SYMBOL_LINK "Rte_GmFctDiArbn_LkaEnaArbn_Logl" 0 DISPLAY_IDENTIFIER GmOvrlStMgr.ReceiverPorts.LkaEna.Logl /end MEASUREMENT
/begin MEASUREMENT GmOvrlStMgr.LkaFltCntr "MICROSAR RTE" UBYTE NO_COMPU_METHOD 0 0 0 255 ECU_ADDRESS 0 SYMBOL_LINK "Rte_GmOvrlStMgr_LkaFltCntr" 0 DISPLAY_IDENTIFIER GmOvrlStMgr.PerInstanceMemories.LkaFltCntr /end MEASUREMENT
/begin MEASUREMENT GmOvrlStMgr.LkaFltPrev "MICROSAR RTE" UBYTE RTE_CM_BOOLEAN 0 0 0 255 ECU_ADDRESS 0 SYMBOL_LINK "Rte_GmOvrlStMgr_LkaFltPrev" 0 DISPLAY_IDENTIFIER GmOvrlStMgr.PerInstanceMemories.LkaFltPrev /end MEASUREMENT
/begin MEASUREMENT GmOvrlStMgr.LkaFltRefTmr "MICROSAR RTE" ULONG NO_COMPU_METHOD 0 0 0 4294967295 ECU_ADDRESS 0 SYMBOL_LINK "Rte_GmOvrlStMgr_LkaFltRefTmr" 0 DISPLAY_IDENTIFIER GmOvrlStMgr.PerInstanceMemories.LkaFltRefTmr /end MEASUREMENT
/begin MEASUREMENT GmOvrlStMgr.LkaIntvPrev "MICROSAR RTE" UBYTE RTE_CM_BOOLEAN 0 0 0 255 ECU_ADDRESS 0 SYMBOL_LINK "Rte_GmOvrlStMgr_LkaIntvPrev" 0 DISPLAY_IDENTIFIER GmOvrlStMgr.PerInstanceMemories.LkaIntvPrev /end MEASUREMENT
/begin MEASUREMENT GmOvrlStMgr.LkaIntvRefTi1 "MICROSAR RTE" ULONG NO_COMPU_METHOD 0 0 0 4294967295 ECU_ADDRESS 0 SYMBOL_LINK "Rte_GmOvrlStMgr_LkaIntvRefTi1" 0 DISPLAY_IDENTIFIER GmOvrlStMgr.PerInstanceMemories.LkaIntvRefTi1 /end MEASUREMENT
/begin MEASUREMENT GmOvrlStMgr.LkaIntvRefTi2 "MICROSAR RTE" ULONG NO_COMPU_METHOD 0 0 0 4294967295 ECU_ADDRESS 0 SYMBOL_LINK "Rte_GmOvrlStMgr_LkaIntvRefTi2" 0 DISPLAY_IDENTIFIER GmOvrlStMgr.PerInstanceMemories.LkaIntvRefTi2 /end MEASUREMENT
/begin MEASUREMENT GmOvrlStMgr.LkaSt.Val "MICROSAR RTE" UBYTE NO_COMPU_METHOD 0 0 0 255 ECU_ADDRESS 0 SYMBOL_LINK "Rte_GmOvrlStMgr_LkaSt_Val" 0 DISPLAY_IDENTIFIER GmOvrlStMgr.SenderPorts.LkaSt.Val /end MEASUREMENT
/begin MEASUREMENT GmOvrlStMgr.LkaTqCmdCdnd.Val "MICROSAR RTE" FLOAT32_IEEE NO_COMPU_METHOD 0 0 -3.402823466e+38 3.402823466e+38 ECU_ADDRESS 0 SYMBOL_LINK "Rte_GmTqArbn_LkaTqCmdCdnd_Val" 0 DISPLAY_IDENTIFIER GmOvrlStMgr.ReceiverPorts.LkaTqCmdCdnd.Val /end MEASUREMENT
/begin MEASUREMENT GmOvrlStMgr.LoaMtgtnHaptcFbStrtOnRefTi "MICROSAR RTE" ULONG NO_COMPU_METHOD 0 0 0 4294967295 ECU_ADDRESS 0 SYMBOL_LINK "Rte_GmOvrlStMgr_LoaMtgtnHaptcFbStrtOnRefTi" 0 DISPLAY_IDENTIFIER GmOvrlStMgr.PerInstanceMemories.LoaMtgtnHaptcFbStrtOnRefTi /end MEASUREMENT
/begin MEASUREMENT GmOvrlStMgr.LoaSt.Val "MICROSAR RTE" UBYTE RTE_CM_ENUM_LoaSt1 0 0 0 255 ECU_ADDRESS 0 SYMBOL_LINK "Rte_LoaMgr_LoaSt_Val" 0 DISPLAY_IDENTIFIER GmOvrlStMgr.ReceiverPorts.LoaSt.Val /end MEASUREMENT
/begin MEASUREMENT GmOvrlStMgr.LoaStChk "MICROSAR RTE" UBYTE RTE_CM_BOOLEAN 0 0 0 255 ECU_ADDRESS 0 SYMBOL_LINK "Rte_GmOvrlStMgr_LoaStChk" 0 DISPLAY_IDENTIFIER GmOvrlStMgr.PerInstanceMemories.LoaStChk /end MEASUREMENT
/begin MEASUREMENT GmOvrlStMgr.Msg17DBusHiSpdInvld.Logl "MICROSAR RTE" UBYTE RTE_CM_BOOLEAN 0 0 0 255 ECU_ADDRESS 0 SYMBOL_LINK "Rte_GmMsg17DBusHiSpd_InvldMsg17D_Logl" 0 DISPLAY_IDENTIFIER GmOvrlStMgr.ReceiverPorts.Msg17DBusHiSpdInvld.Logl /end MEASUREMENT
/begin MEASUREMENT GmOvrlStMgr.Msg17DBusHiSpdMiss.Logl "MICROSAR RTE" UBYTE RTE_CM_BOOLEAN 0 0 0 255 ECU_ADDRESS 0 SYMBOL_LINK "Rte_GmMsg17DBusHiSpd_MissMsg17D_Logl" 0 DISPLAY_IDENTIFIER GmOvrlStMgr.ReceiverPorts.Msg17DBusHiSpdMiss.Logl /end MEASUREMENT
/begin MEASUREMENT GmOvrlStMgr.Msg180BusChassisExpInvld.Logl "MICROSAR RTE" UBYTE RTE_CM_BOOLEAN 0 0 0 255 ECU_ADDRESS 0 SYMBOL_LINK "Rte_GmMsg180BusChassisExp_InvldMsg180BusChassisExp_Logl" 0 DISPLAY_IDENTIFIER GmOvrlStMgr.ReceiverPorts.Msg180BusChassisExpInvld.Logl /end MEASUREMENT
/begin MEASUREMENT GmOvrlStMgr.Msg180BusChassisExpMiss.Logl "MICROSAR RTE" UBYTE RTE_CM_BOOLEAN 0 0 0 255 ECU_ADDRESS 0 SYMBOL_LINK "Rte_GmMsg180BusChassisExp_MissMsg180BusChassisExp_Logl" 0 DISPLAY_IDENTIFIER GmOvrlStMgr.ReceiverPorts.Msg180BusChassisExpMiss.Logl /end MEASUREMENT
/begin MEASUREMENT GmOvrlStMgr.Msg180BusHiSpdInvld.Logl "MICROSAR RTE" UBYTE RTE_CM_BOOLEAN 0 0 0 255 ECU_ADDRESS 0 SYMBOL_LINK "Rte_GmMsg180BusHiSpd_InvldMsg180BusHiSpd_Logl" 0 DISPLAY_IDENTIFIER GmOvrlStMgr.ReceiverPorts.Msg180BusHiSpdInvld.Logl /end MEASUREMENT
/begin MEASUREMENT GmOvrlStMgr.Msg180BusHiSpdMiss.Logl "MICROSAR RTE" UBYTE RTE_CM_BOOLEAN 0 0 0 255 ECU_ADDRESS 0 SYMBOL_LINK "Rte_GmMsg180BusHiSpd_MissMsg180BusHiSpd_Logl" 0 DISPLAY_IDENTIFIER GmOvrlStMgr.ReceiverPorts.Msg180BusHiSpdMiss.Logl /end MEASUREMENT
/begin MEASUREMENT GmOvrlStMgr.Msg1E9BusHiSpdInvld.Logl "MICROSAR RTE" UBYTE RTE_CM_BOOLEAN 0 0 0 255 ECU_ADDRESS 0 SYMBOL_LINK "Rte_GmMsg1E9BusHiSpd_InvldMsg1E9_Logl" 0 DISPLAY_IDENTIFIER GmOvrlStMgr.ReceiverPorts.Msg1E9BusHiSpdInvld.Logl /end MEASUREMENT
/begin MEASUREMENT GmOvrlStMgr.Msg1E9BusHiSpdMiss.Logl "MICROSAR RTE" UBYTE RTE_CM_BOOLEAN 0 0 0 255 ECU_ADDRESS 0 SYMBOL_LINK "Rte_GmMsg1E9BusHiSpd_MissMsg1E9_Logl" 0 DISPLAY_IDENTIFIER GmOvrlStMgr.ReceiverPorts.Msg1E9BusHiSpdMiss.Logl /end MEASUREMENT
/begin MEASUREMENT GmOvrlStMgr.Msg1F5BusHiSpdInvld.Logl "MICROSAR RTE" UBYTE RTE_CM_BOOLEAN 0 0 0 255 ECU_ADDRESS 0 SYMBOL_LINK "Rte_GmMsg1F5BusHiSpd_InvldMsg1F5_Logl" 0 DISPLAY_IDENTIFIER GmOvrlStMgr.ReceiverPorts.Msg1F5BusHiSpdInvld.Logl /end MEASUREMENT
/begin MEASUREMENT GmOvrlStMgr.Msg214BusHiSpdInvld.Logl "MICROSAR RTE" UBYTE RTE_CM_BOOLEAN 0 0 0 255 ECU_ADDRESS 0 SYMBOL_LINK "Rte_GmMsg214BusHiSpd_VehStabyEnhmtInvld_Logl" 0 DISPLAY_IDENTIFIER GmOvrlStMgr.ReceiverPorts.Msg214BusHiSpdInvld.Logl /end MEASUREMENT
/begin MEASUREMENT GmOvrlStMgr.Msg214BusHiSpdMiss.Logl "MICROSAR RTE" UBYTE RTE_CM_BOOLEAN 0 0 0 255 ECU_ADDRESS 0 SYMBOL_LINK "Rte_GmMsg214BusHiSpd_MissMsg214_Logl" 0 DISPLAY_IDENTIFIER GmOvrlStMgr.ReceiverPorts.Msg214BusHiSpdMiss.Logl /end MEASUREMENT
/begin MEASUREMENT GmOvrlStMgr.Msg337BusChassisExpInvld.Logl "MICROSAR RTE" UBYTE RTE_CM_BOOLEAN 0 0 0 255 ECU_ADDRESS 0 SYMBOL_LINK "Rte_GmMsg337BusChassisExp_InvldMsg337_Logl" 0 DISPLAY_IDENTIFIER GmOvrlStMgr.ReceiverPorts.Msg337BusChassisExpInvld.Logl /end MEASUREMENT
/begin MEASUREMENT GmOvrlStMgr.Msg337BusChassisExpMiss.Logl "MICROSAR RTE" UBYTE RTE_CM_BOOLEAN 0 0 0 255 ECU_ADDRESS 0 SYMBOL_LINK "Rte_GmMsg337BusChassisExp_MissMsg337_Logl" 0 DISPLAY_IDENTIFIER GmOvrlStMgr.ReceiverPorts.Msg337BusChassisExpMiss.Logl /end MEASUREMENT
/begin MEASUREMENT GmOvrlStMgr.PrevApaIntvEna "MICROSAR RTE" UBYTE RTE_CM_BOOLEAN 0 0 0 255 ECU_ADDRESS 0 SYMBOL_LINK "Rte_GmOvrlStMgr_PrevApaIntvEna" 0 DISPLAY_IDENTIFIER GmOvrlStMgr.PerInstanceMemories.PrevApaIntvEna /end MEASUREMENT
/begin MEASUREMENT GmOvrlStMgr.PrevApaIntvRefTi "MICROSAR RTE" ULONG NO_COMPU_METHOD 0 0 0 4294967295 ECU_ADDRESS 0 SYMBOL_LINK "Rte_GmOvrlStMgr_PrevApaIntvRefTi" 0 DISPLAY_IDENTIFIER GmOvrlStMgr.PerInstanceMemories.PrevApaIntvRefTi /end MEASUREMENT
/begin MEASUREMENT GmOvrlStMgr.PrevApaSt "MICROSAR RTE" UBYTE NO_COMPU_METHOD 0 0 0 255 ECU_ADDRESS 0 SYMBOL_LINK "Rte_GmOvrlStMgr_PrevApaSt" 0 DISPLAY_IDENTIFIER GmOvrlStMgr.PerInstanceMemories.PrevApaSt /end MEASUREMENT
/begin MEASUREMENT GmOvrlStMgr.PrevEscSt "MICROSAR RTE" UBYTE NO_COMPU_METHOD 0 0 0 255 ECU_ADDRESS 0 SYMBOL_LINK "Rte_GmOvrlStMgr_PrevEscSt" 0 DISPLAY_IDENTIFIER GmOvrlStMgr.PerInstanceMemories.PrevEscSt /end MEASUREMENT
/begin MEASUREMENT GmOvrlStMgr.PrevHaptcReqEna "MICROSAR RTE" UBYTE RTE_CM_BOOLEAN 0 0 0 255 ECU_ADDRESS 0 SYMBOL_LINK "Rte_GmOvrlStMgr_PrevHaptcReqEna" 0 DISPLAY_IDENTIFIER GmOvrlStMgr.PerInstanceMemories.PrevHaptcReqEna /end MEASUREMENT
/begin MEASUREMENT GmOvrlStMgr.PrevHaptcReqRefTi "MICROSAR RTE" ULONG NO_COMPU_METHOD 0 0 0 4294967295 ECU_ADDRESS 0 SYMBOL_LINK "Rte_GmOvrlStMgr_PrevHaptcReqRefTi" 0 DISPLAY_IDENTIFIER GmOvrlStMgr.PerInstanceMemories.PrevHaptcReqRefTi /end MEASUREMENT
/begin MEASUREMENT GmOvrlStMgr.PrevHaptcSt "MICROSAR RTE" UBYTE NO_COMPU_METHOD 0 0 0 255 ECU_ADDRESS 0 SYMBOL_LINK "Rte_GmOvrlStMgr_PrevHaptcSt" 0 DISPLAY_IDENTIFIER GmOvrlStMgr.PerInstanceMemories.PrevHaptcSt /end MEASUREMENT
/begin MEASUREMENT GmOvrlStMgr.PrevLkaFlt "MICROSAR RTE" UBYTE RTE_CM_BOOLEAN 0 0 0 255 ECU_ADDRESS 0 SYMBOL_LINK "Rte_GmOvrlStMgr_PrevLkaFlt" 0 DISPLAY_IDENTIFIER GmOvrlStMgr.PerInstanceMemories.PrevLkaFlt /end MEASUREMENT
/begin MEASUREMENT GmOvrlStMgr.PrevLkaSt "MICROSAR RTE" UBYTE NO_COMPU_METHOD 0 0 0 255 ECU_ADDRESS 0 SYMBOL_LINK "Rte_GmOvrlStMgr_PrevLkaSt" 0 DISPLAY_IDENTIFIER GmOvrlStMgr.PerInstanceMemories.PrevLkaSt /end MEASUREMENT
/begin MEASUREMENT GmOvrlStMgr.PrevShiftLvrRvsEna "MICROSAR RTE" UBYTE RTE_CM_BOOLEAN 0 0 0 255 ECU_ADDRESS 0 SYMBOL_LINK "Rte_GmOvrlStMgr_PrevShiftLvrRvsEna" 0 DISPLAY_IDENTIFIER GmOvrlStMgr.PerInstanceMemories.PrevShiftLvrRvsEna /end MEASUREMENT
/begin MEASUREMENT GmOvrlStMgr.PrevShiftLvrRvsRefTi "MICROSAR RTE" ULONG NO_COMPU_METHOD 0 0 0 4294967295 ECU_ADDRESS 0 SYMBOL_LINK "Rte_GmOvrlStMgr_PrevShiftLvrRvsRefTi" 0 DISPLAY_IDENTIFIER GmOvrlStMgr.PerInstanceMemories.PrevShiftLvrRvsRefTi /end MEASUREMENT
/begin MEASUREMENT GmOvrlStMgr.PrevVehStandStillEna "MICROSAR RTE" UBYTE RTE_CM_BOOLEAN 0 0 0 255 ECU_ADDRESS 0 SYMBOL_LINK "Rte_GmOvrlStMgr_PrevVehStandStillEna" 0 DISPLAY_IDENTIFIER GmOvrlStMgr.PerInstanceMemories.PrevVehStandStillEna /end MEASUREMENT
/begin MEASUREMENT GmOvrlStMgr.PrevVehStandStillRefTi "MICROSAR RTE" ULONG NO_COMPU_METHOD 0 0 0 4294967295 ECU_ADDRESS 0 SYMBOL_LINK "Rte_GmOvrlStMgr_PrevVehStandStillRefTi" 0 DISPLAY_IDENTIFIER GmOvrlStMgr.PerInstanceMemories.PrevVehStandStillRefTi /end MEASUREMENT
/begin MEASUREMENT GmOvrlStMgr.ShiftLvrRvs.Logl "MICROSAR RTE" UBYTE RTE_CM_BOOLEAN 0 0 0 255 ECU_ADDRESS 0 SYMBOL_LINK "Rte_GmMsg1F5BusHiSpd_ShiftLvrInRvs_Logl" 0 DISPLAY_IDENTIFIER GmOvrlStMgr.ReceiverPorts.ShiftLvrRvs.Logl /end MEASUREMENT
/begin MEASUREMENT GmOvrlStMgr.SysSt.Val "MICROSAR RTE" UBYTE RTE_CM_ENUM_SysSt1 0 0 0 255 ECU_ADDRESS 0 SYMBOL_LINK "Rte_SysStMod_SysSt_Val" 0 DISPLAY_IDENTIFIER GmOvrlStMgr.ReceiverPorts.SysSt.Val /end MEASUREMENT
/begin MEASUREMENT GmOvrlStMgr.TqOscCycRefTi "MICROSAR RTE" ULONG NO_COMPU_METHOD 0 0 0 4294967295 ECU_ADDRESS 0 SYMBOL_LINK "Rte_GmOvrlStMgr_TqOscCycRefTi" 0 DISPLAY_IDENTIFIER GmOvrlStMgr.PerInstanceMemories.TqOscCycRefTi /end MEASUREMENT
/begin MEASUREMENT GmOvrlStMgr.TranHaptcWaitToApaStActvRefTi "MICROSAR RTE" ULONG NO_COMPU_METHOD 0 0 0 4294967295 ECU_ADDRESS 0 SYMBOL_LINK "Rte_GmOvrlStMgr_TranHaptcWaitToApaStActvRefTi" 0 DISPLAY_IDENTIFIER GmOvrlStMgr.PerInstanceMemories.TranHaptcWaitToApaStActvRefTi /end MEASUREMENT
/begin MEASUREMENT GmOvrlStMgr.VehSpd.Val "MICROSAR RTE" FLOAT32_IEEE NO_COMPU_METHOD 0 0 -3.402823466e+38 3.402823466e+38 ECU_ADDRESS 0 SYMBOL_LINK "Rte_VehSigCdng_VehSpd_Val" 0 DISPLAY_IDENTIFIER GmOvrlStMgr.ReceiverPorts.VehSpd.Val /end MEASUREMENT
/begin MEASUREMENT GmOvrlStMgr.VehSpdSecurMax.Val "MICROSAR RTE" FLOAT32_IEEE NO_COMPU_METHOD 0 0 -3.402823466e+38 3.402823466e+38 ECU_ADDRESS 0 SYMBOL_LINK "Rte_GmVehSpdArbn_VehSpdMaxSecur_Val" 0 DISPLAY_IDENTIFIER GmOvrlStMgr.ReceiverPorts.VehSpdSecurMax.Val /end MEASUREMENT
/begin MEASUREMENT GmOvrlStMgr.VehSpdSecurMaxVld.Logl "MICROSAR RTE" UBYTE RTE_CM_BOOLEAN 0 0 0 255 ECU_ADDRESS 0 SYMBOL_LINK "Rte_GmVehSpdArbn_VehSpdMaxSecurVld_Logl" 0 DISPLAY_IDENTIFIER GmOvrlStMgr.ReceiverPorts.VehSpdSecurMaxVld.Logl /end MEASUREMENT
/begin MEASUREMENT GmOvrlStMgr.VehSpdSecurMin.Val "MICROSAR RTE" FLOAT32_IEEE NO_COMPU_METHOD 0 0 -3.402823466e+38 3.402823466e+38 ECU_ADDRESS 0 SYMBOL_LINK "Rte_GmVehSpdArbn_VehSpdMinSecur_Val" 0 DISPLAY_IDENTIFIER GmOvrlStMgr.ReceiverPorts.VehSpdSecurMin.Val /end MEASUREMENT
/begin MEASUREMENT GmOvrlStMgr.VehSpdSecurMinVld.Logl "MICROSAR RTE" UBYTE RTE_CM_BOOLEAN 0 0 0 255 ECU_ADDRESS 0 SYMBOL_LINK "Rte_GmVehSpdArbn_VehSpdMinSecurVld_Logl" 0 DISPLAY_IDENTIFIER GmOvrlStMgr.ReceiverPorts.VehSpdSecurMinVld.Logl /end MEASUREMENT
/begin MEASUREMENT GmOvrlStMgr.VehStabyEnhmtActv.Logl "MICROSAR RTE" UBYTE RTE_CM_BOOLEAN 0 0 0 255 ECU_ADDRESS 0 SYMBOL_LINK "Rte_GmMsg1E9BusHiSpd_VehStabyEnhmtActv_Logl" 0 DISPLAY_IDENTIFIER GmOvrlStMgr.ReceiverPorts.VehStabyEnhmtActv.Logl /end MEASUREMENT
/begin MEASUREMENT GmOvrlStMgr.dGmOvrlStMgrApaShiftLvrRvs "MICROSAR RTE" UBYTE RTE_CM_BOOLEAN 0 0 0 255 ECU_ADDRESS 0 SYMBOL_LINK "Rte_GmOvrlStMgr_dGmOvrlStMgrApaShiftLvrRvs" 0 DISPLAY_IDENTIFIER GmOvrlStMgr.PerInstanceMemories.dGmOvrlStMgrApaShiftLvrRvs /end MEASUREMENT
/begin MEASUREMENT GmOvrlStMgr.dGmOvrlStMgrApaStandStill "MICROSAR RTE" UBYTE RTE_CM_BOOLEAN 0 0 0 255 ECU_ADDRESS 0 SYMBOL_LINK "Rte_GmOvrlStMgr_dGmOvrlStMgrApaStandStill" 0 DISPLAY_IDENTIFIER GmOvrlStMgr.PerInstanceMemories.dGmOvrlStMgrApaStandStill /end MEASUREMENT
/begin MEASUREMENT GmRoadWhlInQlfr.PrevLeWhlFrq "MICROSAR RTE" FLOAT32_IEEE NO_COMPU_METHOD 0 0 -3.402823466e+38 3.402823466e+38 ECU_ADDRESS 0 SYMBOL_LINK "Rte_GmRoadWhlInQlfr_PrevLeWhlFrq" 0 DISPLAY_IDENTIFIER GmRoadWhlInQlfr.PerInstanceMemories.PrevLeWhlFrq /end MEASUREMENT
/begin MEASUREMENT GmRoadWhlInQlfr.PrevLeWhlFrqVld "MICROSAR RTE" UBYTE RTE_CM_BOOLEAN 0 0 0 255 ECU_ADDRESS 0 SYMBOL_LINK "Rte_GmRoadWhlInQlfr_PrevLeWhlFrqVld" 0 DISPLAY_IDENTIFIER GmRoadWhlInQlfr.PerInstanceMemories.PrevLeWhlFrqVld /end MEASUREMENT
/begin MEASUREMENT GmRoadWhlInQlfr.PrevRawLeWhlFrq "MICROSAR RTE" FLOAT32_IEEE NO_COMPU_METHOD 0 0 -3.402823466e+38 3.402823466e+38 ECU_ADDRESS 0 SYMBOL_LINK "Rte_GmRoadWhlInQlfr_PrevRawLeWhlFrq" 0 DISPLAY_IDENTIFIER GmRoadWhlInQlfr.PerInstanceMemories.PrevRawLeWhlFrq /end MEASUREMENT
/begin MEASUREMENT GmRoadWhlInQlfr.PrevRawRiWhlFrq "MICROSAR RTE" FLOAT32_IEEE NO_COMPU_METHOD 0 0 -3.402823466e+38 3.402823466e+38 ECU_ADDRESS 0 SYMBOL_LINK "Rte_GmRoadWhlInQlfr_PrevRawRiWhlFrq" 0 DISPLAY_IDENTIFIER GmRoadWhlInQlfr.PerInstanceMemories.PrevRawRiWhlFrq /end MEASUREMENT
/begin MEASUREMENT GmRoadWhlInQlfr.PrevRiWhlFrq "MICROSAR RTE" FLOAT32_IEEE NO_COMPU_METHOD 0 0 -3.402823466e+38 3.402823466e+38 ECU_ADDRESS 0 SYMBOL_LINK "Rte_GmRoadWhlInQlfr_PrevRiWhlFrq" 0 DISPLAY_IDENTIFIER GmRoadWhlInQlfr.PerInstanceMemories.PrevRiWhlFrq /end MEASUREMENT
/begin MEASUREMENT GmRoadWhlInQlfr.PrevRiWhlFrqVld "MICROSAR RTE" UBYTE RTE_CM_BOOLEAN 0 0 0 255 ECU_ADDRESS 0 SYMBOL_LINK "Rte_GmRoadWhlInQlfr_PrevRiWhlFrqVld" 0 DISPLAY_IDENTIFIER GmRoadWhlInQlfr.PerInstanceMemories.PrevRiWhlFrqVld /end MEASUREMENT
/begin MEASUREMENT GmRoadWhlInQlfr.PrevVldLeWhlDstPlsCntr "MICROSAR RTE" UWORD NO_COMPU_METHOD 0 0 0 65535 ECU_ADDRESS 0 SYMBOL_LINK "Rte_GmRoadWhlInQlfr_PrevVldLeWhlDstPlsCntr" 0 DISPLAY_IDENTIFIER GmRoadWhlInQlfr.PerInstanceMemories.PrevVldLeWhlDstPlsCntr /end MEASUREMENT
/begin MEASUREMENT GmRoadWhlInQlfr.PrevVldLeWhlDstTiStamp "MICROSAR RTE" UWORD NO_COMPU_METHOD 0 0 0 65535 ECU_ADDRESS 0 SYMBOL_LINK "Rte_GmRoadWhlInQlfr_PrevVldLeWhlDstTiStamp" 0 DISPLAY_IDENTIFIER GmRoadWhlInQlfr.PerInstanceMemories.PrevVldLeWhlDstTiStamp /end MEASUREMENT
/begin MEASUREMENT GmRoadWhlInQlfr.PrevVldRiWhlDstPlsCntr "MICROSAR RTE" UWORD NO_COMPU_METHOD 0 0 0 65535 ECU_ADDRESS 0 SYMBOL_LINK "Rte_GmRoadWhlInQlfr_PrevVldRiWhlDstPlsCntr" 0 DISPLAY_IDENTIFIER GmRoadWhlInQlfr.PerInstanceMemories.PrevVldRiWhlDstPlsCntr /end MEASUREMENT
/begin MEASUREMENT GmRoadWhlInQlfr.PrevVldRiWhlDstTiStamp "MICROSAR RTE" UWORD NO_COMPU_METHOD 0 0 0 65535 ECU_ADDRESS 0 SYMBOL_LINK "Rte_GmRoadWhlInQlfr_PrevVldRiWhlDstTiStamp" 0 DISPLAY_IDENTIFIER GmRoadWhlInQlfr.PerInstanceMemories.PrevVldRiWhlDstTiStamp /end MEASUREMENT
/begin MEASUREMENT GmRoadWhlInQlfr.PrevVldTiLeFrqChg "MICROSAR RTE" ULONG NO_COMPU_METHOD 0 0 0 4294967295 ECU_ADDRESS 0 SYMBOL_LINK "Rte_GmRoadWhlInQlfr_PrevVldTiLeFrqChg" 0 DISPLAY_IDENTIFIER GmRoadWhlInQlfr.PerInstanceMemories.PrevVldTiLeFrqChg /end MEASUREMENT
/begin MEASUREMENT GmRoadWhlInQlfr.PrevVldTiRiFrqChg "MICROSAR RTE" ULONG NO_COMPU_METHOD 0 0 0 4294967295 ECU_ADDRESS 0 SYMBOL_LINK "Rte_GmRoadWhlInQlfr_PrevVldTiRiFrqChg" 0 DISPLAY_IDENTIFIER GmRoadWhlInQlfr.PerInstanceMemories.PrevVldTiRiFrqChg /end MEASUREMENT
/begin MEASUREMENT GmRoadWhlInQlfr.WhlFrqVld.Logl "MICROSAR RTE" UBYTE RTE_CM_BOOLEAN 0 0 0 255 ECU_ADDRESS 0 SYMBOL_LINK "Rte_GmRoadWhlInQlfr_WhlFrqVld_Logl" 0 DISPLAY_IDENTIFIER GmRoadWhlInQlfr.SenderPorts.WhlFrqVld.Logl /end MEASUREMENT
/begin MEASUREMENT GmRoadWhlInQlfr.WhlLeDstPlsCntr.Val "MICROSAR RTE" UWORD NO_COMPU_METHOD 0 0 0 65535 ECU_ADDRESS 0 SYMBOL_LINK "Rte_GmMsg0C5BusHiSpd_LeWhlDstPlsCntr_Val" 0 DISPLAY_IDENTIFIER GmRoadWhlInQlfr.ReceiverPorts.WhlLeDstPlsCntr.Val /end MEASUREMENT
/begin MEASUREMENT GmRoadWhlInQlfr.WhlLeDstTiStamp.Val "MICROSAR RTE" UWORD NO_COMPU_METHOD 0 0 0 65535 ECU_ADDRESS 0 SYMBOL_LINK "Rte_GmMsg0C5BusHiSpd_LeWhlDstTiStamp_Val" 0 DISPLAY_IDENTIFIER GmRoadWhlInQlfr.ReceiverPorts.WhlLeDstTiStamp.Val /end MEASUREMENT
/begin MEASUREMENT GmRoadWhlInQlfr.WhlLeDstVld.Logl "MICROSAR RTE" UBYTE RTE_CM_BOOLEAN 0 0 0 255 ECU_ADDRESS 0 SYMBOL_LINK "Rte_GmMsg0C5BusHiSpd_LeWhlDstVld_Logl" 0 DISPLAY_IDENTIFIER GmRoadWhlInQlfr.ReceiverPorts.WhlLeDstVld.Logl /end MEASUREMENT
/begin MEASUREMENT GmRoadWhlInQlfr.WhlLeFrq.Val "MICROSAR RTE" FLOAT32_IEEE NO_COMPU_METHOD 0 0 -3.402823466e+38 3.402823466e+38 ECU_ADDRESS 0 SYMBOL_LINK "Rte_GmRoadWhlInQlfr_WhlLeFrq_Val" 0 DISPLAY_IDENTIFIER GmRoadWhlInQlfr.SenderPorts.WhlLeFrq.Val /end MEASUREMENT
/begin MEASUREMENT GmRoadWhlInQlfr.WhlPlsPerRev.Val "MICROSAR RTE" UBYTE NO_COMPU_METHOD 0 0 0 255 ECU_ADDRESS 0 SYMBOL_LINK "Rte_GmMsg500BusHiSpd_WhlPlsPerRev_Val" 0 DISPLAY_IDENTIFIER GmRoadWhlInQlfr.ReceiverPorts.WhlPlsPerRev.Val /end MEASUREMENT
/begin MEASUREMENT GmRoadWhlInQlfr.WhlRiDstPlsCntr.Val "MICROSAR RTE" UWORD NO_COMPU_METHOD 0 0 0 65535 ECU_ADDRESS 0 SYMBOL_LINK "Rte_GmMsg0C5BusHiSpd_RiWhlDstPlsCntr_Val" 0 DISPLAY_IDENTIFIER GmRoadWhlInQlfr.ReceiverPorts.WhlRiDstPlsCntr.Val /end MEASUREMENT
/begin MEASUREMENT GmRoadWhlInQlfr.WhlRiDstTiStamp.Val "MICROSAR RTE" UWORD NO_COMPU_METHOD 0 0 0 65535 ECU_ADDRESS 0 SYMBOL_LINK "Rte_GmMsg0C5BusHiSpd_RiWhlDstTiStamp_Val" 0 DISPLAY_IDENTIFIER GmRoadWhlInQlfr.ReceiverPorts.WhlRiDstTiStamp.Val /end MEASUREMENT
/begin MEASUREMENT GmRoadWhlInQlfr.WhlRiDstVld.Logl "MICROSAR RTE" UBYTE RTE_CM_BOOLEAN 0 0 0 255 ECU_ADDRESS 0 SYMBOL_LINK "Rte_GmMsg0C5BusHiSpd_RiWhlDstVld_Logl" 0 DISPLAY_IDENTIFIER GmRoadWhlInQlfr.ReceiverPorts.WhlRiDstVld.Logl /end MEASUREMENT
/begin MEASUREMENT GmRoadWhlInQlfr.WhlRiFrq.Val "MICROSAR RTE" FLOAT32_IEEE NO_COMPU_METHOD 0 0 -3.402823466e+38 3.402823466e+38 ECU_ADDRESS 0 SYMBOL_LINK "Rte_GmRoadWhlInQlfr_WhlRiFrq_Val" 0 DISPLAY_IDENTIFIER GmRoadWhlInQlfr.SenderPorts.WhlRiFrq.Val /end MEASUREMENT
/begin MEASUREMENT GmRoadWhlInQlfr.WhlRotlStsTiStampResl.Val "MICROSAR RTE" FLOAT32_IEEE NO_COMPU_METHOD 0 0 -3.402823466e+38 3.402823466e+38 ECU_ADDRESS 0 SYMBOL_LINK "Rte_GmMsg500BusHiSpd_WhlRotlStsTiStampResl_Val" 0 DISPLAY_IDENTIFIER GmRoadWhlInQlfr.ReceiverPorts.WhlRotlStsTiStampResl.Val /end MEASUREMENT
/begin MEASUREMENT GmRoadWhlInQlfr.dGmRoadWhlInQlfrLeDeltaPls "MICROSAR RTE" UWORD NO_COMPU_METHOD 0 0 0 65535 ECU_ADDRESS 0 SYMBOL_LINK "Rte_GmRoadWhlInQlfr_dGmRoadWhlInQlfrLeDeltaPls" 0 DISPLAY_IDENTIFIER GmRoadWhlInQlfr.PerInstanceMemories.dGmRoadWhlInQlfrLeDeltaPls /end MEASUREMENT
/begin MEASUREMENT GmRoadWhlInQlfr.dGmRoadWhlInQlfrLeDeltaTiStamp "MICROSAR RTE" UWORD NO_COMPU_METHOD 0 0 0 65535 ECU_ADDRESS 0 SYMBOL_LINK "Rte_GmRoadWhlInQlfr_dGmRoadWhlInQlfrLeDeltaTiStamp" 0 DISPLAY_IDENTIFIER GmRoadWhlInQlfr.PerInstanceMemories.dGmRoadWhlInQlfrLeDeltaTiStamp /end MEASUREMENT
/begin MEASUREMENT GmRoadWhlInQlfr.dGmRoadWhlInQlfrLeWhlFrqVld "MICROSAR RTE" UBYTE RTE_CM_BOOLEAN 0 0 0 255 ECU_ADDRESS 0 SYMBOL_LINK "Rte_GmRoadWhlInQlfr_dGmRoadWhlInQlfrLeWhlFrqVld" 0 DISPLAY_IDENTIFIER GmRoadWhlInQlfr.PerInstanceMemories.dGmRoadWhlInQlfrLeWhlFrqVld /end MEASUREMENT
/begin MEASUREMENT GmRoadWhlInQlfr.dGmRoadWhlInQlfrRawLeWhlFrq "MICROSAR RTE" FLOAT32_IEEE NO_COMPU_METHOD 0 0 -3.402823466e+38 3.402823466e+38 ECU_ADDRESS 0 SYMBOL_LINK "Rte_GmRoadWhlInQlfr_dGmRoadWhlInQlfrRawLeWhlFrq" 0 DISPLAY_IDENTIFIER GmRoadWhlInQlfr.PerInstanceMemories.dGmRoadWhlInQlfrRawLeWhlFrq /end MEASUREMENT
/begin MEASUREMENT GmRoadWhlInQlfr.dGmRoadWhlInQlfrRawRiWhlFrq "MICROSAR RTE" FLOAT32_IEEE NO_COMPU_METHOD 0 0 -3.402823466e+38 3.402823466e+38 ECU_ADDRESS 0 SYMBOL_LINK "Rte_GmRoadWhlInQlfr_dGmRoadWhlInQlfrRawRiWhlFrq" 0 DISPLAY_IDENTIFIER GmRoadWhlInQlfr.PerInstanceMemories.dGmRoadWhlInQlfrRawRiWhlFrq /end MEASUREMENT
/begin MEASUREMENT GmRoadWhlInQlfr.dGmRoadWhlInQlfrRiDeltaPls "MICROSAR RTE" UWORD NO_COMPU_METHOD 0 0 0 65535 ECU_ADDRESS 0 SYMBOL_LINK "Rte_GmRoadWhlInQlfr_dGmRoadWhlInQlfrRiDeltaPls" 0 DISPLAY_IDENTIFIER GmRoadWhlInQlfr.PerInstanceMemories.dGmRoadWhlInQlfrRiDeltaPls /end MEASUREMENT
/begin MEASUREMENT GmRoadWhlInQlfr.dGmRoadWhlInQlfrRiDeltaTiStamp "MICROSAR RTE" UWORD NO_COMPU_METHOD 0 0 0 65535 ECU_ADDRESS 0 SYMBOL_LINK "Rte_GmRoadWhlInQlfr_dGmRoadWhlInQlfrRiDeltaTiStamp" 0 DISPLAY_IDENTIFIER GmRoadWhlInQlfr.PerInstanceMemories.dGmRoadWhlInQlfrRiDeltaTiStamp /end MEASUREMENT
/begin MEASUREMENT GmRoadWhlInQlfr.dGmRoadWhlInQlfrRiWhlFrqVld "MICROSAR RTE" UBYTE RTE_CM_BOOLEAN 0 0 0 255 ECU_ADDRESS 0 SYMBOL_LINK "Rte_GmRoadWhlInQlfr_dGmRoadWhlInQlfrRiWhlFrqVld" 0 DISPLAY_IDENTIFIER GmRoadWhlInQlfr.PerInstanceMemories.dGmRoadWhlInQlfrRiWhlFrqVld /end MEASUREMENT
/begin MEASUREMENT GmStrtStop.EngSpd.Val "MICROSAR RTE" FLOAT32_IEEE NO_COMPU_METHOD 0 0 -3.402823466e+38 3.402823466e+38 ECU_ADDRESS 0 SYMBOL_LINK "Rte_GmMsg0C9BusHiSpd_EngSpd_Val" 0 DISPLAY_IDENTIFIER GmStrtStop.ReceiverPorts.EngSpd.Val /end MEASUREMENT
/begin MEASUREMENT GmStrtStop.HwTq.Val "MICROSAR RTE" FLOAT32_IEEE NO_COMPU_METHOD 0 0 -3.402823466e+38 3.402823466e+38 ECU_ADDRESS 0 SYMBOL_LINK "Rte_Swp_HwTqSwp_Val" 0 DISPLAY_IDENTIFIER GmStrtStop.ReceiverPorts.HwTq.Val /end MEASUREMENT
/begin MEASUREMENT GmStrtStop.HwVel.Val "MICROSAR RTE" FLOAT32_IEEE NO_COMPU_METHOD 0 0 -3.402823466e+38 3.402823466e+38 ECU_ADDRESS 0 SYMBOL_LINK "Rte_CDD_MotVel_HwVel_Val" 0 DISPLAY_IDENTIFIER GmStrtStop.ReceiverPorts.HwVel.Val /end MEASUREMENT
/begin MEASUREMENT GmStrtStop.Mod1RefTmr "MICROSAR RTE" ULONG NO_COMPU_METHOD 0 0 0 4294967295 ECU_ADDRESS 0 SYMBOL_LINK "Rte_GmStrtStop_Mod1RefTmr" 0 DISPLAY_IDENTIFIER GmStrtStop.PerInstanceMemories.Mod1RefTmr /end MEASUREMENT
/begin MEASUREMENT GmStrtStop.Mod2RefTmr "MICROSAR RTE" ULONG NO_COMPU_METHOD 0 0 0 4294967295 ECU_ADDRESS 0 SYMBOL_LINK "Rte_GmStrtStop_Mod2RefTmr" 0 DISPLAY_IDENTIFIER GmStrtStop.PerInstanceMemories.Mod2RefTmr /end MEASUREMENT
/begin MEASUREMENT GmStrtStop.Msg0C9BusHiSpdInvld.Logl "MICROSAR RTE" UBYTE RTE_CM_BOOLEAN 0 0 0 255 ECU_ADDRESS 0 SYMBOL_LINK "Rte_GmMsg0C9BusHiSpd_InvldMsg0C9_Logl" 0 DISPLAY_IDENTIFIER GmStrtStop.ReceiverPorts.Msg0C9BusHiSpdInvld.Logl /end MEASUREMENT
/begin MEASUREMENT GmStrtStop.Msg0C9BusHiSpdMiss.Logl "MICROSAR RTE" UBYTE RTE_CM_BOOLEAN 0 0 0 255 ECU_ADDRESS 0 SYMBOL_LINK "Rte_GmMsg0C9BusHiSpd_MissMsg0C9_Logl" 0 DISPLAY_IDENTIFIER GmStrtStop.ReceiverPorts.Msg0C9BusHiSpdMiss.Logl /end MEASUREMENT
/begin MEASUREMENT GmStrtStop.PrevActSt "MICROSAR RTE" UBYTE NO_COMPU_METHOD 0 0 0 255 ECU_ADDRESS 0 SYMBOL_LINK "Rte_GmStrtStop_PrevActSt" 0 DISPLAY_IDENTIFIER GmStrtStop.PerInstanceMemories.PrevActSt /end MEASUREMENT
/begin MEASUREMENT GmStrtStop.PrevStrtStopSt "MICROSAR RTE" UBYTE NO_COMPU_METHOD 0 0 0 255 ECU_ADDRESS 0 SYMBOL_LINK "Rte_GmStrtStop_PrevStrtStopSt" 0 DISPLAY_IDENTIFIER GmStrtStop.PerInstanceMemories.PrevStrtStopSt /end MEASUREMENT
/begin MEASUREMENT GmStrtStop.VehSpd.Val "MICROSAR RTE" FLOAT32_IEEE NO_COMPU_METHOD 0 0 -3.402823466e+38 3.402823466e+38 ECU_ADDRESS 0 SYMBOL_LINK "Rte_VehSigCdng_VehSpd_Val" 0 DISPLAY_IDENTIFIER GmStrtStop.ReceiverPorts.VehSpd.Val /end MEASUREMENT
/begin MEASUREMENT GmStrtStop.VehSpdVld.Logl "MICROSAR RTE" UBYTE RTE_CM_BOOLEAN 0 0 0 255 ECU_ADDRESS 0 SYMBOL_LINK "Rte_VehSigCdng_VehSpdVld_Logl" 0 DISPLAY_IDENTIFIER GmStrtStop.ReceiverPorts.VehSpdVld.Logl /end MEASUREMENT
/begin MEASUREMENT GmStrtStop.VehStrtStopMotTqCmdSca.Val "MICROSAR RTE" FLOAT32_IEEE NO_COMPU_METHOD 0 0 -3.402823466e+38 3.402823466e+38 ECU_ADDRESS 0 SYMBOL_LINK "Rte_GmStrtStop_VehStrtStopMotTqCmdSca_Val" 0 DISPLAY_IDENTIFIER GmStrtStop.SenderPorts.VehStrtStopMotTqCmdSca.Val /end MEASUREMENT
/begin MEASUREMENT GmStrtStop.VehStrtStopRampRate.Val "MICROSAR RTE" FLOAT32_IEEE NO_COMPU_METHOD 0 0 -3.402823466e+38 3.402823466e+38 ECU_ADDRESS 0 SYMBOL_LINK "Rte_GmStrtStop_VehStrtStopRampRate_Val" 0 DISPLAY_IDENTIFIER GmStrtStop.SenderPorts.VehStrtStopRampRate.Val /end MEASUREMENT
/begin MEASUREMENT GmStrtStop.VehStrtStopSt.Val "MICROSAR RTE" UBYTE NO_COMPU_METHOD 0 0 0 255 ECU_ADDRESS 0 SYMBOL_LINK "Rte_GmStrtStop_VehStrtStopSt_Val" 0 DISPLAY_IDENTIFIER GmStrtStop.SenderPorts.VehStrtStopSt.Val /end MEASUREMENT
/begin MEASUREMENT GmTqArbn.APASmotngHwTqLpFil.FilGain "MICROSAR RTE" FLOAT32_IEEE NO_COMPU_METHOD 0 0 -3.402823466e+38 3.402823466e+38 ECU_ADDRESS 0 SYMBOL_LINK "Rte_GmTqArbn_APASmotngHwTqLpFil.FilGain" 0 DISPLAY_IDENTIFIER GmTqArbn.PerInstanceMemories.APASmotngHwTqLpFil.FilGain /end MEASUREMENT
/begin MEASUREMENT GmTqArbn.APASmotngHwTqLpFil.FilSt "MICROSAR RTE" FLOAT32_IEEE NO_COMPU_METHOD 0 0 -3.402823466e+38 3.402823466e+38 ECU_ADDRESS 0 SYMBOL_LINK "Rte_GmTqArbn_APASmotngHwTqLpFil.FilSt" 0 DISPLAY_IDENTIFIER GmTqArbn.PerInstanceMemories.APASmotngHwTqLpFil.FilSt /end MEASUREMENT
/begin MEASUREMENT GmTqArbn.ActPosnServoCmd "MICROSAR RTE" FLOAT32_IEEE NO_COMPU_METHOD 0 0 -3.402823466e+38 3.402823466e+38 ECU_ADDRESS 0 SYMBOL_LINK "Rte_GmTqArbn_ActPosnServoCmd" 0 DISPLAY_IDENTIFIER GmTqArbn.PerInstanceMemories.ActPosnServoCmd /end MEASUREMENT
/begin MEASUREMENT GmTqArbn.AssiCmdBasSca.Val "MICROSAR RTE" FLOAT32_IEEE NO_COMPU_METHOD 0 0 -3.402823466e+38 3.402823466e+38 ECU_ADDRESS 0 SYMBOL_LINK "Rte_GmTqArbn_AssiCmdBasSca_Val" 0 DISPLAY_IDENTIFIER GmTqArbn.SenderPorts.AssiCmdBasSca.Val /end MEASUREMENT
/begin MEASUREMENT GmTqArbn.DampgCmdSca.Val "MICROSAR RTE" FLOAT32_IEEE NO_COMPU_METHOD 0 0 -3.402823466e+38 3.402823466e+38 ECU_ADDRESS 0 SYMBOL_LINK "Rte_GmTqArbn_DampgCmdSca_Val" 0 DISPLAY_IDENTIFIER GmTqArbn.SenderPorts.DampgCmdSca.Val /end MEASUREMENT
/begin MEASUREMENT GmTqArbn.DesLkaTqCmdRateLim "MICROSAR RTE" FLOAT32_IEEE NO_COMPU_METHOD 0 0 -3.402823466e+38 3.402823466e+38 ECU_ADDRESS 0 SYMBOL_LINK "Rte_GmTqArbn_DesLkaTqCmdRateLim" 0 DISPLAY_IDENTIFIER GmTqArbn.PerInstanceMemories.DesLkaTqCmdRateLim /end MEASUREMENT
/begin MEASUREMENT GmTqArbn.EscCmd.Val "MICROSAR RTE" FLOAT32_IEEE NO_COMPU_METHOD 0 0 -3.402823466e+38 3.402823466e+38 ECU_ADDRESS 0 SYMBOL_LINK "Rte_GmMsg180BusChassisExp_EscCmd_Val" 0 DISPLAY_IDENTIFIER GmTqArbn.ReceiverPorts.EscCmd.Val /end MEASUREMENT
/begin MEASUREMENT GmTqArbn.EscCmdArbd.Val "MICROSAR RTE" FLOAT32_IEEE NO_COMPU_METHOD 0 0 -3.402823466e+38 3.402823466e+38 ECU_ADDRESS 0 SYMBOL_LINK "Rte_GmTqArbn_EscCmdArbd_Val" 0 DISPLAY_IDENTIFIER GmTqArbn.SenderPorts.EscCmdArbd.Val /end MEASUREMENT
/begin MEASUREMENT GmTqArbn.EscLimdActv.Logl "MICROSAR RTE" UBYTE RTE_CM_BOOLEAN 0 0 0 255 ECU_ADDRESS 0 SYMBOL_LINK "Rte_GmTqArbn_EscLimdActv_Logl" 0 DISPLAY_IDENTIFIER GmTqArbn.SenderPorts.EscLimdActv.Logl /end MEASUREMENT
/begin MEASUREMENT GmTqArbn.EscSt.Val "MICROSAR RTE" UBYTE NO_COMPU_METHOD 0 0 0 255 ECU_ADDRESS 0 SYMBOL_LINK "Rte_GmOvrlStMgr_EscSt_Val" 0 DISPLAY_IDENTIFIER GmTqArbn.ReceiverPorts.EscSt.Val /end MEASUREMENT
/begin MEASUREMENT GmTqArbn.HwAgServoEna.Logl "MICROSAR RTE" UBYTE RTE_CM_BOOLEAN 0 0 0 255 ECU_ADDRESS 0 SYMBOL_LINK "Rte_GmOvrlStMgr_HwAgServoEna_Logl" 0 DISPLAY_IDENTIFIER GmTqArbn.ReceiverPorts.HwAgServoEna.Logl /end MEASUREMENT
/begin MEASUREMENT GmTqArbn.HwOscnEna.Logl "MICROSAR RTE" UBYTE RTE_CM_BOOLEAN 0 0 0 255 ECU_ADDRESS 0 SYMBOL_LINK "Rte_GmOvrlStMgr_HwOscnEna_Logl" 0 DISPLAY_IDENTIFIER GmTqArbn.ReceiverPorts.HwOscnEna.Logl /end MEASUREMENT
/begin MEASUREMENT GmTqArbn.HwTq.Val "MICROSAR RTE" FLOAT32_IEEE NO_COMPU_METHOD 0 0 -3.402823466e+38 3.402823466e+38 ECU_ADDRESS 0 SYMBOL_LINK "Rte_Swp_HwTqSwp_Val" 0 DISPLAY_IDENTIFIER GmTqArbn.ReceiverPorts.HwTq.Val /end MEASUREMENT
/begin MEASUREMENT GmTqArbn.HwTqOscCmd.Val "MICROSAR RTE" FLOAT32_IEEE NO_COMPU_METHOD 0 0 -3.402823466e+38 3.402823466e+38 ECU_ADDRESS 0 SYMBOL_LINK "Rte_TqOscn_HwOscnCmd_Val" 0 DISPLAY_IDENTIFIER GmTqArbn.ReceiverPorts.HwTqOscCmd.Val /end MEASUREMENT
/begin MEASUREMENT GmTqArbn.HwTqOvrl.Val "MICROSAR RTE" FLOAT32_IEEE NO_COMPU_METHOD 0 0 -3.402823466e+38 3.402823466e+38 ECU_ADDRESS 0 SYMBOL_LINK "Rte_GmTqArbn_HwTqOvrl_Val" 0 DISPLAY_IDENTIFIER GmTqArbn.SenderPorts.HwTqOvrl.Val /end MEASUREMENT
/begin MEASUREMENT GmTqArbn.LkaSt.Val "MICROSAR RTE" UBYTE NO_COMPU_METHOD 0 0 0 255 ECU_ADDRESS 0 SYMBOL_LINK "Rte_GmOvrlStMgr_LkaSt_Val" 0 DISPLAY_IDENTIFIER GmTqArbn.ReceiverPorts.LkaSt.Val /end MEASUREMENT
/begin MEASUREMENT GmTqArbn.LkaTqCmd.Val "MICROSAR RTE" FLOAT32_IEEE NO_COMPU_METHOD 0 0 -3.402823466e+38 3.402823466e+38 ECU_ADDRESS 0 SYMBOL_LINK "Rte_GmMsg180BusHiSpd_LkaCmd_Val" 0 DISPLAY_IDENTIFIER GmTqArbn.ReceiverPorts.LkaTqCmd.Val /end MEASUREMENT
/begin MEASUREMENT GmTqArbn.LkaTqCmdCdnd.Val "MICROSAR RTE" FLOAT32_IEEE NO_COMPU_METHOD 0 0 -3.402823466e+38 3.402823466e+38 ECU_ADDRESS 0 SYMBOL_LINK "Rte_GmTqArbn_LkaTqCmdCdnd_Val" 0 DISPLAY_IDENTIFIER GmTqArbn.SenderPorts.LkaTqCmdCdnd.Val /end MEASUREMENT
/begin MEASUREMENT GmTqArbn.MotTqCmdOvrl.Val "MICROSAR RTE" FLOAT32_IEEE NO_COMPU_METHOD 0 0 -3.402823466e+38 3.402823466e+38 ECU_ADDRESS 0 SYMBOL_LINK "Rte_GmTqArbn_MotTqCmdOvrl_Val" 0 DISPLAY_IDENTIFIER GmTqArbn.SenderPorts.MotTqCmdOvrl.Val /end MEASUREMENT
/begin MEASUREMENT GmTqArbn.MotTqServoCmd.Val "MICROSAR RTE" FLOAT32_IEEE NO_COMPU_METHOD 0 0 -3.402823466e+38 3.402823466e+38 ECU_ADDRESS 0 SYMBOL_LINK "Rte_HwAgTrakgServo_MotTqServoCmd_Val" 0 DISPLAY_IDENTIFIER GmTqArbn.ReceiverPorts.MotTqServoCmd.Val /end MEASUREMENT
/begin MEASUREMENT GmTqArbn.PosnServoSmotngEnaRateLim "MICROSAR RTE" FLOAT32_IEEE NO_COMPU_METHOD 0 0 -3.402823466e+38 3.402823466e+38 ECU_ADDRESS 0 SYMBOL_LINK "Rte_GmTqArbn_PosnServoSmotngEnaRateLim" 0 DISPLAY_IDENTIFIER GmTqArbn.PerInstanceMemories.PosnServoSmotngEnaRateLim /end MEASUREMENT
/begin MEASUREMENT GmTqArbn.RtnCmdSca.Val "MICROSAR RTE" FLOAT32_IEEE NO_COMPU_METHOD 0 0 -3.402823466e+38 3.402823466e+38 ECU_ADDRESS 0 SYMBOL_LINK "Rte_GmTqArbn_RtnCmdSca_Val" 0 DISPLAY_IDENTIFIER GmTqArbn.SenderPorts.RtnCmdSca.Val /end MEASUREMENT
/begin MEASUREMENT GmTqArbn.VehSpdMaxSecur.Val "MICROSAR RTE" FLOAT32_IEEE NO_COMPU_METHOD 0 0 -3.402823466e+38 3.402823466e+38 ECU_ADDRESS 0 SYMBOL_LINK "Rte_GmVehSpdArbn_VehSpdMaxSecur_Val" 0 DISPLAY_IDENTIFIER GmTqArbn.ReceiverPorts.VehSpdMaxSecur.Val /end MEASUREMENT
/begin MEASUREMENT GmTqArbn.dGmTqArbnDesLkaTqCmd "MICROSAR RTE" FLOAT32_IEEE NO_COMPU_METHOD 0 0 -3.402823466e+38 3.402823466e+38 ECU_ADDRESS 0 SYMBOL_LINK "Rte_GmTqArbn_dGmTqArbnDesLkaTqCmd" 0 DISPLAY_IDENTIFIER GmTqArbn.PerInstanceMemories.dGmTqArbnDesLkaTqCmd /end MEASUREMENT
/begin MEASUREMENT GmTqArbn.dGmTqArbnEscTqCmd "MICROSAR RTE" FLOAT32_IEEE NO_COMPU_METHOD 0 0 -3.402823466e+38 3.402823466e+38 ECU_ADDRESS 0 SYMBOL_LINK "Rte_GmTqArbn_dGmTqArbnEscTqCmd" 0 DISPLAY_IDENTIFIER GmTqArbn.PerInstanceMemories.dGmTqArbnEscTqCmd /end MEASUREMENT
/begin MEASUREMENT GmTqArbn.dGmTqArbnLkaTqCmd "MICROSAR RTE" FLOAT32_IEEE NO_COMPU_METHOD 0 0 -3.402823466e+38 3.402823466e+38 ECU_ADDRESS 0 SYMBOL_LINK "Rte_GmTqArbn_dGmTqArbnLkaTqCmd" 0 DISPLAY_IDENTIFIER GmTqArbn.PerInstanceMemories.dGmTqArbnLkaTqCmd /end MEASUREMENT
/begin MEASUREMENT GmTqArbn.dGmTqArbnPosnServoSmotngLowrLim "MICROSAR RTE" FLOAT32_IEEE NO_COMPU_METHOD 0 0 -3.402823466e+38 3.402823466e+38 ECU_ADDRESS 0 SYMBOL_LINK "Rte_GmTqArbn_dGmTqArbnPosnServoSmotngLowrLim" 0 DISPLAY_IDENTIFIER GmTqArbn.PerInstanceMemories.dGmTqArbnPosnServoSmotngLowrLim /end MEASUREMENT
/begin MEASUREMENT GmVehPwrMod.BusOffHiSpd.Logl "MICROSAR RTE" UBYTE RTE_CM_BOOLEAN 0 0 0 255 ECU_ADDRESS 0 SYMBOL_LINK "Rte_SerlComOutpProxy_BusOffHiSpd_Logl" 0 DISPLAY_IDENTIFIER GmVehPwrMod.ReceiverPorts.BusOffHiSpd.Logl /end MEASUREMENT
/begin MEASUREMENT GmVehPwrMod.EngRunActv.Logl "MICROSAR RTE" UBYTE RTE_CM_BOOLEAN 0 0 0 255 ECU_ADDRESS 0 SYMBOL_LINK "Rte_GmMsg0C9BusHiSpd_EngRunActv_Logl" 0 DISPLAY_IDENTIFIER GmVehPwrMod.ReceiverPorts.EngRunActv.Logl /end MEASUREMENT
/begin MEASUREMENT GmVehPwrMod.HwTq.Val "MICROSAR RTE" FLOAT32_IEEE NO_COMPU_METHOD 0 0 -3.402823466e+38 3.402823466e+38 ECU_ADDRESS 0 SYMBOL_LINK "Rte_Swp_HwTqSwp_Val" 0 DISPLAY_IDENTIFIER GmVehPwrMod.ReceiverPorts.HwTq.Val /end MEASUREMENT
/begin MEASUREMENT GmVehPwrMod.Msg0C9Miss.Logl "MICROSAR RTE" UBYTE RTE_CM_BOOLEAN 0 0 0 255 ECU_ADDRESS 0 SYMBOL_LINK "Rte_GmMsg0C9BusHiSpd_MissMsg0C9_Logl" 0 DISPLAY_IDENTIFIER GmVehPwrMod.ReceiverPorts.Msg0C9Miss.Logl /end MEASUREMENT
/begin MEASUREMENT GmVehPwrMod.Msg1F1Miss.Logl "MICROSAR RTE" UBYTE RTE_CM_BOOLEAN 0 0 0 255 ECU_ADDRESS 0 SYMBOL_LINK "Rte_GmMsg1F1BusHiSpd_MissMsg1F1_Logl" 0 DISPLAY_IDENTIFIER GmVehPwrMod.ReceiverPorts.Msg1F1Miss.Logl /end MEASUREMENT
/begin MEASUREMENT GmVehPwrMod.PrevSysStReqEnaVal "MICROSAR RTE" UBYTE RTE_CM_BOOLEAN 0 0 0 255 ECU_ADDRESS 0 SYMBOL_LINK "Rte_GmVehPwrMod_PrevSysStReqEnaVal" 0 DISPLAY_IDENTIFIER GmVehPwrMod.PerInstanceMemories.PrevSysStReqEnaVal /end MEASUREMENT
/begin MEASUREMENT GmVehPwrMod.PwrSplyEnaReq.Logl "MICROSAR RTE" UBYTE RTE_CM_BOOLEAN 0 0 0 255 ECU_ADDRESS 0 SYMBOL_LINK "Rte_GmVehPwrMod_PwrSplyEnaReq_Logl" 0 DISPLAY_IDENTIFIER GmVehPwrMod.SenderPorts.PwrSplyEnaReq.Logl /end MEASUREMENT
/begin MEASUREMENT GmVehPwrMod.SysOperMotTqCmdSca.Val "MICROSAR RTE" FLOAT32_IEEE NO_COMPU_METHOD 0 0 -3.402823466e+38 3.402823466e+38 ECU_ADDRESS 0 SYMBOL_LINK "Rte_GmVehPwrMod_SysOperMotTqCmdSca_Val" 0 DISPLAY_IDENTIFIER GmVehPwrMod.SenderPorts.SysOperMotTqCmdSca.Val /end MEASUREMENT
/begin MEASUREMENT GmVehPwrMod.SysOperRampRate.Val "MICROSAR RTE" FLOAT32_IEEE NO_COMPU_METHOD 0 0 -3.402823466e+38 3.402823466e+38 ECU_ADDRESS 0 SYMBOL_LINK "Rte_GmVehPwrMod_SysOperRampRate_Val" 0 DISPLAY_IDENTIFIER GmVehPwrMod.SenderPorts.SysOperRampRate.Val /end MEASUREMENT
/begin MEASUREMENT GmVehPwrMod.SysPwrModRun.Logl "MICROSAR RTE" UBYTE RTE_CM_BOOLEAN 0 0 0 255 ECU_ADDRESS 0 SYMBOL_LINK "Rte_GmMsg1F1BusHiSpd_SysPwrModRun_Logl" 0 DISPLAY_IDENTIFIER GmVehPwrMod.ReceiverPorts.SysPwrModRun.Logl /end MEASUREMENT
/begin MEASUREMENT GmVehPwrMod.SysStEnaReqOvrd.Logl "MICROSAR RTE" UBYTE RTE_CM_BOOLEAN 0 0 0 255 ECU_ADDRESS 0 SYMBOL_LINK "Rte_CustDiagc_SysStReqEnaOvrdCombd_Logl" 0 DISPLAY_IDENTIFIER GmVehPwrMod.ReceiverPorts.SysStEnaReqOvrd.Logl /end MEASUREMENT
/begin MEASUREMENT GmVehPwrMod.SysStReqEna.Logl "MICROSAR RTE" UBYTE RTE_CM_BOOLEAN 0 0 0 255 ECU_ADDRESS 0 SYMBOL_LINK "Rte_GmVehPwrMod_SysStReqEna_Logl" 0 DISPLAY_IDENTIFIER GmVehPwrMod.SenderPorts.SysStReqEna.Logl /end MEASUREMENT
/begin MEASUREMENT GmVehPwrMod.TqRefTi "MICROSAR RTE" ULONG NO_COMPU_METHOD 0 0 0 4294967295 ECU_ADDRESS 0 SYMBOL_LINK "Rte_GmVehPwrMod_TqRefTi" 0 DISPLAY_IDENTIFIER GmVehPwrMod.PerInstanceMemories.TqRefTi /end MEASUREMENT
/begin MEASUREMENT GmVehPwrMod.TqRefTiActv "MICROSAR RTE" UBYTE RTE_CM_BOOLEAN 0 0 0 255 ECU_ADDRESS 0 SYMBOL_LINK "Rte_GmVehPwrMod_TqRefTiActv" 0 DISPLAY_IDENTIFIER GmVehPwrMod.PerInstanceMemories.TqRefTiActv /end MEASUREMENT
/begin MEASUREMENT GmVehPwrMod.VehPwrModDftVehSpdEna.Logl "MICROSAR RTE" UBYTE RTE_CM_BOOLEAN 0 0 0 255 ECU_ADDRESS 0 SYMBOL_LINK "Rte_GmVehPwrMod_VehPwrModDftVehSpdEna_Logl" 0 DISPLAY_IDENTIFIER GmVehPwrMod.SenderPorts.VehPwrModDftVehSpdEna.Logl /end MEASUREMENT
/begin MEASUREMENT GmVehPwrMod.VehSpdArbd.Val "MICROSAR RTE" FLOAT32_IEEE NO_COMPU_METHOD 0 0 -3.402823466e+38 3.402823466e+38 ECU_ADDRESS 0 SYMBOL_LINK "Rte_GmVehSpdArbn_VehSpdArbd_Val" 0 DISPLAY_IDENTIFIER GmVehPwrMod.ReceiverPorts.VehSpdArbd.Val /end MEASUREMENT
/begin MEASUREMENT GmVehPwrMod.VehSpdSnsrVld.Logl "MICROSAR RTE" UBYTE RTE_CM_BOOLEAN 0 0 0 255 ECU_ADDRESS 0 SYMBOL_LINK "Rte_GmVehSpdArbn_VehSpdSnsrVld_Logl" 0 DISPLAY_IDENTIFIER GmVehPwrMod.ReceiverPorts.VehSpdSnsrVld.Logl /end MEASUREMENT
/begin MEASUREMENT GmVehPwrMod.dGmVehPwrModHwTqKeepAssi "MICROSAR RTE" UBYTE RTE_CM_BOOLEAN 0 0 0 255 ECU_ADDRESS 0 SYMBOL_LINK "Rte_GmVehPwrMod_dGmVehPwrModHwTqKeepAssi" 0 DISPLAY_IDENTIFIER GmVehPwrMod.PerInstanceMemories.dGmVehPwrModHwTqKeepAssi /end MEASUREMENT
/begin MEASUREMENT GmVehPwrMod.dGmVehPwrModVehSpdAssiKeepMin "MICROSAR RTE" UBYTE RTE_CM_BOOLEAN 0 0 0 255 ECU_ADDRESS 0 SYMBOL_LINK "Rte_GmVehPwrMod_dGmVehPwrModVehSpdAssiKeepMin" 0 DISPLAY_IDENTIFIER GmVehPwrMod.PerInstanceMemories.dGmVehPwrModVehSpdAssiKeepMin /end MEASUREMENT
/begin MEASUREMENT GmVehPwrMod.dGmVehPwrModVehSpdAssiOnMin "MICROSAR RTE" UBYTE RTE_CM_BOOLEAN 0 0 0 255 ECU_ADDRESS 0 SYMBOL_LINK "Rte_GmVehPwrMod_dGmVehPwrModVehSpdAssiOnMin" 0 DISPLAY_IDENTIFIER GmVehPwrMod.PerInstanceMemories.dGmVehPwrModVehSpdAssiOnMin /end MEASUREMENT
/begin MEASUREMENT GmVehSpdArbn.DiagcRefTi "MICROSAR RTE" ULONG NO_COMPU_METHOD 0 0 0 4294967295 ECU_ADDRESS 0 SYMBOL_LINK "Rte_GmVehSpdArbn_DiagcRefTi" 0 DISPLAY_IDENTIFIER GmVehSpdArbn.PerInstanceMemories.DiagcRefTi /end MEASUREMENT
/begin MEASUREMENT GmVehSpdArbn.VehPwrModDftVehSpdEna.Logl "MICROSAR RTE" UBYTE RTE_CM_BOOLEAN 0 0 0 255 ECU_ADDRESS 0 SYMBOL_LINK "Rte_GmVehPwrMod_VehPwrModDftVehSpdEna_Logl" 0 DISPLAY_IDENTIFIER GmVehSpdArbn.ReceiverPorts.VehPwrModDftVehSpdEna.Logl /end MEASUREMENT
/begin MEASUREMENT GmVehSpdArbn.VehSpdArbd.Val "MICROSAR RTE" FLOAT32_IEEE NO_COMPU_METHOD 0 0 -3.402823466e+38 3.402823466e+38 ECU_ADDRESS 0 SYMBOL_LINK "Rte_GmVehSpdArbn_VehSpdArbd_Val" 0 DISPLAY_IDENTIFIER GmVehSpdArbn.SenderPorts.VehSpdArbd.Val /end MEASUREMENT
/begin MEASUREMENT GmVehSpdArbn.VehSpdArbdVld.Logl "MICROSAR RTE" UBYTE RTE_CM_BOOLEAN 0 0 0 255 ECU_ADDRESS 0 SYMBOL_LINK "Rte_GmVehSpdArbn_VehSpdArbdVld_Logl" 0 DISPLAY_IDENTIFIER GmVehSpdArbn.SenderPorts.VehSpdArbdVld.Logl /end MEASUREMENT
/begin MEASUREMENT GmVehSpdArbn.VehSpdMaxSecur.Val "MICROSAR RTE" FLOAT32_IEEE NO_COMPU_METHOD 0 0 -3.402823466e+38 3.402823466e+38 ECU_ADDRESS 0 SYMBOL_LINK "Rte_GmVehSpdArbn_VehSpdMaxSecur_Val" 0 DISPLAY_IDENTIFIER GmVehSpdArbn.SenderPorts.VehSpdMaxSecur.Val /end MEASUREMENT
/begin MEASUREMENT GmVehSpdArbn.VehSpdMaxSecurVld.Logl "MICROSAR RTE" UBYTE RTE_CM_BOOLEAN 0 0 0 255 ECU_ADDRESS 0 SYMBOL_LINK "Rte_GmVehSpdArbn_VehSpdMaxSecurVld_Logl" 0 DISPLAY_IDENTIFIER GmVehSpdArbn.SenderPorts.VehSpdMaxSecurVld.Logl /end MEASUREMENT
/begin MEASUREMENT GmVehSpdArbn.VehSpdMinSecur.Val "MICROSAR RTE" FLOAT32_IEEE NO_COMPU_METHOD 0 0 -3.402823466e+38 3.402823466e+38 ECU_ADDRESS 0 SYMBOL_LINK "Rte_GmVehSpdArbn_VehSpdMinSecur_Val" 0 DISPLAY_IDENTIFIER GmVehSpdArbn.SenderPorts.VehSpdMinSecur.Val /end MEASUREMENT
/begin MEASUREMENT GmVehSpdArbn.VehSpdMinSecurVld.Logl "MICROSAR RTE" UBYTE RTE_CM_BOOLEAN 0 0 0 255 ECU_ADDRESS 0 SYMBOL_LINK "Rte_GmVehSpdArbn_VehSpdMinSecurVld_Logl" 0 DISPLAY_IDENTIFIER GmVehSpdArbn.SenderPorts.VehSpdMinSecurVld.Logl /end MEASUREMENT
/begin MEASUREMENT GmVehSpdArbn.VehSpdSnsrVld.Logl "MICROSAR RTE" UBYTE RTE_CM_BOOLEAN 0 0 0 255 ECU_ADDRESS 0 SYMBOL_LINK "Rte_GmVehSpdArbn_VehSpdSnsrVld_Logl" 0 DISPLAY_IDENTIFIER GmVehSpdArbn.SenderPorts.VehSpdSnsrVld.Logl /end MEASUREMENT
/begin MEASUREMENT GmVehSpdArbn.WhlGndVelLeDrvnBusChassisExp.Val "MICROSAR RTE" FLOAT32_IEEE NO_COMPU_METHOD 0 0 -3.402823466e+38 3.402823466e+38 ECU_ADDRESS 0 SYMBOL_LINK "Rte_GmMsg348BusChassisExp_WhlGndVelLeDrvnBusChassisExp_Val" 0 DISPLAY_IDENTIFIER GmVehSpdArbn.ReceiverPorts.WhlGndVelLeDrvnBusChassisExp.Val /end MEASUREMENT
/begin MEASUREMENT GmVehSpdArbn.WhlGndVelLeDrvnBusHiSpd.Val "MICROSAR RTE" FLOAT32_IEEE NO_COMPU_METHOD 0 0 -3.402823466e+38 3.402823466e+38 ECU_ADDRESS 0 SYMBOL_LINK "Rte_GmMsg348BusHiSpd_WhlGndVelLeDrvnBusHiSpd_Val" 0 DISPLAY_IDENTIFIER GmVehSpdArbn.ReceiverPorts.WhlGndVelLeDrvnBusHiSpd.Val /end MEASUREMENT
/begin MEASUREMENT GmVehSpdArbn.WhlGndVelLeDrvnStuckBusChassisExp.Logl "MICROSAR RTE" UBYTE RTE_CM_BOOLEAN 0 0 0 255 ECU_ADDRESS 0 SYMBOL_LINK "Rte_GmMsg348BusChassisExp_WhlGndVelLeDrvnStuckBusChassisExp_Logl" 0 DISPLAY_IDENTIFIER GmVehSpdArbn.ReceiverPorts.WhlGndVelLeDrvnStuckBusChassisExp.Logl /end MEASUREMENT
/begin MEASUREMENT GmVehSpdArbn.WhlGndVelLeDrvnStuckBusHiSpd.Logl "MICROSAR RTE" UBYTE RTE_CM_BOOLEAN 0 0 0 255 ECU_ADDRESS 0 SYMBOL_LINK "Rte_GmMsg348BusHiSpd_WhlGndVelLeDrvnStuckBusHiSpd_Logl" 0 DISPLAY_IDENTIFIER GmVehSpdArbn.ReceiverPorts.WhlGndVelLeDrvnStuckBusHiSpd.Logl /end MEASUREMENT
/begin MEASUREMENT GmVehSpdArbn.WhlGndVelLeDrvnVldBusChassisExp.Logl "MICROSAR RTE" UBYTE RTE_CM_BOOLEAN 0 0 0 255 ECU_ADDRESS 0 SYMBOL_LINK "Rte_GmMsg348BusChassisExp_WhlGndVelLeDrvnVldBusChassisExp_Logl" 0 DISPLAY_IDENTIFIER GmVehSpdArbn.ReceiverPorts.WhlGndVelLeDrvnVldBusChassisExp.Logl /end MEASUREMENT
/begin MEASUREMENT GmVehSpdArbn.WhlGndVelLeDrvnVldBusHiSpd.Logl "MICROSAR RTE" UBYTE RTE_CM_BOOLEAN 0 0 0 255 ECU_ADDRESS 0 SYMBOL_LINK "Rte_GmMsg348BusHiSpd_WhlGndVelLeDrvnVldBusHiSpd_Logl" 0 DISPLAY_IDENTIFIER GmVehSpdArbn.ReceiverPorts.WhlGndVelLeDrvnVldBusHiSpd.Logl /end MEASUREMENT
/begin MEASUREMENT GmVehSpdArbn.WhlGndVelLeNonDrvnBusChassisExp.Val "MICROSAR RTE" FLOAT32_IEEE NO_COMPU_METHOD 0 0 -3.402823466e+38 3.402823466e+38 ECU_ADDRESS 0 SYMBOL_LINK "Rte_GmMsg34ABusChassisExp_WhlGndVelLeNonDrvnBusChassisExp_Val" 0 DISPLAY_IDENTIFIER GmVehSpdArbn.ReceiverPorts.WhlGndVelLeNonDrvnBusChassisExp.Val /end MEASUREMENT
/begin MEASUREMENT GmVehSpdArbn.WhlGndVelLeNonDrvnBusHiSpd.Val "MICROSAR RTE" FLOAT32_IEEE NO_COMPU_METHOD 0 0 -3.402823466e+38 3.402823466e+38 ECU_ADDRESS 0 SYMBOL_LINK "Rte_GmMsg34ABusHiSpd_WhlGndVelLeNonDrvnBusHiSpd_Val" 0 DISPLAY_IDENTIFIER GmVehSpdArbn.ReceiverPorts.WhlGndVelLeNonDrvnBusHiSpd.Val /end MEASUREMENT
/begin MEASUREMENT GmVehSpdArbn.WhlGndVelLeNonDrvnStuckBusChassisExp.Logl "MICROSAR RTE" UBYTE RTE_CM_BOOLEAN 0 0 0 255 ECU_ADDRESS 0 SYMBOL_LINK "Rte_GmMsg34ABusChassisExp_WhlGndVelLeNonDrvnStuckBusChassisExp_Logl" 0 DISPLAY_IDENTIFIER GmVehSpdArbn.ReceiverPorts.WhlGndVelLeNonDrvnStuckBusChassisExp.Logl /end MEASUREMENT
/begin MEASUREMENT GmVehSpdArbn.WhlGndVelLeNonDrvnStuckBusHiSpd.Logl "MICROSAR RTE" UBYTE RTE_CM_BOOLEAN 0 0 0 255 ECU_ADDRESS 0 SYMBOL_LINK "Rte_GmMsg34ABusHiSpd_WhlGndVelLeNonDrvnStuckBusHiSpd_Logl" 0 DISPLAY_IDENTIFIER GmVehSpdArbn.ReceiverPorts.WhlGndVelLeNonDrvnStuckBusHiSpd.Logl /end MEASUREMENT
/begin MEASUREMENT GmVehSpdArbn.WhlGndVelLeNonDrvnVldBusChassisExp.Logl "MICROSAR RTE" UBYTE RTE_CM_BOOLEAN 0 0 0 255 ECU_ADDRESS 0 SYMBOL_LINK "Rte_GmMsg34ABusChassisExp_WhlGndVelLeNonDrvnVldBusChassisExp_Logl" 0 DISPLAY_IDENTIFIER GmVehSpdArbn.ReceiverPorts.WhlGndVelLeNonDrvnVldBusChassisExp.Logl /end MEASUREMENT
/begin MEASUREMENT GmVehSpdArbn.WhlGndVelLeNonDrvnVldBusHiSpd.Logl "MICROSAR RTE" UBYTE RTE_CM_BOOLEAN 0 0 0 255 ECU_ADDRESS 0 SYMBOL_LINK "Rte_GmMsg34ABusHiSpd_WhlGndVelLeNonDrvnVldBusHiSpd_Logl" 0 DISPLAY_IDENTIFIER GmVehSpdArbn.ReceiverPorts.WhlGndVelLeNonDrvnVldBusHiSpd.Logl /end MEASUREMENT
/begin MEASUREMENT GmVehSpdArbn.WhlGndVelRiDrvnBusChassisExp.Val "MICROSAR RTE" FLOAT32_IEEE NO_COMPU_METHOD 0 0 -3.402823466e+38 3.402823466e+38 ECU_ADDRESS 0 SYMBOL_LINK "Rte_GmMsg348BusChassisExp_WhlGndVelRiDrvnBusChassisExp_Val" 0 DISPLAY_IDENTIFIER GmVehSpdArbn.ReceiverPorts.WhlGndVelRiDrvnBusChassisExp.Val /end MEASUREMENT
/begin MEASUREMENT GmVehSpdArbn.WhlGndVelRiDrvnBusHiSpd.Val "MICROSAR RTE" FLOAT32_IEEE NO_COMPU_METHOD 0 0 -3.402823466e+38 3.402823466e+38 ECU_ADDRESS 0 SYMBOL_LINK "Rte_GmMsg348BusHiSpd_WhlGndVelRiDrvnBusHiSpd_Val" 0 DISPLAY_IDENTIFIER GmVehSpdArbn.ReceiverPorts.WhlGndVelRiDrvnBusHiSpd.Val /end MEASUREMENT
/begin MEASUREMENT GmVehSpdArbn.WhlGndVelRiDrvnStuckBusChassisExp.Logl "MICROSAR RTE" UBYTE RTE_CM_BOOLEAN 0 0 0 255 ECU_ADDRESS 0 SYMBOL_LINK "Rte_GmMsg348BusChassisExp_WhlGndVelRiDrvnStuckBusChassisExp_Logl" 0 DISPLAY_IDENTIFIER GmVehSpdArbn.ReceiverPorts.WhlGndVelRiDrvnStuckBusChassisExp.Logl /end MEASUREMENT
/begin MEASUREMENT GmVehSpdArbn.WhlGndVelRiDrvnStuckBusHiSpd.Logl "MICROSAR RTE" UBYTE RTE_CM_BOOLEAN 0 0 0 255 ECU_ADDRESS 0 SYMBOL_LINK "Rte_GmMsg348BusHiSpd_WhlGndVelRiDrvnStuckBusHiSpd_Logl" 0 DISPLAY_IDENTIFIER GmVehSpdArbn.ReceiverPorts.WhlGndVelRiDrvnStuckBusHiSpd.Logl /end MEASUREMENT
/begin MEASUREMENT GmVehSpdArbn.WhlGndVelRiDrvnVldBusChassisExp.Logl "MICROSAR RTE" UBYTE RTE_CM_BOOLEAN 0 0 0 255 ECU_ADDRESS 0 SYMBOL_LINK "Rte_GmMsg348BusChassisExp_WhlGndVelRiDrvnVldBusChassisExp_Logl" 0 DISPLAY_IDENTIFIER GmVehSpdArbn.ReceiverPorts.WhlGndVelRiDrvnVldBusChassisExp.Logl /end MEASUREMENT
/begin MEASUREMENT GmVehSpdArbn.WhlGndVelRiDrvnVldBusHiSpd.Logl "MICROSAR RTE" UBYTE RTE_CM_BOOLEAN 0 0 0 255 ECU_ADDRESS 0 SYMBOL_LINK "Rte_GmMsg348BusHiSpd_WhlGndVelRiDrvnVldBusHiSpd_Logl" 0 DISPLAY_IDENTIFIER GmVehSpdArbn.ReceiverPorts.WhlGndVelRiDrvnVldBusHiSpd.Logl /end MEASUREMENT
/begin MEASUREMENT GmVehSpdArbn.WhlGndVelRiNonDrvnBusChassisExp.Val "MICROSAR RTE" FLOAT32_IEEE NO_COMPU_METHOD 0 0 -3.402823466e+38 3.402823466e+38 ECU_ADDRESS 0 SYMBOL_LINK "Rte_GmMsg34ABusChassisExp_WhlGndVelRiNonDrvnBusChassisExp_Val" 0 DISPLAY_IDENTIFIER GmVehSpdArbn.ReceiverPorts.WhlGndVelRiNonDrvnBusChassisExp.Val /end MEASUREMENT
/begin MEASUREMENT GmVehSpdArbn.WhlGndVelRiNonDrvnBusHiSpd.Val "MICROSAR RTE" FLOAT32_IEEE NO_COMPU_METHOD 0 0 -3.402823466e+38 3.402823466e+38 ECU_ADDRESS 0 SYMBOL_LINK "Rte_GmMsg34ABusHiSpd_WhlGndVelRiNonDrvnBusHiSpd_Val" 0 DISPLAY_IDENTIFIER GmVehSpdArbn.ReceiverPorts.WhlGndVelRiNonDrvnBusHiSpd.Val /end MEASUREMENT
/begin MEASUREMENT GmVehSpdArbn.WhlGndVelRiNonDrvnStuckBusChassisExp.Logl "MICROSAR RTE" UBYTE RTE_CM_BOOLEAN 0 0 0 255 ECU_ADDRESS 0 SYMBOL_LINK "Rte_GmMsg34ABusChassisExp_WhlGndVelRiNonDrvnStuckBusChassisExp_Logl" 0 DISPLAY_IDENTIFIER GmVehSpdArbn.ReceiverPorts.WhlGndVelRiNonDrvnStuckBusChassisExp.Logl /end MEASUREMENT
/begin MEASUREMENT GmVehSpdArbn.WhlGndVelRiNonDrvnStuckBusHiSpd.Logl "MICROSAR RTE" UBYTE RTE_CM_BOOLEAN 0 0 0 255 ECU_ADDRESS 0 SYMBOL_LINK "Rte_GmMsg34ABusHiSpd_WhlGndVelRiNonDrvnStuckBusHiSpd_Logl" 0 DISPLAY_IDENTIFIER GmVehSpdArbn.ReceiverPorts.WhlGndVelRiNonDrvnStuckBusHiSpd.Logl /end MEASUREMENT
/begin MEASUREMENT GmVehSpdArbn.WhlGndVelRiNonDrvnVldBusChassisExp.Logl "MICROSAR RTE" UBYTE RTE_CM_BOOLEAN 0 0 0 255 ECU_ADDRESS 0 SYMBOL_LINK "Rte_GmMsg34ABusChassisExp_WhlGndVelRiNonDrvnVldBusChassisExp_Logl" 0 DISPLAY_IDENTIFIER GmVehSpdArbn.ReceiverPorts.WhlGndVelRiNonDrvnVldBusChassisExp.Logl /end MEASUREMENT
/begin MEASUREMENT GmVehSpdArbn.WhlGndVelRiNonDrvnVldBusHiSpd.Logl "MICROSAR RTE" UBYTE RTE_CM_BOOLEAN 0 0 0 255 ECU_ADDRESS 0 SYMBOL_LINK "Rte_GmMsg34ABusHiSpd_WhlGndVelRiNonDrvnVldBusHiSpd_Logl" 0 DISPLAY_IDENTIFIER GmVehSpdArbn.ReceiverPorts.WhlGndVelRiNonDrvnVldBusHiSpd.Logl /end MEASUREMENT
/begin MEASUREMENT GmVehSpdArbn.dGmVehSpdArbnLeDrvnVld "MICROSAR RTE" UBYTE RTE_CM_BOOLEAN 0 0 0 255 ECU_ADDRESS 0 SYMBOL_LINK "Rte_GmVehSpdArbn_dGmVehSpdArbnLeDrvnVld" 0 DISPLAY_IDENTIFIER GmVehSpdArbn.PerInstanceMemories.dGmVehSpdArbnLeDrvnVld /end MEASUREMENT
/begin MEASUREMENT GmVehSpdArbn.dGmVehSpdArbnLeNonDrvnVld "MICROSAR RTE" UBYTE RTE_CM_BOOLEAN 0 0 0 255 ECU_ADDRESS 0 SYMBOL_LINK "Rte_GmVehSpdArbn_dGmVehSpdArbnLeNonDrvnVld" 0 DISPLAY_IDENTIFIER GmVehSpdArbn.PerInstanceMemories.dGmVehSpdArbnLeNonDrvnVld /end MEASUREMENT
/begin MEASUREMENT GmVehSpdArbn.dGmVehSpdArbnRiDrvnVld "MICROSAR RTE" UBYTE RTE_CM_BOOLEAN 0 0 0 255 ECU_ADDRESS 0 SYMBOL_LINK "Rte_GmVehSpdArbn_dGmVehSpdArbnRiDrvnVld" 0 DISPLAY_IDENTIFIER GmVehSpdArbn.PerInstanceMemories.dGmVehSpdArbnRiDrvnVld /end MEASUREMENT
/begin MEASUREMENT GmVehSpdArbn.dGmVehSpdArbnRiNonDrvnVld "MICROSAR RTE" UBYTE RTE_CM_BOOLEAN 0 0 0 255 ECU_ADDRESS 0 SYMBOL_LINK "Rte_GmVehSpdArbn_dGmVehSpdArbnRiNonDrvnVld" 0 DISPLAY_IDENTIFIER GmVehSpdArbn.PerInstanceMemories.dGmVehSpdArbnRiNonDrvnVld /end MEASUREMENT
/begin MEASUREMENT HiLoadStallLimr.MotTqCmdLimdPreStall.Val "MICROSAR RTE" FLOAT32_IEEE NO_COMPU_METHOD 0 0 -3.402823466e+38 3.402823466e+38 ECU_ADDRESS 0 SYMBOL_LINK "Rte_AssiSumLim_MotTqCmdLimdPreStall_Val" 0 DISPLAY_IDENTIFIER HiLoadStallLimr.ReceiverPorts.MotTqCmdLimdPreStall.Val /end MEASUREMENT
/begin MEASUREMENT HiLoadStallLimr.MotVelCrf.Val "MICROSAR RTE" FLOAT32_IEEE NO_COMPU_METHOD 0 0 -3.402823466e+38 3.402823466e+38 ECU_ADDRESS 0 SYMBOL_LINK "Rte_CDD_MotVel_MotVelCrf_Val" 0 DISPLAY_IDENTIFIER HiLoadStallLimr.ReceiverPorts.MotVelCrf.Val /end MEASUREMENT
/begin MEASUREMENT HiLoadStallLimr.StallMotTqCmdFil.FilGain "MICROSAR RTE" FLOAT32_IEEE NO_COMPU_METHOD 0 0 -3.402823466e+38 3.402823466e+38 ECU_ADDRESS 0 SYMBOL_LINK "Rte_HiLoadStallLimr_StallMotTqCmdFil.FilGain" 0 DISPLAY_IDENTIFIER HiLoadStallLimr.PerInstanceMemories.StallMotTqCmdFil.FilGain /end MEASUREMENT
/begin MEASUREMENT HiLoadStallLimr.StallMotTqCmdFil.FilSt "MICROSAR RTE" FLOAT32_IEEE NO_COMPU_METHOD 0 0 -3.402823466e+38 3.402823466e+38 ECU_ADDRESS 0 SYMBOL_LINK "Rte_HiLoadStallLimr_StallMotTqCmdFil.FilSt" 0 DISPLAY_IDENTIFIER HiLoadStallLimr.PerInstanceMemories.StallMotTqCmdFil.FilSt /end MEASUREMENT
/begin MEASUREMENT HiLoadStallLimr.StallMotTqLim.Val "MICROSAR RTE" FLOAT32_IEEE NO_COMPU_METHOD 0 0 -3.402823466e+38 3.402823466e+38 ECU_ADDRESS 0 SYMBOL_LINK "Rte_HiLoadStallLimr_StallMotTqLim_Val" 0 DISPLAY_IDENTIFIER HiLoadStallLimr.SenderPorts.StallMotTqLim.Val /end MEASUREMENT
/begin MEASUREMENT HiLoadStallLimr.StallMotTqLimDi.Logl "MICROSAR RTE" UBYTE RTE_CM_BOOLEAN 0 0 0 255 ECU_ADDRESS 0 SYMBOL_LINK "Rte_CmnMfgSrv_StallMotTqLimDi_Logl" 0 DISPLAY_IDENTIFIER HiLoadStallLimr.ReceiverPorts.StallMotTqLimDi.Logl /end MEASUREMENT
/begin MEASUREMENT HiLoadStallLimr.StallMotTqLimPrev "MICROSAR RTE" FLOAT32_IEEE NO_COMPU_METHOD 0 0 -3.402823466e+38 3.402823466e+38 ECU_ADDRESS 0 SYMBOL_LINK "Rte_HiLoadStallLimr_StallMotTqLimPrev" 0 DISPLAY_IDENTIFIER HiLoadStallLimr.PerInstanceMemories.StallMotTqLimPrev /end MEASUREMENT
/begin MEASUREMENT HiLoadStallLimr.dHiLoadStallLimrStallMotTqCmd "MICROSAR RTE" FLOAT32_IEEE NO_COMPU_METHOD 0 0 -3.402823466e+38 3.402823466e+38 ECU_ADDRESS 0 SYMBOL_LINK "Rte_HiLoadStallLimr_dHiLoadStallLimrStallMotTqCmd" 0 DISPLAY_IDENTIFIER HiLoadStallLimr.PerInstanceMemories.dHiLoadStallLimrStallMotTqCmd /end MEASUREMENT
/begin MEASUREMENT HiLoadStallLimr.dHiLoadStallLimrStallMotTqCmdFild "MICROSAR RTE" FLOAT32_IEEE NO_COMPU_METHOD 0 0 -3.402823466e+38 3.402823466e+38 ECU_ADDRESS 0 SYMBOL_LINK "Rte_HiLoadStallLimr_dHiLoadStallLimrStallMotTqCmdFild" 0 DISPLAY_IDENTIFIER HiLoadStallLimr.PerInstanceMemories.dHiLoadStallLimrStallMotTqCmdFild /end MEASUREMENT
/begin MEASUREMENT HiLoadStallLimr.dHiLoadStallLimrStallMotTqLim "MICROSAR RTE" FLOAT32_IEEE NO_COMPU_METHOD 0 0 -3.402823466e+38 3.402823466e+38 ECU_ADDRESS 0 SYMBOL_LINK "Rte_HiLoadStallLimr_dHiLoadStallLimrStallMotTqLim" 0 DISPLAY_IDENTIFIER HiLoadStallLimr.PerInstanceMemories.dHiLoadStallLimrStallMotTqLim /end MEASUREMENT
/begin MEASUREMENT HowDetn.EstimLpFil.FilGain "MICROSAR RTE" FLOAT32_IEEE NO_COMPU_METHOD 0 0 -3.402823466e+38 3.402823466e+38 ECU_ADDRESS 0 SYMBOL_LINK "Rte_HowDetn_EstimLpFil.FilGain" 0 DISPLAY_IDENTIFIER HowDetn.PerInstanceMemories.EstimLpFil.FilGain /end MEASUREMENT
/begin MEASUREMENT HowDetn.EstimLpFil.FilSt "MICROSAR RTE" FLOAT32_IEEE NO_COMPU_METHOD 0 0 -3.402823466e+38 3.402823466e+38 ECU_ADDRESS 0 SYMBOL_LINK "Rte_HowDetn_EstimLpFil.FilSt" 0 DISPLAY_IDENTIFIER HowDetn.PerInstanceMemories.EstimLpFil.FilSt /end MEASUREMENT
/begin MEASUREMENT HowDetn.FinalLpFil.FilGain "MICROSAR RTE" FLOAT32_IEEE NO_COMPU_METHOD 0 0 -3.402823466e+38 3.402823466e+38 ECU_ADDRESS 0 SYMBOL_LINK "Rte_HowDetn_FinalLpFil.FilGain" 0 DISPLAY_IDENTIFIER HowDetn.PerInstanceMemories.FinalLpFil.FilGain /end MEASUREMENT
/begin MEASUREMENT HowDetn.FinalLpFil.FilSt "MICROSAR RTE" FLOAT32_IEEE NO_COMPU_METHOD 0 0 -3.402823466e+38 3.402823466e+38 ECU_ADDRESS 0 SYMBOL_LINK "Rte_HowDetn_FinalLpFil.FilSt" 0 DISPLAY_IDENTIFIER HowDetn.PerInstanceMemories.FinalLpFil.FilSt /end MEASUREMENT
/begin MEASUREMENT HowDetn.HowDetnEstimn.Val "MICROSAR RTE" FLOAT32_IEEE NO_COMPU_METHOD 0 0 -3.402823466e+38 3.402823466e+38 ECU_ADDRESS 0 SYMBOL_LINK "Rte_HowDetn_HowDetnEstimn_Val" 0 DISPLAY_IDENTIFIER HowDetn.SenderPorts.HowDetnEstimn.Val /end MEASUREMENT
/begin MEASUREMENT HowDetn.HowDetnSt.Val "MICROSAR RTE" SBYTE NO_COMPU_METHOD 0 0 -128 127 ECU_ADDRESS 0 SYMBOL_LINK "Rte_HowDetn_HowDetnSt_Val" 0 DISPLAY_IDENTIFIER HowDetn.SenderPorts.HowDetnSt.Val /end MEASUREMENT
/begin MEASUREMENT HowDetn.HwTq.Val "MICROSAR RTE" FLOAT32_IEEE NO_COMPU_METHOD 0 0 -3.402823466e+38 3.402823466e+38 ECU_ADDRESS 0 SYMBOL_LINK "Rte_Swp_HwTqSwp_Val" 0 DISPLAY_IDENTIFIER HowDetn.ReceiverPorts.HwTq.Val /end MEASUREMENT
/begin MEASUREMENT HowDetn.IniLpFil1.FilGain "MICROSAR RTE" FLOAT32_IEEE NO_COMPU_METHOD 0 0 -3.402823466e+38 3.402823466e+38 ECU_ADDRESS 0 SYMBOL_LINK "Rte_HowDetn_IniLpFil1.FilGain" 0 DISPLAY_IDENTIFIER HowDetn.PerInstanceMemories.IniLpFil1.FilGain /end MEASUREMENT
/begin MEASUREMENT HowDetn.IniLpFil1.FilSt "MICROSAR RTE" FLOAT32_IEEE NO_COMPU_METHOD 0 0 -3.402823466e+38 3.402823466e+38 ECU_ADDRESS 0 SYMBOL_LINK "Rte_HowDetn_IniLpFil1.FilSt" 0 DISPLAY_IDENTIFIER HowDetn.PerInstanceMemories.IniLpFil1.FilSt /end MEASUREMENT
/begin MEASUREMENT HowDetn.IniLpFil2.FilGain "MICROSAR RTE" FLOAT32_IEEE NO_COMPU_METHOD 0 0 -3.402823466e+38 3.402823466e+38 ECU_ADDRESS 0 SYMBOL_LINK "Rte_HowDetn_IniLpFil2.FilGain" 0 DISPLAY_IDENTIFIER HowDetn.PerInstanceMemories.IniLpFil2.FilGain /end MEASUREMENT
/begin MEASUREMENT HowDetn.IniLpFil2.FilSt "MICROSAR RTE" FLOAT32_IEEE NO_COMPU_METHOD 0 0 -3.402823466e+38 3.402823466e+38 ECU_ADDRESS 0 SYMBOL_LINK "Rte_HowDetn_IniLpFil2.FilSt" 0 DISPLAY_IDENTIFIER HowDetn.PerInstanceMemories.IniLpFil2.FilSt /end MEASUREMENT
/begin MEASUREMENT HowDetn.IniLpFil3.FilGain "MICROSAR RTE" FLOAT32_IEEE NO_COMPU_METHOD 0 0 -3.402823466e+38 3.402823466e+38 ECU_ADDRESS 0 SYMBOL_LINK "Rte_HowDetn_IniLpFil3.FilGain" 0 DISPLAY_IDENTIFIER HowDetn.PerInstanceMemories.IniLpFil3.FilGain /end MEASUREMENT
/begin MEASUREMENT HowDetn.IniLpFil3.FilSt "MICROSAR RTE" FLOAT32_IEEE NO_COMPU_METHOD 0 0 -3.402823466e+38 3.402823466e+38 ECU_ADDRESS 0 SYMBOL_LINK "Rte_HowDetn_IniLpFil3.FilSt" 0 DISPLAY_IDENTIFIER HowDetn.PerInstanceMemories.IniLpFil3.FilSt /end MEASUREMENT
/begin MEASUREMENT HowDetn.PrevCalcdHowEstim "MICROSAR RTE" FLOAT32_IEEE NO_COMPU_METHOD 0 0 -3.402823466e+38 3.402823466e+38 ECU_ADDRESS 0 SYMBOL_LINK "Rte_HowDetn_PrevCalcdHowEstim" 0 DISPLAY_IDENTIFIER HowDetn.PerInstanceMemories.PrevCalcdHowEstim /end MEASUREMENT
/begin MEASUREMENT HowDetn.PrevHowEstim "MICROSAR RTE" FLOAT32_IEEE NO_COMPU_METHOD 0 0 -3.402823466e+38 3.402823466e+38 ECU_ADDRESS 0 SYMBOL_LINK "Rte_HowDetn_PrevHowEstim" 0 DISPLAY_IDENTIFIER HowDetn.PerInstanceMemories.PrevHowEstim /end MEASUREMENT
/begin MEASUREMENT HowDetn.StLpFil.FilGain "MICROSAR RTE" FLOAT32_IEEE NO_COMPU_METHOD 0 0 -3.402823466e+38 3.402823466e+38 ECU_ADDRESS 0 SYMBOL_LINK "Rte_HowDetn_StLpFil.FilGain" 0 DISPLAY_IDENTIFIER HowDetn.PerInstanceMemories.StLpFil.FilGain /end MEASUREMENT
/begin MEASUREMENT HowDetn.StLpFil.FilSt "MICROSAR RTE" FLOAT32_IEEE NO_COMPU_METHOD 0 0 -3.402823466e+38 3.402823466e+38 ECU_ADDRESS 0 SYMBOL_LINK "Rte_HowDetn_StLpFil.FilSt" 0 DISPLAY_IDENTIFIER HowDetn.PerInstanceMemories.StLpFil.FilSt /end MEASUREMENT
/begin MEASUREMENT HowDetn.TqHpFil.CorrnFac "MICROSAR RTE" FLOAT32_IEEE NO_COMPU_METHOD 0 0 -3.402823466e+38 3.402823466e+38 ECU_ADDRESS 0 SYMBOL_LINK "Rte_HowDetn_TqHpFil.CorrnFac" 0 DISPLAY_IDENTIFIER HowDetn.PerInstanceMemories.TqHpFil.CorrnFac /end MEASUREMENT
/begin MEASUREMENT HowDetn.TqHpFil.FilLpRec.FilGain "MICROSAR RTE" FLOAT32_IEEE NO_COMPU_METHOD 0 0 -3.402823466e+38 3.402823466e+38 ECU_ADDRESS 0 SYMBOL_LINK "Rte_HowDetn_TqHpFil.FilLpRec.FilGain" 0 DISPLAY_IDENTIFIER HowDetn.PerInstanceMemories.TqHpFil.FilLpRec.FilGain /end MEASUREMENT
/begin MEASUREMENT HowDetn.TqHpFil.FilLpRec.FilSt "MICROSAR RTE" FLOAT32_IEEE NO_COMPU_METHOD 0 0 -3.402823466e+38 3.402823466e+38 ECU_ADDRESS 0 SYMBOL_LINK "Rte_HowDetn_TqHpFil.FilLpRec.FilSt" 0 DISPLAY_IDENTIFIER HowDetn.PerInstanceMemories.TqHpFil.FilLpRec.FilSt /end MEASUREMENT
/begin MEASUREMENT HowDetn.VehSpd.Val "MICROSAR RTE" FLOAT32_IEEE NO_COMPU_METHOD 0 0 -3.402823466e+38 3.402823466e+38 ECU_ADDRESS 0 SYMBOL_LINK "Rte_VehSigCdng_VehSpd_Val" 0 DISPLAY_IDENTIFIER HowDetn.ReceiverPorts.VehSpd.Val /end MEASUREMENT
/begin MEASUREMENT HowDetn.dHowDetnAbsHiFrqTq "MICROSAR RTE" FLOAT32_IEEE NO_COMPU_METHOD 0 0 -3.402823466e+38 3.402823466e+38 ECU_ADDRESS 0 SYMBOL_LINK "Rte_HowDetn_dHowDetnAbsHiFrqTq" 0 DISPLAY_IDENTIFIER HowDetn.PerInstanceMemories.dHowDetnAbsHiFrqTq /end MEASUREMENT
/begin MEASUREMENT HowDetn.dHowDetnAbsLoFrqTq "MICROSAR RTE" FLOAT32_IEEE NO_COMPU_METHOD 0 0 -3.402823466e+38 3.402823466e+38 ECU_ADDRESS 0 SYMBOL_LINK "Rte_HowDetn_dHowDetnAbsLoFrqTq" 0 DISPLAY_IDENTIFIER HowDetn.PerInstanceMemories.dHowDetnAbsLoFrqTq /end MEASUREMENT
/begin MEASUREMENT HwAg0Meas.HwAg0.Val "MICROSAR RTE" FLOAT32_IEEE NO_COMPU_METHOD 0 0 -900.0 900.0 ECU_ADDRESS 0 SYMBOL_LINK "Rte_HwAg0Meas_HwAg0_Val" 0 DISPLAY_IDENTIFIER HwAg0Meas.SenderPorts.HwAg0.Val /end MEASUREMENT
/begin MEASUREMENT HwAg0Meas.HwAg0InitStepSeqNrCmpl "MICROSAR RTE" UBYTE RTE_CM_BOOLEAN 0 0 0 255 ECU_ADDRESS 0 SYMBOL_LINK "Rte_HwAg0Meas_HwAg0InitStepSeqNrCmpl" 0 DISPLAY_IDENTIFIER HwAg0Meas.PerInstanceMemories.HwAg0InitStepSeqNrCmpl /end MEASUREMENT
/begin GROUP GmOvrlStMgr.HwOscnEna.Logl "MICROSAR RTE" /begin SUB_GROUP /end SUB_GROUP /begin FUNCTION_LIST /end FUNCTION_LIST /begin REF_CHARACTERISTIC /end REF_CHARACTERISTIC /begin REF_MEASUREMENT GmOvrlStMgr.HwOscnEna.Logl /end REF_MEASUREMENT /end GROUP
/begin GROUP GmOvrlStMgr.HwOscnFrq.Val "MICROSAR RTE" /begin SUB_GROUP /end SUB_GROUP /begin FUNCTION_LIST /end FUNCTION_LIST /begin REF_CHARACTERISTIC /end REF_CHARACTERISTIC /begin REF_MEASUREMENT GmOvrlStMgr.HwOscnFrq.Val /end REF_MEASUREMENT /end GROUP
/begin GROUP GmOvrlStMgr.HwOscnMotAmp.Val "MICROSAR RTE" /begin SUB_GROUP /end SUB_GROUP /begin FUNCTION_LIST /end FUNCTION_LIST /begin REF_CHARACTERISTIC /end REF_CHARACTERISTIC /begin REF_MEASUREMENT GmOvrlStMgr.HwOscnMotAmp.Val /end REF_MEASUREMENT /end GROUP
/begin GROUP GmOvrlStMgr.HwTq.Val "MICROSAR RTE" /begin SUB_GROUP /end SUB_GROUP /begin FUNCTION_LIST /end FUNCTION_LIST /begin REF_CHARACTERISTIC /end REF_CHARACTERISTIC /begin REF_MEASUREMENT GmOvrlStMgr.HwTq.Val /end REF_MEASUREMENT /end GROUP
/begin GROUP GmOvrlStMgr.HwTqLkaLpFil "MICROSAR RTE" /begin SUB_GROUP /end SUB_GROUP /begin FUNCTION_LIST /end FUNCTION_LIST /begin REF_CHARACTERISTIC /end REF_CHARACTERISTIC
 /begin REF_MEASUREMENT GmOvrlStMgr.HwTqLkaLpFil.FilGain GmOvrlStMgr.HwTqLkaLpFil.FilSt /end REF_MEASUREMENT
/end GROUP
/begin GROUP GmOvrlStMgr.HwTqLpFil "MICROSAR RTE" /begin SUB_GROUP /end SUB_GROUP /begin FUNCTION_LIST /end FUNCTION_LIST /begin REF_CHARACTERISTIC /end REF_CHARACTERISTIC /begin REF_MEASUREMENT GmOvrlStMgr.HwTqLpFil.FilGain GmOvrlStMgr.HwTqLpFil.FilSt /end REF_MEASUREMENT /end GROUP
/begin GROUP GmOvrlStMgr.HwTqOscSt.Val "MICROSAR RTE" /begin SUB_GROUP /end SUB_GROUP /begin FUNCTION_LIST /end FUNCTION_LIST /begin REF_CHARACTERISTIC /end REF_CHARACTERISTIC /begin REF_MEASUREMENT GmOvrlStMgr.HwTqOscSt.Val /end REF_MEASUREMENT /end GROUP
/begin GROUP GmOvrlStMgr.HwTqOscnLpFil "MICROSAR RTE" /begin SUB_GROUP /end SUB_GROUP /begin FUNCTION_LIST /end FUNCTION_LIST /begin REF_CHARACTERISTIC /end REF_CHARACTERISTIC
 /begin REF_MEASUREMENT GmOvrlStMgr.HwTqOscnLpFil.FilGain GmOvrlStMgr.HwTqOscnLpFil.FilSt /end REF_MEASUREMENT
/end GROUP
/begin GROUP GmOvrlStMgr.IgnCntrUpd "MICROSAR RTE" /begin SUB_GROUP /end SUB_GROUP /begin FUNCTION_LIST /end FUNCTION_LIST /begin REF_CHARACTERISTIC /end REF_CHARACTERISTIC /begin REF_MEASUREMENT GmOvrlStMgr.IgnCntrUpd /end REF_MEASUREMENT /end GROUP
/begin GROUP GmOvrlStMgr.LkaEna.Logl "MICROSAR RTE" /begin SUB_GROUP /end SUB_GROUP /begin FUNCTION_LIST /end FUNCTION_LIST /begin REF_CHARACTERISTIC /end REF_CHARACTERISTIC /begin REF_MEASUREMENT GmOvrlStMgr.LkaEna.Logl /end REF_MEASUREMENT /end GROUP
/begin GROUP GmOvrlStMgr.LkaFltCntr "MICROSAR RTE" /begin SUB_GROUP /end SUB_GROUP /begin FUNCTION_LIST /end FUNCTION_LIST /begin REF_CHARACTERISTIC /end REF_CHARACTERISTIC /begin REF_MEASUREMENT GmOvrlStMgr.LkaFltCntr /end REF_MEASUREMENT /end GROUP
/begin GROUP GmOvrlStMgr.LkaFltPrev "MICROSAR RTE" /begin SUB_GROUP /end SUB_GROUP /begin FUNCTION_LIST /end FUNCTION_LIST /begin REF_CHARACTERISTIC /end REF_CHARACTERISTIC /begin REF_MEASUREMENT GmOvrlStMgr.LkaFltPrev /end REF_MEASUREMENT /end GROUP
/begin GROUP GmOvrlStMgr.LkaFltRefTmr "MICROSAR RTE" /begin SUB_GROUP /end SUB_GROUP /begin FUNCTION_LIST /end FUNCTION_LIST /begin REF_CHARACTERISTIC /end REF_CHARACTERISTIC /begin REF_MEASUREMENT GmOvrlStMgr.LkaFltRefTmr /end REF_MEASUREMENT /end GROUP
/begin GROUP GmOvrlStMgr.LkaIntvPrev "MICROSAR RTE" /begin SUB_GROUP /end SUB_GROUP /begin FUNCTION_LIST /end FUNCTION_LIST /begin REF_CHARACTERISTIC /end REF_CHARACTERISTIC /begin REF_MEASUREMENT GmOvrlStMgr.LkaIntvPrev /end REF_MEASUREMENT /end GROUP
/begin GROUP GmOvrlStMgr.LkaIntvRefTi1 "MICROSAR RTE" /begin SUB_GROUP /end SUB_GROUP /begin FUNCTION_LIST /end FUNCTION_LIST /begin REF_CHARACTERISTIC /end REF_CHARACTERISTIC /begin REF_MEASUREMENT GmOvrlStMgr.LkaIntvRefTi1 /end REF_MEASUREMENT /end GROUP
/begin GROUP GmOvrlStMgr.LkaIntvRefTi2 "MICROSAR RTE" /begin SUB_GROUP /end SUB_GROUP /begin FUNCTION_LIST /end FUNCTION_LIST /begin REF_CHARACTERISTIC /end REF_CHARACTERISTIC /begin REF_MEASUREMENT GmOvrlStMgr.LkaIntvRefTi2 /end REF_MEASUREMENT /end GROUP
/begin GROUP GmOvrlStMgr.LkaSt.Val "MICROSAR RTE" /begin SUB_GROUP /end SUB_GROUP /begin FUNCTION_LIST /end FUNCTION_LIST /begin REF_CHARACTERISTIC /end REF_CHARACTERISTIC /begin REF_MEASUREMENT GmOvrlStMgr.LkaSt.Val /end REF_MEASUREMENT /end GROUP
/begin GROUP GmOvrlStMgr.LkaTqCmdCdnd.Val "MICROSAR RTE" /begin SUB_GROUP /end SUB_GROUP /begin FUNCTION_LIST /end FUNCTION_LIST /begin REF_CHARACTERISTIC /end REF_CHARACTERISTIC /begin REF_MEASUREMENT GmOvrlStMgr.LkaTqCmdCdnd.Val /end REF_MEASUREMENT /end GROUP
/begin GROUP GmOvrlStMgr.LoaMtgtnHaptcFbStrtOnRefTi "MICROSAR RTE" /begin SUB_GROUP /end SUB_GROUP /begin FUNCTION_LIST /end FUNCTION_LIST /begin REF_CHARACTERISTIC /end REF_CHARACTERISTIC /begin REF_MEASUREMENT GmOvrlStMgr.LoaMtgtnHaptcFbStrtOnRefTi /end REF_MEASUREMENT /end GROUP
/begin GROUP GmOvrlStMgr.LoaSt.Val "MICROSAR RTE" /begin SUB_GROUP /end SUB_GROUP /begin FUNCTION_LIST /end FUNCTION_LIST /begin REF_CHARACTERISTIC /end REF_CHARACTERISTIC /begin REF_MEASUREMENT GmOvrlStMgr.LoaSt.Val /end REF_MEASUREMENT /end GROUP
/begin GROUP GmOvrlStMgr.LoaStChk "MICROSAR RTE" /begin SUB_GROUP /end SUB_GROUP /begin FUNCTION_LIST /end FUNCTION_LIST /begin REF_CHARACTERISTIC /end REF_CHARACTERISTIC /begin REF_MEASUREMENT GmOvrlStMgr.LoaStChk /end REF_MEASUREMENT /end GROUP
/begin GROUP GmOvrlStMgr.Msg17DBusHiSpdInvld.Logl "MICROSAR RTE" /begin SUB_GROUP /end SUB_GROUP /begin FUNCTION_LIST /end FUNCTION_LIST /begin REF_CHARACTERISTIC /end REF_CHARACTERISTIC /begin REF_MEASUREMENT GmOvrlStMgr.Msg17DBusHiSpdInvld.Logl /end REF_MEASUREMENT /end GROUP
/begin GROUP GmOvrlStMgr.Msg17DBusHiSpdMiss.Logl "MICROSAR RTE" /begin SUB_GROUP /end SUB_GROUP /begin FUNCTION_LIST /end FUNCTION_LIST /begin REF_CHARACTERISTIC /end REF_CHARACTERISTIC /begin REF_MEASUREMENT GmOvrlStMgr.Msg17DBusHiSpdMiss.Logl /end REF_MEASUREMENT /end GROUP
/begin GROUP GmOvrlStMgr.Msg180BusChassisExpInvld.Logl "MICROSAR RTE" /begin SUB_GROUP /end SUB_GROUP /begin FUNCTION_LIST /end FUNCTION_LIST /begin REF_CHARACTERISTIC /end REF_CHARACTERISTIC /begin REF_MEASUREMENT GmOvrlStMgr.Msg180BusChassisExpInvld.Logl /end REF_MEASUREMENT /end GROUP
/begin GROUP GmOvrlStMgr.Msg180BusChassisExpMiss.Logl "MICROSAR RTE" /begin SUB_GROUP /end SUB_GROUP /begin FUNCTION_LIST /end FUNCTION_LIST /begin REF_CHARACTERISTIC /end REF_CHARACTERISTIC /begin REF_MEASUREMENT GmOvrlStMgr.Msg180BusChassisExpMiss.Logl /end REF_MEASUREMENT /end GROUP
/begin GROUP GmOvrlStMgr.Msg180BusHiSpdInvld.Logl "MICROSAR RTE" /begin SUB_GROUP /end SUB_GROUP /begin FUNCTION_LIST /end FUNCTION_LIST /begin REF_CHARACTERISTIC /end REF_CHARACTERISTIC /begin REF_MEASUREMENT GmOvrlStMgr.Msg180BusHiSpdInvld.Logl /end REF_MEASUREMENT /end GROUP
/begin GROUP GmOvrlStMgr.Msg180BusHiSpdMiss.Logl "MICROSAR RTE" /begin SUB_GROUP /end SUB_GROUP /begin FUNCTION_LIST /end FUNCTION_LIST /begin REF_CHARACTERISTIC /end REF_CHARACTERISTIC /begin REF_MEASUREMENT GmOvrlStMgr.Msg180BusHiSpdMiss.Logl /end REF_MEASUREMENT /end GROUP
/begin GROUP GmOvrlStMgr.Msg1E9BusHiSpdInvld.Logl "MICROSAR RTE" /begin SUB_GROUP /end SUB_GROUP /begin FUNCTION_LIST /end FUNCTION_LIST /begin REF_CHARACTERISTIC /end REF_CHARACTERISTIC /begin REF_MEASUREMENT GmOvrlStMgr.Msg1E9BusHiSpdInvld.Logl /end REF_MEASUREMENT /end GROUP
/begin GROUP GmOvrlStMgr.Msg1E9BusHiSpdMiss.Logl "MICROSAR RTE" /begin SUB_GROUP /end SUB_GROUP /begin FUNCTION_LIST /end FUNCTION_LIST /begin REF_CHARACTERISTIC /end REF_CHARACTERISTIC /begin REF_MEASUREMENT GmOvrlStMgr.Msg1E9BusHiSpdMiss.Logl /end REF_MEASUREMENT /end GROUP
/begin GROUP GmOvrlStMgr.Msg1F5BusHiSpdInvld.Logl "MICROSAR RTE" /begin SUB_GROUP /end SUB_GROUP /begin FUNCTION_LIST /end FUNCTION_LIST /begin REF_CHARACTERISTIC /end REF_CHARACTERISTIC /begin REF_MEASUREMENT GmOvrlStMgr.Msg1F5BusHiSpdInvld.Logl /end REF_MEASUREMENT /end GROUP
/begin GROUP GmOvrlStMgr.Msg214BusHiSpdInvld.Logl "MICROSAR RTE" /begin SUB_GROUP /end SUB_GROUP /begin FUNCTION_LIST /end FUNCTION_LIST /begin REF_CHARACTERISTIC /end REF_CHARACTERISTIC /begin REF_MEASUREMENT GmOvrlStMgr.Msg214BusHiSpdInvld.Logl /end REF_MEASUREMENT /end GROUP
/begin GROUP GmOvrlStMgr.Msg214BusHiSpdMiss.Logl "MICROSAR RTE" /begin SUB_GROUP /end SUB_GROUP /begin FUNCTION_LIST /end FUNCTION_LIST /begin REF_CHARACTERISTIC /end REF_CHARACTERISTIC /begin REF_MEASUREMENT GmOvrlStMgr.Msg214BusHiSpdMiss.Logl /end REF_MEASUREMENT /end GROUP
/begin GROUP GmOvrlStMgr.Msg337BusChassisExpInvld.Logl "MICROSAR RTE" /begin SUB_GROUP /end SUB_GROUP /begin FUNCTION_LIST /end FUNCTION_LIST /begin REF_CHARACTERISTIC /end REF_CHARACTERISTIC /begin REF_MEASUREMENT GmOvrlStMgr.Msg337BusChassisExpInvld.Logl /end REF_MEASUREMENT /end GROUP
/begin GROUP GmOvrlStMgr.Msg337BusChassisExpMiss.Logl "MICROSAR RTE" /begin SUB_GROUP /end SUB_GROUP /begin FUNCTION_LIST /end FUNCTION_LIST /begin REF_CHARACTERISTIC /end REF_CHARACTERISTIC /begin REF_MEASUREMENT GmOvrlStMgr.Msg337BusChassisExpMiss.Logl /end REF_MEASUREMENT /end GROUP
/begin GROUP GmOvrlStMgr.PerInstanceMemories "MICROSAR RTE"
 /begin SUB_GROUP GmOvrlStMgr.GmLoaIgnCntr GmOvrlStMgr.HaptcStTranActvToWaitRefTi GmOvrlStMgr.HapticActvRefTmr GmOvrlStMgr.HapticWaitRefTmr GmOvrlStMgr.HwTqLkaLpFil GmOvrlStMgr.HwTqLpFil GmOvrlStMgr.HwTqOscnLpFil GmOvrlStMgr.IgnCntrUpd GmOvrlStMgr.LkaFltCntr GmOvrlStMgr.LkaFltPrev GmOvrlStMgr.LkaFltRefTmr GmOvrlStMgr.LkaIntvPrev GmOvrlStMgr.LkaIntvRefTi1 GmOvrlStMgr.LkaIntvRefTi2 GmOvrlStMgr.LoaMtgtnHaptcFbStrtOnRefTi GmOvrlStMgr.LoaStChk GmOvrlStMgr.PrevApaIntvEna GmOvrlStMgr.PrevApaIntvRefTi GmOvrlStMgr.PrevApaSt GmOvrlStMgr.PrevEscSt GmOvrlStMgr.PrevHaptcReqEna GmOvrlStMgr.PrevHaptcReqRefTi GmOvrlStMgr.PrevHaptcSt GmOvrlStMgr.PrevLkaFlt GmOvrlStMgr.PrevLkaSt GmOvrlStMgr.PrevShiftLvrRvsEna GmOvrlStMgr.PrevShiftLvrRvsRefTi GmOvrlStMgr.PrevVehStandStillEna GmOvrlStMgr.PrevVehStandStillRefTi GmOvrlStMgr.TqOscCycRefTi GmOvrlStMgr.TranHaptcWaitToApaStActvRefTi GmOvrlStMgr.dGmOvrlStMgrApaShiftLvrRvs GmOvrlStMgr.dGmOvrlStMgrApaStandStill /end SUB_GROUP
 /begin FUNCTION_LIST /end FUNCTION_LIST
 /begin REF_CHARACTERISTIC /end REF_CHARACTERISTIC
 /begin REF_MEASUREMENT /end REF_MEASUREMENT
/end GROUP
/begin GROUP GmOvrlStMgr.PrevApaIntvEna "MICROSAR RTE" /begin SUB_GROUP /end SUB_GROUP /begin FUNCTION_LIST /end FUNCTION_LIST /begin REF_CHARACTERISTIC /end REF_CHARACTERISTIC /begin REF_MEASUREMENT GmOvrlStMgr.PrevApaIntvEna /end REF_MEASUREMENT /end GROUP
/begin GROUP GmOvrlStMgr.PrevApaIntvRefTi "MICROSAR RTE" /begin SUB_GROUP /end SUB_GROUP /begin FUNCTION_LIST /end FUNCTION_LIST /begin REF_CHARACTERISTIC /end REF_CHARACTERISTIC /begin REF_MEASUREMENT GmOvrlStMgr.PrevApaIntvRefTi /end REF_MEASUREMENT /end GROUP
/begin GROUP GmOvrlStMgr.PrevApaSt "MICROSAR RTE" /begin SUB_GROUP /end SUB_GROUP /begin FUNCTION_LIST /end FUNCTION_LIST /begin REF_CHARACTERISTIC /end REF_CHARACTERISTIC /begin REF_MEASUREMENT GmOvrlStMgr.PrevApaSt /end REF_MEASUREMENT /end GROUP
/begin GROUP GmOvrlStMgr.PrevEscSt "MICROSAR RTE" /begin SUB_GROUP /end SUB_GROUP /begin FUNCTION_LIST /end FUNCTION_LIST /begin REF_CHARACTERISTIC /end REF_CHARACTERISTIC /begin REF_MEASUREMENT GmOvrlStMgr.PrevEscSt /end REF_MEASUREMENT /end GROUP
/begin GROUP GmOvrlStMgr.PrevHaptcReqEna "MICROSAR RTE" /begin SUB_GROUP /end SUB_GROUP /begin FUNCTION_LIST /end FUNCTION_LIST /begin REF_CHARACTERISTIC /end REF_CHARACTERISTIC /begin REF_MEASUREMENT GmOvrlStMgr.PrevHaptcReqEna /end REF_MEASUREMENT /end GROUP
/begin GROUP GmOvrlStMgr.PrevHaptcReqRefTi "MICROSAR RTE" /begin SUB_GROUP /end SUB_GROUP /begin FUNCTION_LIST /end FUNCTION_LIST /begin REF_CHARACTERISTIC /end REF_CHARACTERISTIC /begin REF_MEASUREMENT GmOvrlStMgr.PrevHaptcReqRefTi /end REF_MEASUREMENT /end GROUP
/begin GROUP GmOvrlStMgr.PrevHaptcSt "MICROSAR RTE" /begin SUB_GROUP /end SUB_GROUP /begin FUNCTION_LIST /end FUNCTION_LIST /begin REF_CHARACTERISTIC /end REF_CHARACTERISTIC /begin REF_MEASUREMENT GmOvrlStMgr.PrevHaptcSt /end REF_MEASUREMENT /end GROUP
/begin GROUP GmOvrlStMgr.PrevLkaFlt "MICROSAR RTE" /begin SUB_GROUP /end SUB_GROUP /begin FUNCTION_LIST /end FUNCTION_LIST /begin REF_CHARACTERISTIC /end REF_CHARACTERISTIC /begin REF_MEASUREMENT GmOvrlStMgr.PrevLkaFlt /end REF_MEASUREMENT /end GROUP
/begin GROUP GmOvrlStMgr.PrevLkaSt "MICROSAR RTE" /begin SUB_GROUP /end SUB_GROUP /begin FUNCTION_LIST /end FUNCTION_LIST /begin REF_CHARACTERISTIC /end REF_CHARACTERISTIC /begin REF_MEASUREMENT GmOvrlStMgr.PrevLkaSt /end REF_MEASUREMENT /end GROUP
/begin GROUP GmOvrlStMgr.PrevShiftLvrRvsEna "MICROSAR RTE" /begin SUB_GROUP /end SUB_GROUP /begin FUNCTION_LIST /end FUNCTION_LIST /begin REF_CHARACTERISTIC /end REF_CHARACTERISTIC /begin REF_MEASUREMENT GmOvrlStMgr.PrevShiftLvrRvsEna /end REF_MEASUREMENT /end GROUP
/begin GROUP GmOvrlStMgr.PrevShiftLvrRvsRefTi "MICROSAR RTE" /begin SUB_GROUP /end SUB_GROUP /begin FUNCTION_LIST /end FUNCTION_LIST /begin REF_CHARACTERISTIC /end REF_CHARACTERISTIC /begin REF_MEASUREMENT GmOvrlStMgr.PrevShiftLvrRvsRefTi /end REF_MEASUREMENT /end GROUP
/begin GROUP GmOvrlStMgr.PrevVehStandStillEna "MICROSAR RTE" /begin SUB_GROUP /end SUB_GROUP /begin FUNCTION_LIST /end FUNCTION_LIST /begin REF_CHARACTERISTIC /end REF_CHARACTERISTIC /begin REF_MEASUREMENT GmOvrlStMgr.PrevVehStandStillEna /end REF_MEASUREMENT /end GROUP
/begin GROUP GmOvrlStMgr.PrevVehStandStillRefTi "MICROSAR RTE" /begin SUB_GROUP /end SUB_GROUP /begin FUNCTION_LIST /end FUNCTION_LIST /begin REF_CHARACTERISTIC /end REF_CHARACTERISTIC /begin REF_MEASUREMENT GmOvrlStMgr.PrevVehStandStillRefTi /end REF_MEASUREMENT /end GROUP
/begin GROUP GmOvrlStMgr.ReceiverPorts "MICROSAR RTE"
 /begin SUB_GROUP GmOvrlStMgr.AbsActvProtd.Logl GmOvrlStMgr.ApaEna.Logl GmOvrlStMgr.EscEna.Logl GmOvrlStMgr.EscLimdActv.Logl GmOvrlStMgr.HwAgEotCcw.Val GmOvrlStMgr.HwAgEotCw.Val GmOvrlStMgr.HwAgTar.Val GmOvrlStMgr.HwAgTraj.Val GmOvrlStMgr.HwAgTrajEna.Logl GmOvrlStMgr.HwHaptcEna.Logl GmOvrlStMgr.HwTq.Val GmOvrlStMgr.LkaEna.Logl GmOvrlStMgr.LkaTqCmdCdnd.Val GmOvrlStMgr.LoaSt.Val GmOvrlStMgr.Msg17DBusHiSpdInvld.Logl GmOvrlStMgr.Msg17DBusHiSpdMiss.Logl GmOvrlStMgr.Msg180BusChassisExpInvld.Logl GmOvrlStMgr.Msg180BusChassisExpMiss.Logl GmOvrlStMgr.Msg180BusHiSpdInvld.Logl GmOvrlStMgr.Msg180BusHiSpdMiss.Logl GmOvrlStMgr.Msg1E9BusHiSpdInvld.Logl GmOvrlStMgr.Msg1E9BusHiSpdMiss.Logl GmOvrlStMgr.Msg1F5BusHiSpdInvld.Logl GmOvrlStMgr.Msg214BusHiSpdInvld.Logl GmOvrlStMgr.Msg214BusHiSpdMiss.Logl GmOvrlStMgr.Msg337BusChassisExpInvld.Logl GmOvrlStMgr.Msg337BusChassisExpMiss.Logl GmOvrlStMgr.ShiftLvrRvs.Logl GmOvrlStMgr.SysSt.Val GmOvrlStMgr.VehSpd.Val GmOvrlStMgr.VehSpdSecurMax.Val GmOvrlStMgr.VehSpdSecurMaxVld.Logl GmOvrlStMgr.VehSpdSecurMin.Val GmOvrlStMgr.VehSpdSecurMinVld.Logl GmOvrlStMgr.VehStabyEnhmtActv.Logl /end SUB_GROUP
 /begin FUNCTION_LIST /end FUNCTION_LIST
 /begin REF_CHARACTERISTIC /end REF_CHARACTERISTIC
 /begin REF_MEASUREMENT /end REF_MEASUREMENT
/end GROUP
/begin GROUP GmOvrlStMgr.SenderPorts "MICROSAR RTE"
 /begin SUB_GROUP GmOvrlStMgr.ApaDrvrIntvDetd.Logl GmOvrlStMgr.ApaSt.Val GmOvrlStMgr.EscSt.Val GmOvrlStMgr.HwAgServoCmd.Val GmOvrlStMgr.HwAgServoEna.Logl GmOvrlStMgr.HwOscnEna.Logl GmOvrlStMgr.HwOscnFrq.Val GmOvrlStMgr.HwOscnMotAmp.Val GmOvrlStMgr.HwTqOscSt.Val GmOvrlStMgr.LkaSt.Val /end SUB_GROUP
 /begin FUNCTION_LIST /end FUNCTION_LIST
 /begin REF_CHARACTERISTIC /end REF_CHARACTERISTIC
 /begin REF_MEASUREMENT /end REF_MEASUREMENT
/end GROUP
/begin GROUP GmOvrlStMgr.ShiftLvrRvs.Logl "MICROSAR RTE" /begin SUB_GROUP /end SUB_GROUP /begin FUNCTION_LIST /end FUNCTION_LIST /begin REF_CHARACTERISTIC /end REF_CHARACTERISTIC /begin REF_MEASUREMENT GmOvrlStMgr.ShiftLvrRvs.Logl /end REF_MEASUREMENT /end GROUP
/begin GROUP GmOvrlStMgr.SysSt.Val "MICROSAR RTE" /begin SUB_GROUP /end SUB_GROUP /begin FUNCTION_LIST /end FUNCTION_LIST /begin REF_CHARACTERISTIC /end REF_CHARACTERISTIC /begin REF_MEASUREMENT GmOvrlStMgr.SysSt.Val /end REF_MEASUREMENT /end GROUP
/begin GROUP GmOvrlStMgr.TqOscCycRefTi "MICROSAR RTE" /begin SUB_GROUP /end SUB_GROUP /begin FUNCTION_LIST /end FUNCTION_LIST /begin REF_CHARACTERISTIC /end REF_CHARACTERISTIC /begin REF_MEASUREMENT GmOvrlStMgr.TqOscCycRefTi /end REF_MEASUREMENT /end GROUP
/begin GROUP GmOvrlStMgr.TranHaptcWaitToApaStActvRefTi "MICROSAR RTE" /begin SUB_GROUP /end SUB_GROUP /begin FUNCTION_LIST /end FUNCTION_LIST /begin REF_CHARACTERISTIC /end REF_CHARACTERISTIC /begin REF_MEASUREMENT GmOvrlStMgr.TranHaptcWaitToApaStActvRefTi /end REF_MEASUREMENT /end GROUP
/begin GROUP GmOvrlStMgr.VehSpd.Val "MICROSAR RTE" /begin SUB_GROUP /end SUB_GROUP /begin FUNCTION_LIST /end FUNCTION_LIST /begin REF_CHARACTERISTIC /end REF_CHARACTERISTIC /begin REF_MEASUREMENT GmOvrlStMgr.VehSpd.Val /end REF_MEASUREMENT /end GROUP
/begin GROUP GmOvrlStMgr.VehSpdSecurMax.Val "MICROSAR RTE" /begin SUB_GROUP /end SUB_GROUP /begin FUNCTION_LIST /end FUNCTION_LIST /begin REF_CHARACTERISTIC /end REF_CHARACTERISTIC /begin REF_MEASUREMENT GmOvrlStMgr.VehSpdSecurMax.Val /end REF_MEASUREMENT /end GROUP
/begin GROUP GmOvrlStMgr.VehSpdSecurMaxVld.Logl "MICROSAR RTE" /begin SUB_GROUP /end SUB_GROUP /begin FUNCTION_LIST /end FUNCTION_LIST /begin REF_CHARACTERISTIC /end REF_CHARACTERISTIC /begin REF_MEASUREMENT GmOvrlStMgr.VehSpdSecurMaxVld.Logl /end REF_MEASUREMENT /end GROUP
/begin GROUP GmOvrlStMgr.VehSpdSecurMin.Val "MICROSAR RTE" /begin SUB_GROUP /end SUB_GROUP /begin FUNCTION_LIST /end FUNCTION_LIST /begin REF_CHARACTERISTIC /end REF_CHARACTERISTIC /begin REF_MEASUREMENT GmOvrlStMgr.VehSpdSecurMin.Val /end REF_MEASUREMENT /end GROUP
/begin GROUP GmOvrlStMgr.VehSpdSecurMinVld.Logl "MICROSAR RTE" /begin SUB_GROUP /end SUB_GROUP /begin FUNCTION_LIST /end FUNCTION_LIST /begin REF_CHARACTERISTIC /end REF_CHARACTERISTIC /begin REF_MEASUREMENT GmOvrlStMgr.VehSpdSecurMinVld.Logl /end REF_MEASUREMENT /end GROUP
/begin GROUP GmOvrlStMgr.VehStabyEnhmtActv.Logl "MICROSAR RTE" /begin SUB_GROUP /end SUB_GROUP /begin FUNCTION_LIST /end FUNCTION_LIST /begin REF_CHARACTERISTIC /end REF_CHARACTERISTIC /begin REF_MEASUREMENT GmOvrlStMgr.VehStabyEnhmtActv.Logl /end REF_MEASUREMENT /end GROUP
/begin GROUP GmOvrlStMgr.dGmOvrlStMgrApaShiftLvrRvs "MICROSAR RTE" /begin SUB_GROUP /end SUB_GROUP /begin FUNCTION_LIST /end FUNCTION_LIST /begin REF_CHARACTERISTIC /end REF_CHARACTERISTIC /begin REF_MEASUREMENT GmOvrlStMgr.dGmOvrlStMgrApaShiftLvrRvs /end REF_MEASUREMENT /end GROUP
/begin GROUP GmOvrlStMgr.dGmOvrlStMgrApaStandStill "MICROSAR RTE" /begin SUB_GROUP /end SUB_GROUP /begin FUNCTION_LIST /end FUNCTION_LIST /begin REF_CHARACTERISTIC /end REF_CHARACTERISTIC /begin REF_MEASUREMENT GmOvrlStMgr.dGmOvrlStMgrApaStandStill /end REF_MEASUREMENT /end GROUP
/begin GROUP GmRoadWhlInQlfr "MICROSAR RTE"
 /begin SUB_GROUP GmRoadWhlInQlfr.CalibrationPorts GmRoadWhlInQlfr.PerInstanceMemories GmRoadWhlInQlfr.ReceiverPorts GmRoadWhlInQlfr.SenderPorts /end SUB_GROUP
 /begin FUNCTION_LIST /end FUNCTION_LIST
 /begin REF_CHARACTERISTIC /end REF_CHARACTERISTIC
 /begin REF_MEASUREMENT /end REF_MEASUREMENT
/end GROUP
/begin GROUP GmRoadWhlInQlfr.CalibrationPorts "MICROSAR RTE"
 /begin SUB_GROUP GmRoadWhlInQlfr.GmRoadWhlInQlfrMaxAllwblFrq.Val GmRoadWhlInQlfr.GmRoadWhlInQlfrMaxFrqChg.Val /end SUB_GROUP
 /begin FUNCTION_LIST /end FUNCTION_LIST
 /begin REF_CHARACTERISTIC /end REF_CHARACTERISTIC
 /begin REF_MEASUREMENT /end REF_MEASUREMENT
/end GROUP
/begin GROUP GmRoadWhlInQlfr.GmRoadWhlInQlfrMaxAllwblFrq.Val "MICROSAR RTE" /begin SUB_GROUP /end SUB_GROUP /begin FUNCTION_LIST /end FUNCTION_LIST /begin REF_CHARACTERISTIC GmRoadWhlInQlfr.GmRoadWhlInQlfrMaxAllwblFrq.Val /end REF_CHARACTERISTIC /begin REF_MEASUREMENT /end REF_MEASUREMENT /end GROUP
/begin GROUP GmRoadWhlInQlfr.GmRoadWhlInQlfrMaxFrqChg.Val "MICROSAR RTE" /begin SUB_GROUP /end SUB_GROUP /begin FUNCTION_LIST /end FUNCTION_LIST /begin REF_CHARACTERISTIC GmRoadWhlInQlfr.GmRoadWhlInQlfrMaxFrqChg.Val /end REF_CHARACTERISTIC /begin REF_MEASUREMENT /end REF_MEASUREMENT /end GROUP
/begin GROUP GmRoadWhlInQlfr.PerInstanceMemories "MICROSAR RTE"
 /begin SUB_GROUP GmRoadWhlInQlfr.PrevLeWhlFrq GmRoadWhlInQlfr.PrevLeWhlFrqVld GmRoadWhlInQlfr.PrevRawLeWhlFrq GmRoadWhlInQlfr.PrevRawRiWhlFrq GmRoadWhlInQlfr.PrevRiWhlFrq GmRoadWhlInQlfr.PrevRiWhlFrqVld GmRoadWhlInQlfr.PrevVldLeWhlDstPlsCntr GmRoadWhlInQlfr.PrevVldLeWhlDstTiStamp GmRoadWhlInQlfr.PrevVldRiWhlDstPlsCntr GmRoadWhlInQlfr.PrevVldRiWhlDstTiStamp GmRoadWhlInQlfr.PrevVldTiLeFrqChg GmRoadWhlInQlfr.PrevVldTiRiFrqChg GmRoadWhlInQlfr.dGmRoadWhlInQlfrLeDeltaPls GmRoadWhlInQlfr.dGmRoadWhlInQlfrLeDeltaTiStamp GmRoadWhlInQlfr.dGmRoadWhlInQlfrLeWhlFrqVld GmRoadWhlInQlfr.dGmRoadWhlInQlfrRawLeWhlFrq GmRoadWhlInQlfr.dGmRoadWhlInQlfrRawRiWhlFrq GmRoadWhlInQlfr.dGmRoadWhlInQlfrRiDeltaPls GmRoadWhlInQlfr.dGmRoadWhlInQlfrRiDeltaTiStamp GmRoadWhlInQlfr.dGmRoadWhlInQlfrRiWhlFrqVld /end SUB_GROUP
 /begin FUNCTION_LIST /end FUNCTION_LIST
 /begin REF_CHARACTERISTIC /end REF_CHARACTERISTIC
 /begin REF_MEASUREMENT /end REF_MEASUREMENT
/end GROUP
/begin GROUP GmRoadWhlInQlfr.PrevLeWhlFrq "MICROSAR RTE" /begin SUB_GROUP /end SUB_GROUP /begin FUNCTION_LIST /end FUNCTION_LIST /begin REF_CHARACTERISTIC /end REF_CHARACTERISTIC /begin REF_MEASUREMENT GmRoadWhlInQlfr.PrevLeWhlFrq /end REF_MEASUREMENT /end GROUP
/begin GROUP GmRoadWhlInQlfr.PrevLeWhlFrqVld "MICROSAR RTE" /begin SUB_GROUP /end SUB_GROUP /begin FUNCTION_LIST /end FUNCTION_LIST /begin REF_CHARACTERISTIC /end REF_CHARACTERISTIC /begin REF_MEASUREMENT GmRoadWhlInQlfr.PrevLeWhlFrqVld /end REF_MEASUREMENT /end GROUP
/begin GROUP GmRoadWhlInQlfr.PrevRawLeWhlFrq "MICROSAR RTE" /begin SUB_GROUP /end SUB_GROUP /begin FUNCTION_LIST /end FUNCTION_LIST /begin REF_CHARACTERISTIC /end REF_CHARACTERISTIC /begin REF_MEASUREMENT GmRoadWhlInQlfr.PrevRawLeWhlFrq /end REF_MEASUREMENT /end GROUP
/begin GROUP GmRoadWhlInQlfr.PrevRawRiWhlFrq "MICROSAR RTE" /begin SUB_GROUP /end SUB_GROUP /begin FUNCTION_LIST /end FUNCTION_LIST /begin REF_CHARACTERISTIC /end REF_CHARACTERISTIC /begin REF_MEASUREMENT GmRoadWhlInQlfr.PrevRawRiWhlFrq /end REF_MEASUREMENT /end GROUP
/begin GROUP GmRoadWhlInQlfr.PrevRiWhlFrq "MICROSAR RTE" /begin SUB_GROUP /end SUB_GROUP /begin FUNCTION_LIST /end FUNCTION_LIST /begin REF_CHARACTERISTIC /end REF_CHARACTERISTIC /begin REF_MEASUREMENT GmRoadWhlInQlfr.PrevRiWhlFrq /end REF_MEASUREMENT /end GROUP
/begin GROUP GmRoadWhlInQlfr.PrevRiWhlFrqVld "MICROSAR RTE" /begin SUB_GROUP /end SUB_GROUP /begin FUNCTION_LIST /end FUNCTION_LIST /begin REF_CHARACTERISTIC /end REF_CHARACTERISTIC /begin REF_MEASUREMENT GmRoadWhlInQlfr.PrevRiWhlFrqVld /end REF_MEASUREMENT /end GROUP
/begin GROUP GmRoadWhlInQlfr.PrevVldLeWhlDstPlsCntr "MICROSAR RTE" /begin SUB_GROUP /end SUB_GROUP /begin FUNCTION_LIST /end FUNCTION_LIST /begin REF_CHARACTERISTIC /end REF_CHARACTERISTIC /begin REF_MEASUREMENT GmRoadWhlInQlfr.PrevVldLeWhlDstPlsCntr /end REF_MEASUREMENT /end GROUP
/begin GROUP GmRoadWhlInQlfr.PrevVldLeWhlDstTiStamp "MICROSAR RTE" /begin SUB_GROUP /end SUB_GROUP /begin FUNCTION_LIST /end FUNCTION_LIST /begin REF_CHARACTERISTIC /end REF_CHARACTERISTIC /begin REF_MEASUREMENT GmRoadWhlInQlfr.PrevVldLeWhlDstTiStamp /end REF_MEASUREMENT /end GROUP
/begin GROUP GmRoadWhlInQlfr.PrevVldRiWhlDstPlsCntr "MICROSAR RTE" /begin SUB_GROUP /end SUB_GROUP /begin FUNCTION_LIST /end FUNCTION_LIST /begin REF_CHARACTERISTIC /end REF_CHARACTERISTIC /begin REF_MEASUREMENT GmRoadWhlInQlfr.PrevVldRiWhlDstPlsCntr /end REF_MEASUREMENT /end GROUP
/begin GROUP GmRoadWhlInQlfr.PrevVldRiWhlDstTiStamp "MICROSAR RTE" /begin SUB_GROUP /end SUB_GROUP /begin FUNCTION_LIST /end FUNCTION_LIST /begin REF_CHARACTERISTIC /end REF_CHARACTERISTIC /begin REF_MEASUREMENT GmRoadWhlInQlfr.PrevVldRiWhlDstTiStamp /end REF_MEASUREMENT /end GROUP
/begin GROUP GmRoadWhlInQlfr.PrevVldTiLeFrqChg "MICROSAR RTE" /begin SUB_GROUP /end SUB_GROUP /begin FUNCTION_LIST /end FUNCTION_LIST /begin REF_CHARACTERISTIC /end REF_CHARACTERISTIC /begin REF_MEASUREMENT GmRoadWhlInQlfr.PrevVldTiLeFrqChg /end REF_MEASUREMENT /end GROUP
/begin GROUP GmRoadWhlInQlfr.PrevVldTiRiFrqChg "MICROSAR RTE" /begin SUB_GROUP /end SUB_GROUP /begin FUNCTION_LIST /end FUNCTION_LIST /begin REF_CHARACTERISTIC /end REF_CHARACTERISTIC /begin REF_MEASUREMENT GmRoadWhlInQlfr.PrevVldTiRiFrqChg /end REF_MEASUREMENT /end GROUP
/begin GROUP GmRoadWhlInQlfr.ReceiverPorts "MICROSAR RTE"
 /begin SUB_GROUP GmRoadWhlInQlfr.WhlLeDstPlsCntr.Val GmRoadWhlInQlfr.WhlLeDstTiStamp.Val GmRoadWhlInQlfr.WhlLeDstVld.Logl GmRoadWhlInQlfr.WhlPlsPerRev.Val GmRoadWhlInQlfr.WhlRiDstPlsCntr.Val GmRoadWhlInQlfr.WhlRiDstTiStamp.Val GmRoadWhlInQlfr.WhlRiDstVld.Logl GmRoadWhlInQlfr.WhlRotlStsTiStampResl.Val /end SUB_GROUP
 /begin FUNCTION_LIST /end FUNCTION_LIST
 /begin REF_CHARACTERISTIC /end REF_CHARACTERISTIC
 /begin REF_MEASUREMENT /end REF_MEASUREMENT
/end GROUP
/begin GROUP GmRoadWhlInQlfr.SenderPorts "MICROSAR RTE"
 /begin SUB_GROUP GmRoadWhlInQlfr.WhlFrqVld.Logl GmRoadWhlInQlfr.WhlLeFrq.Val GmRoadWhlInQlfr.WhlRiFrq.Val /end SUB_GROUP
 /begin FUNCTION_LIST /end FUNCTION_LIST
 /begin REF_CHARACTERISTIC /end REF_CHARACTERISTIC
 /begin REF_MEASUREMENT /end REF_MEASUREMENT
/end GROUP
/begin GROUP GmRoadWhlInQlfr.WhlFrqVld.Logl "MICROSAR RTE" /begin SUB_GROUP /end SUB_GROUP /begin FUNCTION_LIST /end FUNCTION_LIST /begin REF_CHARACTERISTIC /end REF_CHARACTERISTIC /begin REF_MEASUREMENT GmRoadWhlInQlfr.WhlFrqVld.Logl /end REF_MEASUREMENT /end GROUP
/begin GROUP GmRoadWhlInQlfr.WhlLeDstPlsCntr.Val "MICROSAR RTE" /begin SUB_GROUP /end SUB_GROUP /begin FUNCTION_LIST /end FUNCTION_LIST /begin REF_CHARACTERISTIC /end REF_CHARACTERISTIC /begin REF_MEASUREMENT GmRoadWhlInQlfr.WhlLeDstPlsCntr.Val /end REF_MEASUREMENT /end GROUP
/begin GROUP GmRoadWhlInQlfr.WhlLeDstTiStamp.Val "MICROSAR RTE" /begin SUB_GROUP /end SUB_GROUP /begin FUNCTION_LIST /end FUNCTION_LIST /begin REF_CHARACTERISTIC /end REF_CHARACTERISTIC /begin REF_MEASUREMENT GmRoadWhlInQlfr.WhlLeDstTiStamp.Val /end REF_MEASUREMENT /end GROUP
/begin GROUP GmRoadWhlInQlfr.WhlLeDstVld.Logl "MICROSAR RTE" /begin SUB_GROUP /end SUB_GROUP /begin FUNCTION_LIST /end FUNCTION_LIST /begin REF_CHARACTERISTIC /end REF_CHARACTERISTIC /begin REF_MEASUREMENT GmRoadWhlInQlfr.WhlLeDstVld.Logl /end REF_MEASUREMENT /end GROUP
/begin GROUP GmRoadWhlInQlfr.WhlLeFrq.Val "MICROSAR RTE" /begin SUB_GROUP /end SUB_GROUP /begin FUNCTION_LIST /end FUNCTION_LIST /begin REF_CHARACTERISTIC /end REF_CHARACTERISTIC /begin REF_MEASUREMENT GmRoadWhlInQlfr.WhlLeFrq.Val /end REF_MEASUREMENT /end GROUP
/begin GROUP GmRoadWhlInQlfr.WhlPlsPerRev.Val "MICROSAR RTE" /begin SUB_GROUP /end SUB_GROUP /begin FUNCTION_LIST /end FUNCTION_LIST /begin REF_CHARACTERISTIC /end REF_CHARACTERISTIC /begin REF_MEASUREMENT GmRoadWhlInQlfr.WhlPlsPerRev.Val /end REF_MEASUREMENT /end GROUP
/begin GROUP GmRoadWhlInQlfr.WhlRiDstPlsCntr.Val "MICROSAR RTE" /begin SUB_GROUP /end SUB_GROUP /begin FUNCTION_LIST /end FUNCTION_LIST /begin REF_CHARACTERISTIC /end REF_CHARACTERISTIC /begin REF_MEASUREMENT GmRoadWhlInQlfr.WhlRiDstPlsCntr.Val /end REF_MEASUREMENT /end GROUP
/begin GROUP GmRoadWhlInQlfr.WhlRiDstTiStamp.Val "MICROSAR RTE" /begin SUB_GROUP /end SUB_GROUP /begin FUNCTION_LIST /end FUNCTION_LIST /begin REF_CHARACTERISTIC /end REF_CHARACTERISTIC /begin REF_MEASUREMENT GmRoadWhlInQlfr.WhlRiDstTiStamp.Val /end REF_MEASUREMENT /end GROUP
/begin GROUP GmRoadWhlInQlfr.WhlRiDstVld.Logl "MICROSAR RTE" /begin SUB_GROUP /end SUB_GROUP /begin FUNCTION_LIST /end FUNCTION_LIST /begin REF_CHARACTERISTIC /end REF_CHARACTERISTIC /begin REF_MEASUREMENT GmRoadWhlInQlfr.WhlRiDstVld.Logl /end REF_MEASUREMENT /end GROUP
/begin GROUP GmRoadWhlInQlfr.WhlRiFrq.Val "MICROSAR RTE" /begin SUB_GROUP /end SUB_GROUP /begin FUNCTION_LIST /end FUNCTION_LIST /begin REF_CHARACTERISTIC /end REF_CHARACTERISTIC /begin REF_MEASUREMENT GmRoadWhlInQlfr.WhlRiFrq.Val /end REF_MEASUREMENT /end GROUP
/begin GROUP GmRoadWhlInQlfr.WhlRotlStsTiStampResl.Val "MICROSAR RTE" /begin SUB_GROUP /end SUB_GROUP /begin FUNCTION_LIST /end FUNCTION_LIST /begin REF_CHARACTERISTIC /end REF_CHARACTERISTIC /begin REF_MEASUREMENT GmRoadWhlInQlfr.WhlRotlStsTiStampResl.Val /end REF_MEASUREMENT /end GROUP
/begin GROUP GmRoadWhlInQlfr.dGmRoadWhlInQlfrLeDeltaPls "MICROSAR RTE" /begin SUB_GROUP /end SUB_GROUP /begin FUNCTION_LIST /end FUNCTION_LIST /begin REF_CHARACTERISTIC /end REF_CHARACTERISTIC /begin REF_MEASUREMENT GmRoadWhlInQlfr.dGmRoadWhlInQlfrLeDeltaPls /end REF_MEASUREMENT /end GROUP
/begin GROUP GmRoadWhlInQlfr.dGmRoadWhlInQlfrLeDeltaTiStamp "MICROSAR RTE" /begin SUB_GROUP /end SUB_GROUP /begin FUNCTION_LIST /end FUNCTION_LIST /begin REF_CHARACTERISTIC /end REF_CHARACTERISTIC /begin REF_MEASUREMENT GmRoadWhlInQlfr.dGmRoadWhlInQlfrLeDeltaTiStamp /end REF_MEASUREMENT /end GROUP
/begin GROUP GmRoadWhlInQlfr.dGmRoadWhlInQlfrLeWhlFrqVld "MICROSAR RTE" /begin SUB_GROUP /end SUB_GROUP /begin FUNCTION_LIST /end FUNCTION_LIST /begin REF_CHARACTERISTIC /end REF_CHARACTERISTIC /begin REF_MEASUREMENT GmRoadWhlInQlfr.dGmRoadWhlInQlfrLeWhlFrqVld /end REF_MEASUREMENT /end GROUP
/begin GROUP GmRoadWhlInQlfr.dGmRoadWhlInQlfrRawLeWhlFrq "MICROSAR RTE" /begin SUB_GROUP /end SUB_GROUP /begin FUNCTION_LIST /end FUNCTION_LIST /begin REF_CHARACTERISTIC /end REF_CHARACTERISTIC /begin REF_MEASUREMENT GmRoadWhlInQlfr.dGmRoadWhlInQlfrRawLeWhlFrq /end REF_MEASUREMENT /end GROUP
/begin GROUP GmRoadWhlInQlfr.dGmRoadWhlInQlfrRawRiWhlFrq "MICROSAR RTE" /begin SUB_GROUP /end SUB_GROUP /begin FUNCTION_LIST /end FUNCTION_LIST /begin REF_CHARACTERISTIC /end REF_CHARACTERISTIC /begin REF_MEASUREMENT GmRoadWhlInQlfr.dGmRoadWhlInQlfrRawRiWhlFrq /end REF_MEASUREMENT /end GROUP
/begin GROUP GmRoadWhlInQlfr.dGmRoadWhlInQlfrRiDeltaPls "MICROSAR RTE" /begin SUB_GROUP /end SUB_GROUP /begin FUNCTION_LIST /end FUNCTION_LIST /begin REF_CHARACTERISTIC /end REF_CHARACTERISTIC /begin REF_MEASUREMENT GmRoadWhlInQlfr.dGmRoadWhlInQlfrRiDeltaPls /end REF_MEASUREMENT /end GROUP
/begin GROUP GmRoadWhlInQlfr.dGmRoadWhlInQlfrRiDeltaTiStamp "MICROSAR RTE" /begin SUB_GROUP /end SUB_GROUP /begin FUNCTION_LIST /end FUNCTION_LIST /begin REF_CHARACTERISTIC /end REF_CHARACTERISTIC /begin REF_MEASUREMENT GmRoadWhlInQlfr.dGmRoadWhlInQlfrRiDeltaTiStamp /end REF_MEASUREMENT /end GROUP
/begin GROUP GmRoadWhlInQlfr.dGmRoadWhlInQlfrRiWhlFrqVld "MICROSAR RTE" /begin SUB_GROUP /end SUB_GROUP /begin FUNCTION_LIST /end FUNCTION_LIST /begin REF_CHARACTERISTIC /end REF_CHARACTERISTIC /begin REF_MEASUREMENT GmRoadWhlInQlfr.dGmRoadWhlInQlfrRiWhlFrqVld /end REF_MEASUREMENT /end GROUP
/begin GROUP GmStrtStop "MICROSAR RTE"
 /begin SUB_GROUP GmStrtStop.CalibrationPorts GmStrtStop.PerInstanceMemories GmStrtStop.ReceiverPorts GmStrtStop.SenderPorts /end SUB_GROUP
 /begin FUNCTION_LIST /end FUNCTION_LIST
 /begin REF_CHARACTERISTIC /end REF_CHARACTERISTIC
 /begin REF_MEASUREMENT /end REF_MEASUREMENT
/end GROUP
/begin GROUP GmStrtStop.CalibrationPorts "MICROSAR RTE"
 /begin SUB_GROUP GmStrtStop.GmStrtStopEna.Logl GmStrtStop.GmStrtStopFltRateLim.Val GmStrtStop.GmStrtStopMod1EngTranThd.Val GmStrtStop.GmStrtStopMod1Sca.Val GmStrtStop.GmStrtStopMod1ToStopRateLim.Val GmStrtStop.GmStrtStopMod1VehSpdTranThd.Val GmStrtStop.GmStrtStopMod2Sca.Val GmStrtStop.GmStrtStopNormModEngTranThd.Val GmStrtStop.GmStrtStopNormModVehSpdTranThd.Val GmStrtStop.GmStrtStopNormRateLim.Val GmStrtStop.GmStrtStopNormToMod1RateLim.Val GmStrtStop.GmStrtStopStopAndMod2RateLim.Val GmStrtStop.GmStrtStopStopMod1HwTqTranThd.Val GmStrtStop.GmStrtStopStopMod1HwVelTranThd.Val GmStrtStop.GmStrtStopStopMod1Tmr.Val GmStrtStop.GmStrtStopStopMod1VehSpdTranThd.Val GmStrtStop.GmStrtStopStopMod2HwTqTranThd.Val GmStrtStop.GmStrtStopStopMod2HwVelTranThd.Val GmStrtStop.GmStrtStopStopMod2Tmr.Val GmStrtStop.GmStrtStopStopMod2VehSpdTranThd.Val GmStrtStop.GmStrtStopStopModSca.Val /end SUB_GROUP
 /begin FUNCTION_LIST /end FUNCTION_LIST
 /begin REF_CHARACTERISTIC /end REF_CHARACTERISTIC
 /begin REF_MEASUREMENT /end REF_MEASUREMENT
/end GROUP
/begin GROUP GmStrtStop.EngSpd.Val "MICROSAR RTE" /begin SUB_GROUP /end SUB_GROUP /begin FUNCTION_LIST /end FUNCTION_LIST /begin REF_CHARACTERISTIC /end REF_CHARACTERISTIC /begin REF_MEASUREMENT GmStrtStop.EngSpd.Val /end REF_MEASUREMENT /end GROUP
/begin GROUP GmStrtStop.GmStrtStopEna.Logl "MICROSAR RTE" /begin SUB_GROUP /end SUB_GROUP /begin FUNCTION_LIST /end FUNCTION_LIST /begin REF_CHARACTERISTIC GmStrtStop.GmStrtStopEna.Logl /end REF_CHARACTERISTIC /begin REF_MEASUREMENT /end REF_MEASUREMENT /end GROUP
/begin GROUP GmStrtStop.GmStrtStopFltRateLim.Val "MICROSAR RTE" /begin SUB_GROUP /end SUB_GROUP /begin FUNCTION_LIST /end FUNCTION_LIST /begin REF_CHARACTERISTIC GmStrtStop.GmStrtStopFltRateLim.Val /end REF_CHARACTERISTIC /begin REF_MEASUREMENT /end REF_MEASUREMENT /end GROUP
/begin GROUP GmStrtStop.GmStrtStopMod1EngTranThd.Val "MICROSAR RTE" /begin SUB_GROUP /end SUB_GROUP /begin FUNCTION_LIST /end FUNCTION_LIST /begin REF_CHARACTERISTIC GmStrtStop.GmStrtStopMod1EngTranThd.Val /end REF_CHARACTERISTIC /begin REF_MEASUREMENT /end REF_MEASUREMENT /end GROUP
/begin GROUP GmStrtStop.GmStrtStopMod1Sca.Val "MICROSAR RTE" /begin SUB_GROUP /end SUB_GROUP /begin FUNCTION_LIST /end FUNCTION_LIST /begin REF_CHARACTERISTIC GmStrtStop.GmStrtStopMod1Sca.Val /end REF_CHARACTERISTIC /begin REF_MEASUREMENT /end REF_MEASUREMENT /end GROUP
/begin GROUP GmStrtStop.GmStrtStopMod1ToStopRateLim.Val "MICROSAR RTE" /begin SUB_GROUP /end SUB_GROUP /begin FUNCTION_LIST /end FUNCTION_LIST /begin REF_CHARACTERISTIC GmStrtStop.GmStrtStopMod1ToStopRateLim.Val /end REF_CHARACTERISTIC /begin REF_MEASUREMENT /end REF_MEASUREMENT /end GROUP
/begin GROUP GmStrtStop.GmStrtStopMod1VehSpdTranThd.Val "MICROSAR RTE" /begin SUB_GROUP /end SUB_GROUP /begin FUNCTION_LIST /end FUNCTION_LIST /begin REF_CHARACTERISTIC GmStrtStop.GmStrtStopMod1VehSpdTranThd.Val /end REF_CHARACTERISTIC /begin REF_MEASUREMENT /end REF_MEASUREMENT /end GROUP
/begin GROUP GmStrtStop.GmStrtStopMod2Sca.Val "MICROSAR RTE" /begin SUB_GROUP /end SUB_GROUP /begin FUNCTION_LIST /end FUNCTION_LIST /begin REF_CHARACTERISTIC GmStrtStop.GmStrtStopMod2Sca.Val /end REF_CHARACTERISTIC /begin REF_MEASUREMENT /end REF_MEASUREMENT /end GROUP
/begin GROUP GmStrtStop.GmStrtStopNormModEngTranThd.Val "MICROSAR RTE" /begin SUB_GROUP /end SUB_GROUP /begin FUNCTION_LIST /end FUNCTION_LIST /begin REF_CHARACTERISTIC GmStrtStop.GmStrtStopNormModEngTranThd.Val /end REF_CHARACTERISTIC /begin REF_MEASUREMENT /end REF_MEASUREMENT /end GROUP
/begin GROUP GmStrtStop.GmStrtStopNormModVehSpdTranThd.Val "MICROSAR RTE" /begin SUB_GROUP /end SUB_GROUP /begin FUNCTION_LIST /end FUNCTION_LIST /begin REF_CHARACTERISTIC GmStrtStop.GmStrtStopNormModVehSpdTranThd.Val /end REF_CHARACTERISTIC /begin REF_MEASUREMENT /end REF_MEASUREMENT /end GROUP
/begin GROUP GmStrtStop.GmStrtStopNormRateLim.Val "MICROSAR RTE" /begin SUB_GROUP /end SUB_GROUP /begin FUNCTION_LIST /end FUNCTION_LIST /begin REF_CHARACTERISTIC GmStrtStop.GmStrtStopNormRateLim.Val /end REF_CHARACTERISTIC /begin REF_MEASUREMENT /end REF_MEASUREMENT /end GROUP
/begin GROUP GmStrtStop.GmStrtStopNormToMod1RateLim.Val "MICROSAR RTE" /begin SUB_GROUP /end SUB_GROUP /begin FUNCTION_LIST /end FUNCTION_LIST /begin REF_CHARACTERISTIC GmStrtStop.GmStrtStopNormToMod1RateLim.Val /end REF_CHARACTERISTIC /begin REF_MEASUREMENT /end REF_MEASUREMENT /end GROUP
/begin GROUP GmStrtStop.GmStrtStopStopAndMod2RateLim.Val "MICROSAR RTE" /begin SUB_GROUP /end SUB_GROUP /begin FUNCTION_LIST /end FUNCTION_LIST /begin REF_CHARACTERISTIC GmStrtStop.GmStrtStopStopAndMod2RateLim.Val /end REF_CHARACTERISTIC /begin REF_MEASUREMENT /end REF_MEASUREMENT /end GROUP
/begin GROUP GmStrtStop.GmStrtStopStopMod1HwTqTranThd.Val "MICROSAR RTE" /begin SUB_GROUP /end SUB_GROUP /begin FUNCTION_LIST /end FUNCTION_LIST /begin REF_CHARACTERISTIC GmStrtStop.GmStrtStopStopMod1HwTqTranThd.Val /end REF_CHARACTERISTIC /begin REF_MEASUREMENT /end REF_MEASUREMENT /end GROUP
/begin GROUP GmStrtStop.GmStrtStopStopMod1HwVelTranThd.Val "MICROSAR RTE" /begin SUB_GROUP /end SUB_GROUP /begin FUNCTION_LIST /end FUNCTION_LIST /begin REF_CHARACTERISTIC GmStrtStop.GmStrtStopStopMod1HwVelTranThd.Val /end REF_CHARACTERISTIC /begin REF_MEASUREMENT /end REF_MEASUREMENT /end GROUP
/begin GROUP GmStrtStop.GmStrtStopStopMod1Tmr.Val "MICROSAR RTE" /begin SUB_GROUP /end SUB_GROUP /begin FUNCTION_LIST /end FUNCTION_LIST /begin REF_CHARACTERISTIC GmStrtStop.GmStrtStopStopMod1Tmr.Val /end REF_CHARACTERISTIC /begin REF_MEASUREMENT /end REF_MEASUREMENT /end GROUP
/begin GROUP GmStrtStop.GmStrtStopStopMod1VehSpdTranThd.Val "MICROSAR RTE" /begin SUB_GROUP /end SUB_GROUP /begin FUNCTION_LIST /end FUNCTION_LIST /begin REF_CHARACTERISTIC GmStrtStop.GmStrtStopStopMod1VehSpdTranThd.Val /end REF_CHARACTERISTIC /begin REF_MEASUREMENT /end REF_MEASUREMENT /end GROUP
/begin GROUP GmStrtStop.GmStrtStopStopMod2HwTqTranThd.Val "MICROSAR RTE" /begin SUB_GROUP /end SUB_GROUP /begin FUNCTION_LIST /end FUNCTION_LIST /begin REF_CHARACTERISTIC GmStrtStop.GmStrtStopStopMod2HwTqTranThd.Val /end REF_CHARACTERISTIC /begin REF_MEASUREMENT /end REF_MEASUREMENT /end GROUP
/begin GROUP GmStrtStop.GmStrtStopStopMod2HwVelTranThd.Val "MICROSAR RTE" /begin SUB_GROUP /end SUB_GROUP /begin FUNCTION_LIST /end FUNCTION_LIST /begin REF_CHARACTERISTIC GmStrtStop.GmStrtStopStopMod2HwVelTranThd.Val /end REF_CHARACTERISTIC /begin REF_MEASUREMENT /end REF_MEASUREMENT /end GROUP
/begin GROUP GmStrtStop.GmStrtStopStopMod2Tmr.Val "MICROSAR RTE" /begin SUB_GROUP /end SUB_GROUP /begin FUNCTION_LIST /end FUNCTION_LIST /begin REF_CHARACTERISTIC GmStrtStop.GmStrtStopStopMod2Tmr.Val /end REF_CHARACTERISTIC /begin REF_MEASUREMENT /end REF_MEASUREMENT /end GROUP
/begin GROUP GmStrtStop.GmStrtStopStopMod2VehSpdTranThd.Val "MICROSAR RTE" /begin SUB_GROUP /end SUB_GROUP /begin FUNCTION_LIST /end FUNCTION_LIST /begin REF_CHARACTERISTIC GmStrtStop.GmStrtStopStopMod2VehSpdTranThd.Val /end REF_CHARACTERISTIC /begin REF_MEASUREMENT /end REF_MEASUREMENT /end GROUP
/begin GROUP GmStrtStop.GmStrtStopStopModSca.Val "MICROSAR RTE" /begin SUB_GROUP /end SUB_GROUP /begin FUNCTION_LIST /end FUNCTION_LIST /begin REF_CHARACTERISTIC GmStrtStop.GmStrtStopStopModSca.Val /end REF_CHARACTERISTIC /begin REF_MEASUREMENT /end REF_MEASUREMENT /end GROUP
/begin GROUP GmStrtStop.HwTq.Val "MICROSAR RTE" /begin SUB_GROUP /end SUB_GROUP /begin FUNCTION_LIST /end FUNCTION_LIST /begin REF_CHARACTERISTIC /end REF_CHARACTERISTIC /begin REF_MEASUREMENT GmStrtStop.HwTq.Val /end REF_MEASUREMENT /end GROUP
/begin GROUP GmStrtStop.HwVel.Val "MICROSAR RTE" /begin SUB_GROUP /end SUB_GROUP /begin FUNCTION_LIST /end FUNCTION_LIST /begin REF_CHARACTERISTIC /end REF_CHARACTERISTIC /begin REF_MEASUREMENT GmStrtStop.HwVel.Val /end REF_MEASUREMENT /end GROUP
/begin GROUP GmStrtStop.Mod1RefTmr "MICROSAR RTE" /begin SUB_GROUP /end SUB_GROUP /begin FUNCTION_LIST /end FUNCTION_LIST /begin REF_CHARACTERISTIC /end REF_CHARACTERISTIC /begin REF_MEASUREMENT GmStrtStop.Mod1RefTmr /end REF_MEASUREMENT /end GROUP
/begin GROUP GmStrtStop.Mod2RefTmr "MICROSAR RTE" /begin SUB_GROUP /end SUB_GROUP /begin FUNCTION_LIST /end FUNCTION_LIST /begin REF_CHARACTERISTIC /end REF_CHARACTERISTIC /begin REF_MEASUREMENT GmStrtStop.Mod2RefTmr /end REF_MEASUREMENT /end GROUP
/begin GROUP GmStrtStop.Msg0C9BusHiSpdInvld.Logl "MICROSAR RTE" /begin SUB_GROUP /end SUB_GROUP /begin FUNCTION_LIST /end FUNCTION_LIST /begin REF_CHARACTERISTIC /end REF_CHARACTERISTIC /begin REF_MEASUREMENT GmStrtStop.Msg0C9BusHiSpdInvld.Logl /end REF_MEASUREMENT /end GROUP
/begin GROUP GmStrtStop.Msg0C9BusHiSpdMiss.Logl "MICROSAR RTE" /begin SUB_GROUP /end SUB_GROUP /begin FUNCTION_LIST /end FUNCTION_LIST /begin REF_CHARACTERISTIC /end REF_CHARACTERISTIC /begin REF_MEASUREMENT GmStrtStop.Msg0C9BusHiSpdMiss.Logl /end REF_MEASUREMENT /end GROUP
/begin GROUP GmStrtStop.PerInstanceMemories "MICROSAR RTE"
 /begin SUB_GROUP GmStrtStop.Mod1RefTmr GmStrtStop.Mod2RefTmr GmStrtStop.PrevActSt GmStrtStop.PrevStrtStopSt /end SUB_GROUP
 /begin FUNCTION_LIST /end FUNCTION_LIST
 /begin REF_CHARACTERISTIC /end REF_CHARACTERISTIC
 /begin REF_MEASUREMENT /end REF_MEASUREMENT
/end GROUP
/begin GROUP GmStrtStop.PrevActSt "MICROSAR RTE" /begin SUB_GROUP /end SUB_GROUP /begin FUNCTION_LIST /end FUNCTION_LIST /begin REF_CHARACTERISTIC /end REF_CHARACTERISTIC /begin REF_MEASUREMENT GmStrtStop.PrevActSt /end REF_MEASUREMENT /end GROUP
/begin GROUP GmStrtStop.PrevStrtStopSt "MICROSAR RTE" /begin SUB_GROUP /end SUB_GROUP /begin FUNCTION_LIST /end FUNCTION_LIST /begin REF_CHARACTERISTIC /end REF_CHARACTERISTIC /begin REF_MEASUREMENT GmStrtStop.PrevStrtStopSt /end REF_MEASUREMENT /end GROUP
/begin GROUP GmStrtStop.ReceiverPorts "MICROSAR RTE"
 /begin SUB_GROUP GmStrtStop.EngSpd.Val GmStrtStop.HwTq.Val GmStrtStop.HwVel.Val GmStrtStop.Msg0C9BusHiSpdInvld.Logl GmStrtStop.Msg0C9BusHiSpdMiss.Logl GmStrtStop.VehSpd.Val GmStrtStop.VehSpdVld.Logl /end SUB_GROUP
 /begin FUNCTION_LIST /end FUNCTION_LIST
 /begin REF_CHARACTERISTIC /end REF_CHARACTERISTIC
 /begin REF_MEASUREMENT /end REF_MEASUREMENT
/end GROUP
/begin GROUP GmStrtStop.SenderPorts "MICROSAR RTE"
 /begin SUB_GROUP GmStrtStop.VehStrtStopMotTqCmdSca.Val GmStrtStop.VehStrtStopRampRate.Val GmStrtStop.VehStrtStopSt.Val /end SUB_GROUP
 /begin FUNCTION_LIST /end FUNCTION_LIST
 /begin REF_CHARACTERISTIC /end REF_CHARACTERISTIC
 /begin REF_MEASUREMENT /end REF_MEASUREMENT
/end GROUP
/begin GROUP GmStrtStop.VehSpd.Val "MICROSAR RTE" /begin SUB_GROUP /end SUB_GROUP /begin FUNCTION_LIST /end FUNCTION_LIST /begin REF_CHARACTERISTIC /end REF_CHARACTERISTIC /begin REF_MEASUREMENT GmStrtStop.VehSpd.Val /end REF_MEASUREMENT /end GROUP
/begin GROUP GmStrtStop.VehSpdVld.Logl "MICROSAR RTE" /begin SUB_GROUP /end SUB_GROUP /begin FUNCTION_LIST /end FUNCTION_LIST /begin REF_CHARACTERISTIC /end REF_CHARACTERISTIC /begin REF_MEASUREMENT GmStrtStop.VehSpdVld.Logl /end REF_MEASUREMENT /end GROUP
/begin GROUP GmStrtStop.VehStrtStopMotTqCmdSca.Val "MICROSAR RTE" /begin SUB_GROUP /end SUB_GROUP /begin FUNCTION_LIST /end FUNCTION_LIST /begin REF_CHARACTERISTIC /end REF_CHARACTERISTIC /begin REF_MEASUREMENT GmStrtStop.VehStrtStopMotTqCmdSca.Val /end REF_MEASUREMENT /end GROUP
/begin GROUP GmStrtStop.VehStrtStopRampRate.Val "MICROSAR RTE" /begin SUB_GROUP /end SUB_GROUP /begin FUNCTION_LIST /end FUNCTION_LIST /begin REF_CHARACTERISTIC /end REF_CHARACTERISTIC /begin REF_MEASUREMENT GmStrtStop.VehStrtStopRampRate.Val /end REF_MEASUREMENT /end GROUP
/begin GROUP GmStrtStop.VehStrtStopSt.Val "MICROSAR RTE" /begin SUB_GROUP /end SUB_GROUP /begin FUNCTION_LIST /end FUNCTION_LIST /begin REF_CHARACTERISTIC /end REF_CHARACTERISTIC /begin REF_MEASUREMENT GmStrtStop.VehStrtStopSt.Val /end REF_MEASUREMENT /end GROUP
/begin GROUP GmTqArbn "MICROSAR RTE"
 /begin SUB_GROUP GmTqArbn.CalibrationPorts GmTqArbn.PerInstanceMemories GmTqArbn.ReceiverPorts GmTqArbn.SenderPorts /end SUB_GROUP
 /begin FUNCTION_LIST /end FUNCTION_LIST
 /begin REF_CHARACTERISTIC /end REF_CHARACTERISTIC
 /begin REF_MEASUREMENT /end REF_MEASUREMENT
/end GROUP
/begin GROUP GmTqArbn.APASmotngHwTqLpFil "MICROSAR RTE" /begin SUB_GROUP /end SUB_GROUP /begin FUNCTION_LIST /end FUNCTION_LIST /begin REF_CHARACTERISTIC /end REF_CHARACTERISTIC
 /begin REF_MEASUREMENT GmTqArbn.APASmotngHwTqLpFil.FilGain GmTqArbn.APASmotngHwTqLpFil.FilSt /end REF_MEASUREMENT
/end GROUP
/begin GROUP GmTqArbn.ActPosnServoCmd "MICROSAR RTE" /begin SUB_GROUP /end SUB_GROUP /begin FUNCTION_LIST /end FUNCTION_LIST /begin REF_CHARACTERISTIC /end REF_CHARACTERISTIC /begin REF_MEASUREMENT GmTqArbn.ActPosnServoCmd /end REF_MEASUREMENT /end GROUP
/begin GROUP GmTqArbn.AssiCmdBasSca.Val "MICROSAR RTE" /begin SUB_GROUP /end SUB_GROUP /begin FUNCTION_LIST /end FUNCTION_LIST /begin REF_CHARACTERISTIC /end REF_CHARACTERISTIC /begin REF_MEASUREMENT GmTqArbn.AssiCmdBasSca.Val /end REF_MEASUREMENT /end GROUP
/begin GROUP GmTqArbn.CalibrationPorts "MICROSAR RTE"
 /begin SUB_GROUP GmTqArbn.GmTqArbnApaAssiScaEna.Logl GmTqArbn.GmTqArbnApaDampgScaEna.Logl GmTqArbn.GmTqArbnApaDiRateX.Ary1D GmTqArbn.GmTqArbnApaDiRateY.Ary1D GmTqArbn.GmTqArbnApaEnaRate.Val GmTqArbn.GmTqArbnApaRtnScaEna.Logl GmTqArbn.GmTqArbnApaSmotngHwTqLpFilFrq.Val GmTqArbn.GmTqArbnApaSmotngX.Ary1D GmTqArbn.GmTqArbnApaSmotngY.Ary1D GmTqArbn.GmTqArbnEscMaxTq.Val GmTqArbn.GmTqArbnLkaSlewEna.Logl GmTqArbn.GmTqArbnLkaSlewX.Ary1D GmTqArbn.GmTqArbnLkaSlewY.Ary1D /end SUB_GROUP
 /begin FUNCTION_LIST /end FUNCTION_LIST
 /begin REF_CHARACTERISTIC /end REF_CHARACTERISTIC
 /begin REF_MEASUREMENT /end REF_MEASUREMENT
/end GROUP
/begin GROUP GmTqArbn.DampgCmdSca.Val "MICROSAR RTE" /begin SUB_GROUP /end SUB_GROUP /begin FUNCTION_LIST /end FUNCTION_LIST /begin REF_CHARACTERISTIC /end REF_CHARACTERISTIC /begin REF_MEASUREMENT GmTqArbn.DampgCmdSca.Val /end REF_MEASUREMENT /end GROUP
/begin GROUP GmTqArbn.DesLkaTqCmdRateLim "MICROSAR RTE" /begin SUB_GROUP /end SUB_GROUP /begin FUNCTION_LIST /end FUNCTION_LIST /begin REF_CHARACTERISTIC /end REF_CHARACTERISTIC /begin REF_MEASUREMENT GmTqArbn.DesLkaTqCmdRateLim /end REF_MEASUREMENT /end GROUP
/begin GROUP GmTqArbn.EscCmd.Val "MICROSAR RTE" /begin SUB_GROUP /end SUB_GROUP /begin FUNCTION_LIST /end FUNCTION_LIST /begin REF_CHARACTERISTIC /end REF_CHARACTERISTIC /begin REF_MEASUREMENT GmTqArbn.EscCmd.Val /end REF_MEASUREMENT /end GROUP
/begin GROUP GmTqArbn.EscCmdArbd.Val "MICROSAR RTE" /begin SUB_GROUP /end SUB_GROUP /begin FUNCTION_LIST /end FUNCTION_LIST /begin REF_CHARACTERISTIC /end REF_CHARACTERISTIC /begin REF_MEASUREMENT GmTqArbn.EscCmdArbd.Val /end REF_MEASUREMENT /end GROUP
/begin GROUP GmTqArbn.EscLimdActv.Logl "MICROSAR RTE" /begin SUB_GROUP /end SUB_GROUP /begin FUNCTION_LIST /end FUNCTION_LIST /begin REF_CHARACTERISTIC /end REF_CHARACTERISTIC /begin REF_MEASUREMENT GmTqArbn.EscLimdActv.Logl /end REF_MEASUREMENT /end GROUP
/begin GROUP GmTqArbn.EscSt.Val "MICROSAR RTE" /begin SUB_GROUP /end SUB_GROUP /begin FUNCTION_LIST /end FUNCTION_LIST /begin REF_CHARACTERISTIC /end REF_CHARACTERISTIC /begin REF_MEASUREMENT GmTqArbn.EscSt.Val /end REF_MEASUREMENT /end GROUP
/begin GROUP GmTqArbn.GmTqArbnApaAssiScaEna.Logl "MICROSAR RTE" /begin SUB_GROUP /end SUB_GROUP /begin FUNCTION_LIST /end FUNCTION_LIST /begin REF_CHARACTERISTIC GmTqArbn.GmTqArbnApaAssiScaEna.Logl /end REF_CHARACTERISTIC /begin REF_MEASUREMENT /end REF_MEASUREMENT /end GROUP
/begin GROUP GmTqArbn.GmTqArbnApaDampgScaEna.Logl "MICROSAR RTE" /begin SUB_GROUP /end SUB_GROUP /begin FUNCTION_LIST /end FUNCTION_LIST /begin REF_CHARACTERISTIC GmTqArbn.GmTqArbnApaDampgScaEna.Logl /end REF_CHARACTERISTIC /begin REF_MEASUREMENT /end REF_MEASUREMENT /end GROUP
/begin GROUP GmTqArbn.GmTqArbnApaDiRateX.Ary1D "MICROSAR RTE" /begin SUB_GROUP /end SUB_GROUP /begin FUNCTION_LIST /end FUNCTION_LIST /begin REF_CHARACTERISTIC GmTqArbn.GmTqArbnApaDiRateX.Ary1D /end REF_CHARACTERISTIC /begin REF_MEASUREMENT /end REF_MEASUREMENT /end GROUP
/begin GROUP GmTqArbn.GmTqArbnApaDiRateY.Ary1D "MICROSAR RTE" /begin SUB_GROUP /end SUB_GROUP /begin FUNCTION_LIST /end FUNCTION_LIST /begin REF_CHARACTERISTIC GmTqArbn.GmTqArbnApaDiRateY.Ary1D /end REF_CHARACTERISTIC /begin REF_MEASUREMENT /end REF_MEASUREMENT /end GROUP
/begin GROUP GmTqArbn.GmTqArbnApaEnaRate.Val "MICROSAR RTE" /begin SUB_GROUP /end SUB_GROUP /begin FUNCTION_LIST /end FUNCTION_LIST /begin REF_CHARACTERISTIC GmTqArbn.GmTqArbnApaEnaRate.Val /end REF_CHARACTERISTIC /begin REF_MEASUREMENT /end REF_MEASUREMENT /end GROUP
/begin GROUP GmTqArbn.GmTqArbnApaRtnScaEna.Logl "MICROSAR RTE" /begin SUB_GROUP /end SUB_GROUP /begin FUNCTION_LIST /end FUNCTION_LIST /begin REF_CHARACTERISTIC GmTqArbn.GmTqArbnApaRtnScaEna.Logl /end REF_CHARACTERISTIC /begin REF_MEASUREMENT /end REF_MEASUREMENT /end GROUP
/begin GROUP GmTqArbn.GmTqArbnApaSmotngHwTqLpFilFrq.Val "MICROSAR RTE" /begin SUB_GROUP /end SUB_GROUP /begin FUNCTION_LIST /end FUNCTION_LIST /begin REF_CHARACTERISTIC GmTqArbn.GmTqArbnApaSmotngHwTqLpFilFrq.Val /end REF_CHARACTERISTIC /begin REF_MEASUREMENT /end REF_MEASUREMENT /end GROUP
/begin GROUP GmTqArbn.GmTqArbnApaSmotngX.Ary1D "MICROSAR RTE" /begin SUB_GROUP /end SUB_GROUP /begin FUNCTION_LIST /end FUNCTION_LIST /begin REF_CHARACTERISTIC GmTqArbn.GmTqArbnApaSmotngX.Ary1D /end REF_CHARACTERISTIC /begin REF_MEASUREMENT /end REF_MEASUREMENT /end GROUP
/begin GROUP GmTqArbn.GmTqArbnApaSmotngY.Ary1D "MICROSAR RTE" /begin SUB_GROUP /end SUB_GROUP /begin FUNCTION_LIST /end FUNCTION_LIST /begin REF_CHARACTERISTIC GmTqArbn.GmTqArbnApaSmotngY.Ary1D /end REF_CHARACTERISTIC /begin REF_MEASUREMENT /end REF_MEASUREMENT /end GROUP
/begin GROUP GmTqArbn.GmTqArbnEscMaxTq.Val "MICROSAR RTE" /begin SUB_GROUP /end SUB_GROUP /begin FUNCTION_LIST /end FUNCTION_LIST /begin REF_CHARACTERISTIC GmTqArbn.GmTqArbnEscMaxTq.Val /end REF_CHARACTERISTIC /begin REF_MEASUREMENT /end REF_MEASUREMENT /end GROUP
/begin GROUP GmTqArbn.GmTqArbnLkaSlewEna.Logl "MICROSAR RTE" /begin SUB_GROUP /end SUB_GROUP /begin FUNCTION_LIST /end FUNCTION_LIST /begin REF_CHARACTERISTIC GmTqArbn.GmTqArbnLkaSlewEna.Logl /end REF_CHARACTERISTIC /begin REF_MEASUREMENT /end REF_MEASUREMENT /end GROUP
/begin GROUP GmTqArbn.GmTqArbnLkaSlewX.Ary1D "MICROSAR RTE" /begin SUB_GROUP /end SUB_GROUP /begin FUNCTION_LIST /end FUNCTION_LIST /begin REF_CHARACTERISTIC GmTqArbn.GmTqArbnLkaSlewX.Ary1D /end REF_CHARACTERISTIC /begin REF_MEASUREMENT /end REF_MEASUREMENT /end GROUP
/begin GROUP GmTqArbn.GmTqArbnLkaSlewY.Ary1D "MICROSAR RTE" /begin SUB_GROUP /end SUB_GROUP /begin FUNCTION_LIST /end FUNCTION_LIST /begin REF_CHARACTERISTIC GmTqArbn.GmTqArbnLkaSlewY.Ary1D /end REF_CHARACTERISTIC /begin REF_MEASUREMENT /end REF_MEASUREMENT /end GROUP
/begin GROUP GmTqArbn.HwAgServoEna.Logl "MICROSAR RTE" /begin SUB_GROUP /end SUB_GROUP /begin FUNCTION_LIST /end FUNCTION_LIST /begin REF_CHARACTERISTIC /end REF_CHARACTERISTIC /begin REF_MEASUREMENT GmTqArbn.HwAgServoEna.Logl /end REF_MEASUREMENT /end GROUP
/begin GROUP GmTqArbn.HwOscnEna.Logl "MICROSAR RTE" /begin SUB_GROUP /end SUB_GROUP /begin FUNCTION_LIST /end FUNCTION_LIST /begin REF_CHARACTERISTIC /end REF_CHARACTERISTIC /begin REF_MEASUREMENT GmTqArbn.HwOscnEna.Logl /end REF_MEASUREMENT /end GROUP
/begin GROUP GmTqArbn.HwTq.Val "MICROSAR RTE" /begin SUB_GROUP /end SUB_GROUP /begin FUNCTION_LIST /end FUNCTION_LIST /begin REF_CHARACTERISTIC /end REF_CHARACTERISTIC /begin REF_MEASUREMENT GmTqArbn.HwTq.Val /end REF_MEASUREMENT /end GROUP
/begin GROUP GmTqArbn.HwTqOscCmd.Val "MICROSAR RTE" /begin SUB_GROUP /end SUB_GROUP /begin FUNCTION_LIST /end FUNCTION_LIST /begin REF_CHARACTERISTIC /end REF_CHARACTERISTIC /begin REF_MEASUREMENT GmTqArbn.HwTqOscCmd.Val /end REF_MEASUREMENT /end GROUP
/begin GROUP GmTqArbn.HwTqOvrl.Val "MICROSAR RTE" /begin SUB_GROUP /end SUB_GROUP /begin FUNCTION_LIST /end FUNCTION_LIST /begin REF_CHARACTERISTIC /end REF_CHARACTERISTIC /begin REF_MEASUREMENT GmTqArbn.HwTqOvrl.Val /end REF_MEASUREMENT /end GROUP
/begin GROUP GmTqArbn.LkaSt.Val "MICROSAR RTE" /begin SUB_GROUP /end SUB_GROUP /begin FUNCTION_LIST /end FUNCTION_LIST /begin REF_CHARACTERISTIC /end REF_CHARACTERISTIC /begin REF_MEASUREMENT GmTqArbn.LkaSt.Val /end REF_MEASUREMENT /end GROUP
/begin GROUP GmTqArbn.LkaTqCmd.Val "MICROSAR RTE" /begin SUB_GROUP /end SUB_GROUP /begin FUNCTION_LIST /end FUNCTION_LIST /begin REF_CHARACTERISTIC /end REF_CHARACTERISTIC /begin REF_MEASUREMENT GmTqArbn.LkaTqCmd.Val /end REF_MEASUREMENT /end GROUP
/begin GROUP GmTqArbn.LkaTqCmdCdnd.Val "MICROSAR RTE" /begin SUB_GROUP /end SUB_GROUP /begin FUNCTION_LIST /end FUNCTION_LIST /begin REF_CHARACTERISTIC /end REF_CHARACTERISTIC /begin REF_MEASUREMENT GmTqArbn.LkaTqCmdCdnd.Val /end REF_MEASUREMENT /end GROUP
/begin GROUP GmTqArbn.MotTqCmdOvrl.Val "MICROSAR RTE" /begin SUB_GROUP /end SUB_GROUP /begin FUNCTION_LIST /end FUNCTION_LIST /begin REF_CHARACTERISTIC /end REF_CHARACTERISTIC /begin REF_MEASUREMENT GmTqArbn.MotTqCmdOvrl.Val /end REF_MEASUREMENT /end GROUP
/begin GROUP GmTqArbn.MotTqServoCmd.Val "MICROSAR RTE" /begin SUB_GROUP /end SUB_GROUP /begin FUNCTION_LIST /end FUNCTION_LIST /begin REF_CHARACTERISTIC /end REF_CHARACTERISTIC /begin REF_MEASUREMENT GmTqArbn.MotTqServoCmd.Val /end REF_MEASUREMENT /end GROUP
/begin GROUP GmTqArbn.PerInstanceMemories "MICROSAR RTE"
 /begin SUB_GROUP GmTqArbn.APASmotngHwTqLpFil GmTqArbn.ActPosnServoCmd GmTqArbn.DesLkaTqCmdRateLim GmTqArbn.PosnServoSmotngEnaRateLim GmTqArbn.dGmTqArbnDesLkaTqCmd GmTqArbn.dGmTqArbnEscTqCmd GmTqArbn.dGmTqArbnLkaTqCmd GmTqArbn.dGmTqArbnPosnServoSmotngLowrLim /end SUB_GROUP
 /begin FUNCTION_LIST /end FUNCTION_LIST
 /begin REF_CHARACTERISTIC /end REF_CHARACTERISTIC
 /begin REF_MEASUREMENT /end REF_MEASUREMENT
/end GROUP
/begin GROUP GmTqArbn.PosnServoSmotngEnaRateLim "MICROSAR RTE" /begin SUB_GROUP /end SUB_GROUP /begin FUNCTION_LIST /end FUNCTION_LIST /begin REF_CHARACTERISTIC /end REF_CHARACTERISTIC /begin REF_MEASUREMENT GmTqArbn.PosnServoSmotngEnaRateLim /end REF_MEASUREMENT /end GROUP
/begin GROUP GmTqArbn.ReceiverPorts "MICROSAR RTE"
 /begin SUB_GROUP GmTqArbn.EscCmd.Val GmTqArbn.EscSt.Val GmTqArbn.HwAgServoEna.Logl GmTqArbn.HwOscnEna.Logl GmTqArbn.HwTq.Val GmTqArbn.HwTqOscCmd.Val GmTqArbn.LkaSt.Val GmTqArbn.LkaTqCmd.Val GmTqArbn.MotTqServoCmd.Val GmTqArbn.VehSpdMaxSecur.Val /end SUB_GROUP
 /begin FUNCTION_LIST /end FUNCTION_LIST
 /begin REF_CHARACTERISTIC /end REF_CHARACTERISTIC
 /begin REF_MEASUREMENT /end REF_MEASUREMENT
/end GROUP
/begin GROUP GmTqArbn.RtnCmdSca.Val "MICROSAR RTE" /begin SUB_GROUP /end SUB_GROUP /begin FUNCTION_LIST /end FUNCTION_LIST /begin REF_CHARACTERISTIC /end REF_CHARACTERISTIC /begin REF_MEASUREMENT GmTqArbn.RtnCmdSca.Val /end REF_MEASUREMENT /end GROUP
/begin GROUP GmTqArbn.SenderPorts "MICROSAR RTE"
 /begin SUB_GROUP GmTqArbn.AssiCmdBasSca.Val GmTqArbn.DampgCmdSca.Val GmTqArbn.EscCmdArbd.Val GmTqArbn.EscLimdActv.Logl GmTqArbn.HwTqOvrl.Val GmTqArbn.LkaTqCmdCdnd.Val GmTqArbn.MotTqCmdOvrl.Val GmTqArbn.RtnCmdSca.Val /end SUB_GROUP
 /begin FUNCTION_LIST /end FUNCTION_LIST
 /begin REF_CHARACTERISTIC /end REF_CHARACTERISTIC
 /begin REF_MEASUREMENT /end REF_MEASUREMENT
/end GROUP
/begin GROUP GmTqArbn.VehSpdMaxSecur.Val "MICROSAR RTE" /begin SUB_GROUP /end SUB_GROUP /begin FUNCTION_LIST /end FUNCTION_LIST /begin REF_CHARACTERISTIC /end REF_CHARACTERISTIC /begin REF_MEASUREMENT GmTqArbn.VehSpdMaxSecur.Val /end REF_MEASUREMENT /end GROUP
/begin GROUP GmTqArbn.dGmTqArbnDesLkaTqCmd "MICROSAR RTE" /begin SUB_GROUP /end SUB_GROUP /begin FUNCTION_LIST /end FUNCTION_LIST /begin REF_CHARACTERISTIC /end REF_CHARACTERISTIC /begin REF_MEASUREMENT GmTqArbn.dGmTqArbnDesLkaTqCmd /end REF_MEASUREMENT /end GROUP
/begin GROUP GmTqArbn.dGmTqArbnEscTqCmd "MICROSAR RTE" /begin SUB_GROUP /end SUB_GROUP /begin FUNCTION_LIST /end FUNCTION_LIST /begin REF_CHARACTERISTIC /end REF_CHARACTERISTIC /begin REF_MEASUREMENT GmTqArbn.dGmTqArbnEscTqCmd /end REF_MEASUREMENT /end GROUP
/begin GROUP GmTqArbn.dGmTqArbnLkaTqCmd "MICROSAR RTE" /begin SUB_GROUP /end SUB_GROUP /begin FUNCTION_LIST /end FUNCTION_LIST /begin REF_CHARACTERISTIC /end REF_CHARACTERISTIC /begin REF_MEASUREMENT GmTqArbn.dGmTqArbnLkaTqCmd /end REF_MEASUREMENT /end GROUP
/begin GROUP GmTqArbn.dGmTqArbnPosnServoSmotngLowrLim "MICROSAR RTE" /begin SUB_GROUP /end SUB_GROUP /begin FUNCTION_LIST /end FUNCTION_LIST /begin REF_CHARACTERISTIC /end REF_CHARACTERISTIC /begin REF_MEASUREMENT GmTqArbn.dGmTqArbnPosnServoSmotngLowrLim /end REF_MEASUREMENT /end GROUP
/begin GROUP GmVehPwrMod "MICROSAR RTE"
 /begin SUB_GROUP GmVehPwrMod.CalibrationPorts GmVehPwrMod.PerInstanceMemories GmVehPwrMod.ReceiverPorts GmVehPwrMod.SenderPorts /end SUB_GROUP
 /begin FUNCTION_LIST /end FUNCTION_LIST
 /begin REF_CHARACTERISTIC /end REF_CHARACTERISTIC
 /begin REF_MEASUREMENT /end REF_MEASUREMENT
/end GROUP
/begin GROUP GmVehPwrMod.BusOffHiSpd.Logl "MICROSAR RTE" /begin SUB_GROUP /end SUB_GROUP /begin FUNCTION_LIST /end FUNCTION_LIST /begin REF_CHARACTERISTIC /end REF_CHARACTERISTIC /begin REF_MEASUREMENT GmVehPwrMod.BusOffHiSpd.Logl /end REF_MEASUREMENT /end GROUP
/begin GROUP GmVehPwrMod.CalibrationPorts "MICROSAR RTE"
 /begin SUB_GROUP GmVehPwrMod.GmVehPwrModHwTqMinKeepAssi.Val GmVehPwrMod.GmVehPwrModHwTqMinKeepTmr.Val GmVehPwrMod.GmVehPwrModOperRampRate.Val GmVehPwrMod.GmVehPwrModVehSpdAssiOnMin.Val GmVehPwrMod.GmVehPwrModVehSpdMinKeepAssi.Val /end SUB_GROUP
 /begin FUNCTION_LIST /end FUNCTION_LIST
 /begin REF_CHARACTERISTIC /end REF_CHARACTERISTIC
 /begin REF_MEASUREMENT /end REF_MEASUREMENT
/end GROUP
/begin GROUP GmVehPwrMod.EngRunActv.Logl "MICROSAR RTE" /begin SUB_GROUP /end SUB_GROUP /begin FUNCTION_LIST /end FUNCTION_LIST /begin REF_CHARACTERISTIC /end REF_CHARACTERISTIC /begin REF_MEASUREMENT GmVehPwrMod.EngRunActv.Logl /end REF_MEASUREMENT /end GROUP
/begin GROUP GmVehPwrMod.GmVehPwrModHwTqMinKeepAssi.Val "MICROSAR RTE" /begin SUB_GROUP /end SUB_GROUP /begin FUNCTION_LIST /end FUNCTION_LIST /begin REF_CHARACTERISTIC GmVehPwrMod.GmVehPwrModHwTqMinKeepAssi.Val /end REF_CHARACTERISTIC /begin REF_MEASUREMENT /end REF_MEASUREMENT /end GROUP
/begin GROUP GmVehPwrMod.GmVehPwrModHwTqMinKeepTmr.Val "MICROSAR RTE" /begin SUB_GROUP /end SUB_GROUP /begin FUNCTION_LIST /end FUNCTION_LIST /begin REF_CHARACTERISTIC GmVehPwrMod.GmVehPwrModHwTqMinKeepTmr.Val /end REF_CHARACTERISTIC /begin REF_MEASUREMENT /end REF_MEASUREMENT /end GROUP
/begin GROUP GmVehPwrMod.GmVehPwrModOperRampRate.Val "MICROSAR RTE" /begin SUB_GROUP /end SUB_GROUP /begin FUNCTION_LIST /end FUNCTION_LIST /begin REF_CHARACTERISTIC GmVehPwrMod.GmVehPwrModOperRampRate.Val /end REF_CHARACTERISTIC /begin REF_MEASUREMENT /end REF_MEASUREMENT /end GROUP
/begin GROUP GmVehPwrMod.GmVehPwrModVehSpdAssiOnMin.Val "MICROSAR RTE" /begin SUB_GROUP /end SUB_GROUP /begin FUNCTION_LIST /end FUNCTION_LIST /begin REF_CHARACTERISTIC GmVehPwrMod.GmVehPwrModVehSpdAssiOnMin.Val /end REF_CHARACTERISTIC /begin REF_MEASUREMENT /end REF_MEASUREMENT /end GROUP
/begin GROUP GmVehPwrMod.GmVehPwrModVehSpdMinKeepAssi.Val "MICROSAR RTE" /begin SUB_GROUP /end SUB_GROUP /begin FUNCTION_LIST /end FUNCTION_LIST /begin REF_CHARACTERISTIC GmVehPwrMod.GmVehPwrModVehSpdMinKeepAssi.Val /end REF_CHARACTERISTIC /begin REF_MEASUREMENT /end REF_MEASUREMENT /end GROUP
/begin GROUP GmVehPwrMod.HwTq.Val "MICROSAR RTE" /begin SUB_GROUP /end SUB_GROUP /begin FUNCTION_LIST /end FUNCTION_LIST /begin REF_CHARACTERISTIC /end REF_CHARACTERISTIC /begin REF_MEASUREMENT GmVehPwrMod.HwTq.Val /end REF_MEASUREMENT /end GROUP
/begin GROUP GmVehPwrMod.Msg0C9Miss.Logl "MICROSAR RTE" /begin SUB_GROUP /end SUB_GROUP /begin FUNCTION_LIST /end FUNCTION_LIST /begin REF_CHARACTERISTIC /end REF_CHARACTERISTIC /begin REF_MEASUREMENT GmVehPwrMod.Msg0C9Miss.Logl /end REF_MEASUREMENT /end GROUP
/begin GROUP GmVehPwrMod.Msg1F1Miss.Logl "MICROSAR RTE" /begin SUB_GROUP /end SUB_GROUP /begin FUNCTION_LIST /end FUNCTION_LIST /begin REF_CHARACTERISTIC /end REF_CHARACTERISTIC /begin REF_MEASUREMENT GmVehPwrMod.Msg1F1Miss.Logl /end REF_MEASUREMENT /end GROUP
/begin GROUP GmVehPwrMod.PerInstanceMemories "MICROSAR RTE"
 /begin SUB_GROUP GmVehPwrMod.PrevSysStReqEnaVal GmVehPwrMod.TqRefTi GmVehPwrMod.TqRefTiActv GmVehPwrMod.dGmVehPwrModHwTqKeepAssi GmVehPwrMod.dGmVehPwrModVehSpdAssiKeepMin GmVehPwrMod.dGmVehPwrModVehSpdAssiOnMin /end SUB_GROUP
 /begin FUNCTION_LIST /end FUNCTION_LIST
 /begin REF_CHARACTERISTIC /end REF_CHARACTERISTIC
 /begin REF_MEASUREMENT /end REF_MEASUREMENT
/end GROUP
/begin GROUP GmVehPwrMod.PrevSysStReqEnaVal "MICROSAR RTE" /begin SUB_GROUP /end SUB_GROUP /begin FUNCTION_LIST /end FUNCTION_LIST /begin REF_CHARACTERISTIC /end REF_CHARACTERISTIC /begin REF_MEASUREMENT GmVehPwrMod.PrevSysStReqEnaVal /end REF_MEASUREMENT /end GROUP
/begin GROUP GmVehPwrMod.PwrSplyEnaReq.Logl "MICROSAR RTE" /begin SUB_GROUP /end SUB_GROUP /begin FUNCTION_LIST /end FUNCTION_LIST /begin REF_CHARACTERISTIC /end REF_CHARACTERISTIC /begin REF_MEASUREMENT GmVehPwrMod.PwrSplyEnaReq.Logl /end REF_MEASUREMENT /end GROUP
/begin GROUP GmVehPwrMod.ReceiverPorts "MICROSAR RTE"
 /begin SUB_GROUP GmVehPwrMod.BusOffHiSpd.Logl GmVehPwrMod.EngRunActv.Logl GmVehPwrMod.HwTq.Val GmVehPwrMod.Msg0C9Miss.Logl GmVehPwrMod.Msg1F1Miss.Logl GmVehPwrMod.SysPwrModRun.Logl GmVehPwrMod.SysStEnaReqOvrd.Logl GmVehPwrMod.VehSpdArbd.Val GmVehPwrMod.VehSpdSnsrVld.Logl /end SUB_GROUP
 /begin FUNCTION_LIST /end FUNCTION_LIST
 /begin REF_CHARACTERISTIC /end REF_CHARACTERISTIC
 /begin REF_MEASUREMENT /end REF_MEASUREMENT
/end GROUP
/begin GROUP GmVehPwrMod.SenderPorts "MICROSAR RTE"
 /begin SUB_GROUP GmVehPwrMod.PwrSplyEnaReq.Logl GmVehPwrMod.SysOperMotTqCmdSca.Val GmVehPwrMod.SysOperRampRate.Val GmVehPwrMod.SysStReqEna.Logl GmVehPwrMod.VehPwrModDftVehSpdEna.Logl /end SUB_GROUP
 /begin FUNCTION_LIST /end FUNCTION_LIST
 /begin REF_CHARACTERISTIC /end REF_CHARACTERISTIC
 /begin REF_MEASUREMENT /end REF_MEASUREMENT
/end GROUP
/begin GROUP GmVehPwrMod.SysOperMotTqCmdSca.Val "MICROSAR RTE" /begin SUB_GROUP /end SUB_GROUP /begin FUNCTION_LIST /end FUNCTION_LIST /begin REF_CHARACTERISTIC /end REF_CHARACTERISTIC /begin REF_MEASUREMENT GmVehPwrMod.SysOperMotTqCmdSca.Val /end REF_MEASUREMENT /end GROUP
/begin GROUP GmVehPwrMod.SysOperRampRate.Val "MICROSAR RTE" /begin SUB_GROUP /end SUB_GROUP /begin FUNCTION_LIST /end FUNCTION_LIST /begin REF_CHARACTERISTIC /end REF_CHARACTERISTIC /begin REF_MEASUREMENT GmVehPwrMod.SysOperRampRate.Val /end REF_MEASUREMENT /end GROUP
/begin GROUP GmVehPwrMod.SysPwrModRun.Logl "MICROSAR RTE" /begin SUB_GROUP /end SUB_GROUP /begin FUNCTION_LIST /end FUNCTION_LIST /begin REF_CHARACTERISTIC /end REF_CHARACTERISTIC /begin REF_MEASUREMENT GmVehPwrMod.SysPwrModRun.Logl /end REF_MEASUREMENT /end GROUP
/begin GROUP GmVehPwrMod.SysStEnaReqOvrd.Logl "MICROSAR RTE" /begin SUB_GROUP /end SUB_GROUP /begin FUNCTION_LIST /end FUNCTION_LIST /begin REF_CHARACTERISTIC /end REF_CHARACTERISTIC /begin REF_MEASUREMENT GmVehPwrMod.SysStEnaReqOvrd.Logl /end REF_MEASUREMENT /end GROUP
/begin GROUP GmVehPwrMod.SysStReqEna.Logl "MICROSAR RTE" /begin SUB_GROUP /end SUB_GROUP /begin FUNCTION_LIST /end FUNCTION_LIST /begin REF_CHARACTERISTIC /end REF_CHARACTERISTIC /begin REF_MEASUREMENT GmVehPwrMod.SysStReqEna.Logl /end REF_MEASUREMENT /end GROUP
/begin GROUP GmVehPwrMod.TqRefTi "MICROSAR RTE" /begin SUB_GROUP /end SUB_GROUP /begin FUNCTION_LIST /end FUNCTION_LIST /begin REF_CHARACTERISTIC /end REF_CHARACTERISTIC /begin REF_MEASUREMENT GmVehPwrMod.TqRefTi /end REF_MEASUREMENT /end GROUP
/begin GROUP GmVehPwrMod.TqRefTiActv "MICROSAR RTE" /begin SUB_GROUP /end SUB_GROUP /begin FUNCTION_LIST /end FUNCTION_LIST /begin REF_CHARACTERISTIC /end REF_CHARACTERISTIC /begin REF_MEASUREMENT GmVehPwrMod.TqRefTiActv /end REF_MEASUREMENT /end GROUP
/begin GROUP GmVehPwrMod.VehPwrModDftVehSpdEna.Logl "MICROSAR RTE" /begin SUB_GROUP /end SUB_GROUP /begin FUNCTION_LIST /end FUNCTION_LIST /begin REF_CHARACTERISTIC /end REF_CHARACTERISTIC /begin REF_MEASUREMENT GmVehPwrMod.VehPwrModDftVehSpdEna.Logl /end REF_MEASUREMENT /end GROUP
/begin GROUP GmVehPwrMod.VehSpdArbd.Val "MICROSAR RTE" /begin SUB_GROUP /end SUB_GROUP /begin FUNCTION_LIST /end FUNCTION_LIST /begin REF_CHARACTERISTIC /end REF_CHARACTERISTIC /begin REF_MEASUREMENT GmVehPwrMod.VehSpdArbd.Val /end REF_MEASUREMENT /end GROUP
/begin GROUP GmVehPwrMod.VehSpdSnsrVld.Logl "MICROSAR RTE" /begin SUB_GROUP /end SUB_GROUP /begin FUNCTION_LIST /end FUNCTION_LIST /begin REF_CHARACTERISTIC /end REF_CHARACTERISTIC /begin REF_MEASUREMENT GmVehPwrMod.VehSpdSnsrVld.Logl /end REF_MEASUREMENT /end GROUP
/begin GROUP GmVehPwrMod.dGmVehPwrModHwTqKeepAssi "MICROSAR RTE" /begin SUB_GROUP /end SUB_GROUP /begin FUNCTION_LIST /end FUNCTION_LIST /begin REF_CHARACTERISTIC /end REF_CHARACTERISTIC /begin REF_MEASUREMENT GmVehPwrMod.dGmVehPwrModHwTqKeepAssi /end REF_MEASUREMENT /end GROUP
/begin GROUP GmVehPwrMod.dGmVehPwrModVehSpdAssiKeepMin "MICROSAR RTE" /begin SUB_GROUP /end SUB_GROUP /begin FUNCTION_LIST /end FUNCTION_LIST /begin REF_CHARACTERISTIC /end REF_CHARACTERISTIC /begin REF_MEASUREMENT GmVehPwrMod.dGmVehPwrModVehSpdAssiKeepMin /end REF_MEASUREMENT /end GROUP
/begin GROUP GmVehPwrMod.dGmVehPwrModVehSpdAssiOnMin "MICROSAR RTE" /begin SUB_GROUP /end SUB_GROUP /begin FUNCTION_LIST /end FUNCTION_LIST /begin REF_CHARACTERISTIC /end REF_CHARACTERISTIC /begin REF_MEASUREMENT GmVehPwrMod.dGmVehPwrModVehSpdAssiOnMin /end REF_MEASUREMENT /end GROUP
/begin GROUP GmVehSpdArbn "MICROSAR RTE"
 /begin SUB_GROUP GmVehSpdArbn.PerInstanceMemories GmVehSpdArbn.ReceiverPorts GmVehSpdArbn.SenderPorts /end SUB_GROUP
 /begin FUNCTION_LIST /end FUNCTION_LIST
 /begin REF_CHARACTERISTIC /end REF_CHARACTERISTIC
 /begin REF_MEASUREMENT /end REF_MEASUREMENT
/end GROUP
/begin GROUP GmVehSpdArbn.DiagcRefTi "MICROSAR RTE" /begin SUB_GROUP /end SUB_GROUP /begin FUNCTION_LIST /end FUNCTION_LIST /begin REF_CHARACTERISTIC /end REF_CHARACTERISTIC /begin REF_MEASUREMENT GmVehSpdArbn.DiagcRefTi /end REF_MEASUREMENT /end GROUP
/begin GROUP GmVehSpdArbn.PerInstanceMemories "MICROSAR RTE"
 /begin SUB_GROUP GmVehSpdArbn.DiagcRefTi GmVehSpdArbn.dGmVehSpdArbnLeDrvnVld GmVehSpdArbn.dGmVehSpdArbnLeNonDrvnVld GmVehSpdArbn.dGmVehSpdArbnRiDrvnVld GmVehSpdArbn.dGmVehSpdArbnRiNonDrvnVld /end SUB_GROUP
 /begin FUNCTION_LIST /end FUNCTION_LIST
 /begin REF_CHARACTERISTIC /end REF_CHARACTERISTIC
 /begin REF_MEASUREMENT /end REF_MEASUREMENT
/end GROUP
/begin GROUP GmVehSpdArbn.ReceiverPorts "MICROSAR RTE"
 /begin SUB_GROUP GmVehSpdArbn.VehPwrModDftVehSpdEna.Logl GmVehSpdArbn.WhlGndVelLeDrvnBusChassisExp.Val GmVehSpdArbn.WhlGndVelLeDrvnBusHiSpd.Val GmVehSpdArbn.WhlGndVelLeDrvnStuckBusChassisExp.Logl GmVehSpdArbn.WhlGndVelLeDrvnStuckBusHiSpd.Logl GmVehSpdArbn.WhlGndVelLeDrvnVldBusChassisExp.Logl GmVehSpdArbn.WhlGndVelLeDrvnVldBusHiSpd.Logl GmVehSpdArbn.WhlGndVelLeNonDrvnBusChassisExp.Val GmVehSpdArbn.WhlGndVelLeNonDrvnBusHiSpd.Val GmVehSpdArbn.WhlGndVelLeNonDrvnStuckBusChassisExp.Logl GmVehSpdArbn.WhlGndVelLeNonDrvnStuckBusHiSpd.Logl GmVehSpdArbn.WhlGndVelLeNonDrvnVldBusChassisExp.Logl GmVehSpdArbn.WhlGndVelLeNonDrvnVldBusHiSpd.Logl GmVehSpdArbn.WhlGndVelRiDrvnBusChassisExp.Val GmVehSpdArbn.WhlGndVelRiDrvnBusHiSpd.Val GmVehSpdArbn.WhlGndVelRiDrvnStuckBusChassisExp.Logl GmVehSpdArbn.WhlGndVelRiDrvnStuckBusHiSpd.Logl GmVehSpdArbn.WhlGndVelRiDrvnVldBusChassisExp.Logl GmVehSpdArbn.WhlGndVelRiDrvnVldBusHiSpd.Logl GmVehSpdArbn.WhlGndVelRiNonDrvnBusChassisExp.Val GmVehSpdArbn.WhlGndVelRiNonDrvnBusHiSpd.Val GmVehSpdArbn.WhlGndVelRiNonDrvnStuckBusChassisExp.Logl GmVehSpdArbn.WhlGndVelRiNonDrvnStuckBusHiSpd.Logl GmVehSpdArbn.WhlGndVelRiNonDrvnVldBusChassisExp.Logl GmVehSpdArbn.WhlGndVelRiNonDrvnVldBusHiSpd.Logl /end SUB_GROUP
 /begin FUNCTION_LIST /end FUNCTION_LIST
 /begin REF_CHARACTERISTIC /end REF_CHARACTERISTIC
 /begin REF_MEASUREMENT /end REF_MEASUREMENT
/end GROUP
/begin GROUP GmVehSpdArbn.SenderPorts "MICROSAR RTE"
 /begin SUB_GROUP GmVehSpdArbn.VehSpdArbd.Val GmVehSpdArbn.VehSpdArbdVld.Logl GmVehSpdArbn.VehSpdMaxSecur.Val GmVehSpdArbn.VehSpdMaxSecurVld.Logl GmVehSpdArbn.VehSpdMinSecur.Val GmVehSpdArbn.VehSpdMinSecurVld.Logl GmVehSpdArbn.VehSpdSnsrVld.Logl /end SUB_GROUP
 /begin FUNCTION_LIST /end FUNCTION_LIST
 /begin REF_CHARACTERISTIC /end REF_CHARACTERISTIC
 /begin REF_MEASUREMENT /end REF_MEASUREMENT
/end GROUP
/begin GROUP GmVehSpdArbn.VehPwrModDftVehSpdEna.Logl "MICROSAR RTE" /begin SUB_GROUP /end SUB_GROUP /begin FUNCTION_LIST /end FUNCTION_LIST /begin REF_CHARACTERISTIC /end REF_CHARACTERISTIC /begin REF_MEASUREMENT GmVehSpdArbn.VehPwrModDftVehSpdEna.Logl /end REF_MEASUREMENT /end GROUP
/begin GROUP GmVehSpdArbn.VehSpdArbd.Val "MICROSAR RTE" /begin SUB_GROUP /end SUB_GROUP /begin FUNCTION_LIST /end FUNCTION_LIST /begin REF_CHARACTERISTIC /end REF_CHARACTERISTIC /begin REF_MEASUREMENT GmVehSpdArbn.VehSpdArbd.Val /end REF_MEASUREMENT /end GROUP
/begin GROUP GmVehSpdArbn.VehSpdArbdVld.Logl "MICROSAR RTE" /begin SUB_GROUP /end SUB_GROUP /begin FUNCTION_LIST /end FUNCTION_LIST /begin REF_CHARACTERISTIC /end REF_CHARACTERISTIC /begin REF_MEASUREMENT GmVehSpdArbn.VehSpdArbdVld.Logl /end REF_MEASUREMENT /end GROUP
/begin GROUP GmVehSpdArbn.VehSpdMaxSecur.Val "MICROSAR RTE" /begin SUB_GROUP /end SUB_GROUP /begin FUNCTION_LIST /end FUNCTION_LIST /begin REF_CHARACTERISTIC /end REF_CHARACTERISTIC /begin REF_MEASUREMENT GmVehSpdArbn.VehSpdMaxSecur.Val /end REF_MEASUREMENT /end GROUP
/begin GROUP GmVehSpdArbn.VehSpdMaxSecurVld.Logl "MICROSAR RTE" /begin SUB_GROUP /end SUB_GROUP /begin FUNCTION_LIST /end FUNCTION_LIST /begin REF_CHARACTERISTIC /end REF_CHARACTERISTIC /begin REF_MEASUREMENT GmVehSpdArbn.VehSpdMaxSecurVld.Logl /end REF_MEASUREMENT /end GROUP
/begin GROUP GmVehSpdArbn.VehSpdMinSecur.Val "MICROSAR RTE" /begin SUB_GROUP /end SUB_GROUP /begin FUNCTION_LIST /end FUNCTION_LIST /begin REF_CHARACTERISTIC /end REF_CHARACTERISTIC /begin REF_MEASUREMENT GmVehSpdArbn.VehSpdMinSecur.Val /end REF_MEASUREMENT /end GROUP
/begin GROUP GmVehSpdArbn.VehSpdMinSecurVld.Logl "MICROSAR RTE" /begin SUB_GROUP /end SUB_GROUP /begin FUNCTION_LIST /end FUNCTION_LIST /begin REF_CHARACTERISTIC /end REF_CHARACTERISTIC /begin REF_MEASUREMENT GmVehSpdArbn.VehSpdMinSecurVld.Logl /end REF_MEASUREMENT /end GROUP
/begin GROUP GmVehSpdArbn.VehSpdSnsrVld.Logl "MICROSAR RTE" /begin SUB_GROUP /end SUB_GROUP /begin FUNCTION_LIST /end FUNCTION_LIST /begin REF_CHARACTERISTIC /end REF_CHARACTERISTIC /begin REF_MEASUREMENT GmVehSpdArbn.VehSpdSnsrVld.Logl /end REF_MEASUREMENT /end GROUP
/begin GROUP GmVehSpdArbn.WhlGndVelLeDrvnBusChassisExp.Val "MICROSAR RTE" /begin SUB_GROUP /end SUB_GROUP /begin FUNCTION_LIST /end FUNCTION_LIST /begin REF_CHARACTERISTIC /end REF_CHARACTERISTIC /begin REF_MEASUREMENT GmVehSpdArbn.WhlGndVelLeDrvnBusChassisExp.Val /end REF_MEASUREMENT /end GROUP
/begin GROUP GmVehSpdArbn.WhlGndVelLeDrvnBusHiSpd.Val "MICROSAR RTE" /begin SUB_GROUP /end SUB_GROUP /begin FUNCTION_LIST /end FUNCTION_LIST /begin REF_CHARACTERISTIC /end REF_CHARACTERISTIC /begin REF_MEASUREMENT GmVehSpdArbn.WhlGndVelLeDrvnBusHiSpd.Val /end REF_MEASUREMENT /end GROUP
/begin GROUP GmVehSpdArbn.WhlGndVelLeDrvnStuckBusChassisExp.Logl "MICROSAR RTE" /begin SUB_GROUP /end SUB_GROUP /begin FUNCTION_LIST /end FUNCTION_LIST /begin REF_CHARACTERISTIC /end REF_CHARACTERISTIC /begin REF_MEASUREMENT GmVehSpdArbn.WhlGndVelLeDrvnStuckBusChassisExp.Logl /end REF_MEASUREMENT /end GROUP
/begin GROUP GmVehSpdArbn.WhlGndVelLeDrvnStuckBusHiSpd.Logl "MICROSAR RTE" /begin SUB_GROUP /end SUB_GROUP /begin FUNCTION_LIST /end FUNCTION_LIST /begin REF_CHARACTERISTIC /end REF_CHARACTERISTIC /begin REF_MEASUREMENT GmVehSpdArbn.WhlGndVelLeDrvnStuckBusHiSpd.Logl /end REF_MEASUREMENT /end GROUP
/begin GROUP GmVehSpdArbn.WhlGndVelLeDrvnVldBusChassisExp.Logl "MICROSAR RTE" /begin SUB_GROUP /end SUB_GROUP /begin FUNCTION_LIST /end FUNCTION_LIST /begin REF_CHARACTERISTIC /end REF_CHARACTERISTIC /begin REF_MEASUREMENT GmVehSpdArbn.WhlGndVelLeDrvnVldBusChassisExp.Logl /end REF_MEASUREMENT /end GROUP
/begin GROUP GmVehSpdArbn.WhlGndVelLeDrvnVldBusHiSpd.Logl "MICROSAR RTE" /begin SUB_GROUP /end SUB_GROUP /begin FUNCTION_LIST /end FUNCTION_LIST /begin REF_CHARACTERISTIC /end REF_CHARACTERISTIC /begin REF_MEASUREMENT GmVehSpdArbn.WhlGndVelLeDrvnVldBusHiSpd.Logl /end REF_MEASUREMENT /end GROUP
/begin GROUP GmVehSpdArbn.WhlGndVelLeNonDrvnBusChassisExp.Val "MICROSAR RTE" /begin SUB_GROUP /end SUB_GROUP /begin FUNCTION_LIST /end FUNCTION_LIST /begin REF_CHARACTERISTIC /end REF_CHARACTERISTIC /begin REF_MEASUREMENT GmVehSpdArbn.WhlGndVelLeNonDrvnBusChassisExp.Val /end REF_MEASUREMENT /end GROUP
/begin GROUP GmVehSpdArbn.WhlGndVelLeNonDrvnBusHiSpd.Val "MICROSAR RTE" /begin SUB_GROUP /end SUB_GROUP /begin FUNCTION_LIST /end FUNCTION_LIST /begin REF_CHARACTERISTIC /end REF_CHARACTERISTIC /begin REF_MEASUREMENT GmVehSpdArbn.WhlGndVelLeNonDrvnBusHiSpd.Val /end REF_MEASUREMENT /end GROUP
/begin GROUP GmVehSpdArbn.WhlGndVelLeNonDrvnStuckBusChassisExp.Logl "MICROSAR RTE" /begin SUB_GROUP /end SUB_GROUP /begin FUNCTION_LIST /end FUNCTION_LIST /begin REF_CHARACTERISTIC /end REF_CHARACTERISTIC /begin REF_MEASUREMENT GmVehSpdArbn.WhlGndVelLeNonDrvnStuckBusChassisExp.Logl /end REF_MEASUREMENT /end GROUP
/begin GROUP GmVehSpdArbn.WhlGndVelLeNonDrvnStuckBusHiSpd.Logl "MICROSAR RTE" /begin SUB_GROUP /end SUB_GROUP /begin FUNCTION_LIST /end FUNCTION_LIST /begin REF_CHARACTERISTIC /end REF_CHARACTERISTIC /begin REF_MEASUREMENT GmVehSpdArbn.WhlGndVelLeNonDrvnStuckBusHiSpd.Logl /end REF_MEASUREMENT /end GROUP
/begin GROUP GmVehSpdArbn.WhlGndVelLeNonDrvnVldBusChassisExp.Logl "MICROSAR RTE" /begin SUB_GROUP /end SUB_GROUP /begin FUNCTION_LIST /end FUNCTION_LIST /begin REF_CHARACTERISTIC /end REF_CHARACTERISTIC /begin REF_MEASUREMENT GmVehSpdArbn.WhlGndVelLeNonDrvnVldBusChassisExp.Logl /end REF_MEASUREMENT /end GROUP
/begin GROUP GmVehSpdArbn.WhlGndVelLeNonDrvnVldBusHiSpd.Logl "MICROSAR RTE" /begin SUB_GROUP /end SUB_GROUP /begin FUNCTION_LIST /end FUNCTION_LIST /begin REF_CHARACTERISTIC /end REF_CHARACTERISTIC /begin REF_MEASUREMENT GmVehSpdArbn.WhlGndVelLeNonDrvnVldBusHiSpd.Logl /end REF_MEASUREMENT /end GROUP
/begin GROUP GmVehSpdArbn.WhlGndVelRiDrvnBusChassisExp.Val "MICROSAR RTE" /begin SUB_GROUP /end SUB_GROUP /begin FUNCTION_LIST /end FUNCTION_LIST /begin REF_CHARACTERISTIC /end REF_CHARACTERISTIC /begin REF_MEASUREMENT GmVehSpdArbn.WhlGndVelRiDrvnBusChassisExp.Val /end REF_MEASUREMENT /end GROUP
/begin GROUP GmVehSpdArbn.WhlGndVelRiDrvnBusHiSpd.Val "MICROSAR RTE" /begin SUB_GROUP /end SUB_GROUP /begin FUNCTION_LIST /end FUNCTION_LIST /begin REF_CHARACTERISTIC /end REF_CHARACTERISTIC /begin REF_MEASUREMENT GmVehSpdArbn.WhlGndVelRiDrvnBusHiSpd.Val /end REF_MEASUREMENT /end GROUP
/begin GROUP GmVehSpdArbn.WhlGndVelRiDrvnStuckBusChassisExp.Logl "MICROSAR RTE" /begin SUB_GROUP /end SUB_GROUP /begin FUNCTION_LIST /end FUNCTION_LIST /begin REF_CHARACTERISTIC /end REF_CHARACTERISTIC /begin REF_MEASUREMENT GmVehSpdArbn.WhlGndVelRiDrvnStuckBusChassisExp.Logl /end REF_MEASUREMENT /end GROUP
/begin GROUP GmVehSpdArbn.WhlGndVelRiDrvnStuckBusHiSpd.Logl "MICROSAR RTE" /begin SUB_GROUP /end SUB_GROUP /begin FUNCTION_LIST /end FUNCTION_LIST /begin REF_CHARACTERISTIC /end REF_CHARACTERISTIC /begin REF_MEASUREMENT GmVehSpdArbn.WhlGndVelRiDrvnStuckBusHiSpd.Logl /end REF_MEASUREMENT /end GROUP
/begin GROUP GmVehSpdArbn.WhlGndVelRiDrvnVldBusChassisExp.Logl "MICROSAR RTE" /begin SUB_GROUP /end SUB_GROUP /begin FUNCTION_LIST /end FUNCTION_LIST /begin REF_CHARACTERISTIC /end REF_CHARACTERISTIC /begin REF_MEASUREMENT GmVehSpdArbn.WhlGndVelRiDrvnVldBusChassisExp.Logl /end REF_MEASUREMENT /end GROUP
/begin GROUP GmVehSpdArbn.WhlGndVelRiDrvnVldBusHiSpd.Logl "MICROSAR RTE" /begin SUB_GROUP /end SUB_GROUP /begin FUNCTION_LIST /end FUNCTION_LIST /begin REF_CHARACTERISTIC /end REF_CHARACTERISTIC /begin REF_MEASUREMENT GmVehSpdArbn.WhlGndVelRiDrvnVldBusHiSpd.Logl /end REF_MEASUREMENT /end GROUP
/begin GROUP GmVehSpdArbn.WhlGndVelRiNonDrvnBusChassisExp.Val "MICROSAR RTE" /begin SUB_GROUP /end SUB_GROUP /begin FUNCTION_LIST /end FUNCTION_LIST /begin REF_CHARACTERISTIC /end REF_CHARACTERISTIC /begin REF_MEASUREMENT GmVehSpdArbn.WhlGndVelRiNonDrvnBusChassisExp.Val /end REF_MEASUREMENT /end GROUP
/begin GROUP GmVehSpdArbn.WhlGndVelRiNonDrvnBusHiSpd.Val "MICROSAR RTE" /begin SUB_GROUP /end SUB_GROUP /begin FUNCTION_LIST /end FUNCTION_LIST /begin REF_CHARACTERISTIC /end REF_CHARACTERISTIC /begin REF_MEASUREMENT GmVehSpdArbn.WhlGndVelRiNonDrvnBusHiSpd.Val /end REF_MEASUREMENT /end GROUP
/begin GROUP GmVehSpdArbn.WhlGndVelRiNonDrvnStuckBusChassisExp.Logl "MICROSAR RTE" /begin SUB_GROUP /end SUB_GROUP /begin FUNCTION_LIST /end FUNCTION_LIST /begin REF_CHARACTERISTIC /end REF_CHARACTERISTIC /begin REF_MEASUREMENT GmVehSpdArbn.WhlGndVelRiNonDrvnStuckBusChassisExp.Logl /end REF_MEASUREMENT /end GROUP
/begin GROUP GmVehSpdArbn.WhlGndVelRiNonDrvnStuckBusHiSpd.Logl "MICROSAR RTE" /begin SUB_GROUP /end SUB_GROUP /begin FUNCTION_LIST /end FUNCTION_LIST /begin REF_CHARACTERISTIC /end REF_CHARACTERISTIC /begin REF_MEASUREMENT GmVehSpdArbn.WhlGndVelRiNonDrvnStuckBusHiSpd.Logl /end REF_MEASUREMENT /end GROUP
/begin GROUP GmVehSpdArbn.WhlGndVelRiNonDrvnVldBusChassisExp.Logl "MICROSAR RTE" /begin SUB_GROUP /end SUB_GROUP /begin FUNCTION_LIST /end FUNCTION_LIST /begin REF_CHARACTERISTIC /end REF_CHARACTERISTIC /begin REF_MEASUREMENT GmVehSpdArbn.WhlGndVelRiNonDrvnVldBusChassisExp.Logl /end REF_MEASUREMENT /end GROUP
/begin GROUP GmVehSpdArbn.WhlGndVelRiNonDrvnVldBusHiSpd.Logl "MICROSAR RTE" /begin SUB_GROUP /end SUB_GROUP /begin FUNCTION_LIST /end FUNCTION_LIST /begin REF_CHARACTERISTIC /end REF_CHARACTERISTIC /begin REF_MEASUREMENT GmVehSpdArbn.WhlGndVelRiNonDrvnVldBusHiSpd.Logl /end REF_MEASUREMENT /end GROUP
/begin GROUP GmVehSpdArbn.dGmVehSpdArbnLeDrvnVld "MICROSAR RTE" /begin SUB_GROUP /end SUB_GROUP /begin FUNCTION_LIST /end FUNCTION_LIST /begin REF_CHARACTERISTIC /end REF_CHARACTERISTIC /begin REF_MEASUREMENT GmVehSpdArbn.dGmVehSpdArbnLeDrvnVld /end REF_MEASUREMENT /end GROUP
/begin GROUP GmVehSpdArbn.dGmVehSpdArbnLeNonDrvnVld "MICROSAR RTE" /begin SUB_GROUP /end SUB_GROUP /begin FUNCTION_LIST /end FUNCTION_LIST /begin REF_CHARACTERISTIC /end REF_CHARACTERISTIC /begin REF_MEASUREMENT GmVehSpdArbn.dGmVehSpdArbnLeNonDrvnVld /end REF_MEASUREMENT /end GROUP
/begin GROUP GmVehSpdArbn.dGmVehSpdArbnRiDrvnVld "MICROSAR RTE" /begin SUB_GROUP /end SUB_GROUP /begin FUNCTION_LIST /end FUNCTION_LIST /begin REF_CHARACTERISTIC /end REF_CHARACTERISTIC /begin REF_MEASUREMENT GmVehSpdArbn.dGmVehSpdArbnRiDrvnVld /end REF_MEASUREMENT /end GROUP
/begin GROUP GmVehSpdArbn.dGmVehSpdArbnRiNonDrvnVld "MICROSAR RTE" /begin SUB_GROUP /end SUB_GROUP /begin FUNCTION_LIST /end FUNCTION_LIST /begin REF_CHARACTERISTIC /end REF_CHARACTERISTIC /begin REF_MEASUREMENT GmVehSpdArbn.dGmVehSpdArbnRiNonDrvnVld /end REF_MEASUREMENT /end GROUP
/begin GROUP HiLoadStallLimr "MICROSAR RTE"
 /begin SUB_GROUP HiLoadStallLimr.CalibrationPorts HiLoadStallLimr.PerInstanceMemories HiLoadStallLimr.ReceiverPorts HiLoadStallLimr.SenderPorts /end SUB_GROUP
 /begin FUNCTION_LIST /end FUNCTION_LIST
 /begin REF_CHARACTERISTIC /end REF_CHARACTERISTIC
 /begin REF_MEASUREMENT /end REF_MEASUREMENT
/end GROUP
/begin GROUP HiLoadStallLimr.CalibrationPorts "MICROSAR RTE"
 /begin SUB_GROUP HiLoadStallLimr.HiLoadStallLimrMotTqCmdFilFrq.Val HiLoadStallLimr.HiLoadStallLimrMotVelMgnThd.Val HiLoadStallLimr.HiLoadStallLimrStallMotTqCmdLimX.Ary1D HiLoadStallLimr.HiLoadStallLimrStallMotTqCmdLimY.Ary1D HiLoadStallLimr.HiLoadStallLimrStallMotTqLimSlewRate.Val /end SUB_GROUP
 /begin FUNCTION_LIST /end FUNCTION_LIST
 /begin REF_CHARACTERISTIC /end REF_CHARACTERISTIC
 /begin REF_MEASUREMENT /end REF_MEASUREMENT
/end GROUP
/begin GROUP HiLoadStallLimr.HiLoadStallLimrMotTqCmdFilFrq.Val "MICROSAR RTE" /begin SUB_GROUP /end SUB_GROUP /begin FUNCTION_LIST /end FUNCTION_LIST /begin REF_CHARACTERISTIC HiLoadStallLimr.HiLoadStallLimrMotTqCmdFilFrq.Val /end REF_CHARACTERISTIC /begin REF_MEASUREMENT /end REF_MEASUREMENT /end GROUP
/begin GROUP HiLoadStallLimr.HiLoadStallLimrMotVelMgnThd.Val "MICROSAR RTE" /begin SUB_GROUP /end SUB_GROUP /begin FUNCTION_LIST /end FUNCTION_LIST /begin REF_CHARACTERISTIC HiLoadStallLimr.HiLoadStallLimrMotVelMgnThd.Val /end REF_CHARACTERISTIC /begin REF_MEASUREMENT /end REF_MEASUREMENT /end GROUP
/begin GROUP HiLoadStallLimr.HiLoadStallLimrStallMotTqCmdLimX.Ary1D "MICROSAR RTE" /begin SUB_GROUP /end SUB_GROUP /begin FUNCTION_LIST /end FUNCTION_LIST /begin REF_CHARACTERISTIC HiLoadStallLimr.HiLoadStallLimrStallMotTqCmdLimX.Ary1D /end REF_CHARACTERISTIC /begin REF_MEASUREMENT /end REF_MEASUREMENT /end GROUP
/begin GROUP HiLoadStallLimr.HiLoadStallLimrStallMotTqCmdLimY.Ary1D "MICROSAR RTE" /begin SUB_GROUP /end SUB_GROUP /begin FUNCTION_LIST /end FUNCTION_LIST /begin REF_CHARACTERISTIC HiLoadStallLimr.HiLoadStallLimrStallMotTqCmdLimY.Ary1D /end REF_CHARACTERISTIC /begin REF_MEASUREMENT /end REF_MEASUREMENT /end GROUP
/begin GROUP HiLoadStallLimr.HiLoadStallLimrStallMotTqLimSlewRate.Val "MICROSAR RTE" /begin SUB_GROUP /end SUB_GROUP /begin FUNCTION_LIST /end FUNCTION_LIST /begin REF_CHARACTERISTIC HiLoadStallLimr.HiLoadStallLimrStallMotTqLimSlewRate.Val /end REF_CHARACTERISTIC /begin REF_MEASUREMENT /end REF_MEASUREMENT /end GROUP
/begin GROUP HiLoadStallLimr.MotTqCmdLimdPreStall.Val "MICROSAR RTE" /begin SUB_GROUP /end SUB_GROUP /begin FUNCTION_LIST /end FUNCTION_LIST /begin REF_CHARACTERISTIC /end REF_CHARACTERISTIC /begin REF_MEASUREMENT HiLoadStallLimr.MotTqCmdLimdPreStall.Val /end REF_MEASUREMENT /end GROUP
/begin GROUP HiLoadStallLimr.MotVelCrf.Val "MICROSAR RTE" /begin SUB_GROUP /end SUB_GROUP /begin FUNCTION_LIST /end FUNCTION_LIST /begin REF_CHARACTERISTIC /end REF_CHARACTERISTIC /begin REF_MEASUREMENT HiLoadStallLimr.MotVelCrf.Val /end REF_MEASUREMENT /end GROUP
/begin GROUP HiLoadStallLimr.PerInstanceMemories "MICROSAR RTE"
 /begin SUB_GROUP HiLoadStallLimr.StallMotTqCmdFil HiLoadStallLimr.StallMotTqLimPrev HiLoadStallLimr.dHiLoadStallLimrStallMotTqCmd HiLoadStallLimr.dHiLoadStallLimrStallMotTqCmdFild HiLoadStallLimr.dHiLoadStallLimrStallMotTqLim /end SUB_GROUP
 /begin FUNCTION_LIST /end FUNCTION_LIST
 /begin REF_CHARACTERISTIC /end REF_CHARACTERISTIC
 /begin REF_MEASUREMENT /end REF_MEASUREMENT
/end GROUP
/begin GROUP HiLoadStallLimr.ReceiverPorts "MICROSAR RTE"
 /begin SUB_GROUP HiLoadStallLimr.MotTqCmdLimdPreStall.Val HiLoadStallLimr.MotVelCrf.Val HiLoadStallLimr.StallMotTqLimDi.Logl /end SUB_GROUP
 /begin FUNCTION_LIST /end FUNCTION_LIST
 /begin REF_CHARACTERISTIC /end REF_CHARACTERISTIC
 /begin REF_MEASUREMENT /end REF_MEASUREMENT
/end GROUP
/begin GROUP HiLoadStallLimr.SenderPorts "MICROSAR RTE" /begin SUB_GROUP HiLoadStallLimr.StallMotTqLim.Val /end SUB_GROUP /begin FUNCTION_LIST /end FUNCTION_LIST /begin REF_CHARACTERISTIC /end REF_CHARACTERISTIC /begin REF_MEASUREMENT /end REF_MEASUREMENT /end GROUP
/begin GROUP HiLoadStallLimr.StallMotTqCmdFil "MICROSAR RTE" /begin SUB_GROUP /end SUB_GROUP /begin FUNCTION_LIST /end FUNCTION_LIST /begin REF_CHARACTERISTIC /end REF_CHARACTERISTIC
 /begin REF_MEASUREMENT HiLoadStallLimr.StallMotTqCmdFil.FilGain HiLoadStallLimr.StallMotTqCmdFil.FilSt /end REF_MEASUREMENT
/end GROUP
/begin GROUP HiLoadStallLimr.StallMotTqLim.Val "MICROSAR RTE" /begin SUB_GROUP /end SUB_GROUP /begin FUNCTION_LIST /end FUNCTION_LIST /begin REF_CHARACTERISTIC /end REF_CHARACTERISTIC /begin REF_MEASUREMENT HiLoadStallLimr.StallMotTqLim.Val /end REF_MEASUREMENT /end GROUP
/begin GROUP HiLoadStallLimr.StallMotTqLimDi.Logl "MICROSAR RTE" /begin SUB_GROUP /end SUB_GROUP /begin FUNCTION_LIST /end FUNCTION_LIST /begin REF_CHARACTERISTIC /end REF_CHARACTERISTIC /begin REF_MEASUREMENT HiLoadStallLimr.StallMotTqLimDi.Logl /end REF_MEASUREMENT /end GROUP
/begin GROUP HiLoadStallLimr.StallMotTqLimPrev "MICROSAR RTE" /begin SUB_GROUP /end SUB_GROUP /begin FUNCTION_LIST /end FUNCTION_LIST /begin REF_CHARACTERISTIC /end REF_CHARACTERISTIC /begin REF_MEASUREMENT HiLoadStallLimr.StallMotTqLimPrev /end REF_MEASUREMENT /end GROUP
/begin GROUP HiLoadStallLimr.dHiLoadStallLimrStallMotTqCmd "MICROSAR RTE" /begin SUB_GROUP /end SUB_GROUP /begin FUNCTION_LIST /end FUNCTION_LIST /begin REF_CHARACTERISTIC /end REF_CHARACTERISTIC /begin REF_MEASUREMENT HiLoadStallLimr.dHiLoadStallLimrStallMotTqCmd /end REF_MEASUREMENT /end GROUP
/begin GROUP HiLoadStallLimr.dHiLoadStallLimrStallMotTqCmdFild "MICROSAR RTE" /begin SUB_GROUP /end SUB_GROUP /begin FUNCTION_LIST /end FUNCTION_LIST /begin REF_CHARACTERISTIC /end REF_CHARACTERISTIC /begin REF_MEASUREMENT HiLoadStallLimr.dHiLoadStallLimrStallMotTqCmdFild /end REF_MEASUREMENT /end GROUP
/begin GROUP HiLoadStallLimr.dHiLoadStallLimrStallMotTqLim "MICROSAR RTE" /begin SUB_GROUP /end SUB_GROUP /begin FUNCTION_LIST /end FUNCTION_LIST /begin REF_CHARACTERISTIC /end REF_CHARACTERISTIC /begin REF_MEASUREMENT HiLoadStallLimr.dHiLoadStallLimrStallMotTqLim /end REF_MEASUREMENT /end GROUP
/begin GROUP HowDetn "MICROSAR RTE"
 /begin SUB_GROUP HowDetn.CalibrationPorts HowDetn.PerInstanceMemories HowDetn.ReceiverPorts HowDetn.SenderPorts /end SUB_GROUP
 /begin FUNCTION_LIST /end FUNCTION_LIST
 /begin REF_CHARACTERISTIC /end REF_CHARACTERISTIC
 /begin REF_MEASUREMENT /end REF_MEASUREMENT
/end GROUP
/begin GROUP HowDetn.CalibrationPorts "MICROSAR RTE"
 /begin SUB_GROUP HowDetn.HowDetnEstimLpFilFrq.Val HowDetn.HowDetnHiFrqGainY.Ary1D HowDetn.HowDetnHiFrqRateX.Ary2D HowDetn.HowDetnHiFrqRateY.Ary2D HowDetn.HowDetnLoFrqRateX.Ary2D HowDetn.HowDetnLoFrqRateY.Ary2D HowDetn.HowDetnMinVehSpd.Val HowDetn.HowDetnPercOfPrevHowEstim.Val HowDetn.HowDetnSlewRate.Val HowDetn.HowDetnStLpFilFrq.Val HowDetn.HowDetnStThdX.Ary1D HowDetn.HowDetnTqFinalLpFilFrq.Val HowDetn.HowDetnTqHpFilFrq.Val HowDetn.HowDetnTqInitLpFilFrq.Val HowDetn.HowDetnVehSpd.Ary1D /end SUB_GROUP
 /begin FUNCTION_LIST /end FUNCTION_LIST
 /begin REF_CHARACTERISTIC /end REF_CHARACTERISTIC
 /begin REF_MEASUREMENT /end REF_MEASUREMENT
/end GROUP
/begin GROUP HowDetn.EstimLpFil "MICROSAR RTE" /begin SUB_GROUP /end SUB_GROUP /begin FUNCTION_LIST /end FUNCTION_LIST /begin REF_CHARACTERISTIC /end REF_CHARACTERISTIC /begin REF_MEASUREMENT HowDetn.EstimLpFil.FilGain HowDetn.EstimLpFil.FilSt /end REF_MEASUREMENT /end GROUP
/begin GROUP HowDetn.FinalLpFil "MICROSAR RTE" /begin SUB_GROUP /end SUB_GROUP /begin FUNCTION_LIST /end FUNCTION_LIST /begin REF_CHARACTERISTIC /end REF_CHARACTERISTIC /begin REF_MEASUREMENT HowDetn.FinalLpFil.FilGain HowDetn.FinalLpFil.FilSt /end REF_MEASUREMENT /end GROUP
/begin GROUP HowDetn.HowDetnEstimLpFilFrq.Val "MICROSAR RTE" /begin SUB_GROUP /end SUB_GROUP /begin FUNCTION_LIST /end FUNCTION_LIST /begin REF_CHARACTERISTIC HowDetn.HowDetnEstimLpFilFrq.Val /end REF_CHARACTERISTIC /begin REF_MEASUREMENT /end REF_MEASUREMENT /end GROUP
/begin GROUP HowDetn.HowDetnEstimn.Val "MICROSAR RTE" /begin SUB_GROUP /end SUB_GROUP /begin FUNCTION_LIST /end FUNCTION_LIST /begin REF_CHARACTERISTIC /end REF_CHARACTERISTIC /begin REF_MEASUREMENT HowDetn.HowDetnEstimn.Val /end REF_MEASUREMENT /end GROUP
/begin GROUP HowDetn.HowDetnHiFrqGainY.Ary1D "MICROSAR RTE" /begin SUB_GROUP /end SUB_GROUP /begin FUNCTION_LIST /end FUNCTION_LIST /begin REF_CHARACTERISTIC HowDetn.HowDetnHiFrqGainY.Ary1D /end REF_CHARACTERISTIC /begin REF_MEASUREMENT /end REF_MEASUREMENT /end GROUP
/begin GROUP HowDetn.HowDetnHiFrqRateX.Ary2D "MICROSAR RTE" /begin SUB_GROUP /end SUB_GROUP /begin FUNCTION_LIST /end FUNCTION_LIST /begin REF_CHARACTERISTIC HowDetn.HowDetnHiFrqRateX.Ary2D /end REF_CHARACTERISTIC /begin REF_MEASUREMENT /end REF_MEASUREMENT /end GROUP
/begin GROUP HowDetn.HowDetnHiFrqRateY.Ary2D "MICROSAR RTE" /begin SUB_GROUP /end SUB_GROUP /begin FUNCTION_LIST /end FUNCTION_LIST /begin REF_CHARACTERISTIC HowDetn.HowDetnHiFrqRateY.Ary2D /end REF_CHARACTERISTIC /begin REF_MEASUREMENT /end REF_MEASUREMENT /end GROUP
/begin GROUP HowDetn.HowDetnLoFrqRateX.Ary2D "MICROSAR RTE" /begin SUB_GROUP /end SUB_GROUP /begin FUNCTION_LIST /end FUNCTION_LIST /begin REF_CHARACTERISTIC HowDetn.HowDetnLoFrqRateX.Ary2D /end REF_CHARACTERISTIC /begin REF_MEASUREMENT /end REF_MEASUREMENT /end GROUP
/begin GROUP HowDetn.HowDetnLoFrqRateY.Ary2D "MICROSAR RTE" /begin SUB_GROUP /end SUB_GROUP /begin FUNCTION_LIST /end FUNCTION_LIST /begin REF_CHARACTERISTIC HowDetn.HowDetnLoFrqRateY.Ary2D /end REF_CHARACTERISTIC /begin REF_MEASUREMENT /end REF_MEASUREMENT /end GROUP
/begin GROUP HowDetn.HowDetnMinVehSpd.Val "MICROSAR RTE" /begin SUB_GROUP /end SUB_GROUP /begin FUNCTION_LIST /end FUNCTION_LIST /begin REF_CHARACTERISTIC HowDetn.HowDetnMinVehSpd.Val /end REF_CHARACTERISTIC /begin REF_MEASUREMENT /end REF_MEASUREMENT /end GROUP
/begin GROUP HowDetn.HowDetnPercOfPrevHowEstim.Val "MICROSAR RTE" /begin SUB_GROUP /end SUB_GROUP /begin FUNCTION_LIST /end FUNCTION_LIST /begin REF_CHARACTERISTIC HowDetn.HowDetnPercOfPrevHowEstim.Val /end REF_CHARACTERISTIC /begin REF_MEASUREMENT /end REF_MEASUREMENT /end GROUP
/begin GROUP HowDetn.HowDetnSlewRate.Val "MICROSAR RTE" /begin SUB_GROUP /end SUB_GROUP /begin FUNCTION_LIST /end FUNCTION_LIST /begin REF_CHARACTERISTIC HowDetn.HowDetnSlewRate.Val /end REF_CHARACTERISTIC /begin REF_MEASUREMENT /end REF_MEASUREMENT /end GROUP
/begin GROUP HowDetn.HowDetnSt.Val "MICROSAR RTE" /begin SUB_GROUP /end SUB_GROUP /begin FUNCTION_LIST /end FUNCTION_LIST /begin REF_CHARACTERISTIC /end REF_CHARACTERISTIC /begin REF_MEASUREMENT HowDetn.HowDetnSt.Val /end REF_MEASUREMENT /end GROUP
/begin GROUP HowDetn.HowDetnStLpFilFrq.Val "MICROSAR RTE" /begin SUB_GROUP /end SUB_GROUP /begin FUNCTION_LIST /end FUNCTION_LIST /begin REF_CHARACTERISTIC HowDetn.HowDetnStLpFilFrq.Val /end REF_CHARACTERISTIC /begin REF_MEASUREMENT /end REF_MEASUREMENT /end GROUP
/begin GROUP HowDetn.HowDetnStThdX.Ary1D "MICROSAR RTE" /begin SUB_GROUP /end SUB_GROUP /begin FUNCTION_LIST /end FUNCTION_LIST /begin REF_CHARACTERISTIC HowDetn.HowDetnStThdX.Ary1D /end REF_CHARACTERISTIC /begin REF_MEASUREMENT /end REF_MEASUREMENT /end GROUP
/begin GROUP HowDetn.HowDetnTqFinalLpFilFrq.Val "MICROSAR RTE" /begin SUB_GROUP /end SUB_GROUP /begin FUNCTION_LIST /end FUNCTION_LIST /begin REF_CHARACTERISTIC HowDetn.HowDetnTqFinalLpFilFrq.Val /end REF_CHARACTERISTIC /begin REF_MEASUREMENT /end REF_MEASUREMENT /end GROUP
/begin GROUP HowDetn.HowDetnTqHpFilFrq.Val "MICROSAR RTE" /begin SUB_GROUP /end SUB_GROUP /begin FUNCTION_LIST /end FUNCTION_LIST /begin REF_CHARACTERISTIC HowDetn.HowDetnTqHpFilFrq.Val /end REF_CHARACTERISTIC /begin REF_MEASUREMENT /end REF_MEASUREMENT /end GROUP
/begin GROUP HowDetn.HowDetnTqInitLpFilFrq.Val "MICROSAR RTE" /begin SUB_GROUP /end SUB_GROUP /begin FUNCTION_LIST /end FUNCTION_LIST /begin REF_CHARACTERISTIC HowDetn.HowDetnTqInitLpFilFrq.Val /end REF_CHARACTERISTIC /begin REF_MEASUREMENT /end REF_MEASUREMENT /end GROUP
/begin GROUP HowDetn.HowDetnVehSpd.Ary1D "MICROSAR RTE" /begin SUB_GROUP /end SUB_GROUP /begin FUNCTION_LIST /end FUNCTION_LIST /begin REF_CHARACTERISTIC HowDetn.HowDetnVehSpd.Ary1D /end REF_CHARACTERISTIC /begin REF_MEASUREMENT /end REF_MEASUREMENT /end GROUP
/begin GROUP HowDetn.HwTq.Val "MICROSAR RTE" /begin SUB_GROUP /end SUB_GROUP /begin FUNCTION_LIST /end FUNCTION_LIST /begin REF_CHARACTERISTIC /end REF_CHARACTERISTIC /begin REF_MEASUREMENT HowDetn.HwTq.Val /end REF_MEASUREMENT /end GROUP
/begin GROUP HowDetn.IniLpFil1 "MICROSAR RTE" /begin SUB_GROUP /end SUB_GROUP /begin FUNCTION_LIST /end FUNCTION_LIST /begin REF_CHARACTERISTIC /end REF_CHARACTERISTIC /begin REF_MEASUREMENT HowDetn.IniLpFil1.FilGain HowDetn.IniLpFil1.FilSt /end REF_MEASUREMENT /end GROUP
/begin GROUP HowDetn.IniLpFil2 "MICROSAR RTE" /begin SUB_GROUP /end SUB_GROUP /begin FUNCTION_LIST /end FUNCTION_LIST /begin REF_CHARACTERISTIC /end REF_CHARACTERISTIC /begin REF_MEASUREMENT HowDetn.IniLpFil2.FilGain HowDetn.IniLpFil2.FilSt /end REF_MEASUREMENT /end GROUP
/begin GROUP HowDetn.IniLpFil3 "MICROSAR RTE" /begin SUB_GROUP /end SUB_GROUP /begin FUNCTION_LIST /end FUNCTION_LIST /begin REF_CHARACTERISTIC /end REF_CHARACTERISTIC /begin REF_MEASUREMENT HowDetn.IniLpFil3.FilGain HowDetn.IniLpFil3.FilSt /end REF_MEASUREMENT /end GROUP
/begin GROUP HowDetn.PerInstanceMemories "MICROSAR RTE"
 /begin SUB_GROUP HowDetn.EstimLpFil HowDetn.FinalLpFil HowDetn.IniLpFil1 HowDetn.IniLpFil2 HowDetn.IniLpFil3 HowDetn.PrevCalcdHowEstim HowDetn.PrevHowEstim HowDetn.StLpFil HowDetn.TqHpFil HowDetn.dHowDetnAbsHiFrqTq HowDetn.dHowDetnAbsLoFrqTq /end SUB_GROUP
 /begin FUNCTION_LIST /end FUNCTION_LIST
 /begin REF_CHARACTERISTIC /end REF_CHARACTERISTIC
 /begin REF_MEASUREMENT /end REF_MEASUREMENT
/end GROUP
/begin GROUP HowDetn.PrevCalcdHowEstim "MICROSAR RTE" /begin SUB_GROUP /end SUB_GROUP /begin FUNCTION_LIST /end FUNCTION_LIST /begin REF_CHARACTERISTIC /end REF_CHARACTERISTIC /begin REF_MEASUREMENT HowDetn.PrevCalcdHowEstim /end REF_MEASUREMENT /end GROUP
/begin GROUP HowDetn.PrevHowEstim "MICROSAR RTE" /begin SUB_GROUP /end SUB_GROUP /begin FUNCTION_LIST /end FUNCTION_LIST /begin REF_CHARACTERISTIC /end REF_CHARACTERISTIC /begin REF_MEASUREMENT HowDetn.PrevHowEstim /end REF_MEASUREMENT /end GROUP
/begin GROUP HowDetn.ReceiverPorts "MICROSAR RTE" /begin SUB_GROUP HowDetn.HwTq.Val HowDetn.VehSpd.Val /end SUB_GROUP /begin FUNCTION_LIST /end FUNCTION_LIST /begin REF_CHARACTERISTIC /end REF_CHARACTERISTIC /begin REF_MEASUREMENT /end REF_MEASUREMENT /end GROUP
/begin GROUP HowDetn.SenderPorts "MICROSAR RTE" /begin SUB_GROUP HowDetn.HowDetnEstimn.Val HowDetn.HowDetnSt.Val /end SUB_GROUP /begin FUNCTION_LIST /end FUNCTION_LIST /begin REF_CHARACTERISTIC /end REF_CHARACTERISTIC /begin REF_MEASUREMENT /end REF_MEASUREMENT /end GROUP
/begin GROUP HowDetn.StLpFil "MICROSAR RTE" /begin SUB_GROUP /end SUB_GROUP /begin FUNCTION_LIST /end FUNCTION_LIST /begin REF_CHARACTERISTIC /end REF_CHARACTERISTIC /begin REF_MEASUREMENT HowDetn.StLpFil.FilGain HowDetn.StLpFil.FilSt /end REF_MEASUREMENT /end GROUP
/begin GROUP HowDetn.TqHpFil "MICROSAR RTE" /begin SUB_GROUP /end SUB_GROUP /begin FUNCTION_LIST /end FUNCTION_LIST /begin REF_CHARACTERISTIC /end REF_CHARACTERISTIC
 /begin REF_MEASUREMENT HowDetn.TqHpFil.CorrnFac HowDetn.TqHpFil.FilLpRec.FilGain HowDetn.TqHpFil.FilLpRec.FilSt /end REF_MEASUREMENT
/end GROUP
/begin GROUP HowDetn.VehSpd.Val "MICROSAR RTE" /begin SUB_GROUP /end SUB_GROUP /begin FUNCTION_LIST /end FUNCTION_LIST /begin REF_CHARACTERISTIC /end REF_CHARACTERISTIC /begin REF_MEASUREMENT HowDetn.VehSpd.Val /end REF_MEASUREMENT /end GROUP
/begin GROUP HowDetn.dHowDetnAbsHiFrqTq "MICROSAR RTE" /begin SUB_GROUP /end SUB_GROUP /begin FUNCTION_LIST /end FUNCTION_LIST /begin REF_CHARACTERISTIC /end REF_CHARACTERISTIC /begin REF_MEASUREMENT HowDetn.dHowDetnAbsHiFrqTq /end REF_MEASUREMENT /end GROUP
/begin GROUP HowDetn.dHowDetnAbsLoFrqTq "MICROSAR RTE" /begin SUB_GROUP /end SUB_GROUP /begin FUNCTION_LIST /end FUNCTION_LIST /begin REF_CHARACTERISTIC /end REF_CHARACTERISTIC /begin REF_MEASUREMENT HowDetn.dHowDetnAbsLoFrqTq /end REF_MEASUREMENT /end GROUP
/begin GROUP HwAg0Meas "MICROSAR RTE"
 /begin SUB_GROUP HwAg0Meas.CalibrationParameters HwAg0Meas.CalibrationPorts HwAg0Meas.PerInstanceMemories HwAg0Meas.ReceiverPorts HwAg0Meas.SenderPorts /end SUB_GROUP
 /begin FUNCTION_LIST /end FUNCTION_LIST
 /begin REF_CHARACTERISTIC /end REF_CHARACTERISTIC
 /begin REF_MEASUREMENT /end REF_MEASUREMENT
/end GROUP
/begin GROUP HwAg0Meas.CalibrationParameters "MICROSAR RTE" /begin SUB_GROUP HwAg0Meas.HwAg0OffsDft /end SUB_GROUP /begin FUNCTION_LIST /end FUNCTION_LIST /begin REF_CHARACTERISTIC /end REF_CHARACTERISTIC /begin REF_MEASUREMENT /end REF_MEASUREMENT /end GROUP
/begin GROUP HwAg0Meas.CalibrationPorts "MICROSAR RTE"
 /begin SUB_GROUP HwAg0Meas.HwAg0MeasHwAg0IfFltFailStep.Val HwAg0Meas.HwAg0MeasHwAg0IfFltPassStep.Val HwAg0Meas.HwAg0MeasHwAg0Snsr0PrtclFltFailStep.Val HwAg0Meas.HwAg0MeasHwAg0Snsr0PrtclFltPassStep.Val HwAg0Meas.HwAg0MeasHwAg0Snsr1PrtclFltFailStep.Val HwAg0Meas.HwAg0MeasHwAg0Snsr1PrtclFltPassStep.Val HwAg0Meas.HwAg0MeasSnsr0Rev.Ary1D HwAg0Meas.HwAg0MeasSnsr1Rev.Ary1D HwAg0Meas.HwAg0MeasStep.Ary1D HwAg0Meas.HwAg0MeasVrnrErrThd.Val /end SUB_GROUP
 /begin FUNCTION_LIST /end FUNCTION_LIST
 /begin REF_CHARACTERISTIC /end REF_CHARACTERISTIC
 /begin REF_MEASUREMENT /end REF_MEASUREMENT
/end GROUP
/begin GROUP HwAg0Meas.HwAg0.Val "MICROSAR RTE" /begin SUB_GROUP /end SUB_GROUP /begin FUNCTION_LIST /end FUNCTION_LIST /begin REF_CHARACTERISTIC /end REF_CHARACTERISTIC /begin REF_MEASUREMENT HwAg0Meas.HwAg0.Val /end REF_MEASUREMENT /end GROUP
/begin GROUP HwAg0Meas.HwAg0InitStepSeqNrCmpl "MICROSAR RTE" /begin SUB_GROUP /end SUB_GROUP /begin FUNCTION_LIST /end FUNCTION_LIST /begin REF_CHARACTERISTIC /end REF_CHARACTERISTIC /begin REF_MEASUREMENT HwAg0Meas.HwAg0InitStepSeqNrCmpl /end REF_MEASUREMENT /end GROUP
/begin GROUP HwAg0Meas.HwAg0MeasHwAg0IfFltFailStep.Val "MICROSAR RTE" /begin SUB_GROUP /end SUB_GROUP /begin FUNCTION_LIST /end FUNCTION_LIST /begin REF_CHARACTERISTIC HwAg0Meas.HwAg0MeasHwAg0IfFltFailStep.Val /end REF_CHARACTERISTIC /begin REF_MEASUREMENT /end REF_MEASUREMENT /end GROUP
/begin GROUP HwAg0Meas.HwAg0MeasHwAg0IfFltPassStep.Val "MICROSAR RTE" /begin SUB_GROUP /end SUB_GROUP /begin FUNCTION_LIST /end FUNCTION_LIST /begin REF_CHARACTERISTIC HwAg0Meas.HwAg0MeasHwAg0IfFltPassStep.Val /end REF_CHARACTERISTIC /begin REF_MEASUREMENT /end REF_MEASUREMENT /end GROUP
/begin GROUP HwAg0Meas.HwAg0MeasHwAg0Snsr0PrtclFltFailStep.Val "MICROSAR RTE" /begin SUB_GROUP /end SUB_GROUP /begin FUNCTION_LIST /end FUNCTION_LIST /begin REF_CHARACTERISTIC HwAg0Meas.HwAg0MeasHwAg0Snsr0PrtclFltFailStep.Val /end REF_CHARACTERISTIC /begin REF_MEASUREMENT /end REF_MEASUREMENT /end GROUP
/begin GROUP HwAg0Meas.HwAg0MeasHwAg0Snsr0PrtclFltPassStep.Val "MICROSAR RTE" /begin SUB_GROUP /end SUB_GROUP /begin FUNCTION_LIST /end FUNCTION_LIST /begin REF_CHARACTERISTIC HwAg0Meas.HwAg0MeasHwAg0Snsr0PrtclFltPassStep.Val /end REF_CHARACTERISTIC /begin REF_MEASUREMENT /end REF_MEASUREMENT /end GROUP
/begin GROUP HwAg0Meas.HwAg0MeasHwAg0Snsr1PrtclFltFailStep.Val "MICROSAR RTE" /begin SUB_GROUP /end SUB_GROUP /begin FUNCTION_LIST /end FUNCTION_LIST /begin REF_CHARACTERISTIC HwAg0Meas.HwAg0MeasHwAg0Snsr1PrtclFltFailStep.Val /end REF_CHARACTERISTIC /begin REF_MEASUREMENT /end REF_MEASUREMENT /end GROUP
/begin GROUP HwAg0Meas.HwAg0MeasHwAg0Snsr1PrtclFltPassStep.Val "MICROSAR RTE" /begin SUB_GROUP /end SUB_GROUP /begin FUNCTION_LIST /end FUNCTION_LIST /begin REF_CHARACTERISTIC HwAg0Meas.HwAg0MeasHwAg0Snsr1PrtclFltPassStep.Val /end REF_CHARACTERISTIC /begin REF_MEASUREMENT /end REF_MEASUREMENT /end GROUP
/begin GROUP HwAg0Meas.HwAg0MeasSnsr0Rev.Ary1D "MICROSAR RTE" /begin SUB_GROUP /end SUB_GROUP /begin FUNCTION_LIST /end FUNCTION_LIST /begin REF_CHARACTERISTIC HwAg0Meas.HwAg0MeasSnsr0Rev.Ary1D /end REF_CHARACTERISTIC /begin REF_MEASUREMENT /end REF_MEASUREMENT /end GROUP
/begin GROUP HwAg0Meas.HwAg0MeasSnsr1Rev.Ary1D "MICROSAR RTE" /begin SUB_GROUP /end SUB_GROUP /begin FUNCTION_LIST /end FUNCTION_LIST /begin REF_CHARACTERISTIC HwAg0Meas.HwAg0MeasSnsr1Rev.Ary1D /end REF_CHARACTERISTIC /begin REF_MEASUREMENT /end REF_MEASUREMENT /end GROUP
/begin GROUP HwAg0Meas.HwAg0MeasStep.Ary1D "MICROSAR RTE" /begin SUB_GROUP /end SUB_GROUP /begin FUNCTION_LIST /end FUNCTION_LIST /begin REF_CHARACTERISTIC HwAg0Meas.HwAg0MeasStep.Ary1D /end REF_CHARACTERISTIC /begin REF_MEASUREMENT /end REF_MEASUREMENT /end GROUP
/**********************************************************************************************************************
* RECORD_LAYOUT
*********************************************************************************************************************/
/begin RECORD_LAYOUT RTE_RL_UBYTE FNC_VALUES 1 UBYTE ROW_DIR DIRECT /end RECORD_LAYOUT
/begin RECORD_LAYOUT RTE_RL_UWORD FNC_VALUES 1 UWORD ROW_DIR DIRECT /end RECORD_LAYOUT
/begin RECORD_LAYOUT RTE_RL_ULONG FNC_VALUES 1 ULONG ROW_DIR DIRECT /end RECORD_LAYOUT
/begin RECORD_LAYOUT RTE_RL_SWORD FNC_VALUES 1 SWORD ROW_DIR DIRECT /end RECORD_LAYOUT
/begin RECORD_LAYOUT RTE_RL_FLOAT32_IEEE FNC_VALUES 1 FLOAT32_IEEE ROW_DIR DIRECT /end RECORD_LAYOUT
/begin RECORD_LAYOUT RTE_RL_BOOLEAN FNC_VALUES 1 UBYTE ROW_DIR DIRECT /end RECORD_LAYOUT
/**********************************************************************************************************************
* COMPU_METHOD / COMPU_VTAB_RANGE
*********************************************************************************************************************/
/begin COMPU_METHOD RTE_CM_BOOLEAN "" TAB_VERB "%3.1" "" COMPU_TAB_REF RTE_CM_BOOLEAN /end COMPU_METHOD
/begin COMPU_VTAB_RANGE RTE_CM_BOOLEAN "" 2 0 0 "false" 1 255 "true" /end COMPU_VTAB_RANGE
/begin COMPU_METHOD RTE_CM_ENUM_SysSt1 "" TAB_VERB "%.1" "" COMPU_TAB_REF RTE_CM_ENUM_SysSt1 /end COMPU_METHOD
/begin COMPU_VTAB_RANGE RTE_CM_ENUM_SysSt1 "" 4 0 0 "SYSST_DI" 1 1 "SYSST_OFF" 2 2 "SYSST_ENA" 3 3 "SYSST_WRMININ" /end COMPU_VTAB_RANGE
/begin COMPU_METHOD RTE_CM_ENUM_LoaSt1 "" TAB_VERB "%.1" "" COMPU_TAB_REF RTE_CM_ENUM_LoaSt1 /end COMPU_METHOD
/begin COMPU_VTAB_RANGE RTE_CM_ENUM_LoaSt1 "" 6 0 0 "LOAST_NORM" 1 1 "LOAST_LIMD" 2 2 "LOAST_SWBASDMTGTN" 3 3 "LOAST_FADEOUT" 4 4 "LOAST_CTRLDSHTDWNREQD" 5 5 "LOAST_IMDTSHTDWNREQD" /end COMPU_VTAB_RANGE
