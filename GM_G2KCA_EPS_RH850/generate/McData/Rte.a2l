/begin CHARACTERISTIC CalRegn03Rt01GroupA_Dummy.DampgHydCoeff3ScaY.Ary1D "MICROSAR RTE" VAL_BLK 0x0 RTE_RL_UWORD 0 NO_COMPU_METHOD 0 65535 MATRIX_DIM 12 1 1 SYMBOL_LINK "Rte_CalprmRom_CalRegn03Rt01GroupA_DEFAULT_RTE_CALPRM_GROUP.DampgHydCoeff3ScaY_Ary1D" 0 DISPLAY_IDENTIFIER CalRegn03Rt01GroupA_Dummy.CalibrationPorts.DampgHydCoeff3ScaY.Ary1D /end CHARACTERISTIC
/begin CHARACTERISTIC CalRegn03Rt01GroupA_Dummy.DampgHydCoeff4ScaY.Ary1D "MICROSAR RTE" VAL_BLK 0x0 RTE_RL_UWORD 0 NO_COMPU_METHOD 0 65535 MATRIX_DIM 12 1 1 SYMBOL_LINK "Rte_CalprmRom_CalRegn03Rt01GroupA_DEFAULT_RTE_CALPRM_GROUP.DampgHydCoeff4ScaY_Ary1D" 0 DISPLAY_IDENTIFIER CalRegn03Rt01GroupA_Dummy.CalibrationPorts.DampgHydCoeff4ScaY.Ary1D /end CHARACTERISTIC
/begin CHARACTERISTIC CalRegn03Rt01GroupA_Dummy.DampgMotVelX.Ary2D "MICROSAR RTE" VAL_BLK 0x0 RTE_RL_UWORD 0 NO_COMPU_METHOD 0 65535 MATRIX_DIM 13 12 1 SYMBOL_LINK "Rte_CalprmRom_CalRegn03Rt01GroupA_DEFAULT_RTE_CALPRM_GROUP.DampgMotVelX_Ary2D" 0 DISPLAY_IDENTIFIER CalRegn03Rt01GroupA_Dummy.CalibrationPorts.DampgMotVelX.Ary2D /end CHARACTERISTIC
/begin CHARACTERISTIC CalRegn03Rt01GroupA_Dummy.DampgMotVelY.Ary2D "MICROSAR RTE" VAL_BLK 0x0 RTE_RL_UWORD 0 NO_COMPU_METHOD 0 65535 MATRIX_DIM 13 12 1 SYMBOL_LINK "Rte_CalprmRom_CalRegn03Rt01GroupA_DEFAULT_RTE_CALPRM_GROUP.DampgMotVelY_Ary2D" 0 DISPLAY_IDENTIFIER CalRegn03Rt01GroupA_Dummy.CalibrationPorts.DampgMotVelY.Ary2D /end CHARACTERISTIC
/begin CHARACTERISTIC CalRegn03Rt01GroupA_Dummy.HysCmpFricWhlImbRejctnBlndX.Ary1D "MICROSAR RTE" VAL_BLK 0x0 RTE_RL_UWORD 0 NO_COMPU_METHOD 0 65535 MATRIX_DIM 6 1 1 SYMBOL_LINK "Rte_CalprmRom_CalRegn03Rt01GroupA_DEFAULT_RTE_CALPRM_GROUP.HysCmpFricWhlImbRejctnBlndX_Ary1D" 0 DISPLAY_IDENTIFIER CalRegn03Rt01GroupA_Dummy.CalibrationPorts.HysCmpFricWhlImbRejctnBlndX.Ary1D /end CHARACTERISTIC
/begin CHARACTERISTIC CalRegn03Rt01GroupA_Dummy.HysCmpFricWhlImbRejctnBlndY.Ary1D "MICROSAR RTE" VAL_BLK 0x0 RTE_RL_UWORD 0 NO_COMPU_METHOD 0 65535 MATRIX_DIM 6 1 1 SYMBOL_LINK "Rte_CalprmRom_CalRegn03Rt01GroupA_DEFAULT_RTE_CALPRM_GROUP.HysCmpFricWhlImbRejctnBlndY_Ary1D" 0 DISPLAY_IDENTIFIER CalRegn03Rt01GroupA_Dummy.CalibrationPorts.HysCmpFricWhlImbRejctnBlndY.Ary1D /end CHARACTERISTIC
/begin CHARACTERISTIC CalRegn03Rt01GroupA_Dummy.HysCmpFricWhlImbRejctnOffY.Ary1D "MICROSAR RTE" VAL_BLK 0x0 RTE_RL_UWORD 0 NO_COMPU_METHOD 0 65535 MATRIX_DIM 12 1 1 SYMBOL_LINK "Rte_CalprmRom_CalRegn03Rt01GroupA_DEFAULT_RTE_CALPRM_GROUP.HysCmpFricWhlImbRejctnOffY_Ary1D" 0 DISPLAY_IDENTIFIER CalRegn03Rt01GroupA_Dummy.CalibrationPorts.HysCmpFricWhlImbRejctnOffY.Ary1D /end CHARACTERISTIC
/begin CHARACTERISTIC CalRegn03Rt01GroupA_Dummy.HysCmpFricWhlImbRejctnOnY.Ary1D "MICROSAR RTE" VAL_BLK 0x0 RTE_RL_UWORD 0 NO_COMPU_METHOD 0 65535 MATRIX_DIM 12 1 1 SYMBOL_LINK "Rte_CalprmRom_CalRegn03Rt01GroupA_DEFAULT_RTE_CALPRM_GROUP.HysCmpFricWhlImbRejctnOnY_Ary1D" 0 DISPLAY_IDENTIFIER CalRegn03Rt01GroupA_Dummy.CalibrationPorts.HysCmpFricWhlImbRejctnOnY.Ary1D /end CHARACTERISTIC
/begin CHARACTERISTIC CalRegn03Rt01GroupA_Dummy.InertiaCmpVelAssiBasdDampgCoeffX.Ary1D "MICROSAR RTE" VAL_BLK 0x0 RTE_RL_UWORD 0 NO_COMPU_METHOD 0 65535 MATRIX_DIM 10 1 1 SYMBOL_LINK "Rte_CalprmRom_CalRegn03Rt01GroupA_DEFAULT_RTE_CALPRM_GROUP.InertiaCmpVelAssiBasdDampgCoeffX_Ary1D" 0 DISPLAY_IDENTIFIER CalRegn03Rt01GroupA_Dummy.CalibrationPorts.InertiaCmpVelAssiBasdDampgCoeffX.Ary1D /end CHARACTERISTIC
/begin CHARACTERISTIC CalRegn03Rt01GroupA_Dummy.InertiaCmpVelAssiBasdDampgRollgY.Ary1D "MICROSAR RTE" VAL_BLK 0x0 RTE_RL_UWORD 0 NO_COMPU_METHOD 0 65535 MATRIX_DIM 10 1 1 SYMBOL_LINK "Rte_CalprmRom_CalRegn03Rt01GroupA_DEFAULT_RTE_CALPRM_GROUP.InertiaCmpVelAssiBasdDampgRollgY_Ary1D" 0 DISPLAY_IDENTIFIER CalRegn03Rt01GroupA_Dummy.CalibrationPorts.InertiaCmpVelAssiBasdDampgRollgY.Ary1D /end CHARACTERISTIC
/begin CHARACTERISTIC CalRegn03Rt01GroupA_Dummy.InertiaCmpVelAssiBasdDampgStatY.Ary1D "MICROSAR RTE" VAL_BLK 0x0 RTE_RL_UWORD 0 NO_COMPU_METHOD 0 65535 MATRIX_DIM 10 1 1 SYMBOL_LINK "Rte_CalprmRom_CalRegn03Rt01GroupA_DEFAULT_RTE_CALPRM_GROUP.InertiaCmpVelAssiBasdDampgStatY_Ary1D" 0 DISPLAY_IDENTIFIER CalRegn03Rt01GroupA_Dummy.CalibrationPorts.InertiaCmpVelAssiBasdDampgStatY.Ary1D /end CHARACTERISTIC
/begin CHARACTERISTIC CalRegn03Rt01GroupA_Dummy.InertiaCmpVelDampgSpdBlndY.Ary1D "MICROSAR RTE" VAL_BLK 0x0 RTE_RL_UWORD 0 NO_COMPU_METHOD 0 65535 MATRIX_DIM 12 1 1 SYMBOL_LINK "Rte_CalprmRom_CalRegn03Rt01GroupA_DEFAULT_RTE_CALPRM_GROUP.InertiaCmpVelDampgSpdBlndY_Ary1D" 0 DISPLAY_IDENTIFIER CalRegn03Rt01GroupA_Dummy.CalibrationPorts.InertiaCmpVelDampgSpdBlndY.Ary1D /end CHARACTERISTIC
/begin CHARACTERISTIC CalRegn03Rt01GroupA_Dummy.InertiaCmpVelNotchBlndY.Ary1D "MICROSAR RTE" VAL_BLK 0x0 RTE_RL_UWORD 0 NO_COMPU_METHOD 0 65535 MATRIX_DIM 12 1 1 SYMBOL_LINK "Rte_CalprmRom_CalRegn03Rt01GroupA_DEFAULT_RTE_CALPRM_GROUP.InertiaCmpVelNotchBlndY_Ary1D" 0 DISPLAY_IDENTIFIER CalRegn03Rt01GroupA_Dummy.CalibrationPorts.InertiaCmpVelNotchBlndY.Ary1D /end CHARACTERISTIC
/begin CHARACTERISTIC CalRegn03Rt01GroupA_Dummy.RtnHwAgOffsCalcdX.Ary2D "MICROSAR RTE" VAL_BLK 0x0 RTE_RL_UWORD 0 NO_COMPU_METHOD 0 65535 MATRIX_DIM 16 9 1 SYMBOL_LINK "Rte_CalprmRom_CalRegn03Rt01GroupA_DEFAULT_RTE_CALPRM_GROUP.RtnHwAgOffsCalcdX_Ary2D" 0 DISPLAY_IDENTIFIER CalRegn03Rt01GroupA_Dummy.CalibrationPorts.RtnHwAgOffsCalcdX.Ary2D /end CHARACTERISTIC
/begin CHARACTERISTIC CalRegn03Rt01GroupA_Dummy.RtnHwAgOffsCalcdY.Ary2D "MICROSAR RTE" VAL_BLK 0x0 RTE_RL_UWORD 0 NO_COMPU_METHOD 0 65535 MATRIX_DIM 16 9 1 SYMBOL_LINK "Rte_CalprmRom_CalRegn03Rt01GroupA_DEFAULT_RTE_CALPRM_GROUP.RtnHwAgOffsCalcdY_Ary2D" 0 DISPLAY_IDENTIFIER CalRegn03Rt01GroupA_Dummy.CalibrationPorts.RtnHwAgOffsCalcdY.Ary2D /end CHARACTERISTIC
/begin CHARACTERISTIC CalRegn03Rt01GroupA_Dummy.RtnScaTqX.Ary2D "MICROSAR RTE" VAL_BLK 0x0 RTE_RL_UWORD 0 NO_COMPU_METHOD 0 65535 MATRIX_DIM 8 9 1 SYMBOL_LINK "Rte_CalprmRom_CalRegn03Rt01GroupA_DEFAULT_RTE_CALPRM_GROUP.RtnScaTqX_Ary2D" 0 DISPLAY_IDENTIFIER CalRegn03Rt01GroupA_Dummy.CalibrationPorts.RtnScaTqX.Ary2D /end CHARACTERISTIC
/begin CHARACTERISTIC CalRegn03Rt01GroupA_Dummy.RtnScaTqY.Ary2D "MICROSAR RTE" VAL_BLK 0x0 RTE_RL_UWORD 0 NO_COMPU_METHOD 0 65535 MATRIX_DIM 8 9 1 SYMBOL_LINK "Rte_CalprmRom_CalRegn03Rt01GroupA_DEFAULT_RTE_CALPRM_GROUP.RtnScaTqY_Ary2D" 0 DISPLAY_IDENTIFIER CalRegn03Rt01GroupA_Dummy.CalibrationPorts.RtnScaTqY.Ary2D /end CHARACTERISTIC
/begin CHARACTERISTIC CalRegn03Rt01GroupA_Dummy.RtnScaVelX.Ary2D "MICROSAR RTE" VAL_BLK 0x0 RTE_RL_UWORD 0 NO_COMPU_METHOD 0 65535 MATRIX_DIM 4 9 1 SYMBOL_LINK "Rte_CalprmRom_CalRegn03Rt01GroupA_DEFAULT_RTE_CALPRM_GROUP.RtnScaVelX_Ary2D" 0 DISPLAY_IDENTIFIER CalRegn03Rt01GroupA_Dummy.CalibrationPorts.RtnScaVelX.Ary2D /end CHARACTERISTIC
/begin CHARACTERISTIC CalRegn03Rt01GroupA_Dummy.RtnScaVelY.Ary2D "MICROSAR RTE" VAL_BLK 0x0 RTE_RL_UWORD 0 NO_COMPU_METHOD 0 65535 MATRIX_DIM 4 9 1 SYMBOL_LINK "Rte_CalprmRom_CalRegn03Rt01GroupA_DEFAULT_RTE_CALPRM_GROUP.RtnScaVelY_Ary2D" 0 DISPLAY_IDENTIFIER CalRegn03Rt01GroupA_Dummy.CalibrationPorts.RtnScaVelY.Ary2D /end CHARACTERISTIC
/begin CHARACTERISTIC CalRegn03Rt01GroupA_Dummy_1.AssiHiFrqGainY.Ary2D "MICROSAR RTE" VAL_BLK 0x0 RTE_RL_UWORD 0 NO_COMPU_METHOD 0 65535 MATRIX_DIM 13 12 1 SYMBOL_LINK "Rte_CalprmRom_CalRegn03Rt02GroupA_DEFAULT_RTE_CALPRM_GROUP.AssiHiFrqGainY_Ary2D" 0 DISPLAY_IDENTIFIER CalRegn03Rt01GroupA_Dummy_1.CalibrationPorts.AssiHiFrqGainY.Ary2D /end CHARACTERISTIC
/begin CHARACTERISTIC CalRegn03Rt01GroupA_Dummy_1.AssiHiFrqTqX.Ary2D "MICROSAR RTE" VAL_BLK 0x0 RTE_RL_UWORD 0 NO_COMPU_METHOD 0 65535 MATRIX_DIM 13 12 1 SYMBOL_LINK "Rte_CalprmRom_CalRegn03Rt02GroupA_DEFAULT_RTE_CALPRM_GROUP.AssiHiFrqTqX_Ary2D" 0 DISPLAY_IDENTIFIER CalRegn03Rt01GroupA_Dummy_1.CalibrationPorts.AssiHiFrqTqX.Ary2D /end CHARACTERISTIC
/begin CHARACTERISTIC CalRegn03Rt01GroupA_Dummy_1.AssiMotTqWhlImbRejctnMinX.Ary2D "MICROSAR RTE" VAL_BLK 0x0 RTE_RL_UWORD 0 NO_COMPU_METHOD 0 65535 MATRIX_DIM 20 12 1 SYMBOL_LINK "Rte_CalprmRom_CalRegn03Rt02GroupA_DEFAULT_RTE_CALPRM_GROUP.AssiMotTqWhlImbRejctnMinX_Ary2D" 0 DISPLAY_IDENTIFIER CalRegn03Rt01GroupA_Dummy_1.CalibrationPorts.AssiMotTqWhlImbRejctnMinX.Ary2D /end CHARACTERISTIC
/begin CHARACTERISTIC CalRegn03Rt01GroupA_Dummy_1.AssiMotTqWhlImbRejctnMinY.Ary2D "MICROSAR RTE" VAL_BLK 0x0 RTE_RL_SWORD 0 NO_COMPU_METHOD -32768 32767 MATRIX_DIM 20 12 1 SYMBOL_LINK "Rte_CalprmRom_CalRegn03Rt02GroupA_DEFAULT_RTE_CALPRM_GROUP.AssiMotTqWhlImbRejctnMinY_Ary2D" 0 DISPLAY_IDENTIFIER CalRegn03Rt01GroupA_Dummy_1.CalibrationPorts.AssiMotTqWhlImbRejctnMinY.Ary2D /end CHARACTERISTIC
/begin CHARACTERISTIC CalRegn03Rt01GroupA_Dummy_1.DampgHydCoeff1ScaY.Ary1D "MICROSAR RTE" VAL_BLK 0x0 RTE_RL_UWORD 0 NO_COMPU_METHOD 0 65535 MATRIX_DIM 12 1 1 SYMBOL_LINK "Rte_CalprmRom_CalRegn03Rt02GroupA_DEFAULT_RTE_CALPRM_GROUP.DampgHydCoeff1ScaY_Ary1D" 0 DISPLAY_IDENTIFIER CalRegn03Rt01GroupA_Dummy_1.CalibrationPorts.DampgHydCoeff1ScaY.Ary1D /end CHARACTERISTIC
/begin CHARACTERISTIC CalRegn03Rt01GroupA_Dummy_1.DampgHydCoeff2ScaY.Ary1D "MICROSAR RTE" VAL_BLK 0x0 RTE_RL_UWORD 0 NO_COMPU_METHOD 0 65535 MATRIX_DIM 12 1 1 SYMBOL_LINK "Rte_CalprmRom_CalRegn03Rt02GroupA_DEFAULT_RTE_CALPRM_GROUP.DampgHydCoeff2ScaY_Ary1D" 0 DISPLAY_IDENTIFIER CalRegn03Rt01GroupA_Dummy_1.CalibrationPorts.DampgHydCoeff2ScaY.Ary1D /end CHARACTERISTIC
/begin CHARACTERISTIC CalRegn03Rt01GroupA_Dummy_1.DampgHydCoeff3ScaY.Ary1D "MICROSAR RTE" VAL_BLK 0x0 RTE_RL_UWORD 0 NO_COMPU_METHOD 0 65535 MATRIX_DIM 12 1 1 SYMBOL_LINK "Rte_CalprmRom_CalRegn03Rt02GroupA_DEFAULT_RTE_CALPRM_GROUP.DampgHydCoeff3ScaY_Ary1D" 0 DISPLAY_IDENTIFIER CalRegn03Rt01GroupA_Dummy_1.CalibrationPorts.DampgHydCoeff3ScaY.Ary1D /end CHARACTERISTIC
/begin CHARACTERISTIC CalRegn03Rt01GroupA_Dummy_1.DampgHydCoeff4ScaY.Ary1D "MICROSAR RTE" VAL_BLK 0x0 RTE_RL_UWORD 0 NO_COMPU_METHOD 0 65535 MATRIX_DIM 12 1 1 SYMBOL_LINK "Rte_CalprmRom_CalRegn03Rt02GroupA_DEFAULT_RTE_CALPRM_GROUP.DampgHydCoeff4ScaY_Ary1D" 0 DISPLAY_IDENTIFIER CalRegn03Rt01GroupA_Dummy_1.CalibrationPorts.DampgHydCoeff4ScaY.Ary1D /end CHARACTERISTIC
/begin CHARACTERISTIC CalRegn03Rt01GroupA_Dummy_1.DampgMotVelX.Ary2D "MICROSAR RTE" VAL_BLK 0x0 RTE_RL_UWORD 0 NO_COMPU_METHOD 0 65535 MATRIX_DIM 13 12 1 SYMBOL_LINK "Rte_CalprmRom_CalRegn03Rt02GroupA_DEFAULT_RTE_CALPRM_GROUP.DampgMotVelX_Ary2D" 0 DISPLAY_IDENTIFIER CalRegn03Rt01GroupA_Dummy_1.CalibrationPorts.DampgMotVelX.Ary2D /end CHARACTERISTIC
/begin CHARACTERISTIC CalRegn03Rt01GroupA_Dummy_1.DampgMotVelY.Ary2D "MICROSAR RTE" VAL_BLK 0x0 RTE_RL_UWORD 0 NO_COMPU_METHOD 0 65535 MATRIX_DIM 13 12 1 SYMBOL_LINK "Rte_CalprmRom_CalRegn03Rt02GroupA_DEFAULT_RTE_CALPRM_GROUP.DampgMotVelY_Ary2D" 0 DISPLAY_IDENTIFIER CalRegn03Rt01GroupA_Dummy_1.CalibrationPorts.DampgMotVelY.Ary2D /end CHARACTERISTIC
/begin CHARACTERISTIC CalRegn03Rt01GroupA_Dummy_1.HysCmpFricWhlImbRejctnBlndX.Ary1D "MICROSAR RTE" VAL_BLK 0x0 RTE_RL_UWORD 0 NO_COMPU_METHOD 0 65535 MATRIX_DIM 6 1 1 SYMBOL_LINK "Rte_CalprmRom_CalRegn03Rt02GroupA_DEFAULT_RTE_CALPRM_GROUP.HysCmpFricWhlImbRejctnBlndX_Ary1D" 0 DISPLAY_IDENTIFIER CalRegn03Rt01GroupA_Dummy_1.CalibrationPorts.HysCmpFricWhlImbRejctnBlndX.Ary1D /end CHARACTERISTIC
/begin CHARACTERISTIC CalRegn03Rt01GroupA_Dummy_1.HysCmpFricWhlImbRejctnBlndY.Ary1D "MICROSAR RTE" VAL_BLK 0x0 RTE_RL_UWORD 0 NO_COMPU_METHOD 0 65535 MATRIX_DIM 6 1 1 SYMBOL_LINK "Rte_CalprmRom_CalRegn03Rt02GroupA_DEFAULT_RTE_CALPRM_GROUP.HysCmpFricWhlImbRejctnBlndY_Ary1D" 0 DISPLAY_IDENTIFIER CalRegn03Rt01GroupA_Dummy_1.CalibrationPorts.HysCmpFricWhlImbRejctnBlndY.Ary1D /end CHARACTERISTIC
/begin CHARACTERISTIC CalRegn03Rt01GroupA_Dummy_1.HysCmpFricWhlImbRejctnOffY.Ary1D "MICROSAR RTE" VAL_BLK 0x0 RTE_RL_UWORD 0 NO_COMPU_METHOD 0 65535 MATRIX_DIM 12 1 1 SYMBOL_LINK "Rte_CalprmRom_CalRegn03Rt02GroupA_DEFAULT_RTE_CALPRM_GROUP.HysCmpFricWhlImbRejctnOffY_Ary1D" 0 DISPLAY_IDENTIFIER CalRegn03Rt01GroupA_Dummy_1.CalibrationPorts.HysCmpFricWhlImbRejctnOffY.Ary1D /end CHARACTERISTIC
/begin CHARACTERISTIC CalRegn03Rt01GroupA_Dummy_1.HysCmpFricWhlImbRejctnOnY.Ary1D "MICROSAR RTE" VAL_BLK 0x0 RTE_RL_UWORD 0 NO_COMPU_METHOD 0 65535 MATRIX_DIM 12 1 1 SYMBOL_LINK "Rte_CalprmRom_CalRegn03Rt02GroupA_DEFAULT_RTE_CALPRM_GROUP.HysCmpFricWhlImbRejctnOnY_Ary1D" 0 DISPLAY_IDENTIFIER CalRegn03Rt01GroupA_Dummy_1.CalibrationPorts.HysCmpFricWhlImbRejctnOnY.Ary1D /end CHARACTERISTIC
/begin CHARACTERISTIC CalRegn03Rt01GroupA_Dummy_1.InertiaCmpVelAssiBasdDampgCoeffX.Ary1D "MICROSAR RTE" VAL_BLK 0x0 RTE_RL_UWORD 0 NO_COMPU_METHOD 0 65535 MATRIX_DIM 10 1 1 SYMBOL_LINK "Rte_CalprmRom_CalRegn03Rt02GroupA_DEFAULT_RTE_CALPRM_GROUP.InertiaCmpVelAssiBasdDampgCoeffX_Ary1D" 0 DISPLAY_IDENTIFIER CalRegn03Rt01GroupA_Dummy_1.CalibrationPorts.InertiaCmpVelAssiBasdDampgCoeffX.Ary1D /end CHARACTERISTIC
/begin CHARACTERISTIC CalRegn03Rt01GroupA_Dummy_1.InertiaCmpVelAssiBasdDampgRollgY.Ary1D "MICROSAR RTE" VAL_BLK 0x0 RTE_RL_UWORD 0 NO_COMPU_METHOD 0 65535 MATRIX_DIM 10 1 1 SYMBOL_LINK "Rte_CalprmRom_CalRegn03Rt02GroupA_DEFAULT_RTE_CALPRM_GROUP.InertiaCmpVelAssiBasdDampgRollgY_Ary1D" 0 DISPLAY_IDENTIFIER CalRegn03Rt01GroupA_Dummy_1.CalibrationPorts.InertiaCmpVelAssiBasdDampgRollgY.Ary1D /end CHARACTERISTIC
/begin CHARACTERISTIC CalRegn03Rt01GroupA_Dummy_1.InertiaCmpVelAssiBasdDampgStatY.Ary1D "MICROSAR RTE" VAL_BLK 0x0 RTE_RL_UWORD 0 NO_COMPU_METHOD 0 65535 MATRIX_DIM 10 1 1 SYMBOL_LINK "Rte_CalprmRom_CalRegn03Rt02GroupA_DEFAULT_RTE_CALPRM_GROUP.InertiaCmpVelAssiBasdDampgStatY_Ary1D" 0 DISPLAY_IDENTIFIER CalRegn03Rt01GroupA_Dummy_1.CalibrationPorts.InertiaCmpVelAssiBasdDampgStatY.Ary1D /end CHARACTERISTIC
/begin CHARACTERISTIC CalRegn03Rt01GroupA_Dummy_1.InertiaCmpVelDampgSpdBlndY.Ary1D "MICROSAR RTE" VAL_BLK 0x0 RTE_RL_UWORD 0 NO_COMPU_METHOD 0 65535 MATRIX_DIM 12 1 1 SYMBOL_LINK "Rte_CalprmRom_CalRegn03Rt02GroupA_DEFAULT_RTE_CALPRM_GROUP.InertiaCmpVelDampgSpdBlndY_Ary1D" 0 DISPLAY_IDENTIFIER CalRegn03Rt01GroupA_Dummy_1.CalibrationPorts.InertiaCmpVelDampgSpdBlndY.Ary1D /end CHARACTERISTIC
/begin CHARACTERISTIC CalRegn03Rt01GroupA_Dummy_1.InertiaCmpVelNotchBlndY.Ary1D "MICROSAR RTE" VAL_BLK 0x0 RTE_RL_UWORD 0 NO_COMPU_METHOD 0 65535 MATRIX_DIM 12 1 1 SYMBOL_LINK "Rte_CalprmRom_CalRegn03Rt02GroupA_DEFAULT_RTE_CALPRM_GROUP.InertiaCmpVelNotchBlndY_Ary1D" 0 DISPLAY_IDENTIFIER CalRegn03Rt01GroupA_Dummy_1.CalibrationPorts.InertiaCmpVelNotchBlndY.Ary1D /end CHARACTERISTIC
/begin CHARACTERISTIC CalRegn03Rt01GroupA_Dummy_1.RtnHwAgOffsCalcdX.Ary2D "MICROSAR RTE" VAL_BLK 0x0 RTE_RL_UWORD 0 NO_COMPU_METHOD 0 65535 MATRIX_DIM 16 9 1 SYMBOL_LINK "Rte_CalprmRom_CalRegn03Rt02GroupA_DEFAULT_RTE_CALPRM_GROUP.RtnHwAgOffsCalcdX_Ary2D" 0 DISPLAY_IDENTIFIER CalRegn03Rt01GroupA_Dummy_1.CalibrationPorts.RtnHwAgOffsCalcdX.Ary2D /end CHARACTERISTIC
/begin CHARACTERISTIC CalRegn03Rt01GroupA_Dummy_1.RtnHwAgOffsCalcdY.Ary2D "MICROSAR RTE" VAL_BLK 0x0 RTE_RL_UWORD 0 NO_COMPU_METHOD 0 65535 MATRIX_DIM 16 9 1 SYMBOL_LINK "Rte_CalprmRom_CalRegn03Rt02GroupA_DEFAULT_RTE_CALPRM_GROUP.RtnHwAgOffsCalcdY_Ary2D" 0 DISPLAY_IDENTIFIER CalRegn03Rt01GroupA_Dummy_1.CalibrationPorts.RtnHwAgOffsCalcdY.Ary2D /end CHARACTERISTIC
/begin CHARACTERISTIC CalRegn03Rt01GroupA_Dummy_1.RtnScaTqX.Ary2D "MICROSAR RTE" VAL_BLK 0x0 RTE_RL_UWORD 0 NO_COMPU_METHOD 0 65535 MATRIX_DIM 8 9 1 SYMBOL_LINK "Rte_CalprmRom_CalRegn03Rt02GroupA_DEFAULT_RTE_CALPRM_GROUP.RtnScaTqX_Ary2D" 0 DISPLAY_IDENTIFIER CalRegn03Rt01GroupA_Dummy_1.CalibrationPorts.RtnScaTqX.Ary2D /end CHARACTERISTIC
/begin CHARACTERISTIC CalRegn03Rt01GroupA_Dummy_1.RtnScaTqY.Ary2D "MICROSAR RTE" VAL_BLK 0x0 RTE_RL_UWORD 0 NO_COMPU_METHOD 0 65535 MATRIX_DIM 8 9 1 SYMBOL_LINK "Rte_CalprmRom_CalRegn03Rt02GroupA_DEFAULT_RTE_CALPRM_GROUP.RtnScaTqY_Ary2D" 0 DISPLAY_IDENTIFIER CalRegn03Rt01GroupA_Dummy_1.CalibrationPorts.RtnScaTqY.Ary2D /end CHARACTERISTIC
/begin CHARACTERISTIC CalRegn03Rt01GroupA_Dummy_1.RtnScaVelX.Ary2D "MICROSAR RTE" VAL_BLK 0x0 RTE_RL_UWORD 0 NO_COMPU_METHOD 0 65535 MATRIX_DIM 4 9 1 SYMBOL_LINK "Rte_CalprmRom_CalRegn03Rt02GroupA_DEFAULT_RTE_CALPRM_GROUP.RtnScaVelX_Ary2D" 0 DISPLAY_IDENTIFIER CalRegn03Rt01GroupA_Dummy_1.CalibrationPorts.RtnScaVelX.Ary2D /end CHARACTERISTIC
/begin CHARACTERISTIC CalRegn03Rt01GroupA_Dummy_1.RtnScaVelY.Ary2D "MICROSAR RTE" VAL_BLK 0x0 RTE_RL_UWORD 0 NO_COMPU_METHOD 0 65535 MATRIX_DIM 4 9 1 SYMBOL_LINK "Rte_CalprmRom_CalRegn03Rt02GroupA_DEFAULT_RTE_CALPRM_GROUP.RtnScaVelY_Ary2D" 0 DISPLAY_IDENTIFIER CalRegn03Rt01GroupA_Dummy_1.CalibrationPorts.RtnScaVelY.Ary2D /end CHARACTERISTIC
/begin CHARACTERISTIC CalRegn03Rt01GroupA_Dummy_2.AssiHiFrqGainY.Ary2D "MICROSAR RTE" VAL_BLK 0x0 RTE_RL_UWORD 0 NO_COMPU_METHOD 0 65535 MATRIX_DIM 13 12 1 SYMBOL_LINK "Rte_CalprmRom_CalRegn03Rt03GroupA_DEFAULT_RTE_CALPRM_GROUP.AssiHiFrqGainY_Ary2D" 0 DISPLAY_IDENTIFIER CalRegn03Rt01GroupA_Dummy_2.CalibrationPorts.AssiHiFrqGainY.Ary2D /end CHARACTERISTIC
/begin CHARACTERISTIC CalRegn03Rt01GroupA_Dummy_2.AssiHiFrqTqX.Ary2D "MICROSAR RTE" VAL_BLK 0x0 RTE_RL_UWORD 0 NO_COMPU_METHOD 0 65535 MATRIX_DIM 13 12 1 SYMBOL_LINK "Rte_CalprmRom_CalRegn03Rt03GroupA_DEFAULT_RTE_CALPRM_GROUP.AssiHiFrqTqX_Ary2D" 0 DISPLAY_IDENTIFIER CalRegn03Rt01GroupA_Dummy_2.CalibrationPorts.AssiHiFrqTqX.Ary2D /end CHARACTERISTIC
/begin CHARACTERISTIC CalRegn03Rt01GroupA_Dummy_2.AssiMotTqWhlImbRejctnMinX.Ary2D "MICROSAR RTE" VAL_BLK 0x0 RTE_RL_UWORD 0 NO_COMPU_METHOD 0 65535 MATRIX_DIM 20 12 1 SYMBOL_LINK "Rte_CalprmRom_CalRegn03Rt03GroupA_DEFAULT_RTE_CALPRM_GROUP.AssiMotTqWhlImbRejctnMinX_Ary2D" 0 DISPLAY_IDENTIFIER CalRegn03Rt01GroupA_Dummy_2.CalibrationPorts.AssiMotTqWhlImbRejctnMinX.Ary2D /end CHARACTERISTIC
/begin CHARACTERISTIC CalRegn03Rt01GroupA_Dummy_2.AssiMotTqWhlImbRejctnMinY.Ary2D "MICROSAR RTE" VAL_BLK 0x0 RTE_RL_SWORD 0 NO_COMPU_METHOD -32768 32767 MATRIX_DIM 20 12 1 SYMBOL_LINK "Rte_CalprmRom_CalRegn03Rt03GroupA_DEFAULT_RTE_CALPRM_GROUP.AssiMotTqWhlImbRejctnMinY_Ary2D" 0 DISPLAY_IDENTIFIER CalRegn03Rt01GroupA_Dummy_2.CalibrationPorts.AssiMotTqWhlImbRejctnMinY.Ary2D /end CHARACTERISTIC
/begin CHARACTERISTIC CalRegn03Rt01GroupA_Dummy_2.DampgHydCoeff1ScaY.Ary1D "MICROSAR RTE" VAL_BLK 0x0 RTE_RL_UWORD 0 NO_COMPU_METHOD 0 65535 MATRIX_DIM 12 1 1 SYMBOL_LINK "Rte_CalprmRom_CalRegn03Rt03GroupA_DEFAULT_RTE_CALPRM_GROUP.DampgHydCoeff1ScaY_Ary1D" 0 DISPLAY_IDENTIFIER CalRegn03Rt01GroupA_Dummy_2.CalibrationPorts.DampgHydCoeff1ScaY.Ary1D /end CHARACTERISTIC
/begin CHARACTERISTIC CalRegn03Rt01GroupA_Dummy_2.DampgHydCoeff2ScaY.Ary1D "MICROSAR RTE" VAL_BLK 0x0 RTE_RL_UWORD 0 NO_COMPU_METHOD 0 65535 MATRIX_DIM 12 1 1 SYMBOL_LINK "Rte_CalprmRom_CalRegn03Rt03GroupA_DEFAULT_RTE_CALPRM_GROUP.DampgHydCoeff2ScaY_Ary1D" 0 DISPLAY_IDENTIFIER CalRegn03Rt01GroupA_Dummy_2.CalibrationPorts.DampgHydCoeff2ScaY.Ary1D /end CHARACTERISTIC
/begin CHARACTERISTIC CalRegn03Rt01GroupA_Dummy_2.DampgHydCoeff3ScaY.Ary1D "MICROSAR RTE" VAL_BLK 0x0 RTE_RL_UWORD 0 NO_COMPU_METHOD 0 65535 MATRIX_DIM 12 1 1 SYMBOL_LINK "Rte_CalprmRom_CalRegn03Rt03GroupA_DEFAULT_RTE_CALPRM_GROUP.DampgHydCoeff3ScaY_Ary1D" 0 DISPLAY_IDENTIFIER CalRegn03Rt01GroupA_Dummy_2.CalibrationPorts.DampgHydCoeff3ScaY.Ary1D /end CHARACTERISTIC
/begin CHARACTERISTIC CalRegn03Rt01GroupA_Dummy_2.DampgHydCoeff4ScaY.Ary1D "MICROSAR RTE" VAL_BLK 0x0 RTE_RL_UWORD 0 NO_COMPU_METHOD 0 65535 MATRIX_DIM 12 1 1 SYMBOL_LINK "Rte_CalprmRom_CalRegn03Rt03GroupA_DEFAULT_RTE_CALPRM_GROUP.DampgHydCoeff4ScaY_Ary1D" 0 DISPLAY_IDENTIFIER CalRegn03Rt01GroupA_Dummy_2.CalibrationPorts.DampgHydCoeff4ScaY.Ary1D /end CHARACTERISTIC
/begin CHARACTERISTIC CalRegn03Rt01GroupA_Dummy_2.DampgMotVelX.Ary2D "MICROSAR RTE" VAL_BLK 0x0 RTE_RL_UWORD 0 NO_COMPU_METHOD 0 65535 MATRIX_DIM 13 12 1 SYMBOL_LINK "Rte_CalprmRom_CalRegn03Rt03GroupA_DEFAULT_RTE_CALPRM_GROUP.DampgMotVelX_Ary2D" 0 DISPLAY_IDENTIFIER CalRegn03Rt01GroupA_Dummy_2.CalibrationPorts.DampgMotVelX.Ary2D /end CHARACTERISTIC
/begin CHARACTERISTIC CalRegn03Rt01GroupA_Dummy_2.DampgMotVelY.Ary2D "MICROSAR RTE" VAL_BLK 0x0 RTE_RL_UWORD 0 NO_COMPU_METHOD 0 65535 MATRIX_DIM 13 12 1 SYMBOL_LINK "Rte_CalprmRom_CalRegn03Rt03GroupA_DEFAULT_RTE_CALPRM_GROUP.DampgMotVelY_Ary2D" 0 DISPLAY_IDENTIFIER CalRegn03Rt01GroupA_Dummy_2.CalibrationPorts.DampgMotVelY.Ary2D /end CHARACTERISTIC
/begin CHARACTERISTIC CalRegn03Rt01GroupA_Dummy_2.HysCmpFricWhlImbRejctnBlndX.Ary1D "MICROSAR RTE" VAL_BLK 0x0 RTE_RL_UWORD 0 NO_COMPU_METHOD 0 65535 MATRIX_DIM 6 1 1 SYMBOL_LINK "Rte_CalprmRom_CalRegn03Rt03GroupA_DEFAULT_RTE_CALPRM_GROUP.HysCmpFricWhlImbRejctnBlndX_Ary1D" 0 DISPLAY_IDENTIFIER CalRegn03Rt01GroupA_Dummy_2.CalibrationPorts.HysCmpFricWhlImbRejctnBlndX.Ary1D /end CHARACTERISTIC
/begin CHARACTERISTIC CalRegn03Rt01GroupA_Dummy_2.HysCmpFricWhlImbRejctnBlndY.Ary1D "MICROSAR RTE" VAL_BLK 0x0 RTE_RL_UWORD 0 NO_COMPU_METHOD 0 65535 MATRIX_DIM 6 1 1 SYMBOL_LINK "Rte_CalprmRom_CalRegn03Rt03GroupA_DEFAULT_RTE_CALPRM_GROUP.HysCmpFricWhlImbRejctnBlndY_Ary1D" 0 DISPLAY_IDENTIFIER CalRegn03Rt01GroupA_Dummy_2.CalibrationPorts.HysCmpFricWhlImbRejctnBlndY.Ary1D /end CHARACTERISTIC
/begin CHARACTERISTIC CalRegn03Rt01GroupA_Dummy_2.HysCmpFricWhlImbRejctnOffY.Ary1D "MICROSAR RTE" VAL_BLK 0x0 RTE_RL_UWORD 0 NO_COMPU_METHOD 0 65535 MATRIX_DIM 12 1 1 SYMBOL_LINK "Rte_CalprmRom_CalRegn03Rt03GroupA_DEFAULT_RTE_CALPRM_GROUP.HysCmpFricWhlImbRejctnOffY_Ary1D" 0 DISPLAY_IDENTIFIER CalRegn03Rt01GroupA_Dummy_2.CalibrationPorts.HysCmpFricWhlImbRejctnOffY.Ary1D /end CHARACTERISTIC
/begin CHARACTERISTIC CalRegn03Rt01GroupA_Dummy_2.HysCmpFricWhlImbRejctnOnY.Ary1D "MICROSAR RTE" VAL_BLK 0x0 RTE_RL_UWORD 0 NO_COMPU_METHOD 0 65535 MATRIX_DIM 12 1 1 SYMBOL_LINK "Rte_CalprmRom_CalRegn03Rt03GroupA_DEFAULT_RTE_CALPRM_GROUP.HysCmpFricWhlImbRejctnOnY_Ary1D" 0 DISPLAY_IDENTIFIER CalRegn03Rt01GroupA_Dummy_2.CalibrationPorts.HysCmpFricWhlImbRejctnOnY.Ary1D /end CHARACTERISTIC
/begin CHARACTERISTIC CalRegn03Rt01GroupA_Dummy_2.InertiaCmpVelAssiBasdDampgCoeffX.Ary1D "MICROSAR RTE" VAL_BLK 0x0 RTE_RL_UWORD 0 NO_COMPU_METHOD 0 65535 MATRIX_DIM 10 1 1 SYMBOL_LINK "Rte_CalprmRom_CalRegn03Rt03GroupA_DEFAULT_RTE_CALPRM_GROUP.InertiaCmpVelAssiBasdDampgCoeffX_Ary1D" 0 DISPLAY_IDENTIFIER CalRegn03Rt01GroupA_Dummy_2.CalibrationPorts.InertiaCmpVelAssiBasdDampgCoeffX.Ary1D /end CHARACTERISTIC
/begin CHARACTERISTIC CalRegn03Rt01GroupA_Dummy_2.InertiaCmpVelAssiBasdDampgRollgY.Ary1D "MICROSAR RTE" VAL_BLK 0x0 RTE_RL_UWORD 0 NO_COMPU_METHOD 0 65535 MATRIX_DIM 10 1 1 SYMBOL_LINK "Rte_CalprmRom_CalRegn03Rt03GroupA_DEFAULT_RTE_CALPRM_GROUP.InertiaCmpVelAssiBasdDampgRollgY_Ary1D" 0 DISPLAY_IDENTIFIER CalRegn03Rt01GroupA_Dummy_2.CalibrationPorts.InertiaCmpVelAssiBasdDampgRollgY.Ary1D /end CHARACTERISTIC
/begin CHARACTERISTIC CalRegn03Rt01GroupA_Dummy_2.InertiaCmpVelAssiBasdDampgStatY.Ary1D "MICROSAR RTE" VAL_BLK 0x0 RTE_RL_UWORD 0 NO_COMPU_METHOD 0 65535 MATRIX_DIM 10 1 1 SYMBOL_LINK "Rte_CalprmRom_CalRegn03Rt03GroupA_DEFAULT_RTE_CALPRM_GROUP.InertiaCmpVelAssiBasdDampgStatY_Ary1D" 0 DISPLAY_IDENTIFIER CalRegn03Rt01GroupA_Dummy_2.CalibrationPorts.InertiaCmpVelAssiBasdDampgStatY.Ary1D /end CHARACTERISTIC
/begin CHARACTERISTIC CalRegn03Rt01GroupA_Dummy_2.InertiaCmpVelDampgSpdBlndY.Ary1D "MICROSAR RTE" VAL_BLK 0x0 RTE_RL_UWORD 0 NO_COMPU_METHOD 0 65535 MATRIX_DIM 12 1 1 SYMBOL_LINK "Rte_CalprmRom_CalRegn03Rt03GroupA_DEFAULT_RTE_CALPRM_GROUP.InertiaCmpVelDampgSpdBlndY_Ary1D" 0 DISPLAY_IDENTIFIER CalRegn03Rt01GroupA_Dummy_2.CalibrationPorts.InertiaCmpVelDampgSpdBlndY.Ary1D /end CHARACTERISTIC
/begin CHARACTERISTIC CalRegn03Rt01GroupA_Dummy_2.InertiaCmpVelNotchBlndY.Ary1D "MICROSAR RTE" VAL_BLK 0x0 RTE_RL_UWORD 0 NO_COMPU_METHOD 0 65535 MATRIX_DIM 12 1 1 SYMBOL_LINK "Rte_CalprmRom_CalRegn03Rt03GroupA_DEFAULT_RTE_CALPRM_GROUP.InertiaCmpVelNotchBlndY_Ary1D" 0 DISPLAY_IDENTIFIER CalRegn03Rt01GroupA_Dummy_2.CalibrationPorts.InertiaCmpVelNotchBlndY.Ary1D /end CHARACTERISTIC
/begin CHARACTERISTIC CalRegn03Rt01GroupA_Dummy_2.RtnHwAgOffsCalcdX.Ary2D "MICROSAR RTE" VAL_BLK 0x0 RTE_RL_UWORD 0 NO_COMPU_METHOD 0 65535 MATRIX_DIM 16 9 1 SYMBOL_LINK "Rte_CalprmRom_CalRegn03Rt03GroupA_DEFAULT_RTE_CALPRM_GROUP.RtnHwAgOffsCalcdX_Ary2D" 0 DISPLAY_IDENTIFIER CalRegn03Rt01GroupA_Dummy_2.CalibrationPorts.RtnHwAgOffsCalcdX.Ary2D /end CHARACTERISTIC
/begin CHARACTERISTIC CalRegn03Rt01GroupA_Dummy_2.RtnHwAgOffsCalcdY.Ary2D "MICROSAR RTE" VAL_BLK 0x0 RTE_RL_UWORD 0 NO_COMPU_METHOD 0 65535 MATRIX_DIM 16 9 1 SYMBOL_LINK "Rte_CalprmRom_CalRegn03Rt03GroupA_DEFAULT_RTE_CALPRM_GROUP.RtnHwAgOffsCalcdY_Ary2D" 0 DISPLAY_IDENTIFIER CalRegn03Rt01GroupA_Dummy_2.CalibrationPorts.RtnHwAgOffsCalcdY.Ary2D /end CHARACTERISTIC
/begin CHARACTERISTIC CalRegn03Rt01GroupA_Dummy_2.RtnScaTqX.Ary2D "MICROSAR RTE" VAL_BLK 0x0 RTE_RL_UWORD 0 NO_COMPU_METHOD 0 65535 MATRIX_DIM 8 9 1 SYMBOL_LINK "Rte_CalprmRom_CalRegn03Rt03GroupA_DEFAULT_RTE_CALPRM_GROUP.RtnScaTqX_Ary2D" 0 DISPLAY_IDENTIFIER CalRegn03Rt01GroupA_Dummy_2.CalibrationPorts.RtnScaTqX.Ary2D /end CHARACTERISTIC
/begin CHARACTERISTIC CalRegn03Rt01GroupA_Dummy_2.RtnScaTqY.Ary2D "MICROSAR RTE" VAL_BLK 0x0 RTE_RL_UWORD 0 NO_COMPU_METHOD 0 65535 MATRIX_DIM 8 9 1 SYMBOL_LINK "Rte_CalprmRom_CalRegn03Rt03GroupA_DEFAULT_RTE_CALPRM_GROUP.RtnScaTqY_Ary2D" 0 DISPLAY_IDENTIFIER CalRegn03Rt01GroupA_Dummy_2.CalibrationPorts.RtnScaTqY.Ary2D /end CHARACTERISTIC
/begin CHARACTERISTIC CalRegn03Rt01GroupA_Dummy_2.RtnScaVelX.Ary2D "MICROSAR RTE" VAL_BLK 0x0 RTE_RL_UWORD 0 NO_COMPU_METHOD 0 65535 MATRIX_DIM 4 9 1 SYMBOL_LINK "Rte_CalprmRom_CalRegn03Rt03GroupA_DEFAULT_RTE_CALPRM_GROUP.RtnScaVelX_Ary2D" 0 DISPLAY_IDENTIFIER CalRegn03Rt01GroupA_Dummy_2.CalibrationPorts.RtnScaVelX.Ary2D /end CHARACTERISTIC
/begin CHARACTERISTIC CalRegn03Rt01GroupA_Dummy_2.RtnScaVelY.Ary2D "MICROSAR RTE" VAL_BLK 0x0 RTE_RL_UWORD 0 NO_COMPU_METHOD 0 65535 MATRIX_DIM 4 9 1 SYMBOL_LINK "Rte_CalprmRom_CalRegn03Rt03GroupA_DEFAULT_RTE_CALPRM_GROUP.RtnScaVelY_Ary2D" 0 DISPLAY_IDENTIFIER CalRegn03Rt01GroupA_Dummy_2.CalibrationPorts.RtnScaVelY.Ary2D /end CHARACTERISTIC
/begin CHARACTERISTIC CalRegn03Rt01GroupA_Dummy_3.AssiHiFrqGainY.Ary2D "MICROSAR RTE" VAL_BLK 0x0 RTE_RL_UWORD 0 NO_COMPU_METHOD 0 65535 MATRIX_DIM 13 12 1 SYMBOL_LINK "Rte_CalprmRom_CalRegn03Rt04GroupA_DEFAULT_RTE_CALPRM_GROUP.AssiHiFrqGainY_Ary2D" 0 DISPLAY_IDENTIFIER CalRegn03Rt01GroupA_Dummy_3.CalibrationPorts.AssiHiFrqGainY.Ary2D /end CHARACTERISTIC
/begin CHARACTERISTIC CalRegn03Rt01GroupA_Dummy_3.AssiHiFrqTqX.Ary2D "MICROSAR RTE" VAL_BLK 0x0 RTE_RL_UWORD 0 NO_COMPU_METHOD 0 65535 MATRIX_DIM 13 12 1 SYMBOL_LINK "Rte_CalprmRom_CalRegn03Rt04GroupA_DEFAULT_RTE_CALPRM_GROUP.AssiHiFrqTqX_Ary2D" 0 DISPLAY_IDENTIFIER CalRegn03Rt01GroupA_Dummy_3.CalibrationPorts.AssiHiFrqTqX.Ary2D /end CHARACTERISTIC
/begin CHARACTERISTIC CalRegn03Rt01GroupA_Dummy_3.AssiMotTqWhlImbRejctnMinX.Ary2D "MICROSAR RTE" VAL_BLK 0x0 RTE_RL_UWORD 0 NO_COMPU_METHOD 0 65535 MATRIX_DIM 20 12 1 SYMBOL_LINK "Rte_CalprmRom_CalRegn03Rt04GroupA_DEFAULT_RTE_CALPRM_GROUP.AssiMotTqWhlImbRejctnMinX_Ary2D" 0 DISPLAY_IDENTIFIER CalRegn03Rt01GroupA_Dummy_3.CalibrationPorts.AssiMotTqWhlImbRejctnMinX.Ary2D /end CHARACTERISTIC
/begin CHARACTERISTIC CalRegn03Rt01GroupA_Dummy_3.AssiMotTqWhlImbRejctnMinY.Ary2D "MICROSAR RTE" VAL_BLK 0x0 RTE_RL_SWORD 0 NO_COMPU_METHOD -32768 32767 MATRIX_DIM 20 12 1 SYMBOL_LINK "Rte_CalprmRom_CalRegn03Rt04GroupA_DEFAULT_RTE_CALPRM_GROUP.AssiMotTqWhlImbRejctnMinY_Ary2D" 0 DISPLAY_IDENTIFIER CalRegn03Rt01GroupA_Dummy_3.CalibrationPorts.AssiMotTqWhlImbRejctnMinY.Ary2D /end CHARACTERISTIC
/begin CHARACTERISTIC CalRegn03Rt01GroupA_Dummy_3.DampgHydCoeff1ScaY.Ary1D "MICROSAR RTE" VAL_BLK 0x0 RTE_RL_UWORD 0 NO_COMPU_METHOD 0 65535 MATRIX_DIM 12 1 1 SYMBOL_LINK "Rte_CalprmRom_CalRegn03Rt04GroupA_DEFAULT_RTE_CALPRM_GROUP.DampgHydCoeff1ScaY_Ary1D" 0 DISPLAY_IDENTIFIER CalRegn03Rt01GroupA_Dummy_3.CalibrationPorts.DampgHydCoeff1ScaY.Ary1D /end CHARACTERISTIC
/begin CHARACTERISTIC CalRegn03Rt01GroupA_Dummy_3.DampgHydCoeff2ScaY.Ary1D "MICROSAR RTE" VAL_BLK 0x0 RTE_RL_UWORD 0 NO_COMPU_METHOD 0 65535 MATRIX_DIM 12 1 1 SYMBOL_LINK "Rte_CalprmRom_CalRegn03Rt04GroupA_DEFAULT_RTE_CALPRM_GROUP.DampgHydCoeff2ScaY_Ary1D" 0 DISPLAY_IDENTIFIER CalRegn03Rt01GroupA_Dummy_3.CalibrationPorts.DampgHydCoeff2ScaY.Ary1D /end CHARACTERISTIC
/begin CHARACTERISTIC CalRegn03Rt01GroupA_Dummy_3.DampgHydCoeff3ScaY.Ary1D "MICROSAR RTE" VAL_BLK 0x0 RTE_RL_UWORD 0 NO_COMPU_METHOD 0 65535 MATRIX_DIM 12 1 1 SYMBOL_LINK "Rte_CalprmRom_CalRegn03Rt04GroupA_DEFAULT_RTE_CALPRM_GROUP.DampgHydCoeff3ScaY_Ary1D" 0 DISPLAY_IDENTIFIER CalRegn03Rt01GroupA_Dummy_3.CalibrationPorts.DampgHydCoeff3ScaY.Ary1D /end CHARACTERISTIC
/begin CHARACTERISTIC CalRegn03Rt01GroupA_Dummy_3.DampgHydCoeff4ScaY.Ary1D "MICROSAR RTE" VAL_BLK 0x0 RTE_RL_UWORD 0 NO_COMPU_METHOD 0 65535 MATRIX_DIM 12 1 1 SYMBOL_LINK "Rte_CalprmRom_CalRegn03Rt04GroupA_DEFAULT_RTE_CALPRM_GROUP.DampgHydCoeff4ScaY_Ary1D" 0 DISPLAY_IDENTIFIER CalRegn03Rt01GroupA_Dummy_3.CalibrationPorts.DampgHydCoeff4ScaY.Ary1D /end CHARACTERISTIC
/begin CHARACTERISTIC CalRegn03Rt01GroupA_Dummy_3.DampgMotVelX.Ary2D "MICROSAR RTE" VAL_BLK 0x0 RTE_RL_UWORD 0 NO_COMPU_METHOD 0 65535 MATRIX_DIM 13 12 1 SYMBOL_LINK "Rte_CalprmRom_CalRegn03Rt04GroupA_DEFAULT_RTE_CALPRM_GROUP.DampgMotVelX_Ary2D" 0 DISPLAY_IDENTIFIER CalRegn03Rt01GroupA_Dummy_3.CalibrationPorts.DampgMotVelX.Ary2D /end CHARACTERISTIC
/begin CHARACTERISTIC CalRegn03Rt01GroupA_Dummy_3.DampgMotVelY.Ary2D "MICROSAR RTE" VAL_BLK 0x0 RTE_RL_UWORD 0 NO_COMPU_METHOD 0 65535 MATRIX_DIM 13 12 1 SYMBOL_LINK "Rte_CalprmRom_CalRegn03Rt04GroupA_DEFAULT_RTE_CALPRM_GROUP.DampgMotVelY_Ary2D" 0 DISPLAY_IDENTIFIER CalRegn03Rt01GroupA_Dummy_3.CalibrationPorts.DampgMotVelY.Ary2D /end CHARACTERISTIC
/begin CHARACTERISTIC CalRegn03Rt01GroupA_Dummy_3.HysCmpFricWhlImbRejctnBlndX.Ary1D "MICROSAR RTE" VAL_BLK 0x0 RTE_RL_UWORD 0 NO_COMPU_METHOD 0 65535 MATRIX_DIM 6 1 1 SYMBOL_LINK "Rte_CalprmRom_CalRegn03Rt04GroupA_DEFAULT_RTE_CALPRM_GROUP.HysCmpFricWhlImbRejctnBlndX_Ary1D" 0 DISPLAY_IDENTIFIER CalRegn03Rt01GroupA_Dummy_3.CalibrationPorts.HysCmpFricWhlImbRejctnBlndX.Ary1D /end CHARACTERISTIC
/begin CHARACTERISTIC CalRegn03Rt01GroupA_Dummy_3.HysCmpFricWhlImbRejctnBlndY.Ary1D "MICROSAR RTE" VAL_BLK 0x0 RTE_RL_UWORD 0 NO_COMPU_METHOD 0 65535 MATRIX_DIM 6 1 1 SYMBOL_LINK "Rte_CalprmRom_CalRegn03Rt04GroupA_DEFAULT_RTE_CALPRM_GROUP.HysCmpFricWhlImbRejctnBlndY_Ary1D" 0 DISPLAY_IDENTIFIER CalRegn03Rt01GroupA_Dummy_3.CalibrationPorts.HysCmpFricWhlImbRejctnBlndY.Ary1D /end CHARACTERISTIC
/begin CHARACTERISTIC CalRegn03Rt01GroupA_Dummy_3.HysCmpFricWhlImbRejctnOffY.Ary1D "MICROSAR RTE" VAL_BLK 0x0 RTE_RL_UWORD 0 NO_COMPU_METHOD 0 65535 MATRIX_DIM 12 1 1 SYMBOL_LINK "Rte_CalprmRom_CalRegn03Rt04GroupA_DEFAULT_RTE_CALPRM_GROUP.HysCmpFricWhlImbRejctnOffY_Ary1D" 0 DISPLAY_IDENTIFIER CalRegn03Rt01GroupA_Dummy_3.CalibrationPorts.HysCmpFricWhlImbRejctnOffY.Ary1D /end CHARACTERISTIC
/begin CHARACTERISTIC CalRegn03Rt01GroupA_Dummy_3.HysCmpFricWhlImbRejctnOnY.Ary1D "MICROSAR RTE" VAL_BLK 0x0 RTE_RL_UWORD 0 NO_COMPU_METHOD 0 65535 MATRIX_DIM 12 1 1 SYMBOL_LINK "Rte_CalprmRom_CalRegn03Rt04GroupA_DEFAULT_RTE_CALPRM_GROUP.HysCmpFricWhlImbRejctnOnY_Ary1D" 0 DISPLAY_IDENTIFIER CalRegn03Rt01GroupA_Dummy_3.CalibrationPorts.HysCmpFricWhlImbRejctnOnY.Ary1D /end CHARACTERISTIC
/begin CHARACTERISTIC CalRegn03Rt01GroupA_Dummy_3.InertiaCmpVelAssiBasdDampgCoeffX.Ary1D "MICROSAR RTE" VAL_BLK 0x0 RTE_RL_UWORD 0 NO_COMPU_METHOD 0 65535 MATRIX_DIM 10 1 1 SYMBOL_LINK "Rte_CalprmRom_CalRegn03Rt04GroupA_DEFAULT_RTE_CALPRM_GROUP.InertiaCmpVelAssiBasdDampgCoeffX_Ary1D" 0 DISPLAY_IDENTIFIER CalRegn03Rt01GroupA_Dummy_3.CalibrationPorts.InertiaCmpVelAssiBasdDampgCoeffX.Ary1D /end CHARACTERISTIC
/begin CHARACTERISTIC CalRegn03Rt01GroupA_Dummy_3.InertiaCmpVelAssiBasdDampgRollgY.Ary1D "MICROSAR RTE" VAL_BLK 0x0 RTE_RL_UWORD 0 NO_COMPU_METHOD 0 65535 MATRIX_DIM 10 1 1 SYMBOL_LINK "Rte_CalprmRom_CalRegn03Rt04GroupA_DEFAULT_RTE_CALPRM_GROUP.InertiaCmpVelAssiBasdDampgRollgY_Ary1D" 0 DISPLAY_IDENTIFIER CalRegn03Rt01GroupA_Dummy_3.CalibrationPorts.InertiaCmpVelAssiBasdDampgRollgY.Ary1D /end CHARACTERISTIC
/begin CHARACTERISTIC CalRegn03Rt01GroupA_Dummy_3.InertiaCmpVelAssiBasdDampgStatY.Ary1D "MICROSAR RTE" VAL_BLK 0x0 RTE_RL_UWORD 0 NO_COMPU_METHOD 0 65535 MATRIX_DIM 10 1 1 SYMBOL_LINK "Rte_CalprmRom_CalRegn03Rt04GroupA_DEFAULT_RTE_CALPRM_GROUP.InertiaCmpVelAssiBasdDampgStatY_Ary1D" 0 DISPLAY_IDENTIFIER CalRegn03Rt01GroupA_Dummy_3.CalibrationPorts.InertiaCmpVelAssiBasdDampgStatY.Ary1D /end CHARACTERISTIC
/begin CHARACTERISTIC CalRegn03Rt01GroupA_Dummy_3.InertiaCmpVelDampgSpdBlndY.Ary1D "MICROSAR RTE" VAL_BLK 0x0 RTE_RL_UWORD 0 NO_COMPU_METHOD 0 65535 MATRIX_DIM 12 1 1 SYMBOL_LINK "Rte_CalprmRom_CalRegn03Rt04GroupA_DEFAULT_RTE_CALPRM_GROUP.InertiaCmpVelDampgSpdBlndY_Ary1D" 0 DISPLAY_IDENTIFIER CalRegn03Rt01GroupA_Dummy_3.CalibrationPorts.InertiaCmpVelDampgSpdBlndY.Ary1D /end CHARACTERISTIC
/begin CHARACTERISTIC CalRegn03Rt01GroupA_Dummy_3.InertiaCmpVelNotchBlndY.Ary1D "MICROSAR RTE" VAL_BLK 0x0 RTE_RL_UWORD 0 NO_COMPU_METHOD 0 65535 MATRIX_DIM 12 1 1 SYMBOL_LINK "Rte_CalprmRom_CalRegn03Rt04GroupA_DEFAULT_RTE_CALPRM_GROUP.InertiaCmpVelNotchBlndY_Ary1D" 0 DISPLAY_IDENTIFIER CalRegn03Rt01GroupA_Dummy_3.CalibrationPorts.InertiaCmpVelNotchBlndY.Ary1D /end CHARACTERISTIC
/begin CHARACTERISTIC CalRegn03Rt01GroupA_Dummy_3.RtnHwAgOffsCalcdX.Ary2D "MICROSAR RTE" VAL_BLK 0x0 RTE_RL_UWORD 0 NO_COMPU_METHOD 0 65535 MATRIX_DIM 16 9 1 SYMBOL_LINK "Rte_CalprmRom_CalRegn03Rt04GroupA_DEFAULT_RTE_CALPRM_GROUP.RtnHwAgOffsCalcdX_Ary2D" 0 DISPLAY_IDENTIFIER CalRegn03Rt01GroupA_Dummy_3.CalibrationPorts.RtnHwAgOffsCalcdX.Ary2D /end CHARACTERISTIC
/begin CHARACTERISTIC CalRegn03Rt01GroupA_Dummy_3.RtnHwAgOffsCalcdY.Ary2D "MICROSAR RTE" VAL_BLK 0x0 RTE_RL_UWORD 0 NO_COMPU_METHOD 0 65535 MATRIX_DIM 16 9 1 SYMBOL_LINK "Rte_CalprmRom_CalRegn03Rt04GroupA_DEFAULT_RTE_CALPRM_GROUP.RtnHwAgOffsCalcdY_Ary2D" 0 DISPLAY_IDENTIFIER CalRegn03Rt01GroupA_Dummy_3.CalibrationPorts.RtnHwAgOffsCalcdY.Ary2D /end CHARACTERISTIC
/begin CHARACTERISTIC CalRegn03Rt01GroupA_Dummy_3.RtnScaTqX.Ary2D "MICROSAR RTE" VAL_BLK 0x0 RTE_RL_UWORD 0 NO_COMPU_METHOD 0 65535 MATRIX_DIM 8 9 1 SYMBOL_LINK "Rte_CalprmRom_CalRegn03Rt04GroupA_DEFAULT_RTE_CALPRM_GROUP.RtnScaTqX_Ary2D" 0 DISPLAY_IDENTIFIER CalRegn03Rt01GroupA_Dummy_3.CalibrationPorts.RtnScaTqX.Ary2D /end CHARACTERISTIC
/begin CHARACTERISTIC CalRegn03Rt01GroupA_Dummy_3.RtnScaTqY.Ary2D "MICROSAR RTE" VAL_BLK 0x0 RTE_RL_UWORD 0 NO_COMPU_METHOD 0 65535 MATRIX_DIM 8 9 1 SYMBOL_LINK "Rte_CalprmRom_CalRegn03Rt04GroupA_DEFAULT_RTE_CALPRM_GROUP.RtnScaTqY_Ary2D" 0 DISPLAY_IDENTIFIER CalRegn03Rt01GroupA_Dummy_3.CalibrationPorts.RtnScaTqY.Ary2D /end CHARACTERISTIC
/begin CHARACTERISTIC CalRegn03Rt01GroupA_Dummy_3.RtnScaVelX.Ary2D "MICROSAR RTE" VAL_BLK 0x0 RTE_RL_UWORD 0 NO_COMPU_METHOD 0 65535 MATRIX_DIM 4 9 1 SYMBOL_LINK "Rte_CalprmRom_CalRegn03Rt04GroupA_DEFAULT_RTE_CALPRM_GROUP.RtnScaVelX_Ary2D" 0 DISPLAY_IDENTIFIER CalRegn03Rt01GroupA_Dummy_3.CalibrationPorts.RtnScaVelX.Ary2D /end CHARACTERISTIC
/begin CHARACTERISTIC CalRegn03Rt01GroupA_Dummy_3.RtnScaVelY.Ary2D "MICROSAR RTE" VAL_BLK 0x0 RTE_RL_UWORD 0 NO_COMPU_METHOD 0 65535 MATRIX_DIM 4 9 1 SYMBOL_LINK "Rte_CalprmRom_CalRegn03Rt04GroupA_DEFAULT_RTE_CALPRM_GROUP.RtnScaVelY_Ary2D" 0 DISPLAY_IDENTIFIER CalRegn03Rt01GroupA_Dummy_3.CalibrationPorts.RtnScaVelY.Ary2D /end CHARACTERISTIC
/begin CHARACTERISTIC CalRegn03Rt01GroupA_Dummy_4.AssiHiFrqGainY.Ary2D "MICROSAR RTE" VAL_BLK 0x0 RTE_RL_UWORD 0 NO_COMPU_METHOD 0 65535 MATRIX_DIM 13 12 1 SYMBOL_LINK "Rte_CalprmRom_CalRegn03Rt00GroupA_DEFAULT_RTE_CALPRM_GROUP.AssiHiFrqGainY_Ary2D" 0 DISPLAY_IDENTIFIER CalRegn03Rt01GroupA_Dummy_4.CalibrationPorts.AssiHiFrqGainY.Ary2D /end CHARACTERISTIC
/begin CHARACTERISTIC CalRegn03Rt01GroupA_Dummy_4.AssiHiFrqTqX.Ary2D "MICROSAR RTE" VAL_BLK 0x0 RTE_RL_UWORD 0 NO_COMPU_METHOD 0 65535 MATRIX_DIM 13 12 1 SYMBOL_LINK "Rte_CalprmRom_CalRegn03Rt00GroupA_DEFAULT_RTE_CALPRM_GROUP.AssiHiFrqTqX_Ary2D" 0 DISPLAY_IDENTIFIER CalRegn03Rt01GroupA_Dummy_4.CalibrationPorts.AssiHiFrqTqX.Ary2D /end CHARACTERISTIC
/begin CHARACTERISTIC CalRegn03Rt01GroupA_Dummy_4.AssiMotTqWhlImbRejctnMinX.Ary2D "MICROSAR RTE" VAL_BLK 0x0 RTE_RL_UWORD 0 NO_COMPU_METHOD 0 65535 MATRIX_DIM 20 12 1 SYMBOL_LINK "Rte_CalprmRom_CalRegn03Rt00GroupA_DEFAULT_RTE_CALPRM_GROUP.AssiMotTqWhlImbRejctnMinX_Ary2D" 0 DISPLAY_IDENTIFIER CalRegn03Rt01GroupA_Dummy_4.CalibrationPorts.AssiMotTqWhlImbRejctnMinX.Ary2D /end CHARACTERISTIC
/begin CHARACTERISTIC CalRegn03Rt01GroupA_Dummy_4.AssiMotTqWhlImbRejctnMinY.Ary2D "MICROSAR RTE" VAL_BLK 0x0 RTE_RL_SWORD 0 NO_COMPU_METHOD -32768 32767 MATRIX_DIM 20 12 1 SYMBOL_LINK "Rte_CalprmRom_CalRegn03Rt00GroupA_DEFAULT_RTE_CALPRM_GROUP.AssiMotTqWhlImbRejctnMinY_Ary2D" 0 DISPLAY_IDENTIFIER CalRegn03Rt01GroupA_Dummy_4.CalibrationPorts.AssiMotTqWhlImbRejctnMinY.Ary2D /end CHARACTERISTIC
/begin CHARACTERISTIC CalRegn03Rt01GroupA_Dummy_4.DampgHydCoeff1ScaY.Ary1D "MICROSAR RTE" VAL_BLK 0x0 RTE_RL_UWORD 0 NO_COMPU_METHOD 0 65535 MATRIX_DIM 12 1 1 SYMBOL_LINK "Rte_CalprmRom_CalRegn03Rt00GroupA_DEFAULT_RTE_CALPRM_GROUP.DampgHydCoeff1ScaY_Ary1D" 0 DISPLAY_IDENTIFIER CalRegn03Rt01GroupA_Dummy_4.CalibrationPorts.DampgHydCoeff1ScaY.Ary1D /end CHARACTERISTIC
/begin CHARACTERISTIC CalRegn03Rt01GroupA_Dummy_4.DampgHydCoeff2ScaY.Ary1D "MICROSAR RTE" VAL_BLK 0x0 RTE_RL_UWORD 0 NO_COMPU_METHOD 0 65535 MATRIX_DIM 12 1 1 SYMBOL_LINK "Rte_CalprmRom_CalRegn03Rt00GroupA_DEFAULT_RTE_CALPRM_GROUP.DampgHydCoeff2ScaY_Ary1D" 0 DISPLAY_IDENTIFIER CalRegn03Rt01GroupA_Dummy_4.CalibrationPorts.DampgHydCoeff2ScaY.Ary1D /end CHARACTERISTIC
/begin CHARACTERISTIC CalRegn03Rt01GroupA_Dummy_4.DampgHydCoeff3ScaY.Ary1D "MICROSAR RTE" VAL_BLK 0x0 RTE_RL_UWORD 0 NO_COMPU_METHOD 0 65535 MATRIX_DIM 12 1 1 SYMBOL_LINK "Rte_CalprmRom_CalRegn03Rt00GroupA_DEFAULT_RTE_CALPRM_GROUP.DampgHydCoeff3ScaY_Ary1D" 0 DISPLAY_IDENTIFIER CalRegn03Rt01GroupA_Dummy_4.CalibrationPorts.DampgHydCoeff3ScaY.Ary1D /end CHARACTERISTIC
/begin CHARACTERISTIC CalRegn03Rt01GroupA_Dummy_4.DampgHydCoeff4ScaY.Ary1D "MICROSAR RTE" VAL_BLK 0x0 RTE_RL_UWORD 0 NO_COMPU_METHOD 0 65535 MATRIX_DIM 12 1 1 SYMBOL_LINK "Rte_CalprmRom_CalRegn03Rt00GroupA_DEFAULT_RTE_CALPRM_GROUP.DampgHydCoeff4ScaY_Ary1D" 0 DISPLAY_IDENTIFIER CalRegn03Rt01GroupA_Dummy_4.CalibrationPorts.DampgHydCoeff4ScaY.Ary1D /end CHARACTERISTIC
/begin CHARACTERISTIC CalRegn03Rt01GroupA_Dummy_4.DampgMotVelX.Ary2D "MICROSAR RTE" VAL_BLK 0x0 RTE_RL_UWORD 0 NO_COMPU_METHOD 0 65535 MATRIX_DIM 13 12 1 SYMBOL_LINK "Rte_CalprmRom_CalRegn03Rt00GroupA_DEFAULT_RTE_CALPRM_GROUP.DampgMotVelX_Ary2D" 0 DISPLAY_IDENTIFIER CalRegn03Rt01GroupA_Dummy_4.CalibrationPorts.DampgMotVelX.Ary2D /end CHARACTERISTIC
/begin CHARACTERISTIC CalRegn03Rt01GroupA_Dummy_4.DampgMotVelY.Ary2D "MICROSAR RTE" VAL_BLK 0x0 RTE_RL_UWORD 0 NO_COMPU_METHOD 0 65535 MATRIX_DIM 13 12 1 SYMBOL_LINK "Rte_CalprmRom_CalRegn03Rt00GroupA_DEFAULT_RTE_CALPRM_GROUP.DampgMotVelY_Ary2D" 0 DISPLAY_IDENTIFIER CalRegn03Rt01GroupA_Dummy_4.CalibrationPorts.DampgMotVelY.Ary2D /end CHARACTERISTIC
/begin CHARACTERISTIC CalRegn03Rt01GroupA_Dummy_4.HysCmpFricWhlImbRejctnBlndX.Ary1D "MICROSAR RTE" VAL_BLK 0x0 RTE_RL_UWORD 0 NO_COMPU_METHOD 0 65535 MATRIX_DIM 6 1 1 SYMBOL_LINK "Rte_CalprmRom_CalRegn03Rt00GroupA_DEFAULT_RTE_CALPRM_GROUP.HysCmpFricWhlImbRejctnBlndX_Ary1D" 0 DISPLAY_IDENTIFIER CalRegn03Rt01GroupA_Dummy_4.CalibrationPorts.HysCmpFricWhlImbRejctnBlndX.Ary1D /end CHARACTERISTIC
/begin CHARACTERISTIC CalRegn03Rt01GroupA_Dummy_4.HysCmpFricWhlImbRejctnBlndY.Ary1D "MICROSAR RTE" VAL_BLK 0x0 RTE_RL_UWORD 0 NO_COMPU_METHOD 0 65535 MATRIX_DIM 6 1 1 SYMBOL_LINK "Rte_CalprmRom_CalRegn03Rt00GroupA_DEFAULT_RTE_CALPRM_GROUP.HysCmpFricWhlImbRejctnBlndY_Ary1D" 0 DISPLAY_IDENTIFIER CalRegn03Rt01GroupA_Dummy_4.CalibrationPorts.HysCmpFricWhlImbRejctnBlndY.Ary1D /end CHARACTERISTIC
/begin CHARACTERISTIC CalRegn03Rt01GroupA_Dummy_4.HysCmpFricWhlImbRejctnOffY.Ary1D "MICROSAR RTE" VAL_BLK 0x0 RTE_RL_UWORD 0 NO_COMPU_METHOD 0 65535 MATRIX_DIM 12 1 1 SYMBOL_LINK "Rte_CalprmRom_CalRegn03Rt00GroupA_DEFAULT_RTE_CALPRM_GROUP.HysCmpFricWhlImbRejctnOffY_Ary1D" 0 DISPLAY_IDENTIFIER CalRegn03Rt01GroupA_Dummy_4.CalibrationPorts.HysCmpFricWhlImbRejctnOffY.Ary1D /end CHARACTERISTIC
/begin CHARACTERISTIC CalRegn03Rt01GroupA_Dummy_4.HysCmpFricWhlImbRejctnOnY.Ary1D "MICROSAR RTE" VAL_BLK 0x0 RTE_RL_UWORD 0 NO_COMPU_METHOD 0 65535 MATRIX_DIM 12 1 1 SYMBOL_LINK "Rte_CalprmRom_CalRegn03Rt00GroupA_DEFAULT_RTE_CALPRM_GROUP.HysCmpFricWhlImbRejctnOnY_Ary1D" 0 DISPLAY_IDENTIFIER CalRegn03Rt01GroupA_Dummy_4.CalibrationPorts.HysCmpFricWhlImbRejctnOnY.Ary1D /end CHARACTERISTIC
/begin CHARACTERISTIC CalRegn03Rt01GroupA_Dummy_4.InertiaCmpVelAssiBasdDampgCoeffX.Ary1D "MICROSAR RTE" VAL_BLK 0x0 RTE_RL_UWORD 0 NO_COMPU_METHOD 0 65535 MATRIX_DIM 10 1 1 SYMBOL_LINK "Rte_CalprmRom_CalRegn03Rt00GroupA_DEFAULT_RTE_CALPRM_GROUP.InertiaCmpVelAssiBasdDampgCoeffX_Ary1D" 0 DISPLAY_IDENTIFIER CalRegn03Rt01GroupA_Dummy_4.CalibrationPorts.InertiaCmpVelAssiBasdDampgCoeffX.Ary1D /end CHARACTERISTIC
/begin CHARACTERISTIC CalRegn03Rt01GroupA_Dummy_4.InertiaCmpVelAssiBasdDampgRollgY.Ary1D "MICROSAR RTE" VAL_BLK 0x0 RTE_RL_UWORD 0 NO_COMPU_METHOD 0 65535 MATRIX_DIM 10 1 1 SYMBOL_LINK "Rte_CalprmRom_CalRegn03Rt00GroupA_DEFAULT_RTE_CALPRM_GROUP.InertiaCmpVelAssiBasdDampgRollgY_Ary1D" 0 DISPLAY_IDENTIFIER CalRegn03Rt01GroupA_Dummy_4.CalibrationPorts.InertiaCmpVelAssiBasdDampgRollgY.Ary1D /end CHARACTERISTIC
/begin CHARACTERISTIC CalRegn03Rt01GroupA_Dummy_4.InertiaCmpVelAssiBasdDampgStatY.Ary1D "MICROSAR RTE" VAL_BLK 0x0 RTE_RL_UWORD 0 NO_COMPU_METHOD 0 65535 MATRIX_DIM 10 1 1 SYMBOL_LINK "Rte_CalprmRom_CalRegn03Rt00GroupA_DEFAULT_RTE_CALPRM_GROUP.InertiaCmpVelAssiBasdDampgStatY_Ary1D" 0 DISPLAY_IDENTIFIER CalRegn03Rt01GroupA_Dummy_4.CalibrationPorts.InertiaCmpVelAssiBasdDampgStatY.Ary1D /end CHARACTERISTIC
/begin CHARACTERISTIC CalRegn03Rt01GroupA_Dummy_4.InertiaCmpVelDampgSpdBlndY.Ary1D "MICROSAR RTE" VAL_BLK 0x0 RTE_RL_UWORD 0 NO_COMPU_METHOD 0 65535 MATRIX_DIM 12 1 1 SYMBOL_LINK "Rte_CalprmRom_CalRegn03Rt00GroupA_DEFAULT_RTE_CALPRM_GROUP.InertiaCmpVelDampgSpdBlndY_Ary1D" 0 DISPLAY_IDENTIFIER CalRegn03Rt01GroupA_Dummy_4.CalibrationPorts.InertiaCmpVelDampgSpdBlndY.Ary1D /end CHARACTERISTIC
/begin CHARACTERISTIC CalRegn03Rt01GroupA_Dummy_4.InertiaCmpVelNotchBlndY.Ary1D "MICROSAR RTE" VAL_BLK 0x0 RTE_RL_UWORD 0 NO_COMPU_METHOD 0 65535 MATRIX_DIM 12 1 1 SYMBOL_LINK "Rte_CalprmRom_CalRegn03Rt00GroupA_DEFAULT_RTE_CALPRM_GROUP.InertiaCmpVelNotchBlndY_Ary1D" 0 DISPLAY_IDENTIFIER CalRegn03Rt01GroupA_Dummy_4.CalibrationPorts.InertiaCmpVelNotchBlndY.Ary1D /end CHARACTERISTIC
/begin CHARACTERISTIC CalRegn03Rt01GroupA_Dummy_4.RtnHwAgOffsCalcdX.Ary2D "MICROSAR RTE" VAL_BLK 0x0 RTE_RL_UWORD 0 NO_COMPU_METHOD 0 65535 MATRIX_DIM 16 9 1 SYMBOL_LINK "Rte_CalprmRom_CalRegn03Rt00GroupA_DEFAULT_RTE_CALPRM_GROUP.RtnHwAgOffsCalcdX_Ary2D" 0 DISPLAY_IDENTIFIER CalRegn03Rt01GroupA_Dummy_4.CalibrationPorts.RtnHwAgOffsCalcdX.Ary2D /end CHARACTERISTIC
/begin CHARACTERISTIC CalRegn03Rt01GroupA_Dummy_4.RtnHwAgOffsCalcdY.Ary2D "MICROSAR RTE" VAL_BLK 0x0 RTE_RL_UWORD 0 NO_COMPU_METHOD 0 65535 MATRIX_DIM 16 9 1 SYMBOL_LINK "Rte_CalprmRom_CalRegn03Rt00GroupA_DEFAULT_RTE_CALPRM_GROUP.RtnHwAgOffsCalcdY_Ary2D" 0 DISPLAY_IDENTIFIER CalRegn03Rt01GroupA_Dummy_4.CalibrationPorts.RtnHwAgOffsCalcdY.Ary2D /end CHARACTERISTIC
/begin CHARACTERISTIC CalRegn03Rt01GroupA_Dummy_4.RtnScaTqX.Ary2D "MICROSAR RTE" VAL_BLK 0x0 RTE_RL_UWORD 0 NO_COMPU_METHOD 0 65535 MATRIX_DIM 8 9 1 SYMBOL_LINK "Rte_CalprmRom_CalRegn03Rt00GroupA_DEFAULT_RTE_CALPRM_GROUP.RtnScaTqX_Ary2D" 0 DISPLAY_IDENTIFIER CalRegn03Rt01GroupA_Dummy_4.CalibrationPorts.RtnScaTqX.Ary2D /end CHARACTERISTIC
/begin CHARACTERISTIC CalRegn03Rt01GroupA_Dummy_4.RtnScaTqY.Ary2D "MICROSAR RTE" VAL_BLK 0x0 RTE_RL_UWORD 0 NO_COMPU_METHOD 0 65535 MATRIX_DIM 8 9 1 SYMBOL_LINK "Rte_CalprmRom_CalRegn03Rt00GroupA_DEFAULT_RTE_CALPRM_GROUP.RtnScaTqY_Ary2D" 0 DISPLAY_IDENTIFIER CalRegn03Rt01GroupA_Dummy_4.CalibrationPorts.RtnScaTqY.Ary2D /end CHARACTERISTIC
/begin CHARACTERISTIC CalRegn03Rt01GroupA_Dummy_4.RtnScaVelX.Ary2D "MICROSAR RTE" VAL_BLK 0x0 RTE_RL_UWORD 0 NO_COMPU_METHOD 0 65535 MATRIX_DIM 4 9 1 SYMBOL_LINK "Rte_CalprmRom_CalRegn03Rt00GroupA_DEFAULT_RTE_CALPRM_GROUP.RtnScaVelX_Ary2D" 0 DISPLAY_IDENTIFIER CalRegn03Rt01GroupA_Dummy_4.CalibrationPorts.RtnScaVelX.Ary2D /end CHARACTERISTIC
/begin CHARACTERISTIC CalRegn03Rt01GroupA_Dummy_4.RtnScaVelY.Ary2D "MICROSAR RTE" VAL_BLK 0x0 RTE_RL_UWORD 0 NO_COMPU_METHOD 0 65535 MATRIX_DIM 4 9 1 SYMBOL_LINK "Rte_CalprmRom_CalRegn03Rt00GroupA_DEFAULT_RTE_CALPRM_GROUP.RtnScaVelY_Ary2D" 0 DISPLAY_IDENTIFIER CalRegn03Rt01GroupA_Dummy_4.CalibrationPorts.RtnScaVelY.Ary2D /end CHARACTERISTIC
/begin CHARACTERISTIC CalRegn03Rt01GroupB.AssiHiFrqTqWhlImbRejctnTqX.Ary2D "MICROSAR RTE" VAL_BLK 0x0 RTE_RL_UWORD 0 NO_COMPU_METHOD 0 65535 MATRIX_DIM 13 12 1 SYMBOL_LINK "Rte_CalprmRom_CalRegn03Rt01GroupB_DEFAULT_RTE_CALPRM_GROUP.AssiHiFrqTqWhlImbRejctnTqX_Ary2D" 0 DISPLAY_IDENTIFIER CalRegn03Rt01GroupB.CalibrationPorts.AssiHiFrqTqWhlImbRejctnTqX.Ary2D /end CHARACTERISTIC
/begin CHARACTERISTIC CalRegn03Rt01GroupB.AssiHiFrqWhlImbRejctnGainY.Ary2D "MICROSAR RTE" VAL_BLK 0x0 RTE_RL_UWORD 0 NO_COMPU_METHOD 0 65535 MATRIX_DIM 13 12 1 SYMBOL_LINK "Rte_CalprmRom_CalRegn03Rt01GroupB_DEFAULT_RTE_CALPRM_GROUP.AssiHiFrqWhlImbRejctnGainY_Ary2D" 0 DISPLAY_IDENTIFIER CalRegn03Rt01GroupB.CalibrationPorts.AssiHiFrqWhlImbRejctnGainY.Ary2D /end CHARACTERISTIC
/begin CHARACTERISTIC CalRegn03Rt01GroupB.AssiHiFrqWhlImbRejtcnBlndX.Ary2D "MICROSAR RTE" VAL_BLK 0x0 RTE_RL_UWORD 0 NO_COMPU_METHOD 0 65535 MATRIX_DIM 5 12 1 SYMBOL_LINK "Rte_CalprmRom_CalRegn03Rt01GroupB_DEFAULT_RTE_CALPRM_GROUP.AssiHiFrqWhlImbRejtcnBlndX_Ary2D" 0 DISPLAY_IDENTIFIER CalRegn03Rt01GroupB.CalibrationPorts.AssiHiFrqWhlImbRejtcnBlndX.Ary2D /end CHARACTERISTIC
/begin CHARACTERISTIC CalRegn03Rt01GroupB.AssiHiFrqWhlImbRejtcnBlndY.Ary2D "MICROSAR RTE" VAL_BLK 0x0 RTE_RL_UWORD 0 NO_COMPU_METHOD 0 65535 MATRIX_DIM 5 12 1 SYMBOL_LINK "Rte_CalprmRom_CalRegn03Rt01GroupB_DEFAULT_RTE_CALPRM_GROUP.AssiHiFrqWhlImbRejtcnBlndY_Ary2D" 0 DISPLAY_IDENTIFIER CalRegn03Rt01GroupB.CalibrationPorts.AssiHiFrqWhlImbRejtcnBlndY.Ary2D /end CHARACTERISTIC
/begin CHARACTERISTIC CalRegn03Rt01GroupB.AssiMotTqWhlImbRejctnMaxX.Ary2D "MICROSAR RTE" VAL_BLK 0x0 RTE_RL_UWORD 0 NO_COMPU_METHOD 0 65535 MATRIX_DIM 20 12 1 SYMBOL_LINK "Rte_CalprmRom_CalRegn03Rt01GroupB_DEFAULT_RTE_CALPRM_GROUP.AssiMotTqWhlImbRejctnMaxX_Ary2D" 0 DISPLAY_IDENTIFIER CalRegn03Rt01GroupB.CalibrationPorts.AssiMotTqWhlImbRejctnMaxX.Ary2D /end CHARACTERISTIC
/begin CHARACTERISTIC CalRegn03Rt01GroupB.AssiMotTqWhlImbRejctnMaxY.Ary2D "MICROSAR RTE" VAL_BLK 0x0 RTE_RL_SWORD 0 NO_COMPU_METHOD -32768 32767 MATRIX_DIM 20 12 1 SYMBOL_LINK "Rte_CalprmRom_CalRegn03Rt01GroupB_DEFAULT_RTE_CALPRM_GROUP.AssiMotTqWhlImbRejctnMaxY_Ary2D" 0 DISPLAY_IDENTIFIER CalRegn03Rt01GroupB.CalibrationPorts.AssiMotTqWhlImbRejctnMaxY.Ary2D /end CHARACTERISTIC
/begin CHARACTERISTIC CalRegn03Rt01GroupB.AssiWhlImbRejctnBlndScaX.Ary2D "MICROSAR RTE" VAL_BLK 0x0 RTE_RL_UWORD 0 NO_COMPU_METHOD 0 65535 MATRIX_DIM 5 12 1 SYMBOL_LINK "Rte_CalprmRom_CalRegn03Rt01GroupB_DEFAULT_RTE_CALPRM_GROUP.AssiWhlImbRejctnBlndScaX_Ary2D" 0 DISPLAY_IDENTIFIER CalRegn03Rt01GroupB.CalibrationPorts.AssiWhlImbRejctnBlndScaX.Ary2D /end CHARACTERISTIC
/begin CHARACTERISTIC CalRegn03Rt01GroupB.AssiWhlImbRejctnBlndScaY.Ary2D "MICROSAR RTE" VAL_BLK 0x0 RTE_RL_UWORD 0 NO_COMPU_METHOD 0 65535 MATRIX_DIM 5 12 1 SYMBOL_LINK "Rte_CalprmRom_CalRegn03Rt01GroupB_DEFAULT_RTE_CALPRM_GROUP.AssiWhlImbRejctnBlndScaY_Ary2D" 0 DISPLAY_IDENTIFIER CalRegn03Rt01GroupB.CalibrationPorts.AssiWhlImbRejctnBlndScaY.Ary2D /end CHARACTERISTIC
/begin CHARACTERISTIC CalRegn03Rt01GroupB.EotProtnDampgVehSpdTbl.Ary1D "MICROSAR RTE" VAL_BLK 0x0 RTE_RL_UWORD 0 NO_COMPU_METHOD 0 65535 MATRIX_DIM 4 1 1 SYMBOL_LINK "Rte_CalprmRom_CalRegn03Rt01GroupB_DEFAULT_RTE_CALPRM_GROUP.EotProtnDampgVehSpdTbl_Ary1D" 0 DISPLAY_IDENTIFIER CalRegn03Rt01GroupB.CalibrationPorts.EotProtnDampgVehSpdTbl.Ary1D /end CHARACTERISTIC
/begin CHARACTERISTIC CalRegn03Rt01GroupB.EotProtnEntrGainVehSpdTbl.Ary1D "MICROSAR RTE" VAL_BLK 0x0 RTE_RL_UWORD 0 NO_COMPU_METHOD 0 65535 MATRIX_DIM 5 1 1 SYMBOL_LINK "Rte_CalprmRom_CalRegn03Rt01GroupB_DEFAULT_RTE_CALPRM_GROUP.EotProtnEntrGainVehSpdTbl_Ary1D" 0 DISPLAY_IDENTIFIER CalRegn03Rt01GroupB.CalibrationPorts.EotProtnEntrGainVehSpdTbl.Ary1D /end CHARACTERISTIC
/begin CHARACTERISTIC CalRegn03Rt01GroupB.EotProtnEntrGainX.Ary2D "MICROSAR RTE" VAL_BLK 0x0 RTE_RL_UWORD 0 NO_COMPU_METHOD 0 65535 MATRIX_DIM 4 5 1 SYMBOL_LINK "Rte_CalprmRom_CalRegn03Rt01GroupB_DEFAULT_RTE_CALPRM_GROUP.EotProtnEntrGainX_Ary2D" 0 DISPLAY_IDENTIFIER CalRegn03Rt01GroupB.CalibrationPorts.EotProtnEntrGainX.Ary2D /end CHARACTERISTIC
/begin CHARACTERISTIC CalRegn03Rt01GroupB.EotProtnEntrGainY.Ary2D "MICROSAR RTE" VAL_BLK 0x0 RTE_RL_UWORD 0 NO_COMPU_METHOD 0 65535 MATRIX_DIM 4 5 1 SYMBOL_LINK "Rte_CalprmRom_CalRegn03Rt01GroupB_DEFAULT_RTE_CALPRM_GROUP.EotProtnEntrGainY_Ary2D" 0 DISPLAY_IDENTIFIER CalRegn03Rt01GroupB.CalibrationPorts.EotProtnEntrGainY.Ary2D /end CHARACTERISTIC
/begin CHARACTERISTIC CalRegn03Rt01GroupB.EotProtnExitDampgY.Ary2D "MICROSAR RTE" VAL_BLK 0x0 RTE_RL_UWORD 0 NO_COMPU_METHOD 0 65535 MATRIX_DIM 2 4 1 SYMBOL_LINK "Rte_CalprmRom_CalRegn03Rt01GroupB_DEFAULT_RTE_CALPRM_GROUP.EotProtnExitDampgY_Ary2D" 0 DISPLAY_IDENTIFIER CalRegn03Rt01GroupB.CalibrationPorts.EotProtnExitDampgY.Ary2D /end CHARACTERISTIC
/begin CHARACTERISTIC CalRegn03Rt01GroupB.EotProtnHwDegDampgX.Ary2D "MICROSAR RTE" VAL_BLK 0x0 RTE_RL_UWORD 0 NO_COMPU_METHOD 0 65535 MATRIX_DIM 2 4 1 SYMBOL_LINK "Rte_CalprmRom_CalRegn03Rt01GroupB_DEFAULT_RTE_CALPRM_GROUP.EotProtnHwDegDampgX_Ary2D" 0 DISPLAY_IDENTIFIER CalRegn03Rt01GroupB.CalibrationPorts.EotProtnHwDegDampgX.Ary2D /end CHARACTERISTIC
/begin CHARACTERISTIC CalRegn03Rt01GroupB.EotProtnNormDampgY.Ary2D "MICROSAR RTE" VAL_BLK 0x0 RTE_RL_UWORD 0 NO_COMPU_METHOD 0 65535 MATRIX_DIM 2 4 1 SYMBOL_LINK "Rte_CalprmRom_CalRegn03Rt01GroupB_DEFAULT_RTE_CALPRM_GROUP.EotProtnNormDampgY_Ary2D" 0 DISPLAY_IDENTIFIER CalRegn03Rt01GroupB.CalibrationPorts.EotProtnNormDampgY.Ary2D /end CHARACTERISTIC
/begin CHARACTERISTIC CalRegn03Rt01GroupB.InertiaCmpVelAssiBasdDampgRollgWhlImbRejctnOnY.Ary1D "MICROSAR RTE" VAL_BLK 0x0 RTE_RL_UWORD 0 NO_COMPU_METHOD 0 65535 MATRIX_DIM 10 1 1 SYMBOL_LINK "Rte_CalprmRom_CalRegn03Rt01GroupB_DEFAULT_RTE_CALPRM_GROUP.InertiaCmpVelAssiBasdDampgRollgWhlImbRejctnOnY_Ary1D" 0 DISPLAY_IDENTIFIER CalRegn03Rt01GroupB.CalibrationPorts.InertiaCmpVelAssiBasdDampgRollgWhlImbRejctnOnY.Ary1D /end CHARACTERISTIC
/begin CHARACTERISTIC CalRegn03Rt01GroupB_Dummy.AssiHiFrqTqWhlImbRejctnTqX.Ary2D "MICROSAR RTE" VAL_BLK 0x0 RTE_RL_UWORD 0 NO_COMPU_METHOD 0 65535 MATRIX_DIM 13 12 1 SYMBOL_LINK "Rte_CalprmRom_CalRegn03Rt01GroupB_DEFAULT_RTE_CALPRM_GROUP.AssiHiFrqTqWhlImbRejctnTqX_Ary2D" 0 DISPLAY_IDENTIFIER CalRegn03Rt01GroupB_Dummy.CalibrationPorts.AssiHiFrqTqWhlImbRejctnTqX.Ary2D /end CHARACTERISTIC
/begin CHARACTERISTIC CalRegn03Rt01GroupB_Dummy.AssiHiFrqWhlImbRejctnGainY.Ary2D "MICROSAR RTE" VAL_BLK 0x0 RTE_RL_UWORD 0 NO_COMPU_METHOD 0 65535 MATRIX_DIM 13 12 1 SYMBOL_LINK "Rte_CalprmRom_CalRegn03Rt01GroupB_DEFAULT_RTE_CALPRM_GROUP.AssiHiFrqWhlImbRejctnGainY_Ary2D" 0 DISPLAY_IDENTIFIER CalRegn03Rt01GroupB_Dummy.CalibrationPorts.AssiHiFrqWhlImbRejctnGainY.Ary2D /end CHARACTERISTIC
/begin CHARACTERISTIC CalRegn03Rt01GroupB_Dummy.AssiHiFrqWhlImbRejtcnBlndX.Ary2D "MICROSAR RTE" VAL_BLK 0x0 RTE_RL_UWORD 0 NO_COMPU_METHOD 0 65535 MATRIX_DIM 5 12 1 SYMBOL_LINK "Rte_CalprmRom_CalRegn03Rt01GroupB_DEFAULT_RTE_CALPRM_GROUP.AssiHiFrqWhlImbRejtcnBlndX_Ary2D" 0 DISPLAY_IDENTIFIER CalRegn03Rt01GroupB_Dummy.CalibrationPorts.AssiHiFrqWhlImbRejtcnBlndX.Ary2D /end CHARACTERISTIC
/begin CHARACTERISTIC CalRegn03Rt01GroupB_Dummy.AssiHiFrqWhlImbRejtcnBlndY.Ary2D "MICROSAR RTE" VAL_BLK 0x0 RTE_RL_UWORD 0 NO_COMPU_METHOD 0 65535 MATRIX_DIM 5 12 1 SYMBOL_LINK "Rte_CalprmRom_CalRegn03Rt01GroupB_DEFAULT_RTE_CALPRM_GROUP.AssiHiFrqWhlImbRejtcnBlndY_Ary2D" 0 DISPLAY_IDENTIFIER CalRegn03Rt01GroupB_Dummy.CalibrationPorts.AssiHiFrqWhlImbRejtcnBlndY.Ary2D /end CHARACTERISTIC
/begin CHARACTERISTIC CalRegn03Rt01GroupB_Dummy.AssiMotTqWhlImbRejctnMaxX.Ary2D "MICROSAR RTE" VAL_BLK 0x0 RTE_RL_UWORD 0 NO_COMPU_METHOD 0 65535 MATRIX_DIM 20 12 1 SYMBOL_LINK "Rte_CalprmRom_CalRegn03Rt01GroupB_DEFAULT_RTE_CALPRM_GROUP.AssiMotTqWhlImbRejctnMaxX_Ary2D" 0 DISPLAY_IDENTIFIER CalRegn03Rt01GroupB_Dummy.CalibrationPorts.AssiMotTqWhlImbRejctnMaxX.Ary2D /end CHARACTERISTIC
/begin CHARACTERISTIC CalRegn03Rt01GroupB_Dummy.AssiMotTqWhlImbRejctnMaxY.Ary2D "MICROSAR RTE" VAL_BLK 0x0 RTE_RL_SWORD 0 NO_COMPU_METHOD -32768 32767 MATRIX_DIM 20 12 1 SYMBOL_LINK "Rte_CalprmRom_CalRegn03Rt01GroupB_DEFAULT_RTE_CALPRM_GROUP.AssiMotTqWhlImbRejctnMaxY_Ary2D" 0 DISPLAY_IDENTIFIER CalRegn03Rt01GroupB_Dummy.CalibrationPorts.AssiMotTqWhlImbRejctnMaxY.Ary2D /end CHARACTERISTIC
/begin CHARACTERISTIC CalRegn03Rt01GroupB_Dummy.AssiWhlImbRejctnBlndScaX.Ary2D "MICROSAR RTE" VAL_BLK 0x0 RTE_RL_UWORD 0 NO_COMPU_METHOD 0 65535 MATRIX_DIM 5 12 1 SYMBOL_LINK "Rte_CalprmRom_CalRegn03Rt01GroupB_DEFAULT_RTE_CALPRM_GROUP.AssiWhlImbRejctnBlndScaX_Ary2D" 0 DISPLAY_IDENTIFIER CalRegn03Rt01GroupB_Dummy.CalibrationPorts.AssiWhlImbRejctnBlndScaX.Ary2D /end CHARACTERISTIC
/begin CHARACTERISTIC CalRegn03Rt01GroupB_Dummy.AssiWhlImbRejctnBlndScaY.Ary2D "MICROSAR RTE" VAL_BLK 0x0 RTE_RL_UWORD 0 NO_COMPU_METHOD 0 65535 MATRIX_DIM 5 12 1 SYMBOL_LINK "Rte_CalprmRom_CalRegn03Rt01GroupB_DEFAULT_RTE_CALPRM_GROUP.AssiWhlImbRejctnBlndScaY_Ary2D" 0 DISPLAY_IDENTIFIER CalRegn03Rt01GroupB_Dummy.CalibrationPorts.AssiWhlImbRejctnBlndScaY.Ary2D /end CHARACTERISTIC
/begin CHARACTERISTIC CalRegn03Rt01GroupB_Dummy.EotProtnDampgVehSpdTbl.Ary1D "MICROSAR RTE" VAL_BLK 0x0 RTE_RL_UWORD 0 NO_COMPU_METHOD 0 65535 MATRIX_DIM 4 1 1 SYMBOL_LINK "Rte_CalprmRom_CalRegn03Rt01GroupB_DEFAULT_RTE_CALPRM_GROUP.EotProtnDampgVehSpdTbl_Ary1D" 0 DISPLAY_IDENTIFIER CalRegn03Rt01GroupB_Dummy.CalibrationPorts.EotProtnDampgVehSpdTbl.Ary1D /end CHARACTERISTIC
/begin CHARACTERISTIC CalRegn03Rt01GroupB_Dummy.EotProtnEntrGainVehSpdTbl.Ary1D "MICROSAR RTE" VAL_BLK 0x0 RTE_RL_UWORD 0 NO_COMPU_METHOD 0 65535 MATRIX_DIM 5 1 1 SYMBOL_LINK "Rte_CalprmRom_CalRegn03Rt01GroupB_DEFAULT_RTE_CALPRM_GROUP.EotProtnEntrGainVehSpdTbl_Ary1D" 0 DISPLAY_IDENTIFIER CalRegn03Rt01GroupB_Dummy.CalibrationPorts.EotProtnEntrGainVehSpdTbl.Ary1D /end CHARACTERISTIC
/begin CHARACTERISTIC CalRegn03Rt01GroupB_Dummy.EotProtnEntrGainX.Ary2D "MICROSAR RTE" VAL_BLK 0x0 RTE_RL_UWORD 0 NO_COMPU_METHOD 0 65535 MATRIX_DIM 4 5 1 SYMBOL_LINK "Rte_CalprmRom_CalRegn03Rt01GroupB_DEFAULT_RTE_CALPRM_GROUP.EotProtnEntrGainX_Ary2D" 0 DISPLAY_IDENTIFIER CalRegn03Rt01GroupB_Dummy.CalibrationPorts.EotProtnEntrGainX.Ary2D /end CHARACTERISTIC
/begin CHARACTERISTIC CalRegn03Rt01GroupB_Dummy.EotProtnEntrGainY.Ary2D "MICROSAR RTE" VAL_BLK 0x0 RTE_RL_UWORD 0 NO_COMPU_METHOD 0 65535 MATRIX_DIM 4 5 1 SYMBOL_LINK "Rte_CalprmRom_CalRegn03Rt01GroupB_DEFAULT_RTE_CALPRM_GROUP.EotProtnEntrGainY_Ary2D" 0 DISPLAY_IDENTIFIER CalRegn03Rt01GroupB_Dummy.CalibrationPorts.EotProtnEntrGainY.Ary2D /end CHARACTERISTIC
/begin CHARACTERISTIC CalRegn03Rt01GroupB_Dummy.EotProtnExitDampgY.Ary2D "MICROSAR RTE" VAL_BLK 0x0 RTE_RL_UWORD 0 NO_COMPU_METHOD 0 65535 MATRIX_DIM 2 4 1 SYMBOL_LINK "Rte_CalprmRom_CalRegn03Rt01GroupB_DEFAULT_RTE_CALPRM_GROUP.EotProtnExitDampgY_Ary2D" 0 DISPLAY_IDENTIFIER CalRegn03Rt01GroupB_Dummy.CalibrationPorts.EotProtnExitDampgY.Ary2D /end CHARACTERISTIC
/begin CHARACTERISTIC CalRegn03Rt01GroupB_Dummy.EotProtnHwDegDampgX.Ary2D "MICROSAR RTE" VAL_BLK 0x0 RTE_RL_UWORD 0 NO_COMPU_METHOD 0 65535 MATRIX_DIM 2 4 1 SYMBOL_LINK "Rte_CalprmRom_CalRegn03Rt01GroupB_DEFAULT_RTE_CALPRM_GROUP.EotProtnHwDegDampgX_Ary2D" 0 DISPLAY_IDENTIFIER CalRegn03Rt01GroupB_Dummy.CalibrationPorts.EotProtnHwDegDampgX.Ary2D /end CHARACTERISTIC
/begin CHARACTERISTIC CalRegn03Rt01GroupB_Dummy.EotProtnNormDampgY.Ary2D "MICROSAR RTE" VAL_BLK 0x0 RTE_RL_UWORD 0 NO_COMPU_METHOD 0 65535 MATRIX_DIM 2 4 1 SYMBOL_LINK "Rte_CalprmRom_CalRegn03Rt01GroupB_DEFAULT_RTE_CALPRM_GROUP.EotProtnNormDampgY_Ary2D" 0 DISPLAY_IDENTIFIER CalRegn03Rt01GroupB_Dummy.CalibrationPorts.EotProtnNormDampgY.Ary2D /end CHARACTERISTIC
/begin CHARACTERISTIC CalRegn03Rt01GroupB_Dummy.InertiaCmpVelAssiBasdDampgRollgWhlImbRejctnOnY.Ary1D "MICROSAR RTE" VAL_BLK 0x0 RTE_RL_UWORD 0 NO_COMPU_METHOD 0 65535 MATRIX_DIM 10 1 1 SYMBOL_LINK "Rte_CalprmRom_CalRegn03Rt01GroupB_DEFAULT_RTE_CALPRM_GROUP.InertiaCmpVelAssiBasdDampgRollgWhlImbRejctnOnY_Ary1D" 0 DISPLAY_IDENTIFIER CalRegn03Rt01GroupB_Dummy.CalibrationPorts.InertiaCmpVelAssiBasdDampgRollgWhlImbRejctnOnY.Ary1D /end CHARACTERISTIC
/begin CHARACTERISTIC CalRegn03Rt01GroupB_Dummy_1.AssiHiFrqTqWhlImbRejctnTqX.Ary2D "MICROSAR RTE" VAL_BLK 0x0 RTE_RL_UWORD 0 NO_COMPU_METHOD 0 65535 MATRIX_DIM 13 12 1 SYMBOL_LINK "Rte_CalprmRom_CalRegn03Rt02GroupB_DEFAULT_RTE_CALPRM_GROUP.AssiHiFrqTqWhlImbRejctnTqX_Ary2D" 0 DISPLAY_IDENTIFIER CalRegn03Rt01GroupB_Dummy_1.CalibrationPorts.AssiHiFrqTqWhlImbRejctnTqX.Ary2D /end CHARACTERISTIC
/begin CHARACTERISTIC CalRegn03Rt01GroupB_Dummy_1.AssiHiFrqWhlImbRejctnGainY.Ary2D "MICROSAR RTE" VAL_BLK 0x0 RTE_RL_UWORD 0 NO_COMPU_METHOD 0 65535 MATRIX_DIM 13 12 1 SYMBOL_LINK "Rte_CalprmRom_CalRegn03Rt02GroupB_DEFAULT_RTE_CALPRM_GROUP.AssiHiFrqWhlImbRejctnGainY_Ary2D" 0 DISPLAY_IDENTIFIER CalRegn03Rt01GroupB_Dummy_1.CalibrationPorts.AssiHiFrqWhlImbRejctnGainY.Ary2D /end CHARACTERISTIC
/begin CHARACTERISTIC CalRegn03Rt01GroupB_Dummy_1.AssiHiFrqWhlImbRejtcnBlndX.Ary2D "MICROSAR RTE" VAL_BLK 0x0 RTE_RL_UWORD 0 NO_COMPU_METHOD 0 65535 MATRIX_DIM 5 12 1 SYMBOL_LINK "Rte_CalprmRom_CalRegn03Rt02GroupB_DEFAULT_RTE_CALPRM_GROUP.AssiHiFrqWhlImbRejtcnBlndX_Ary2D" 0 DISPLAY_IDENTIFIER CalRegn03Rt01GroupB_Dummy_1.CalibrationPorts.AssiHiFrqWhlImbRejtcnBlndX.Ary2D /end CHARACTERISTIC
/begin CHARACTERISTIC CalRegn03Rt01GroupB_Dummy_1.AssiHiFrqWhlImbRejtcnBlndY.Ary2D "MICROSAR RTE" VAL_BLK 0x0 RTE_RL_UWORD 0 NO_COMPU_METHOD 0 65535 MATRIX_DIM 5 12 1 SYMBOL_LINK "Rte_CalprmRom_CalRegn03Rt02GroupB_DEFAULT_RTE_CALPRM_GROUP.AssiHiFrqWhlImbRejtcnBlndY_Ary2D" 0 DISPLAY_IDENTIFIER CalRegn03Rt01GroupB_Dummy_1.CalibrationPorts.AssiHiFrqWhlImbRejtcnBlndY.Ary2D /end CHARACTERISTIC
/begin CHARACTERISTIC CalRegn03Rt01GroupB_Dummy_1.AssiMotTqWhlImbRejctnMaxX.Ary2D "MICROSAR RTE" VAL_BLK 0x0 RTE_RL_UWORD 0 NO_COMPU_METHOD 0 65535 MATRIX_DIM 20 12 1 SYMBOL_LINK "Rte_CalprmRom_CalRegn03Rt02GroupB_DEFAULT_RTE_CALPRM_GROUP.AssiMotTqWhlImbRejctnMaxX_Ary2D" 0 DISPLAY_IDENTIFIER CalRegn03Rt01GroupB_Dummy_1.CalibrationPorts.AssiMotTqWhlImbRejctnMaxX.Ary2D /end CHARACTERISTIC
/begin CHARACTERISTIC CalRegn03Rt01GroupB_Dummy_1.AssiMotTqWhlImbRejctnMaxY.Ary2D "MICROSAR RTE" VAL_BLK 0x0 RTE_RL_SWORD 0 NO_COMPU_METHOD -32768 32767 MATRIX_DIM 20 12 1 SYMBOL_LINK "Rte_CalprmRom_CalRegn03Rt02GroupB_DEFAULT_RTE_CALPRM_GROUP.AssiMotTqWhlImbRejctnMaxY_Ary2D" 0 DISPLAY_IDENTIFIER CalRegn03Rt01GroupB_Dummy_1.CalibrationPorts.AssiMotTqWhlImbRejctnMaxY.Ary2D /end CHARACTERISTIC
/begin CHARACTERISTIC CalRegn03Rt01GroupB_Dummy_1.AssiWhlImbRejctnBlndScaX.Ary2D "MICROSAR RTE" VAL_BLK 0x0 RTE_RL_UWORD 0 NO_COMPU_METHOD 0 65535 MATRIX_DIM 5 12 1 SYMBOL_LINK "Rte_CalprmRom_CalRegn03Rt02GroupB_DEFAULT_RTE_CALPRM_GROUP.AssiWhlImbRejctnBlndScaX_Ary2D" 0 DISPLAY_IDENTIFIER CalRegn03Rt01GroupB_Dummy_1.CalibrationPorts.AssiWhlImbRejctnBlndScaX.Ary2D /end CHARACTERISTIC
/begin CHARACTERISTIC CalRegn03Rt01GroupB_Dummy_1.AssiWhlImbRejctnBlndScaY.Ary2D "MICROSAR RTE" VAL_BLK 0x0 RTE_RL_UWORD 0 NO_COMPU_METHOD 0 65535 MATRIX_DIM 5 12 1 SYMBOL_LINK "Rte_CalprmRom_CalRegn03Rt02GroupB_DEFAULT_RTE_CALPRM_GROUP.AssiWhlImbRejctnBlndScaY_Ary2D" 0 DISPLAY_IDENTIFIER CalRegn03Rt01GroupB_Dummy_1.CalibrationPorts.AssiWhlImbRejctnBlndScaY.Ary2D /end CHARACTERISTIC
/begin CHARACTERISTIC CalRegn03Rt01GroupB_Dummy_1.EotProtnDampgVehSpdTbl.Ary1D "MICROSAR RTE" VAL_BLK 0x0 RTE_RL_UWORD 0 NO_COMPU_METHOD 0 65535 MATRIX_DIM 4 1 1 SYMBOL_LINK "Rte_CalprmRom_CalRegn03Rt02GroupB_DEFAULT_RTE_CALPRM_GROUP.EotProtnDampgVehSpdTbl_Ary1D" 0 DISPLAY_IDENTIFIER CalRegn03Rt01GroupB_Dummy_1.CalibrationPorts.EotProtnDampgVehSpdTbl.Ary1D /end CHARACTERISTIC
/begin CHARACTERISTIC CalRegn03Rt01GroupB_Dummy_1.EotProtnEntrGainVehSpdTbl.Ary1D "MICROSAR RTE" VAL_BLK 0x0 RTE_RL_UWORD 0 NO_COMPU_METHOD 0 65535 MATRIX_DIM 5 1 1 SYMBOL_LINK "Rte_CalprmRom_CalRegn03Rt02GroupB_DEFAULT_RTE_CALPRM_GROUP.EotProtnEntrGainVehSpdTbl_Ary1D" 0 DISPLAY_IDENTIFIER CalRegn03Rt01GroupB_Dummy_1.CalibrationPorts.EotProtnEntrGainVehSpdTbl.Ary1D /end CHARACTERISTIC
/begin CHARACTERISTIC CalRegn03Rt01GroupB_Dummy_1.EotProtnEntrGainX.Ary2D "MICROSAR RTE" VAL_BLK 0x0 RTE_RL_UWORD 0 NO_COMPU_METHOD 0 65535 MATRIX_DIM 4 5 1 SYMBOL_LINK "Rte_CalprmRom_CalRegn03Rt02GroupB_DEFAULT_RTE_CALPRM_GROUP.EotProtnEntrGainX_Ary2D" 0 DISPLAY_IDENTIFIER CalRegn03Rt01GroupB_Dummy_1.CalibrationPorts.EotProtnEntrGainX.Ary2D /end CHARACTERISTIC
/begin CHARACTERISTIC CalRegn03Rt01GroupB_Dummy_1.EotProtnEntrGainY.Ary2D "MICROSAR RTE" VAL_BLK 0x0 RTE_RL_UWORD 0 NO_COMPU_METHOD 0 65535 MATRIX_DIM 4 5 1 SYMBOL_LINK "Rte_CalprmRom_CalRegn03Rt02GroupB_DEFAULT_RTE_CALPRM_GROUP.EotProtnEntrGainY_Ary2D" 0 DISPLAY_IDENTIFIER CalRegn03Rt01GroupB_Dummy_1.CalibrationPorts.EotProtnEntrGainY.Ary2D /end CHARACTERISTIC
/begin CHARACTERISTIC CalRegn03Rt01GroupB_Dummy_1.EotProtnExitDampgY.Ary2D "MICROSAR RTE" VAL_BLK 0x0 RTE_RL_UWORD 0 NO_COMPU_METHOD 0 65535 MATRIX_DIM 2 4 1 SYMBOL_LINK "Rte_CalprmRom_CalRegn03Rt02GroupB_DEFAULT_RTE_CALPRM_GROUP.EotProtnExitDampgY_Ary2D" 0 DISPLAY_IDENTIFIER CalRegn03Rt01GroupB_Dummy_1.CalibrationPorts.EotProtnExitDampgY.Ary2D /end CHARACTERISTIC
/begin CHARACTERISTIC CalRegn03Rt01GroupB_Dummy_1.EotProtnHwDegDampgX.Ary2D "MICROSAR RTE" VAL_BLK 0x0 RTE_RL_UWORD 0 NO_COMPU_METHOD 0 65535 MATRIX_DIM 2 4 1 SYMBOL_LINK "Rte_CalprmRom_CalRegn03Rt02GroupB_DEFAULT_RTE_CALPRM_GROUP.EotProtnHwDegDampgX_Ary2D" 0 DISPLAY_IDENTIFIER CalRegn03Rt01GroupB_Dummy_1.CalibrationPorts.EotProtnHwDegDampgX.Ary2D /end CHARACTERISTIC
/begin CHARACTERISTIC CalRegn03Rt01GroupB_Dummy_1.EotProtnNormDampgY.Ary2D "MICROSAR RTE" VAL_BLK 0x0 RTE_RL_UWORD 0 NO_COMPU_METHOD 0 65535 MATRIX_DIM 2 4 1 SYMBOL_LINK "Rte_CalprmRom_CalRegn03Rt02GroupB_DEFAULT_RTE_CALPRM_GROUP.EotProtnNormDampgY_Ary2D" 0 DISPLAY_IDENTIFIER CalRegn03Rt01GroupB_Dummy_1.CalibrationPorts.EotProtnNormDampgY.Ary2D /end CHARACTERISTIC
/begin CHARACTERISTIC CalRegn03Rt01GroupB_Dummy_1.InertiaCmpVelAssiBasdDampgRollgWhlImbRejctnOnY.Ary1D "MICROSAR RTE" VAL_BLK 0x0 RTE_RL_UWORD 0 NO_COMPU_METHOD 0 65535 MATRIX_DIM 10 1 1 SYMBOL_LINK "Rte_CalprmRom_CalRegn03Rt02GroupB_DEFAULT_RTE_CALPRM_GROUP.InertiaCmpVelAssiBasdDampgRollgWhlImbRejctnOnY_Ary1D" 0 DISPLAY_IDENTIFIER CalRegn03Rt01GroupB_Dummy_1.CalibrationPorts.InertiaCmpVelAssiBasdDampgRollgWhlImbRejctnOnY.Ary1D /end CHARACTERISTIC
/begin CHARACTERISTIC CalRegn03Rt01GroupB_Dummy_2.AssiHiFrqTqWhlImbRejctnTqX.Ary2D "MICROSAR RTE" VAL_BLK 0x0 RTE_RL_UWORD 0 NO_COMPU_METHOD 0 65535 MATRIX_DIM 13 12 1 SYMBOL_LINK "Rte_CalprmRom_CalRegn03Rt03GroupB_DEFAULT_RTE_CALPRM_GROUP.AssiHiFrqTqWhlImbRejctnTqX_Ary2D" 0 DISPLAY_IDENTIFIER CalRegn03Rt01GroupB_Dummy_2.CalibrationPorts.AssiHiFrqTqWhlImbRejctnTqX.Ary2D /end CHARACTERISTIC
/begin CHARACTERISTIC CalRegn03Rt01GroupB_Dummy_2.AssiHiFrqWhlImbRejctnGainY.Ary2D "MICROSAR RTE" VAL_BLK 0x0 RTE_RL_UWORD 0 NO_COMPU_METHOD 0 65535 MATRIX_DIM 13 12 1 SYMBOL_LINK "Rte_CalprmRom_CalRegn03Rt03GroupB_DEFAULT_RTE_CALPRM_GROUP.AssiHiFrqWhlImbRejctnGainY_Ary2D" 0 DISPLAY_IDENTIFIER CalRegn03Rt01GroupB_Dummy_2.CalibrationPorts.AssiHiFrqWhlImbRejctnGainY.Ary2D /end CHARACTERISTIC
/begin CHARACTERISTIC CalRegn03Rt01GroupB_Dummy_2.AssiHiFrqWhlImbRejtcnBlndX.Ary2D "MICROSAR RTE" VAL_BLK 0x0 RTE_RL_UWORD 0 NO_COMPU_METHOD 0 65535 MATRIX_DIM 5 12 1 SYMBOL_LINK "Rte_CalprmRom_CalRegn03Rt03GroupB_DEFAULT_RTE_CALPRM_GROUP.AssiHiFrqWhlImbRejtcnBlndX_Ary2D" 0 DISPLAY_IDENTIFIER CalRegn03Rt01GroupB_Dummy_2.CalibrationPorts.AssiHiFrqWhlImbRejtcnBlndX.Ary2D /end CHARACTERISTIC
/begin CHARACTERISTIC CalRegn03Rt01GroupB_Dummy_2.AssiHiFrqWhlImbRejtcnBlndY.Ary2D "MICROSAR RTE" VAL_BLK 0x0 RTE_RL_UWORD 0 NO_COMPU_METHOD 0 65535 MATRIX_DIM 5 12 1 SYMBOL_LINK "Rte_CalprmRom_CalRegn03Rt03GroupB_DEFAULT_RTE_CALPRM_GROUP.AssiHiFrqWhlImbRejtcnBlndY_Ary2D" 0 DISPLAY_IDENTIFIER CalRegn03Rt01GroupB_Dummy_2.CalibrationPorts.AssiHiFrqWhlImbRejtcnBlndY.Ary2D /end CHARACTERISTIC
/begin CHARACTERISTIC CalRegn03Rt01GroupB_Dummy_2.AssiMotTqWhlImbRejctnMaxX.Ary2D "MICROSAR RTE" VAL_BLK 0x0 RTE_RL_UWORD 0 NO_COMPU_METHOD 0 65535 MATRIX_DIM 20 12 1 SYMBOL_LINK "Rte_CalprmRom_CalRegn03Rt03GroupB_DEFAULT_RTE_CALPRM_GROUP.AssiMotTqWhlImbRejctnMaxX_Ary2D" 0 DISPLAY_IDENTIFIER CalRegn03Rt01GroupB_Dummy_2.CalibrationPorts.AssiMotTqWhlImbRejctnMaxX.Ary2D /end CHARACTERISTIC
/begin CHARACTERISTIC CalRegn03Rt01GroupB_Dummy_2.AssiMotTqWhlImbRejctnMaxY.Ary2D "MICROSAR RTE" VAL_BLK 0x0 RTE_RL_SWORD 0 NO_COMPU_METHOD -32768 32767 MATRIX_DIM 20 12 1 SYMBOL_LINK "Rte_CalprmRom_CalRegn03Rt03GroupB_DEFAULT_RTE_CALPRM_GROUP.AssiMotTqWhlImbRejctnMaxY_Ary2D" 0 DISPLAY_IDENTIFIER CalRegn03Rt01GroupB_Dummy_2.CalibrationPorts.AssiMotTqWhlImbRejctnMaxY.Ary2D /end CHARACTERISTIC
/begin CHARACTERISTIC CalRegn03Rt01GroupB_Dummy_2.AssiWhlImbRejctnBlndScaX.Ary2D "MICROSAR RTE" VAL_BLK 0x0 RTE_RL_UWORD 0 NO_COMPU_METHOD 0 65535 MATRIX_DIM 5 12 1 SYMBOL_LINK "Rte_CalprmRom_CalRegn03Rt03GroupB_DEFAULT_RTE_CALPRM_GROUP.AssiWhlImbRejctnBlndScaX_Ary2D" 0 DISPLAY_IDENTIFIER CalRegn03Rt01GroupB_Dummy_2.CalibrationPorts.AssiWhlImbRejctnBlndScaX.Ary2D /end CHARACTERISTIC
/begin CHARACTERISTIC CalRegn03Rt01GroupB_Dummy_2.AssiWhlImbRejctnBlndScaY.Ary2D "MICROSAR RTE" VAL_BLK 0x0 RTE_RL_UWORD 0 NO_COMPU_METHOD 0 65535 MATRIX_DIM 5 12 1 SYMBOL_LINK "Rte_CalprmRom_CalRegn03Rt03GroupB_DEFAULT_RTE_CALPRM_GROUP.AssiWhlImbRejctnBlndScaY_Ary2D" 0 DISPLAY_IDENTIFIER CalRegn03Rt01GroupB_Dummy_2.CalibrationPorts.AssiWhlImbRejctnBlndScaY.Ary2D /end CHARACTERISTIC
/begin CHARACTERISTIC CalRegn03Rt01GroupB_Dummy_2.EotProtnDampgVehSpdTbl.Ary1D "MICROSAR RTE" VAL_BLK 0x0 RTE_RL_UWORD 0 NO_COMPU_METHOD 0 65535 MATRIX_DIM 4 1 1 SYMBOL_LINK "Rte_CalprmRom_CalRegn03Rt03GroupB_DEFAULT_RTE_CALPRM_GROUP.EotProtnDampgVehSpdTbl_Ary1D" 0 DISPLAY_IDENTIFIER CalRegn03Rt01GroupB_Dummy_2.CalibrationPorts.EotProtnDampgVehSpdTbl.Ary1D /end CHARACTERISTIC
/begin CHARACTERISTIC CalRegn03Rt01GroupB_Dummy_2.EotProtnEntrGainVehSpdTbl.Ary1D "MICROSAR RTE" VAL_BLK 0x0 RTE_RL_UWORD 0 NO_COMPU_METHOD 0 65535 MATRIX_DIM 5 1 1 SYMBOL_LINK "Rte_CalprmRom_CalRegn03Rt03GroupB_DEFAULT_RTE_CALPRM_GROUP.EotProtnEntrGainVehSpdTbl_Ary1D" 0 DISPLAY_IDENTIFIER CalRegn03Rt01GroupB_Dummy_2.CalibrationPorts.EotProtnEntrGainVehSpdTbl.Ary1D /end CHARACTERISTIC
/begin CHARACTERISTIC CalRegn03Rt01GroupB_Dummy_2.EotProtnEntrGainX.Ary2D "MICROSAR RTE" VAL_BLK 0x0 RTE_RL_UWORD 0 NO_COMPU_METHOD 0 65535 MATRIX_DIM 4 5 1 SYMBOL_LINK "Rte_CalprmRom_CalRegn03Rt03GroupB_DEFAULT_RTE_CALPRM_GROUP.EotProtnEntrGainX_Ary2D" 0 DISPLAY_IDENTIFIER CalRegn03Rt01GroupB_Dummy_2.CalibrationPorts.EotProtnEntrGainX.Ary2D /end CHARACTERISTIC
/begin CHARACTERISTIC CalRegn03Rt01GroupB_Dummy_2.EotProtnEntrGainY.Ary2D "MICROSAR RTE" VAL_BLK 0x0 RTE_RL_UWORD 0 NO_COMPU_METHOD 0 65535 MATRIX_DIM 4 5 1 SYMBOL_LINK "Rte_CalprmRom_CalRegn03Rt03GroupB_DEFAULT_RTE_CALPRM_GROUP.EotProtnEntrGainY_Ary2D" 0 DISPLAY_IDENTIFIER CalRegn03Rt01GroupB_Dummy_2.CalibrationPorts.EotProtnEntrGainY.Ary2D /end CHARACTERISTIC
/begin CHARACTERISTIC CalRegn03Rt01GroupB_Dummy_2.EotProtnExitDampgY.Ary2D "MICROSAR RTE" VAL_BLK 0x0 RTE_RL_UWORD 0 NO_COMPU_METHOD 0 65535 MATRIX_DIM 2 4 1 SYMBOL_LINK "Rte_CalprmRom_CalRegn03Rt03GroupB_DEFAULT_RTE_CALPRM_GROUP.EotProtnExitDampgY_Ary2D" 0 DISPLAY_IDENTIFIER CalRegn03Rt01GroupB_Dummy_2.CalibrationPorts.EotProtnExitDampgY.Ary2D /end CHARACTERISTIC
/begin CHARACTERISTIC CalRegn03Rt01GroupB_Dummy_2.EotProtnHwDegDampgX.Ary2D "MICROSAR RTE" VAL_BLK 0x0 RTE_RL_UWORD 0 NO_COMPU_METHOD 0 65535 MATRIX_DIM 2 4 1 SYMBOL_LINK "Rte_CalprmRom_CalRegn03Rt03GroupB_DEFAULT_RTE_CALPRM_GROUP.EotProtnHwDegDampgX_Ary2D" 0 DISPLAY_IDENTIFIER CalRegn03Rt01GroupB_Dummy_2.CalibrationPorts.EotProtnHwDegDampgX.Ary2D /end CHARACTERISTIC
/begin CHARACTERISTIC CalRegn03Rt01GroupB_Dummy_2.EotProtnNormDampgY.Ary2D "MICROSAR RTE" VAL_BLK 0x0 RTE_RL_UWORD 0 NO_COMPU_METHOD 0 65535 MATRIX_DIM 2 4 1 SYMBOL_LINK "Rte_CalprmRom_CalRegn03Rt03GroupB_DEFAULT_RTE_CALPRM_GROUP.EotProtnNormDampgY_Ary2D" 0 DISPLAY_IDENTIFIER CalRegn03Rt01GroupB_Dummy_2.CalibrationPorts.EotProtnNormDampgY.Ary2D /end CHARACTERISTIC
/begin CHARACTERISTIC CalRegn03Rt01GroupB_Dummy_2.InertiaCmpVelAssiBasdDampgRollgWhlImbRejctnOnY.Ary1D "MICROSAR RTE" VAL_BLK 0x0 RTE_RL_UWORD 0 NO_COMPU_METHOD 0 65535 MATRIX_DIM 10 1 1 SYMBOL_LINK "Rte_CalprmRom_CalRegn03Rt03GroupB_DEFAULT_RTE_CALPRM_GROUP.InertiaCmpVelAssiBasdDampgRollgWhlImbRejctnOnY_Ary1D" 0 DISPLAY_IDENTIFIER CalRegn03Rt01GroupB_Dummy_2.CalibrationPorts.InertiaCmpVelAssiBasdDampgRollgWhlImbRejctnOnY.Ary1D /end CHARACTERISTIC
/begin CHARACTERISTIC CalRegn03Rt01GroupB_Dummy_3.AssiHiFrqTqWhlImbRejctnTqX.Ary2D "MICROSAR RTE" VAL_BLK 0x0 RTE_RL_UWORD 0 NO_COMPU_METHOD 0 65535 MATRIX_DIM 13 12 1 SYMBOL_LINK "Rte_CalprmRom_CalRegn03Rt04GroupB_DEFAULT_RTE_CALPRM_GROUP.AssiHiFrqTqWhlImbRejctnTqX_Ary2D" 0 DISPLAY_IDENTIFIER CalRegn03Rt01GroupB_Dummy_3.CalibrationPorts.AssiHiFrqTqWhlImbRejctnTqX.Ary2D /end CHARACTERISTIC
/begin CHARACTERISTIC CalRegn03Rt01GroupB_Dummy_3.AssiHiFrqWhlImbRejctnGainY.Ary2D "MICROSAR RTE" VAL_BLK 0x0 RTE_RL_UWORD 0 NO_COMPU_METHOD 0 65535 MATRIX_DIM 13 12 1 SYMBOL_LINK "Rte_CalprmRom_CalRegn03Rt04GroupB_DEFAULT_RTE_CALPRM_GROUP.AssiHiFrqWhlImbRejctnGainY_Ary2D" 0 DISPLAY_IDENTIFIER CalRegn03Rt01GroupB_Dummy_3.CalibrationPorts.AssiHiFrqWhlImbRejctnGainY.Ary2D /end CHARACTERISTIC
/begin CHARACTERISTIC CalRegn03Rt01GroupB_Dummy_3.AssiHiFrqWhlImbRejtcnBlndX.Ary2D "MICROSAR RTE" VAL_BLK 0x0 RTE_RL_UWORD 0 NO_COMPU_METHOD 0 65535 MATRIX_DIM 5 12 1 SYMBOL_LINK "Rte_CalprmRom_CalRegn03Rt04GroupB_DEFAULT_RTE_CALPRM_GROUP.AssiHiFrqWhlImbRejtcnBlndX_Ary2D" 0 DISPLAY_IDENTIFIER CalRegn03Rt01GroupB_Dummy_3.CalibrationPorts.AssiHiFrqWhlImbRejtcnBlndX.Ary2D /end CHARACTERISTIC
/begin CHARACTERISTIC CalRegn03Rt01GroupB_Dummy_3.AssiHiFrqWhlImbRejtcnBlndY.Ary2D "MICROSAR RTE" VAL_BLK 0x0 RTE_RL_UWORD 0 NO_COMPU_METHOD 0 65535 MATRIX_DIM 5 12 1 SYMBOL_LINK "Rte_CalprmRom_CalRegn03Rt04GroupB_DEFAULT_RTE_CALPRM_GROUP.AssiHiFrqWhlImbRejtcnBlndY_Ary2D" 0 DISPLAY_IDENTIFIER CalRegn03Rt01GroupB_Dummy_3.CalibrationPorts.AssiHiFrqWhlImbRejtcnBlndY.Ary2D /end CHARACTERISTIC
/begin CHARACTERISTIC CalRegn03Rt01GroupB_Dummy_3.AssiMotTqWhlImbRejctnMaxX.Ary2D "MICROSAR RTE" VAL_BLK 0x0 RTE_RL_UWORD 0 NO_COMPU_METHOD 0 65535 MATRIX_DIM 20 12 1 SYMBOL_LINK "Rte_CalprmRom_CalRegn03Rt04GroupB_DEFAULT_RTE_CALPRM_GROUP.AssiMotTqWhlImbRejctnMaxX_Ary2D" 0 DISPLAY_IDENTIFIER CalRegn03Rt01GroupB_Dummy_3.CalibrationPorts.AssiMotTqWhlImbRejctnMaxX.Ary2D /end CHARACTERISTIC
/begin CHARACTERISTIC CalRegn03Rt01GroupB_Dummy_3.AssiMotTqWhlImbRejctnMaxY.Ary2D "MICROSAR RTE" VAL_BLK 0x0 RTE_RL_SWORD 0 NO_COMPU_METHOD -32768 32767 MATRIX_DIM 20 12 1 SYMBOL_LINK "Rte_CalprmRom_CalRegn03Rt04GroupB_DEFAULT_RTE_CALPRM_GROUP.AssiMotTqWhlImbRejctnMaxY_Ary2D" 0 DISPLAY_IDENTIFIER CalRegn03Rt01GroupB_Dummy_3.CalibrationPorts.AssiMotTqWhlImbRejctnMaxY.Ary2D /end CHARACTERISTIC
/begin CHARACTERISTIC CalRegn03Rt01GroupB_Dummy_3.AssiWhlImbRejctnBlndScaX.Ary2D "MICROSAR RTE" VAL_BLK 0x0 RTE_RL_UWORD 0 NO_COMPU_METHOD 0 65535 MATRIX_DIM 5 12 1 SYMBOL_LINK "Rte_CalprmRom_CalRegn03Rt04GroupB_DEFAULT_RTE_CALPRM_GROUP.AssiWhlImbRejctnBlndScaX_Ary2D" 0 DISPLAY_IDENTIFIER CalRegn03Rt01GroupB_Dummy_3.CalibrationPorts.AssiWhlImbRejctnBlndScaX.Ary2D /end CHARACTERISTIC
/begin CHARACTERISTIC CalRegn03Rt01GroupB_Dummy_3.AssiWhlImbRejctnBlndScaY.Ary2D "MICROSAR RTE" VAL_BLK 0x0 RTE_RL_UWORD 0 NO_COMPU_METHOD 0 65535 MATRIX_DIM 5 12 1 SYMBOL_LINK "Rte_CalprmRom_CalRegn03Rt04GroupB_DEFAULT_RTE_CALPRM_GROUP.AssiWhlImbRejctnBlndScaY_Ary2D" 0 DISPLAY_IDENTIFIER CalRegn03Rt01GroupB_Dummy_3.CalibrationPorts.AssiWhlImbRejctnBlndScaY.Ary2D /end CHARACTERISTIC
/begin CHARACTERISTIC CalRegn03Rt01GroupB_Dummy_3.EotProtnDampgVehSpdTbl.Ary1D "MICROSAR RTE" VAL_BLK 0x0 RTE_RL_UWORD 0 NO_COMPU_METHOD 0 65535 MATRIX_DIM 4 1 1 SYMBOL_LINK "Rte_CalprmRom_CalRegn03Rt04GroupB_DEFAULT_RTE_CALPRM_GROUP.EotProtnDampgVehSpdTbl_Ary1D" 0 DISPLAY_IDENTIFIER CalRegn03Rt01GroupB_Dummy_3.CalibrationPorts.EotProtnDampgVehSpdTbl.Ary1D /end CHARACTERISTIC
/begin CHARACTERISTIC CalRegn03Rt01GroupB_Dummy_3.EotProtnEntrGainVehSpdTbl.Ary1D "MICROSAR RTE" VAL_BLK 0x0 RTE_RL_UWORD 0 NO_COMPU_METHOD 0 65535 MATRIX_DIM 5 1 1 SYMBOL_LINK "Rte_CalprmRom_CalRegn03Rt04GroupB_DEFAULT_RTE_CALPRM_GROUP.EotProtnEntrGainVehSpdTbl_Ary1D" 0 DISPLAY_IDENTIFIER CalRegn03Rt01GroupB_Dummy_3.CalibrationPorts.EotProtnEntrGainVehSpdTbl.Ary1D /end CHARACTERISTIC
/begin CHARACTERISTIC CalRegn03Rt01GroupB_Dummy_3.EotProtnEntrGainX.Ary2D "MICROSAR RTE" VAL_BLK 0x0 RTE_RL_UWORD 0 NO_COMPU_METHOD 0 65535 MATRIX_DIM 4 5 1 SYMBOL_LINK "Rte_CalprmRom_CalRegn03Rt04GroupB_DEFAULT_RTE_CALPRM_GROUP.EotProtnEntrGainX_Ary2D" 0 DISPLAY_IDENTIFIER CalRegn03Rt01GroupB_Dummy_3.CalibrationPorts.EotProtnEntrGainX.Ary2D /end CHARACTERISTIC
/begin CHARACTERISTIC CalRegn03Rt01GroupB_Dummy_3.EotProtnEntrGainY.Ary2D "MICROSAR RTE" VAL_BLK 0x0 RTE_RL_UWORD 0 NO_COMPU_METHOD 0 65535 MATRIX_DIM 4 5 1 SYMBOL_LINK "Rte_CalprmRom_CalRegn03Rt04GroupB_DEFAULT_RTE_CALPRM_GROUP.EotProtnEntrGainY_Ary2D" 0 DISPLAY_IDENTIFIER CalRegn03Rt01GroupB_Dummy_3.CalibrationPorts.EotProtnEntrGainY.Ary2D /end CHARACTERISTIC
/begin CHARACTERISTIC CalRegn03Rt01GroupB_Dummy_3.EotProtnExitDampgY.Ary2D "MICROSAR RTE" VAL_BLK 0x0 RTE_RL_UWORD 0 NO_COMPU_METHOD 0 65535 MATRIX_DIM 2 4 1 SYMBOL_LINK "Rte_CalprmRom_CalRegn03Rt04GroupB_DEFAULT_RTE_CALPRM_GROUP.EotProtnExitDampgY_Ary2D" 0 DISPLAY_IDENTIFIER CalRegn03Rt01GroupB_Dummy_3.CalibrationPorts.EotProtnExitDampgY.Ary2D /end CHARACTERISTIC
/begin CHARACTERISTIC CalRegn03Rt01GroupB_Dummy_3.EotProtnHwDegDampgX.Ary2D "MICROSAR RTE" VAL_BLK 0x0 RTE_RL_UWORD 0 NO_COMPU_METHOD 0 65535 MATRIX_DIM 2 4 1 SYMBOL_LINK "Rte_CalprmRom_CalRegn03Rt04GroupB_DEFAULT_RTE_CALPRM_GROUP.EotProtnHwDegDampgX_Ary2D" 0 DISPLAY_IDENTIFIER CalRegn03Rt01GroupB_Dummy_3.CalibrationPorts.EotProtnHwDegDampgX.Ary2D /end CHARACTERISTIC
/begin CHARACTERISTIC CalRegn03Rt01GroupB_Dummy_3.EotProtnNormDampgY.Ary2D "MICROSAR RTE" VAL_BLK 0x0 RTE_RL_UWORD 0 NO_COMPU_METHOD 0 65535 MATRIX_DIM 2 4 1 SYMBOL_LINK "Rte_CalprmRom_CalRegn03Rt04GroupB_DEFAULT_RTE_CALPRM_GROUP.EotProtnNormDampgY_Ary2D" 0 DISPLAY_IDENTIFIER CalRegn03Rt01GroupB_Dummy_3.CalibrationPorts.EotProtnNormDampgY.Ary2D /end CHARACTERISTIC
/begin CHARACTERISTIC CalRegn03Rt01GroupB_Dummy_3.InertiaCmpVelAssiBasdDampgRollgWhlImbRejctnOnY.Ary1D "MICROSAR RTE" VAL_BLK 0x0 RTE_RL_UWORD 0 NO_COMPU_METHOD 0 65535 MATRIX_DIM 10 1 1 SYMBOL_LINK "Rte_CalprmRom_CalRegn03Rt04GroupB_DEFAULT_RTE_CALPRM_GROUP.InertiaCmpVelAssiBasdDampgRollgWhlImbRejctnOnY_Ary1D" 0 DISPLAY_IDENTIFIER CalRegn03Rt01GroupB_Dummy_3.CalibrationPorts.InertiaCmpVelAssiBasdDampgRollgWhlImbRejctnOnY.Ary1D /end CHARACTERISTIC
/begin CHARACTERISTIC CalRegn03Rt01GroupB_Dummy_4.AssiHiFrqTqWhlImbRejctnTqX.Ary2D "MICROSAR RTE" VAL_BLK 0x0 RTE_RL_UWORD 0 NO_COMPU_METHOD 0 65535 MATRIX_DIM 13 12 1 SYMBOL_LINK "Rte_CalprmRom_CalRegn03Rt00GroupB_DEFAULT_RTE_CALPRM_GROUP.AssiHiFrqTqWhlImbRejctnTqX_Ary2D" 0 DISPLAY_IDENTIFIER CalRegn03Rt01GroupB_Dummy_4.CalibrationPorts.AssiHiFrqTqWhlImbRejctnTqX.Ary2D /end CHARACTERISTIC
/begin CHARACTERISTIC CalRegn03Rt01GroupB_Dummy_4.AssiHiFrqWhlImbRejctnGainY.Ary2D "MICROSAR RTE" VAL_BLK 0x0 RTE_RL_UWORD 0 NO_COMPU_METHOD 0 65535 MATRIX_DIM 13 12 1 SYMBOL_LINK "Rte_CalprmRom_CalRegn03Rt00GroupB_DEFAULT_RTE_CALPRM_GROUP.AssiHiFrqWhlImbRejctnGainY_Ary2D" 0 DISPLAY_IDENTIFIER CalRegn03Rt01GroupB_Dummy_4.CalibrationPorts.AssiHiFrqWhlImbRejctnGainY.Ary2D /end CHARACTERISTIC
/begin CHARACTERISTIC CalRegn03Rt01GroupB_Dummy_4.AssiHiFrqWhlImbRejtcnBlndX.Ary2D "MICROSAR RTE" VAL_BLK 0x0 RTE_RL_UWORD 0 NO_COMPU_METHOD 0 65535 MATRIX_DIM 5 12 1 SYMBOL_LINK "Rte_CalprmRom_CalRegn03Rt00GroupB_DEFAULT_RTE_CALPRM_GROUP.AssiHiFrqWhlImbRejtcnBlndX_Ary2D" 0 DISPLAY_IDENTIFIER CalRegn03Rt01GroupB_Dummy_4.CalibrationPorts.AssiHiFrqWhlImbRejtcnBlndX.Ary2D /end CHARACTERISTIC
/begin CHARACTERISTIC CalRegn03Rt01GroupB_Dummy_4.AssiHiFrqWhlImbRejtcnBlndY.Ary2D "MICROSAR RTE" VAL_BLK 0x0 RTE_RL_UWORD 0 NO_COMPU_METHOD 0 65535 MATRIX_DIM 5 12 1 SYMBOL_LINK "Rte_CalprmRom_CalRegn03Rt00GroupB_DEFAULT_RTE_CALPRM_GROUP.AssiHiFrqWhlImbRejtcnBlndY_Ary2D" 0 DISPLAY_IDENTIFIER CalRegn03Rt01GroupB_Dummy_4.CalibrationPorts.AssiHiFrqWhlImbRejtcnBlndY.Ary2D /end CHARACTERISTIC
/begin CHARACTERISTIC CalRegn03Rt01GroupB_Dummy_4.AssiMotTqWhlImbRejctnMaxX.Ary2D "MICROSAR RTE" VAL_BLK 0x0 RTE_RL_UWORD 0 NO_COMPU_METHOD 0 65535 MATRIX_DIM 20 12 1 SYMBOL_LINK "Rte_CalprmRom_CalRegn03Rt00GroupB_DEFAULT_RTE_CALPRM_GROUP.AssiMotTqWhlImbRejctnMaxX_Ary2D" 0 DISPLAY_IDENTIFIER CalRegn03Rt01GroupB_Dummy_4.CalibrationPorts.AssiMotTqWhlImbRejctnMaxX.Ary2D /end CHARACTERISTIC
/begin CHARACTERISTIC CalRegn03Rt01GroupB_Dummy_4.AssiMotTqWhlImbRejctnMaxY.Ary2D "MICROSAR RTE" VAL_BLK 0x0 RTE_RL_SWORD 0 NO_COMPU_METHOD -32768 32767 MATRIX_DIM 20 12 1 SYMBOL_LINK "Rte_CalprmRom_CalRegn03Rt00GroupB_DEFAULT_RTE_CALPRM_GROUP.AssiMotTqWhlImbRejctnMaxY_Ary2D" 0 DISPLAY_IDENTIFIER CalRegn03Rt01GroupB_Dummy_4.CalibrationPorts.AssiMotTqWhlImbRejctnMaxY.Ary2D /end CHARACTERISTIC
/begin CHARACTERISTIC CalRegn03Rt01GroupB_Dummy_4.AssiWhlImbRejctnBlndScaX.Ary2D "MICROSAR RTE" VAL_BLK 0x0 RTE_RL_UWORD 0 NO_COMPU_METHOD 0 65535 MATRIX_DIM 5 12 1 SYMBOL_LINK "Rte_CalprmRom_CalRegn03Rt00GroupB_DEFAULT_RTE_CALPRM_GROUP.AssiWhlImbRejctnBlndScaX_Ary2D" 0 DISPLAY_IDENTIFIER CalRegn03Rt01GroupB_Dummy_4.CalibrationPorts.AssiWhlImbRejctnBlndScaX.Ary2D /end CHARACTERISTIC
/begin CHARACTERISTIC CalRegn03Rt01GroupB_Dummy_4.AssiWhlImbRejctnBlndScaY.Ary2D "MICROSAR RTE" VAL_BLK 0x0 RTE_RL_UWORD 0 NO_COMPU_METHOD 0 65535 MATRIX_DIM 5 12 1 SYMBOL_LINK "Rte_CalprmRom_CalRegn03Rt00GroupB_DEFAULT_RTE_CALPRM_GROUP.AssiWhlImbRejctnBlndScaY_Ary2D" 0 DISPLAY_IDENTIFIER CalRegn03Rt01GroupB_Dummy_4.CalibrationPorts.AssiWhlImbRejctnBlndScaY.Ary2D /end CHARACTERISTIC
/begin CHARACTERISTIC CalRegn03Rt01GroupB_Dummy_4.EotProtnDampgVehSpdTbl.Ary1D "MICROSAR RTE" VAL_BLK 0x0 RTE_RL_UWORD 0 NO_COMPU_METHOD 0 65535 MATRIX_DIM 4 1 1 SYMBOL_LINK "Rte_CalprmRom_CalRegn03Rt00GroupB_DEFAULT_RTE_CALPRM_GROUP.EotProtnDampgVehSpdTbl_Ary1D" 0 DISPLAY_IDENTIFIER CalRegn03Rt01GroupB_Dummy_4.CalibrationPorts.EotProtnDampgVehSpdTbl.Ary1D /end CHARACTERISTIC
/begin CHARACTERISTIC CalRegn03Rt01GroupB_Dummy_4.EotProtnEntrGainVehSpdTbl.Ary1D "MICROSAR RTE" VAL_BLK 0x0 RTE_RL_UWORD 0 NO_COMPU_METHOD 0 65535 MATRIX_DIM 5 1 1 SYMBOL_LINK "Rte_CalprmRom_CalRegn03Rt00GroupB_DEFAULT_RTE_CALPRM_GROUP.EotProtnEntrGainVehSpdTbl_Ary1D" 0 DISPLAY_IDENTIFIER CalRegn03Rt01GroupB_Dummy_4.CalibrationPorts.EotProtnEntrGainVehSpdTbl.Ary1D /end CHARACTERISTIC
/begin CHARACTERISTIC CalRegn03Rt01GroupB_Dummy_4.EotProtnEntrGainX.Ary2D "MICROSAR RTE" VAL_BLK 0x0 RTE_RL_UWORD 0 NO_COMPU_METHOD 0 65535 MATRIX_DIM 4 5 1 SYMBOL_LINK "Rte_CalprmRom_CalRegn03Rt00GroupB_DEFAULT_RTE_CALPRM_GROUP.EotProtnEntrGainX_Ary2D" 0 DISPLAY_IDENTIFIER CalRegn03Rt01GroupB_Dummy_4.CalibrationPorts.EotProtnEntrGainX.Ary2D /end CHARACTERISTIC
/begin CHARACTERISTIC CalRegn03Rt01GroupB_Dummy_4.EotProtnEntrGainY.Ary2D "MICROSAR RTE" VAL_BLK 0x0 RTE_RL_UWORD 0 NO_COMPU_METHOD 0 65535 MATRIX_DIM 4 5 1 SYMBOL_LINK "Rte_CalprmRom_CalRegn03Rt00GroupB_DEFAULT_RTE_CALPRM_GROUP.EotProtnEntrGainY_Ary2D" 0 DISPLAY_IDENTIFIER CalRegn03Rt01GroupB_Dummy_4.CalibrationPorts.EotProtnEntrGainY.Ary2D /end CHARACTERISTIC
/begin CHARACTERISTIC CalRegn03Rt01GroupB_Dummy_4.EotProtnExitDampgY.Ary2D "MICROSAR RTE" VAL_BLK 0x0 RTE_RL_UWORD 0 NO_COMPU_METHOD 0 65535 MATRIX_DIM 2 4 1 SYMBOL_LINK "Rte_CalprmRom_CalRegn03Rt00GroupB_DEFAULT_RTE_CALPRM_GROUP.EotProtnExitDampgY_Ary2D" 0 DISPLAY_IDENTIFIER CalRegn03Rt01GroupB_Dummy_4.CalibrationPorts.EotProtnExitDampgY.Ary2D /end CHARACTERISTIC
/begin CHARACTERISTIC CalRegn03Rt01GroupB_Dummy_4.EotProtnHwDegDampgX.Ary2D "MICROSAR RTE" VAL_BLK 0x0 RTE_RL_UWORD 0 NO_COMPU_METHOD 0 65535 MATRIX_DIM 2 4 1 SYMBOL_LINK "Rte_CalprmRom_CalRegn03Rt00GroupB_DEFAULT_RTE_CALPRM_GROUP.EotProtnHwDegDampgX_Ary2D" 0 DISPLAY_IDENTIFIER CalRegn03Rt01GroupB_Dummy_4.CalibrationPorts.EotProtnHwDegDampgX.Ary2D /end CHARACTERISTIC
/begin CHARACTERISTIC CalRegn03Rt01GroupB_Dummy_4.EotProtnNormDampgY.Ary2D "MICROSAR RTE" VAL_BLK 0x0 RTE_RL_UWORD 0 NO_COMPU_METHOD 0 65535 MATRIX_DIM 2 4 1 SYMBOL_LINK "Rte_CalprmRom_CalRegn03Rt00GroupB_DEFAULT_RTE_CALPRM_GROUP.EotProtnNormDampgY_Ary2D" 0 DISPLAY_IDENTIFIER CalRegn03Rt01GroupB_Dummy_4.CalibrationPorts.EotProtnNormDampgY.Ary2D /end CHARACTERISTIC
/begin CHARACTERISTIC CalRegn03Rt01GroupB_Dummy_4.InertiaCmpVelAssiBasdDampgRollgWhlImbRejctnOnY.Ary1D "MICROSAR RTE" VAL_BLK 0x0 RTE_RL_UWORD 0 NO_COMPU_METHOD 0 65535 MATRIX_DIM 10 1 1 SYMBOL_LINK "Rte_CalprmRom_CalRegn03Rt00GroupB_DEFAULT_RTE_CALPRM_GROUP.InertiaCmpVelAssiBasdDampgRollgWhlImbRejctnOnY_Ary1D" 0 DISPLAY_IDENTIFIER CalRegn03Rt01GroupB_Dummy_4.CalibrationPorts.InertiaCmpVelAssiBasdDampgRollgWhlImbRejctnOnY.Ary1D /end CHARACTERISTIC
/begin CHARACTERISTIC CalRegn03Rt01_Dummy.InertiaCmpVelDampgFilFrq.Ary1D "MICROSAR RTE" VAL_BLK 0x0 RTE_RL_UWORD 0 NO_COMPU_METHOD 0 65535 MATRIX_DIM 12 1 1 SYMBOL_LINK "Rte_CalprmRom_CalRegn03Rt01_DEFAULT_RTE_CALPRM_GROUP.InertiaCmpVelDampgFilFrq_Ary1D" 0 DISPLAY_IDENTIFIER CalRegn03Rt01_Dummy.CalibrationPorts.InertiaCmpVelDampgFilFrq.Ary1D /end CHARACTERISTIC
/begin CHARACTERISTIC CalRegn03Rt01_Dummy.InertiaCmpVelDampgFilFrqWhlImbRejctnOn.Ary1D "MICROSAR RTE" VAL_BLK 0x0 RTE_RL_UWORD 0 NO_COMPU_METHOD 0 65535 MATRIX_DIM 12 1 1 SYMBOL_LINK "Rte_CalprmRom_CalRegn03Rt01_DEFAULT_RTE_CALPRM_GROUP.InertiaCmpVelDampgFilFrqWhlImbRejctnOn_Ary1D" 0 DISPLAY_IDENTIFIER CalRegn03Rt01_Dummy.CalibrationPorts.InertiaCmpVelDampgFilFrqWhlImbRejctnOn.Ary1D /end CHARACTERISTIC
/begin CHARACTERISTIC CalRegn03Rt01_Dummy_1.InertiaCmpVelDampgFilFrq.Ary1D "MICROSAR RTE" VAL_BLK 0x0 RTE_RL_UWORD 0 NO_COMPU_METHOD 0 65535 MATRIX_DIM 12 1 1 SYMBOL_LINK "Rte_CalprmRom_CalRegn03Rt02_DEFAULT_RTE_CALPRM_GROUP.InertiaCmpVelDampgFilFrq_Ary1D" 0 DISPLAY_IDENTIFIER CalRegn03Rt01_Dummy_1.CalibrationPorts.InertiaCmpVelDampgFilFrq.Ary1D /end CHARACTERISTIC
/begin CHARACTERISTIC CalRegn03Rt01_Dummy_1.InertiaCmpVelDampgFilFrqWhlImbRejctnOn.Ary1D "MICROSAR RTE" VAL_BLK 0x0 RTE_RL_UWORD 0 NO_COMPU_METHOD 0 65535 MATRIX_DIM 12 1 1 SYMBOL_LINK "Rte_CalprmRom_CalRegn03Rt02_DEFAULT_RTE_CALPRM_GROUP.InertiaCmpVelDampgFilFrqWhlImbRejctnOn_Ary1D" 0 DISPLAY_IDENTIFIER CalRegn03Rt01_Dummy_1.CalibrationPorts.InertiaCmpVelDampgFilFrqWhlImbRejctnOn.Ary1D /end CHARACTERISTIC
/begin CHARACTERISTIC CalRegn03Rt01_Dummy_2.InertiaCmpVelDampgFilFrq.Ary1D "MICROSAR RTE" VAL_BLK 0x0 RTE_RL_UWORD 0 NO_COMPU_METHOD 0 65535 MATRIX_DIM 12 1 1 SYMBOL_LINK "Rte_CalprmRom_CalRegn03Rt03_DEFAULT_RTE_CALPRM_GROUP.InertiaCmpVelDampgFilFrq_Ary1D" 0 DISPLAY_IDENTIFIER CalRegn03Rt01_Dummy_2.CalibrationPorts.InertiaCmpVelDampgFilFrq.Ary1D /end CHARACTERISTIC
/begin CHARACTERISTIC CalRegn03Rt01_Dummy_2.InertiaCmpVelDampgFilFrqWhlImbRejctnOn.Ary1D "MICROSAR RTE" VAL_BLK 0x0 RTE_RL_UWORD 0 NO_COMPU_METHOD 0 65535 MATRIX_DIM 12 1 1 SYMBOL_LINK "Rte_CalprmRom_CalRegn03Rt03_DEFAULT_RTE_CALPRM_GROUP.InertiaCmpVelDampgFilFrqWhlImbRejctnOn_Ary1D" 0 DISPLAY_IDENTIFIER CalRegn03Rt01_Dummy_2.CalibrationPorts.InertiaCmpVelDampgFilFrqWhlImbRejctnOn.Ary1D /end CHARACTERISTIC
/begin CHARACTERISTIC CalRegn03Rt01_Dummy_3.InertiaCmpVelDampgFilFrq.Ary1D "MICROSAR RTE" VAL_BLK 0x0 RTE_RL_UWORD 0 NO_COMPU_METHOD 0 65535 MATRIX_DIM 12 1 1 SYMBOL_LINK "Rte_CalprmRom_CalRegn03Rt04_DEFAULT_RTE_CALPRM_GROUP.InertiaCmpVelDampgFilFrq_Ary1D" 0 DISPLAY_IDENTIFIER CalRegn03Rt01_Dummy_3.CalibrationPorts.InertiaCmpVelDampgFilFrq.Ary1D /end CHARACTERISTIC
/begin CHARACTERISTIC CalRegn03Rt01_Dummy_3.InertiaCmpVelDampgFilFrqWhlImbRejctnOn.Ary1D "MICROSAR RTE" VAL_BLK 0x0 RTE_RL_UWORD 0 NO_COMPU_METHOD 0 65535 MATRIX_DIM 12 1 1 SYMBOL_LINK "Rte_CalprmRom_CalRegn03Rt04_DEFAULT_RTE_CALPRM_GROUP.InertiaCmpVelDampgFilFrqWhlImbRejctnOn_Ary1D" 0 DISPLAY_IDENTIFIER CalRegn03Rt01_Dummy_3.CalibrationPorts.InertiaCmpVelDampgFilFrqWhlImbRejctnOn.Ary1D /end CHARACTERISTIC
/begin CHARACTERISTIC CalRegn03Rt01_Dummy_4.InertiaCmpVelDampgFilFrq.Ary1D "MICROSAR RTE" VAL_BLK 0x0 RTE_RL_UWORD 0 NO_COMPU_METHOD 0 65535 MATRIX_DIM 12 1 1 SYMBOL_LINK "Rte_CalprmRom_CalRegn03Rt00_DEFAULT_RTE_CALPRM_GROUP.InertiaCmpVelDampgFilFrq_Ary1D" 0 DISPLAY_IDENTIFIER CalRegn03Rt01_Dummy_4.CalibrationPorts.InertiaCmpVelDampgFilFrq.Ary1D /end CHARACTERISTIC
/begin CHARACTERISTIC CalRegn03Rt01_Dummy_4.InertiaCmpVelDampgFilFrqWhlImbRejctnOn.Ary1D "MICROSAR RTE" VAL_BLK 0x0 RTE_RL_UWORD 0 NO_COMPU_METHOD 0 65535 MATRIX_DIM 12 1 1 SYMBOL_LINK "Rte_CalprmRom_CalRegn03Rt00_DEFAULT_RTE_CALPRM_GROUP.InertiaCmpVelDampgFilFrqWhlImbRejctnOn_Ary1D" 0 DISPLAY_IDENTIFIER CalRegn03Rt01_Dummy_4.CalibrationPorts.InertiaCmpVelDampgFilFrqWhlImbRejctnOn.Ary1D /end CHARACTERISTIC
/begin CHARACTERISTIC CalRegn03Rt02.InertiaCmpVelDampgFilFrq.Ary1D "MICROSAR RTE" VAL_BLK 0x0 RTE_RL_UWORD 0 NO_COMPU_METHOD 0 65535 MATRIX_DIM 12 1 1 SYMBOL_LINK "Rte_CalprmRom_CalRegn03Rt02_DEFAULT_RTE_CALPRM_GROUP.InertiaCmpVelDampgFilFrq_Ary1D" 0 DISPLAY_IDENTIFIER CalRegn03Rt02.CalibrationPorts.InertiaCmpVelDampgFilFrq.Ary1D /end CHARACTERISTIC
/begin CHARACTERISTIC CalRegn03Rt02.InertiaCmpVelDampgFilFrqWhlImbRejctnOn.Ary1D "MICROSAR RTE" VAL_BLK 0x0 RTE_RL_UWORD 0 NO_COMPU_METHOD 0 65535 MATRIX_DIM 12 1 1 SYMBOL_LINK "Rte_CalprmRom_CalRegn03Rt02_DEFAULT_RTE_CALPRM_GROUP.InertiaCmpVelDampgFilFrqWhlImbRejctnOn_Ary1D" 0 DISPLAY_IDENTIFIER CalRegn03Rt02.CalibrationPorts.InertiaCmpVelDampgFilFrqWhlImbRejctnOn.Ary1D /end CHARACTERISTIC
/begin CHARACTERISTIC CalRegn03Rt02GroupA.AssiHiFrqGainY.Ary2D "MICROSAR RTE" VAL_BLK 0x0 RTE_RL_UWORD 0 NO_COMPU_METHOD 0 65535 MATRIX_DIM 13 12 1 SYMBOL_LINK "Rte_CalprmRom_CalRegn03Rt02GroupA_DEFAULT_RTE_CALPRM_GROUP.AssiHiFrqGainY_Ary2D" 0 DISPLAY_IDENTIFIER CalRegn03Rt02GroupA.CalibrationPorts.AssiHiFrqGainY.Ary2D /end CHARACTERISTIC
/begin CHARACTERISTIC CalRegn03Rt02GroupA.AssiHiFrqTqX.Ary2D "MICROSAR RTE" VAL_BLK 0x0 RTE_RL_UWORD 0 NO_COMPU_METHOD 0 65535 MATRIX_DIM 13 12 1 SYMBOL_LINK "Rte_CalprmRom_CalRegn03Rt02GroupA_DEFAULT_RTE_CALPRM_GROUP.AssiHiFrqTqX_Ary2D" 0 DISPLAY_IDENTIFIER CalRegn03Rt02GroupA.CalibrationPorts.AssiHiFrqTqX.Ary2D /end CHARACTERISTIC
/begin CHARACTERISTIC CalRegn03Rt02GroupA.AssiMotTqWhlImbRejctnMinX.Ary2D "MICROSAR RTE" VAL_BLK 0x0 RTE_RL_UWORD 0 NO_COMPU_METHOD 0 65535 MATRIX_DIM 20 12 1 SYMBOL_LINK "Rte_CalprmRom_CalRegn03Rt02GroupA_DEFAULT_RTE_CALPRM_GROUP.AssiMotTqWhlImbRejctnMinX_Ary2D" 0 DISPLAY_IDENTIFIER CalRegn03Rt02GroupA.CalibrationPorts.AssiMotTqWhlImbRejctnMinX.Ary2D /end CHARACTERISTIC
/begin CHARACTERISTIC CalRegn03Rt02GroupA.AssiMotTqWhlImbRejctnMinY.Ary2D "MICROSAR RTE" VAL_BLK 0x0 RTE_RL_SWORD 0 NO_COMPU_METHOD -32768 32767 MATRIX_DIM 20 12 1 SYMBOL_LINK "Rte_CalprmRom_CalRegn03Rt02GroupA_DEFAULT_RTE_CALPRM_GROUP.AssiMotTqWhlImbRejctnMinY_Ary2D" 0 DISPLAY_IDENTIFIER CalRegn03Rt02GroupA.CalibrationPorts.AssiMotTqWhlImbRejctnMinY.Ary2D /end CHARACTERISTIC
/begin CHARACTERISTIC CalRegn03Rt02GroupA.DampgHydCoeff1ScaY.Ary1D "MICROSAR RTE" VAL_BLK 0x0 RTE_RL_UWORD 0 NO_COMPU_METHOD 0 65535 MATRIX_DIM 12 1 1 SYMBOL_LINK "Rte_CalprmRom_CalRegn03Rt02GroupA_DEFAULT_RTE_CALPRM_GROUP.DampgHydCoeff1ScaY_Ary1D" 0 DISPLAY_IDENTIFIER CalRegn03Rt02GroupA.CalibrationPorts.DampgHydCoeff1ScaY.Ary1D /end CHARACTERISTIC
/begin CHARACTERISTIC CalRegn03Rt02GroupA.DampgHydCoeff2ScaY.Ary1D "MICROSAR RTE" VAL_BLK 0x0 RTE_RL_UWORD 0 NO_COMPU_METHOD 0 65535 MATRIX_DIM 12 1 1 SYMBOL_LINK "Rte_CalprmRom_CalRegn03Rt02GroupA_DEFAULT_RTE_CALPRM_GROUP.DampgHydCoeff2ScaY_Ary1D" 0 DISPLAY_IDENTIFIER CalRegn03Rt02GroupA.CalibrationPorts.DampgHydCoeff2ScaY.Ary1D /end CHARACTERISTIC
/begin CHARACTERISTIC CalRegn03Rt02GroupA.DampgHydCoeff3ScaY.Ary1D "MICROSAR RTE" VAL_BLK 0x0 RTE_RL_UWORD 0 NO_COMPU_METHOD 0 65535 MATRIX_DIM 12 1 1 SYMBOL_LINK "Rte_CalprmRom_CalRegn03Rt02GroupA_DEFAULT_RTE_CALPRM_GROUP.DampgHydCoeff3ScaY_Ary1D" 0 DISPLAY_IDENTIFIER CalRegn03Rt02GroupA.CalibrationPorts.DampgHydCoeff3ScaY.Ary1D /end CHARACTERISTIC
/begin CHARACTERISTIC CalRegn03Rt02GroupA.DampgHydCoeff4ScaY.Ary1D "MICROSAR RTE" VAL_BLK 0x0 RTE_RL_UWORD 0 NO_COMPU_METHOD 0 65535 MATRIX_DIM 12 1 1 SYMBOL_LINK "Rte_CalprmRom_CalRegn03Rt02GroupA_DEFAULT_RTE_CALPRM_GROUP.DampgHydCoeff4ScaY_Ary1D" 0 DISPLAY_IDENTIFIER CalRegn03Rt02GroupA.CalibrationPorts.DampgHydCoeff4ScaY.Ary1D /end CHARACTERISTIC
/begin CHARACTERISTIC CalRegn03Rt02GroupA.DampgMotVelX.Ary2D "MICROSAR RTE" VAL_BLK 0x0 RTE_RL_UWORD 0 NO_COMPU_METHOD 0 65535 MATRIX_DIM 13 12 1 SYMBOL_LINK "Rte_CalprmRom_CalRegn03Rt02GroupA_DEFAULT_RTE_CALPRM_GROUP.DampgMotVelX_Ary2D" 0 DISPLAY_IDENTIFIER CalRegn03Rt02GroupA.CalibrationPorts.DampgMotVelX.Ary2D /end CHARACTERISTIC
/begin CHARACTERISTIC CalRegn03Rt02GroupA.DampgMotVelY.Ary2D "MICROSAR RTE" VAL_BLK 0x0 RTE_RL_UWORD 0 NO_COMPU_METHOD 0 65535 MATRIX_DIM 13 12 1 SYMBOL_LINK "Rte_CalprmRom_CalRegn03Rt02GroupA_DEFAULT_RTE_CALPRM_GROUP.DampgMotVelY_Ary2D" 0 DISPLAY_IDENTIFIER CalRegn03Rt02GroupA.CalibrationPorts.DampgMotVelY.Ary2D /end CHARACTERISTIC
/begin GROUP CalRegn03Rt01GroupA_Dummy.DampgHydCoeff3ScaY.Ary1D "MICROSAR RTE" /begin SUB_GROUP /end SUB_GROUP /begin FUNCTION_LIST /end FUNCTION_LIST /begin REF_CHARACTERISTIC CalRegn03Rt01GroupA_Dummy.DampgHydCoeff3ScaY.Ary1D /end REF_CHARACTERISTIC /begin REF_MEASUREMENT /end REF_MEASUREMENT /end GROUP
/begin GROUP CalRegn03Rt01GroupA_Dummy.DampgHydCoeff4ScaY.Ary1D "MICROSAR RTE" /begin SUB_GROUP /end SUB_GROUP /begin FUNCTION_LIST /end FUNCTION_LIST /begin REF_CHARACTERISTIC CalRegn03Rt01GroupA_Dummy.DampgHydCoeff4ScaY.Ary1D /end REF_CHARACTERISTIC /begin REF_MEASUREMENT /end REF_MEASUREMENT /end GROUP
/begin GROUP CalRegn03Rt01GroupA_Dummy.DampgMotVelX.Ary2D "MICROSAR RTE" /begin SUB_GROUP /end SUB_GROUP /begin FUNCTION_LIST /end FUNCTION_LIST /begin REF_CHARACTERISTIC CalRegn03Rt01GroupA_Dummy.DampgMotVelX.Ary2D /end REF_CHARACTERISTIC /begin REF_MEASUREMENT /end REF_MEASUREMENT /end GROUP
/begin GROUP CalRegn03Rt01GroupA_Dummy.DampgMotVelY.Ary2D "MICROSAR RTE" /begin SUB_GROUP /end SUB_GROUP /begin FUNCTION_LIST /end FUNCTION_LIST /begin REF_CHARACTERISTIC CalRegn03Rt01GroupA_Dummy.DampgMotVelY.Ary2D /end REF_CHARACTERISTIC /begin REF_MEASUREMENT /end REF_MEASUREMENT /end GROUP
/begin GROUP CalRegn03Rt01GroupA_Dummy.HysCmpFricWhlImbRejctnBlndX.Ary1D "MICROSAR RTE" /begin SUB_GROUP /end SUB_GROUP /begin FUNCTION_LIST /end FUNCTION_LIST
 /begin REF_CHARACTERISTIC CalRegn03Rt01GroupA_Dummy.HysCmpFricWhlImbRejctnBlndX.Ary1D /end REF_CHARACTERISTIC
 /begin REF_MEASUREMENT /end REF_MEASUREMENT
/end GROUP
/begin GROUP CalRegn03Rt01GroupA_Dummy.HysCmpFricWhlImbRejctnBlndY.Ary1D "MICROSAR RTE" /begin SUB_GROUP /end SUB_GROUP /begin FUNCTION_LIST /end FUNCTION_LIST
 /begin REF_CHARACTERISTIC CalRegn03Rt01GroupA_Dummy.HysCmpFricWhlImbRejctnBlndY.Ary1D /end REF_CHARACTERISTIC
 /begin REF_MEASUREMENT /end REF_MEASUREMENT
/end GROUP
/begin GROUP CalRegn03Rt01GroupA_Dummy.HysCmpFricWhlImbRejctnOffY.Ary1D "MICROSAR RTE" /begin SUB_GROUP /end SUB_GROUP /begin FUNCTION_LIST /end FUNCTION_LIST /begin REF_CHARACTERISTIC CalRegn03Rt01GroupA_Dummy.HysCmpFricWhlImbRejctnOffY.Ary1D /end REF_CHARACTERISTIC /begin REF_MEASUREMENT /end REF_MEASUREMENT /end GROUP
/begin GROUP CalRegn03Rt01GroupA_Dummy.HysCmpFricWhlImbRejctnOnY.Ary1D "MICROSAR RTE" /begin SUB_GROUP /end SUB_GROUP /begin FUNCTION_LIST /end FUNCTION_LIST /begin REF_CHARACTERISTIC CalRegn03Rt01GroupA_Dummy.HysCmpFricWhlImbRejctnOnY.Ary1D /end REF_CHARACTERISTIC /begin REF_MEASUREMENT /end REF_MEASUREMENT /end GROUP
/begin GROUP CalRegn03Rt01GroupA_Dummy.InertiaCmpVelAssiBasdDampgCoeffX.Ary1D "MICROSAR RTE" /begin SUB_GROUP /end SUB_GROUP /begin FUNCTION_LIST /end FUNCTION_LIST
 /begin REF_CHARACTERISTIC CalRegn03Rt01GroupA_Dummy.InertiaCmpVelAssiBasdDampgCoeffX.Ary1D /end REF_CHARACTERISTIC
 /begin REF_MEASUREMENT /end REF_MEASUREMENT
/end GROUP
/begin GROUP CalRegn03Rt01GroupA_Dummy.InertiaCmpVelAssiBasdDampgRollgY.Ary1D "MICROSAR RTE" /begin SUB_GROUP /end SUB_GROUP /begin FUNCTION_LIST /end FUNCTION_LIST
 /begin REF_CHARACTERISTIC CalRegn03Rt01GroupA_Dummy.InertiaCmpVelAssiBasdDampgRollgY.Ary1D /end REF_CHARACTERISTIC
 /begin REF_MEASUREMENT /end REF_MEASUREMENT
/end GROUP
/begin GROUP CalRegn03Rt01GroupA_Dummy.InertiaCmpVelAssiBasdDampgStatY.Ary1D "MICROSAR RTE" /begin SUB_GROUP /end SUB_GROUP /begin FUNCTION_LIST /end FUNCTION_LIST
 /begin REF_CHARACTERISTIC CalRegn03Rt01GroupA_Dummy.InertiaCmpVelAssiBasdDampgStatY.Ary1D /end REF_CHARACTERISTIC
 /begin REF_MEASUREMENT /end REF_MEASUREMENT
/end GROUP
/begin GROUP CalRegn03Rt01GroupA_Dummy.InertiaCmpVelDampgSpdBlndY.Ary1D "MICROSAR RTE" /begin SUB_GROUP /end SUB_GROUP /begin FUNCTION_LIST /end FUNCTION_LIST /begin REF_CHARACTERISTIC CalRegn03Rt01GroupA_Dummy.InertiaCmpVelDampgSpdBlndY.Ary1D /end REF_CHARACTERISTIC /begin REF_MEASUREMENT /end REF_MEASUREMENT /end GROUP
/begin GROUP CalRegn03Rt01GroupA_Dummy.InertiaCmpVelNotchBlndY.Ary1D "MICROSAR RTE" /begin SUB_GROUP /end SUB_GROUP /begin FUNCTION_LIST /end FUNCTION_LIST /begin REF_CHARACTERISTIC CalRegn03Rt01GroupA_Dummy.InertiaCmpVelNotchBlndY.Ary1D /end REF_CHARACTERISTIC /begin REF_MEASUREMENT /end REF_MEASUREMENT /end GROUP
/begin GROUP CalRegn03Rt01GroupA_Dummy.RtnHwAgOffsCalcdX.Ary2D "MICROSAR RTE" /begin SUB_GROUP /end SUB_GROUP /begin FUNCTION_LIST /end FUNCTION_LIST /begin REF_CHARACTERISTIC CalRegn03Rt01GroupA_Dummy.RtnHwAgOffsCalcdX.Ary2D /end REF_CHARACTERISTIC /begin REF_MEASUREMENT /end REF_MEASUREMENT /end GROUP
/begin GROUP CalRegn03Rt01GroupA_Dummy.RtnHwAgOffsCalcdY.Ary2D "MICROSAR RTE" /begin SUB_GROUP /end SUB_GROUP /begin FUNCTION_LIST /end FUNCTION_LIST /begin REF_CHARACTERISTIC CalRegn03Rt01GroupA_Dummy.RtnHwAgOffsCalcdY.Ary2D /end REF_CHARACTERISTIC /begin REF_MEASUREMENT /end REF_MEASUREMENT /end GROUP
/begin GROUP CalRegn03Rt01GroupA_Dummy.RtnScaTqX.Ary2D "MICROSAR RTE" /begin SUB_GROUP /end SUB_GROUP /begin FUNCTION_LIST /end FUNCTION_LIST /begin REF_CHARACTERISTIC CalRegn03Rt01GroupA_Dummy.RtnScaTqX.Ary2D /end REF_CHARACTERISTIC /begin REF_MEASUREMENT /end REF_MEASUREMENT /end GROUP
/begin GROUP CalRegn03Rt01GroupA_Dummy.RtnScaTqY.Ary2D "MICROSAR RTE" /begin SUB_GROUP /end SUB_GROUP /begin FUNCTION_LIST /end FUNCTION_LIST /begin REF_CHARACTERISTIC CalRegn03Rt01GroupA_Dummy.RtnScaTqY.Ary2D /end REF_CHARACTERISTIC /begin REF_MEASUREMENT /end REF_MEASUREMENT /end GROUP
/begin GROUP CalRegn03Rt01GroupA_Dummy.RtnScaVelX.Ary2D "MICROSAR RTE" /begin SUB_GROUP /end SUB_GROUP /begin FUNCTION_LIST /end FUNCTION_LIST /begin REF_CHARACTERISTIC CalRegn03Rt01GroupA_Dummy.RtnScaVelX.Ary2D /end REF_CHARACTERISTIC /begin REF_MEASUREMENT /end REF_MEASUREMENT /end GROUP
/begin GROUP CalRegn03Rt01GroupA_Dummy.RtnScaVelY.Ary2D "MICROSAR RTE" /begin SUB_GROUP /end SUB_GROUP /begin FUNCTION_LIST /end FUNCTION_LIST /begin REF_CHARACTERISTIC CalRegn03Rt01GroupA_Dummy.RtnScaVelY.Ary2D /end REF_CHARACTERISTIC /begin REF_MEASUREMENT /end REF_MEASUREMENT /end GROUP
/begin GROUP CalRegn03Rt01GroupA_Dummy_1 "MICROSAR RTE" /begin SUB_GROUP CalRegn03Rt01GroupA_Dummy_1.CalibrationPorts /end SUB_GROUP /begin FUNCTION_LIST /end FUNCTION_LIST /begin REF_CHARACTERISTIC /end REF_CHARACTERISTIC /begin REF_MEASUREMENT /end REF_MEASUREMENT /end GROUP
/begin GROUP CalRegn03Rt01GroupA_Dummy_1.AssiHiFrqGainY.Ary2D "MICROSAR RTE" /begin SUB_GROUP /end SUB_GROUP /begin FUNCTION_LIST /end FUNCTION_LIST /begin REF_CHARACTERISTIC CalRegn03Rt01GroupA_Dummy_1.AssiHiFrqGainY.Ary2D /end REF_CHARACTERISTIC /begin REF_MEASUREMENT /end REF_MEASUREMENT /end GROUP
/begin GROUP CalRegn03Rt01GroupA_Dummy_1.AssiHiFrqTqX.Ary2D "MICROSAR RTE" /begin SUB_GROUP /end SUB_GROUP /begin FUNCTION_LIST /end FUNCTION_LIST /begin REF_CHARACTERISTIC CalRegn03Rt01GroupA_Dummy_1.AssiHiFrqTqX.Ary2D /end REF_CHARACTERISTIC /begin REF_MEASUREMENT /end REF_MEASUREMENT /end GROUP
/begin GROUP CalRegn03Rt01GroupA_Dummy_1.AssiMotTqWhlImbRejctnMinX.Ary2D "MICROSAR RTE" /begin SUB_GROUP /end SUB_GROUP /begin FUNCTION_LIST /end FUNCTION_LIST
 /begin REF_CHARACTERISTIC CalRegn03Rt01GroupA_Dummy_1.AssiMotTqWhlImbRejctnMinX.Ary2D /end REF_CHARACTERISTIC
 /begin REF_MEASUREMENT /end REF_MEASUREMENT
/end GROUP
/begin GROUP CalRegn03Rt01GroupA_Dummy_1.AssiMotTqWhlImbRejctnMinY.Ary2D "MICROSAR RTE" /begin SUB_GROUP /end SUB_GROUP /begin FUNCTION_LIST /end FUNCTION_LIST
 /begin REF_CHARACTERISTIC CalRegn03Rt01GroupA_Dummy_1.AssiMotTqWhlImbRejctnMinY.Ary2D /end REF_CHARACTERISTIC
 /begin REF_MEASUREMENT /end REF_MEASUREMENT
/end GROUP
/begin GROUP CalRegn03Rt01GroupA_Dummy_1.CalibrationPorts "MICROSAR RTE"
 /begin SUB_GROUP CalRegn03Rt01GroupA_Dummy_1.AssiHiFrqGainY.Ary2D CalRegn03Rt01GroupA_Dummy_1.AssiHiFrqTqX.Ary2D CalRegn03Rt01GroupA_Dummy_1.AssiMotTqWhlImbRejctnMinX.Ary2D CalRegn03Rt01GroupA_Dummy_1.AssiMotTqWhlImbRejctnMinY.Ary2D CalRegn03Rt01GroupA_Dummy_1.DampgHydCoeff1ScaY.Ary1D CalRegn03Rt01GroupA_Dummy_1.DampgHydCoeff2ScaY.Ary1D CalRegn03Rt01GroupA_Dummy_1.DampgHydCoeff3ScaY.Ary1D CalRegn03Rt01GroupA_Dummy_1.DampgHydCoeff4ScaY.Ary1D CalRegn03Rt01GroupA_Dummy_1.DampgMotVelX.Ary2D CalRegn03Rt01GroupA_Dummy_1.DampgMotVelY.Ary2D CalRegn03Rt01GroupA_Dummy_1.HysCmpFricWhlImbRejctnBlndX.Ary1D CalRegn03Rt01GroupA_Dummy_1.HysCmpFricWhlImbRejctnBlndY.Ary1D CalRegn03Rt01GroupA_Dummy_1.HysCmpFricWhlImbRejctnOffY.Ary1D CalRegn03Rt01GroupA_Dummy_1.HysCmpFricWhlImbRejctnOnY.Ary1D CalRegn03Rt01GroupA_Dummy_1.InertiaCmpVelAssiBasdDampgCoeffX.Ary1D CalRegn03Rt01GroupA_Dummy_1.InertiaCmpVelAssiBasdDampgRollgY.Ary1D CalRegn03Rt01GroupA_Dummy_1.InertiaCmpVelAssiBasdDampgStatY.Ary1D CalRegn03Rt01GroupA_Dummy_1.InertiaCmpVelDampgSpdBlndY.Ary1D CalRegn03Rt01GroupA_Dummy_1.InertiaCmpVelNotchBlndY.Ary1D CalRegn03Rt01GroupA_Dummy_1.RtnHwAgOffsCalcdX.Ary2D CalRegn03Rt01GroupA_Dummy_1.RtnHwAgOffsCalcdY.Ary2D CalRegn03Rt01GroupA_Dummy_1.RtnScaTqX.Ary2D CalRegn03Rt01GroupA_Dummy_1.RtnScaTqY.Ary2D CalRegn03Rt01GroupA_Dummy_1.RtnScaVelX.Ary2D CalRegn03Rt01GroupA_Dummy_1.RtnScaVelY.Ary2D /end SUB_GROUP
 /begin FUNCTION_LIST /end FUNCTION_LIST
 /begin REF_CHARACTERISTIC /end REF_CHARACTERISTIC
 /begin REF_MEASUREMENT /end REF_MEASUREMENT
/end GROUP
/begin GROUP CalRegn03Rt01GroupA_Dummy_1.DampgHydCoeff1ScaY.Ary1D "MICROSAR RTE" /begin SUB_GROUP /end SUB_GROUP /begin FUNCTION_LIST /end FUNCTION_LIST /begin REF_CHARACTERISTIC CalRegn03Rt01GroupA_Dummy_1.DampgHydCoeff1ScaY.Ary1D /end REF_CHARACTERISTIC /begin REF_MEASUREMENT /end REF_MEASUREMENT /end GROUP
/begin GROUP CalRegn03Rt01GroupA_Dummy_1.DampgHydCoeff2ScaY.Ary1D "MICROSAR RTE" /begin SUB_GROUP /end SUB_GROUP /begin FUNCTION_LIST /end FUNCTION_LIST /begin REF_CHARACTERISTIC CalRegn03Rt01GroupA_Dummy_1.DampgHydCoeff2ScaY.Ary1D /end REF_CHARACTERISTIC /begin REF_MEASUREMENT /end REF_MEASUREMENT /end GROUP
/begin GROUP CalRegn03Rt01GroupA_Dummy_1.DampgHydCoeff3ScaY.Ary1D "MICROSAR RTE" /begin SUB_GROUP /end SUB_GROUP /begin FUNCTION_LIST /end FUNCTION_LIST /begin REF_CHARACTERISTIC CalRegn03Rt01GroupA_Dummy_1.DampgHydCoeff3ScaY.Ary1D /end REF_CHARACTERISTIC /begin REF_MEASUREMENT /end REF_MEASUREMENT /end GROUP
/begin GROUP CalRegn03Rt01GroupA_Dummy_1.DampgHydCoeff4ScaY.Ary1D "MICROSAR RTE" /begin SUB_GROUP /end SUB_GROUP /begin FUNCTION_LIST /end FUNCTION_LIST /begin REF_CHARACTERISTIC CalRegn03Rt01GroupA_Dummy_1.DampgHydCoeff4ScaY.Ary1D /end REF_CHARACTERISTIC /begin REF_MEASUREMENT /end REF_MEASUREMENT /end GROUP
/begin GROUP CalRegn03Rt01GroupA_Dummy_1.DampgMotVelX.Ary2D "MICROSAR RTE" /begin SUB_GROUP /end SUB_GROUP /begin FUNCTION_LIST /end FUNCTION_LIST /begin REF_CHARACTERISTIC CalRegn03Rt01GroupA_Dummy_1.DampgMotVelX.Ary2D /end REF_CHARACTERISTIC /begin REF_MEASUREMENT /end REF_MEASUREMENT /end GROUP
/begin GROUP CalRegn03Rt01GroupA_Dummy_1.DampgMotVelY.Ary2D "MICROSAR RTE" /begin SUB_GROUP /end SUB_GROUP /begin FUNCTION_LIST /end FUNCTION_LIST /begin REF_CHARACTERISTIC CalRegn03Rt01GroupA_Dummy_1.DampgMotVelY.Ary2D /end REF_CHARACTERISTIC /begin REF_MEASUREMENT /end REF_MEASUREMENT /end GROUP
/begin GROUP CalRegn03Rt01GroupA_Dummy_1.HysCmpFricWhlImbRejctnBlndX.Ary1D "MICROSAR RTE" /begin SUB_GROUP /end SUB_GROUP /begin FUNCTION_LIST /end FUNCTION_LIST
 /begin REF_CHARACTERISTIC CalRegn03Rt01GroupA_Dummy_1.HysCmpFricWhlImbRejctnBlndX.Ary1D /end REF_CHARACTERISTIC
 /begin REF_MEASUREMENT /end REF_MEASUREMENT
/end GROUP
/begin GROUP CalRegn03Rt01GroupA_Dummy_1.HysCmpFricWhlImbRejctnBlndY.Ary1D "MICROSAR RTE" /begin SUB_GROUP /end SUB_GROUP /begin FUNCTION_LIST /end FUNCTION_LIST
 /begin REF_CHARACTERISTIC CalRegn03Rt01GroupA_Dummy_1.HysCmpFricWhlImbRejctnBlndY.Ary1D /end REF_CHARACTERISTIC
 /begin REF_MEASUREMENT /end REF_MEASUREMENT
/end GROUP
/begin GROUP CalRegn03Rt01GroupA_Dummy_1.HysCmpFricWhlImbRejctnOffY.Ary1D "MICROSAR RTE" /begin SUB_GROUP /end SUB_GROUP /begin FUNCTION_LIST /end FUNCTION_LIST
 /begin REF_CHARACTERISTIC CalRegn03Rt01GroupA_Dummy_1.HysCmpFricWhlImbRejctnOffY.Ary1D /end REF_CHARACTERISTIC
 /begin REF_MEASUREMENT /end REF_MEASUREMENT
/end GROUP
/begin GROUP CalRegn03Rt01GroupA_Dummy_1.HysCmpFricWhlImbRejctnOnY.Ary1D "MICROSAR RTE" /begin SUB_GROUP /end SUB_GROUP /begin FUNCTION_LIST /end FUNCTION_LIST
 /begin REF_CHARACTERISTIC CalRegn03Rt01GroupA_Dummy_1.HysCmpFricWhlImbRejctnOnY.Ary1D /end REF_CHARACTERISTIC
 /begin REF_MEASUREMENT /end REF_MEASUREMENT
/end GROUP
/begin GROUP CalRegn03Rt01GroupA_Dummy_1.InertiaCmpVelAssiBasdDampgCoeffX.Ary1D "MICROSAR RTE" /begin SUB_GROUP /end SUB_GROUP /begin FUNCTION_LIST /end FUNCTION_LIST
 /begin REF_CHARACTERISTIC CalRegn03Rt01GroupA_Dummy_1.InertiaCmpVelAssiBasdDampgCoeffX.Ary1D /end REF_CHARACTERISTIC
 /begin REF_MEASUREMENT /end REF_MEASUREMENT
/end GROUP
/begin GROUP CalRegn03Rt01GroupA_Dummy_1.InertiaCmpVelAssiBasdDampgRollgY.Ary1D "MICROSAR RTE" /begin SUB_GROUP /end SUB_GROUP /begin FUNCTION_LIST /end FUNCTION_LIST
 /begin REF_CHARACTERISTIC CalRegn03Rt01GroupA_Dummy_1.InertiaCmpVelAssiBasdDampgRollgY.Ary1D /end REF_CHARACTERISTIC
 /begin REF_MEASUREMENT /end REF_MEASUREMENT
/end GROUP
/begin GROUP CalRegn03Rt01GroupA_Dummy_1.InertiaCmpVelAssiBasdDampgStatY.Ary1D "MICROSAR RTE" /begin SUB_GROUP /end SUB_GROUP /begin FUNCTION_LIST /end FUNCTION_LIST
 /begin REF_CHARACTERISTIC CalRegn03Rt01GroupA_Dummy_1.InertiaCmpVelAssiBasdDampgStatY.Ary1D /end REF_CHARACTERISTIC
 /begin REF_MEASUREMENT /end REF_MEASUREMENT
/end GROUP
/begin GROUP CalRegn03Rt01GroupA_Dummy_1.InertiaCmpVelDampgSpdBlndY.Ary1D "MICROSAR RTE" /begin SUB_GROUP /end SUB_GROUP /begin FUNCTION_LIST /end FUNCTION_LIST
 /begin REF_CHARACTERISTIC CalRegn03Rt01GroupA_Dummy_1.InertiaCmpVelDampgSpdBlndY.Ary1D /end REF_CHARACTERISTIC
 /begin REF_MEASUREMENT /end REF_MEASUREMENT
/end GROUP
/begin GROUP CalRegn03Rt01GroupA_Dummy_1.InertiaCmpVelNotchBlndY.Ary1D "MICROSAR RTE" /begin SUB_GROUP /end SUB_GROUP /begin FUNCTION_LIST /end FUNCTION_LIST /begin REF_CHARACTERISTIC CalRegn03Rt01GroupA_Dummy_1.InertiaCmpVelNotchBlndY.Ary1D /end REF_CHARACTERISTIC /begin REF_MEASUREMENT /end REF_MEASUREMENT /end GROUP
/begin GROUP CalRegn03Rt01GroupA_Dummy_1.RtnHwAgOffsCalcdX.Ary2D "MICROSAR RTE" /begin SUB_GROUP /end SUB_GROUP /begin FUNCTION_LIST /end FUNCTION_LIST /begin REF_CHARACTERISTIC CalRegn03Rt01GroupA_Dummy_1.RtnHwAgOffsCalcdX.Ary2D /end REF_CHARACTERISTIC /begin REF_MEASUREMENT /end REF_MEASUREMENT /end GROUP
/begin GROUP CalRegn03Rt01GroupA_Dummy_1.RtnHwAgOffsCalcdY.Ary2D "MICROSAR RTE" /begin SUB_GROUP /end SUB_GROUP /begin FUNCTION_LIST /end FUNCTION_LIST /begin REF_CHARACTERISTIC CalRegn03Rt01GroupA_Dummy_1.RtnHwAgOffsCalcdY.Ary2D /end REF_CHARACTERISTIC /begin REF_MEASUREMENT /end REF_MEASUREMENT /end GROUP
/begin GROUP CalRegn03Rt01GroupA_Dummy_1.RtnScaTqX.Ary2D "MICROSAR RTE" /begin SUB_GROUP /end SUB_GROUP /begin FUNCTION_LIST /end FUNCTION_LIST /begin REF_CHARACTERISTIC CalRegn03Rt01GroupA_Dummy_1.RtnScaTqX.Ary2D /end REF_CHARACTERISTIC /begin REF_MEASUREMENT /end REF_MEASUREMENT /end GROUP
/begin GROUP CalRegn03Rt01GroupA_Dummy_1.RtnScaTqY.Ary2D "MICROSAR RTE" /begin SUB_GROUP /end SUB_GROUP /begin FUNCTION_LIST /end FUNCTION_LIST /begin REF_CHARACTERISTIC CalRegn03Rt01GroupA_Dummy_1.RtnScaTqY.Ary2D /end REF_CHARACTERISTIC /begin REF_MEASUREMENT /end REF_MEASUREMENT /end GROUP
/begin GROUP CalRegn03Rt01GroupA_Dummy_1.RtnScaVelX.Ary2D "MICROSAR RTE" /begin SUB_GROUP /end SUB_GROUP /begin FUNCTION_LIST /end FUNCTION_LIST /begin REF_CHARACTERISTIC CalRegn03Rt01GroupA_Dummy_1.RtnScaVelX.Ary2D /end REF_CHARACTERISTIC /begin REF_MEASUREMENT /end REF_MEASUREMENT /end GROUP
/begin GROUP CalRegn03Rt01GroupA_Dummy_1.RtnScaVelY.Ary2D "MICROSAR RTE" /begin SUB_GROUP /end SUB_GROUP /begin FUNCTION_LIST /end FUNCTION_LIST /begin REF_CHARACTERISTIC CalRegn03Rt01GroupA_Dummy_1.RtnScaVelY.Ary2D /end REF_CHARACTERISTIC /begin REF_MEASUREMENT /end REF_MEASUREMENT /end GROUP
/begin GROUP CalRegn03Rt01GroupA_Dummy_2 "MICROSAR RTE" /begin SUB_GROUP CalRegn03Rt01GroupA_Dummy_2.CalibrationPorts /end SUB_GROUP /begin FUNCTION_LIST /end FUNCTION_LIST /begin REF_CHARACTERISTIC /end REF_CHARACTERISTIC /begin REF_MEASUREMENT /end REF_MEASUREMENT /end GROUP
/begin GROUP CalRegn03Rt01GroupA_Dummy_2.AssiHiFrqGainY.Ary2D "MICROSAR RTE" /begin SUB_GROUP /end SUB_GROUP /begin FUNCTION_LIST /end FUNCTION_LIST /begin REF_CHARACTERISTIC CalRegn03Rt01GroupA_Dummy_2.AssiHiFrqGainY.Ary2D /end REF_CHARACTERISTIC /begin REF_MEASUREMENT /end REF_MEASUREMENT /end GROUP
/begin GROUP CalRegn03Rt01GroupA_Dummy_2.AssiHiFrqTqX.Ary2D "MICROSAR RTE" /begin SUB_GROUP /end SUB_GROUP /begin FUNCTION_LIST /end FUNCTION_LIST /begin REF_CHARACTERISTIC CalRegn03Rt01GroupA_Dummy_2.AssiHiFrqTqX.Ary2D /end REF_CHARACTERISTIC /begin REF_MEASUREMENT /end REF_MEASUREMENT /end GROUP
/begin GROUP CalRegn03Rt01GroupA_Dummy_2.AssiMotTqWhlImbRejctnMinX.Ary2D "MICROSAR RTE" /begin SUB_GROUP /end SUB_GROUP /begin FUNCTION_LIST /end FUNCTION_LIST
 /begin REF_CHARACTERISTIC CalRegn03Rt01GroupA_Dummy_2.AssiMotTqWhlImbRejctnMinX.Ary2D /end REF_CHARACTERISTIC
 /begin REF_MEASUREMENT /end REF_MEASUREMENT
/end GROUP
/begin GROUP CalRegn03Rt01GroupA_Dummy_2.AssiMotTqWhlImbRejctnMinY.Ary2D "MICROSAR RTE" /begin SUB_GROUP /end SUB_GROUP /begin FUNCTION_LIST /end FUNCTION_LIST
 /begin REF_CHARACTERISTIC CalRegn03Rt01GroupA_Dummy_2.AssiMotTqWhlImbRejctnMinY.Ary2D /end REF_CHARACTERISTIC
 /begin REF_MEASUREMENT /end REF_MEASUREMENT
/end GROUP
/begin GROUP CalRegn03Rt01GroupA_Dummy_2.CalibrationPorts "MICROSAR RTE"
 /begin SUB_GROUP CalRegn03Rt01GroupA_Dummy_2.AssiHiFrqGainY.Ary2D CalRegn03Rt01GroupA_Dummy_2.AssiHiFrqTqX.Ary2D CalRegn03Rt01GroupA_Dummy_2.AssiMotTqWhlImbRejctnMinX.Ary2D CalRegn03Rt01GroupA_Dummy_2.AssiMotTqWhlImbRejctnMinY.Ary2D CalRegn03Rt01GroupA_Dummy_2.DampgHydCoeff1ScaY.Ary1D CalRegn03Rt01GroupA_Dummy_2.DampgHydCoeff2ScaY.Ary1D CalRegn03Rt01GroupA_Dummy_2.DampgHydCoeff3ScaY.Ary1D CalRegn03Rt01GroupA_Dummy_2.DampgHydCoeff4ScaY.Ary1D CalRegn03Rt01GroupA_Dummy_2.DampgMotVelX.Ary2D CalRegn03Rt01GroupA_Dummy_2.DampgMotVelY.Ary2D CalRegn03Rt01GroupA_Dummy_2.HysCmpFricWhlImbRejctnBlndX.Ary1D CalRegn03Rt01GroupA_Dummy_2.HysCmpFricWhlImbRejctnBlndY.Ary1D CalRegn03Rt01GroupA_Dummy_2.HysCmpFricWhlImbRejctnOffY.Ary1D CalRegn03Rt01GroupA_Dummy_2.HysCmpFricWhlImbRejctnOnY.Ary1D CalRegn03Rt01GroupA_Dummy_2.InertiaCmpVelAssiBasdDampgCoeffX.Ary1D CalRegn03Rt01GroupA_Dummy_2.InertiaCmpVelAssiBasdDampgRollgY.Ary1D CalRegn03Rt01GroupA_Dummy_2.InertiaCmpVelAssiBasdDampgStatY.Ary1D CalRegn03Rt01GroupA_Dummy_2.InertiaCmpVelDampgSpdBlndY.Ary1D CalRegn03Rt01GroupA_Dummy_2.InertiaCmpVelNotchBlndY.Ary1D CalRegn03Rt01GroupA_Dummy_2.RtnHwAgOffsCalcdX.Ary2D CalRegn03Rt01GroupA_Dummy_2.RtnHwAgOffsCalcdY.Ary2D CalRegn03Rt01GroupA_Dummy_2.RtnScaTqX.Ary2D CalRegn03Rt01GroupA_Dummy_2.RtnScaTqY.Ary2D CalRegn03Rt01GroupA_Dummy_2.RtnScaVelX.Ary2D CalRegn03Rt01GroupA_Dummy_2.RtnScaVelY.Ary2D /end SUB_GROUP
 /begin FUNCTION_LIST /end FUNCTION_LIST
 /begin REF_CHARACTERISTIC /end REF_CHARACTERISTIC
 /begin REF_MEASUREMENT /end REF_MEASUREMENT
/end GROUP
/begin GROUP CalRegn03Rt01GroupA_Dummy_2.DampgHydCoeff1ScaY.Ary1D "MICROSAR RTE" /begin SUB_GROUP /end SUB_GROUP /begin FUNCTION_LIST /end FUNCTION_LIST /begin REF_CHARACTERISTIC CalRegn03Rt01GroupA_Dummy_2.DampgHydCoeff1ScaY.Ary1D /end REF_CHARACTERISTIC /begin REF_MEASUREMENT /end REF_MEASUREMENT /end GROUP
/begin GROUP CalRegn03Rt01GroupA_Dummy_2.DampgHydCoeff2ScaY.Ary1D "MICROSAR RTE" /begin SUB_GROUP /end SUB_GROUP /begin FUNCTION_LIST /end FUNCTION_LIST /begin REF_CHARACTERISTIC CalRegn03Rt01GroupA_Dummy_2.DampgHydCoeff2ScaY.Ary1D /end REF_CHARACTERISTIC /begin REF_MEASUREMENT /end REF_MEASUREMENT /end GROUP
/begin GROUP CalRegn03Rt01GroupA_Dummy_2.DampgHydCoeff3ScaY.Ary1D "MICROSAR RTE" /begin SUB_GROUP /end SUB_GROUP /begin FUNCTION_LIST /end FUNCTION_LIST /begin REF_CHARACTERISTIC CalRegn03Rt01GroupA_Dummy_2.DampgHydCoeff3ScaY.Ary1D /end REF_CHARACTERISTIC /begin REF_MEASUREMENT /end REF_MEASUREMENT /end GROUP
/begin GROUP CalRegn03Rt01GroupA_Dummy_2.DampgHydCoeff4ScaY.Ary1D "MICROSAR RTE" /begin SUB_GROUP /end SUB_GROUP /begin FUNCTION_LIST /end FUNCTION_LIST /begin REF_CHARACTERISTIC CalRegn03Rt01GroupA_Dummy_2.DampgHydCoeff4ScaY.Ary1D /end REF_CHARACTERISTIC /begin REF_MEASUREMENT /end REF_MEASUREMENT /end GROUP
/begin GROUP CalRegn03Rt01GroupA_Dummy_2.DampgMotVelX.Ary2D "MICROSAR RTE" /begin SUB_GROUP /end SUB_GROUP /begin FUNCTION_LIST /end FUNCTION_LIST /begin REF_CHARACTERISTIC CalRegn03Rt01GroupA_Dummy_2.DampgMotVelX.Ary2D /end REF_CHARACTERISTIC /begin REF_MEASUREMENT /end REF_MEASUREMENT /end GROUP
/begin GROUP CalRegn03Rt01GroupA_Dummy_2.DampgMotVelY.Ary2D "MICROSAR RTE" /begin SUB_GROUP /end SUB_GROUP /begin FUNCTION_LIST /end FUNCTION_LIST /begin REF_CHARACTERISTIC CalRegn03Rt01GroupA_Dummy_2.DampgMotVelY.Ary2D /end REF_CHARACTERISTIC /begin REF_MEASUREMENT /end REF_MEASUREMENT /end GROUP
/begin GROUP CalRegn03Rt01GroupA_Dummy_2.HysCmpFricWhlImbRejctnBlndX.Ary1D "MICROSAR RTE" /begin SUB_GROUP /end SUB_GROUP /begin FUNCTION_LIST /end FUNCTION_LIST
 /begin REF_CHARACTERISTIC CalRegn03Rt01GroupA_Dummy_2.HysCmpFricWhlImbRejctnBlndX.Ary1D /end REF_CHARACTERISTIC
 /begin REF_MEASUREMENT /end REF_MEASUREMENT
/end GROUP
/begin GROUP CalRegn03Rt01GroupA_Dummy_2.HysCmpFricWhlImbRejctnBlndY.Ary1D "MICROSAR RTE" /begin SUB_GROUP /end SUB_GROUP /begin FUNCTION_LIST /end FUNCTION_LIST
 /begin REF_CHARACTERISTIC CalRegn03Rt01GroupA_Dummy_2.HysCmpFricWhlImbRejctnBlndY.Ary1D /end REF_CHARACTERISTIC
 /begin REF_MEASUREMENT /end REF_MEASUREMENT
/end GROUP
/begin GROUP CalRegn03Rt01GroupA_Dummy_2.HysCmpFricWhlImbRejctnOffY.Ary1D "MICROSAR RTE" /begin SUB_GROUP /end SUB_GROUP /begin FUNCTION_LIST /end FUNCTION_LIST
 /begin REF_CHARACTERISTIC CalRegn03Rt01GroupA_Dummy_2.HysCmpFricWhlImbRejctnOffY.Ary1D /end REF_CHARACTERISTIC
 /begin REF_MEASUREMENT /end REF_MEASUREMENT
/end GROUP
/begin GROUP CalRegn03Rt01GroupA_Dummy_2.HysCmpFricWhlImbRejctnOnY.Ary1D "MICROSAR RTE" /begin SUB_GROUP /end SUB_GROUP /begin FUNCTION_LIST /end FUNCTION_LIST
 /begin REF_CHARACTERISTIC CalRegn03Rt01GroupA_Dummy_2.HysCmpFricWhlImbRejctnOnY.Ary1D /end REF_CHARACTERISTIC
 /begin REF_MEASUREMENT /end REF_MEASUREMENT
/end GROUP
/begin GROUP CalRegn03Rt01GroupA_Dummy_2.InertiaCmpVelAssiBasdDampgCoeffX.Ary1D "MICROSAR RTE" /begin SUB_GROUP /end SUB_GROUP /begin FUNCTION_LIST /end FUNCTION_LIST
 /begin REF_CHARACTERISTIC CalRegn03Rt01GroupA_Dummy_2.InertiaCmpVelAssiBasdDampgCoeffX.Ary1D /end REF_CHARACTERISTIC
 /begin REF_MEASUREMENT /end REF_MEASUREMENT
/end GROUP
/begin GROUP CalRegn03Rt01GroupA_Dummy_2.InertiaCmpVelAssiBasdDampgRollgY.Ary1D "MICROSAR RTE" /begin SUB_GROUP /end SUB_GROUP /begin FUNCTION_LIST /end FUNCTION_LIST
 /begin REF_CHARACTERISTIC CalRegn03Rt01GroupA_Dummy_2.InertiaCmpVelAssiBasdDampgRollgY.Ary1D /end REF_CHARACTERISTIC
 /begin REF_MEASUREMENT /end REF_MEASUREMENT
/end GROUP
/begin GROUP CalRegn03Rt01GroupA_Dummy_2.InertiaCmpVelAssiBasdDampgStatY.Ary1D "MICROSAR RTE" /begin SUB_GROUP /end SUB_GROUP /begin FUNCTION_LIST /end FUNCTION_LIST
 /begin REF_CHARACTERISTIC CalRegn03Rt01GroupA_Dummy_2.InertiaCmpVelAssiBasdDampgStatY.Ary1D /end REF_CHARACTERISTIC
 /begin REF_MEASUREMENT /end REF_MEASUREMENT
/end GROUP
/begin GROUP CalRegn03Rt01GroupA_Dummy_2.InertiaCmpVelDampgSpdBlndY.Ary1D "MICROSAR RTE" /begin SUB_GROUP /end SUB_GROUP /begin FUNCTION_LIST /end FUNCTION_LIST
 /begin REF_CHARACTERISTIC CalRegn03Rt01GroupA_Dummy_2.InertiaCmpVelDampgSpdBlndY.Ary1D /end REF_CHARACTERISTIC
 /begin REF_MEASUREMENT /end REF_MEASUREMENT
/end GROUP
/begin GROUP CalRegn03Rt01GroupA_Dummy_2.InertiaCmpVelNotchBlndY.Ary1D "MICROSAR RTE" /begin SUB_GROUP /end SUB_GROUP /begin FUNCTION_LIST /end FUNCTION_LIST /begin REF_CHARACTERISTIC CalRegn03Rt01GroupA_Dummy_2.InertiaCmpVelNotchBlndY.Ary1D /end REF_CHARACTERISTIC /begin REF_MEASUREMENT /end REF_MEASUREMENT /end GROUP
/begin GROUP CalRegn03Rt01GroupA_Dummy_2.RtnHwAgOffsCalcdX.Ary2D "MICROSAR RTE" /begin SUB_GROUP /end SUB_GROUP /begin FUNCTION_LIST /end FUNCTION_LIST /begin REF_CHARACTERISTIC CalRegn03Rt01GroupA_Dummy_2.RtnHwAgOffsCalcdX.Ary2D /end REF_CHARACTERISTIC /begin REF_MEASUREMENT /end REF_MEASUREMENT /end GROUP
/begin GROUP CalRegn03Rt01GroupA_Dummy_2.RtnHwAgOffsCalcdY.Ary2D "MICROSAR RTE" /begin SUB_GROUP /end SUB_GROUP /begin FUNCTION_LIST /end FUNCTION_LIST /begin REF_CHARACTERISTIC CalRegn03Rt01GroupA_Dummy_2.RtnHwAgOffsCalcdY.Ary2D /end REF_CHARACTERISTIC /begin REF_MEASUREMENT /end REF_MEASUREMENT /end GROUP
/begin GROUP CalRegn03Rt01GroupA_Dummy_2.RtnScaTqX.Ary2D "MICROSAR RTE" /begin SUB_GROUP /end SUB_GROUP /begin FUNCTION_LIST /end FUNCTION_LIST /begin REF_CHARACTERISTIC CalRegn03Rt01GroupA_Dummy_2.RtnScaTqX.Ary2D /end REF_CHARACTERISTIC /begin REF_MEASUREMENT /end REF_MEASUREMENT /end GROUP
/begin GROUP CalRegn03Rt01GroupA_Dummy_2.RtnScaTqY.Ary2D "MICROSAR RTE" /begin SUB_GROUP /end SUB_GROUP /begin FUNCTION_LIST /end FUNCTION_LIST /begin REF_CHARACTERISTIC CalRegn03Rt01GroupA_Dummy_2.RtnScaTqY.Ary2D /end REF_CHARACTERISTIC /begin REF_MEASUREMENT /end REF_MEASUREMENT /end GROUP
/begin GROUP CalRegn03Rt01GroupA_Dummy_2.RtnScaVelX.Ary2D "MICROSAR RTE" /begin SUB_GROUP /end SUB_GROUP /begin FUNCTION_LIST /end FUNCTION_LIST /begin REF_CHARACTERISTIC CalRegn03Rt01GroupA_Dummy_2.RtnScaVelX.Ary2D /end REF_CHARACTERISTIC /begin REF_MEASUREMENT /end REF_MEASUREMENT /end GROUP
/begin GROUP CalRegn03Rt01GroupA_Dummy_2.RtnScaVelY.Ary2D "MICROSAR RTE" /begin SUB_GROUP /end SUB_GROUP /begin FUNCTION_LIST /end FUNCTION_LIST /begin REF_CHARACTERISTIC CalRegn03Rt01GroupA_Dummy_2.RtnScaVelY.Ary2D /end REF_CHARACTERISTIC /begin REF_MEASUREMENT /end REF_MEASUREMENT /end GROUP
/begin GROUP CalRegn03Rt01GroupA_Dummy_3 "MICROSAR RTE" /begin SUB_GROUP CalRegn03Rt01GroupA_Dummy_3.CalibrationPorts /end SUB_GROUP /begin FUNCTION_LIST /end FUNCTION_LIST /begin REF_CHARACTERISTIC /end REF_CHARACTERISTIC /begin REF_MEASUREMENT /end REF_MEASUREMENT /end GROUP
/begin GROUP CalRegn03Rt01GroupA_Dummy_3.AssiHiFrqGainY.Ary2D "MICROSAR RTE" /begin SUB_GROUP /end SUB_GROUP /begin FUNCTION_LIST /end FUNCTION_LIST /begin REF_CHARACTERISTIC CalRegn03Rt01GroupA_Dummy_3.AssiHiFrqGainY.Ary2D /end REF_CHARACTERISTIC /begin REF_MEASUREMENT /end REF_MEASUREMENT /end GROUP
/begin GROUP CalRegn03Rt01GroupA_Dummy_3.AssiHiFrqTqX.Ary2D "MICROSAR RTE" /begin SUB_GROUP /end SUB_GROUP /begin FUNCTION_LIST /end FUNCTION_LIST /begin REF_CHARACTERISTIC CalRegn03Rt01GroupA_Dummy_3.AssiHiFrqTqX.Ary2D /end REF_CHARACTERISTIC /begin REF_MEASUREMENT /end REF_MEASUREMENT /end GROUP
/begin GROUP CalRegn03Rt01GroupA_Dummy_3.AssiMotTqWhlImbRejctnMinX.Ary2D "MICROSAR RTE" /begin SUB_GROUP /end SUB_GROUP /begin FUNCTION_LIST /end FUNCTION_LIST
 /begin REF_CHARACTERISTIC CalRegn03Rt01GroupA_Dummy_3.AssiMotTqWhlImbRejctnMinX.Ary2D /end REF_CHARACTERISTIC
 /begin REF_MEASUREMENT /end REF_MEASUREMENT
/end GROUP
/begin GROUP CalRegn03Rt01GroupA_Dummy_3.AssiMotTqWhlImbRejctnMinY.Ary2D "MICROSAR RTE" /begin SUB_GROUP /end SUB_GROUP /begin FUNCTION_LIST /end FUNCTION_LIST
 /begin REF_CHARACTERISTIC CalRegn03Rt01GroupA_Dummy_3.AssiMotTqWhlImbRejctnMinY.Ary2D /end REF_CHARACTERISTIC
 /begin REF_MEASUREMENT /end REF_MEASUREMENT
/end GROUP
/begin GROUP CalRegn03Rt01GroupA_Dummy_3.CalibrationPorts "MICROSAR RTE"
 /begin SUB_GROUP CalRegn03Rt01GroupA_Dummy_3.AssiHiFrqGainY.Ary2D CalRegn03Rt01GroupA_Dummy_3.AssiHiFrqTqX.Ary2D CalRegn03Rt01GroupA_Dummy_3.AssiMotTqWhlImbRejctnMinX.Ary2D CalRegn03Rt01GroupA_Dummy_3.AssiMotTqWhlImbRejctnMinY.Ary2D CalRegn03Rt01GroupA_Dummy_3.DampgHydCoeff1ScaY.Ary1D CalRegn03Rt01GroupA_Dummy_3.DampgHydCoeff2ScaY.Ary1D CalRegn03Rt01GroupA_Dummy_3.DampgHydCoeff3ScaY.Ary1D CalRegn03Rt01GroupA_Dummy_3.DampgHydCoeff4ScaY.Ary1D CalRegn03Rt01GroupA_Dummy_3.DampgMotVelX.Ary2D CalRegn03Rt01GroupA_Dummy_3.DampgMotVelY.Ary2D CalRegn03Rt01GroupA_Dummy_3.HysCmpFricWhlImbRejctnBlndX.Ary1D CalRegn03Rt01GroupA_Dummy_3.HysCmpFricWhlImbRejctnBlndY.Ary1D CalRegn03Rt01GroupA_Dummy_3.HysCmpFricWhlImbRejctnOffY.Ary1D CalRegn03Rt01GroupA_Dummy_3.HysCmpFricWhlImbRejctnOnY.Ary1D CalRegn03Rt01GroupA_Dummy_3.InertiaCmpVelAssiBasdDampgCoeffX.Ary1D CalRegn03Rt01GroupA_Dummy_3.InertiaCmpVelAssiBasdDampgRollgY.Ary1D CalRegn03Rt01GroupA_Dummy_3.InertiaCmpVelAssiBasdDampgStatY.Ary1D CalRegn03Rt01GroupA_Dummy_3.InertiaCmpVelDampgSpdBlndY.Ary1D CalRegn03Rt01GroupA_Dummy_3.InertiaCmpVelNotchBlndY.Ary1D CalRegn03Rt01GroupA_Dummy_3.RtnHwAgOffsCalcdX.Ary2D CalRegn03Rt01GroupA_Dummy_3.RtnHwAgOffsCalcdY.Ary2D CalRegn03Rt01GroupA_Dummy_3.RtnScaTqX.Ary2D CalRegn03Rt01GroupA_Dummy_3.RtnScaTqY.Ary2D CalRegn03Rt01GroupA_Dummy_3.RtnScaVelX.Ary2D CalRegn03Rt01GroupA_Dummy_3.RtnScaVelY.Ary2D /end SUB_GROUP
 /begin FUNCTION_LIST /end FUNCTION_LIST
 /begin REF_CHARACTERISTIC /end REF_CHARACTERISTIC
 /begin REF_MEASUREMENT /end REF_MEASUREMENT
/end GROUP
/begin GROUP CalRegn03Rt01GroupA_Dummy_3.DampgHydCoeff1ScaY.Ary1D "MICROSAR RTE" /begin SUB_GROUP /end SUB_GROUP /begin FUNCTION_LIST /end FUNCTION_LIST /begin REF_CHARACTERISTIC CalRegn03Rt01GroupA_Dummy_3.DampgHydCoeff1ScaY.Ary1D /end REF_CHARACTERISTIC /begin REF_MEASUREMENT /end REF_MEASUREMENT /end GROUP
/begin GROUP CalRegn03Rt01GroupA_Dummy_3.DampgHydCoeff2ScaY.Ary1D "MICROSAR RTE" /begin SUB_GROUP /end SUB_GROUP /begin FUNCTION_LIST /end FUNCTION_LIST /begin REF_CHARACTERISTIC CalRegn03Rt01GroupA_Dummy_3.DampgHydCoeff2ScaY.Ary1D /end REF_CHARACTERISTIC /begin REF_MEASUREMENT /end REF_MEASUREMENT /end GROUP
/begin GROUP CalRegn03Rt01GroupA_Dummy_3.DampgHydCoeff3ScaY.Ary1D "MICROSAR RTE" /begin SUB_GROUP /end SUB_GROUP /begin FUNCTION_LIST /end FUNCTION_LIST /begin REF_CHARACTERISTIC CalRegn03Rt01GroupA_Dummy_3.DampgHydCoeff3ScaY.Ary1D /end REF_CHARACTERISTIC /begin REF_MEASUREMENT /end REF_MEASUREMENT /end GROUP
/begin GROUP CalRegn03Rt01GroupA_Dummy_3.DampgHydCoeff4ScaY.Ary1D "MICROSAR RTE" /begin SUB_GROUP /end SUB_GROUP /begin FUNCTION_LIST /end FUNCTION_LIST /begin REF_CHARACTERISTIC CalRegn03Rt01GroupA_Dummy_3.DampgHydCoeff4ScaY.Ary1D /end REF_CHARACTERISTIC /begin REF_MEASUREMENT /end REF_MEASUREMENT /end GROUP
/begin GROUP CalRegn03Rt01GroupA_Dummy_3.DampgMotVelX.Ary2D "MICROSAR RTE" /begin SUB_GROUP /end SUB_GROUP /begin FUNCTION_LIST /end FUNCTION_LIST /begin REF_CHARACTERISTIC CalRegn03Rt01GroupA_Dummy_3.DampgMotVelX.Ary2D /end REF_CHARACTERISTIC /begin REF_MEASUREMENT /end REF_MEASUREMENT /end GROUP
/begin GROUP CalRegn03Rt01GroupA_Dummy_3.DampgMotVelY.Ary2D "MICROSAR RTE" /begin SUB_GROUP /end SUB_GROUP /begin FUNCTION_LIST /end FUNCTION_LIST /begin REF_CHARACTERISTIC CalRegn03Rt01GroupA_Dummy_3.DampgMotVelY.Ary2D /end REF_CHARACTERISTIC /begin REF_MEASUREMENT /end REF_MEASUREMENT /end GROUP
/begin GROUP CalRegn03Rt01GroupA_Dummy_3.HysCmpFricWhlImbRejctnBlndX.Ary1D "MICROSAR RTE" /begin SUB_GROUP /end SUB_GROUP /begin FUNCTION_LIST /end FUNCTION_LIST
 /begin REF_CHARACTERISTIC CalRegn03Rt01GroupA_Dummy_3.HysCmpFricWhlImbRejctnBlndX.Ary1D /end REF_CHARACTERISTIC
 /begin REF_MEASUREMENT /end REF_MEASUREMENT
/end GROUP
/begin GROUP CalRegn03Rt01GroupA_Dummy_3.HysCmpFricWhlImbRejctnBlndY.Ary1D "MICROSAR RTE" /begin SUB_GROUP /end SUB_GROUP /begin FUNCTION_LIST /end FUNCTION_LIST
 /begin REF_CHARACTERISTIC CalRegn03Rt01GroupA_Dummy_3.HysCmpFricWhlImbRejctnBlndY.Ary1D /end REF_CHARACTERISTIC
 /begin REF_MEASUREMENT /end REF_MEASUREMENT
/end GROUP
/begin GROUP CalRegn03Rt01GroupA_Dummy_3.HysCmpFricWhlImbRejctnOffY.Ary1D "MICROSAR RTE" /begin SUB_GROUP /end SUB_GROUP /begin FUNCTION_LIST /end FUNCTION_LIST
 /begin REF_CHARACTERISTIC CalRegn03Rt01GroupA_Dummy_3.HysCmpFricWhlImbRejctnOffY.Ary1D /end REF_CHARACTERISTIC
 /begin REF_MEASUREMENT /end REF_MEASUREMENT
/end GROUP
/begin GROUP CalRegn03Rt01GroupA_Dummy_3.HysCmpFricWhlImbRejctnOnY.Ary1D "MICROSAR RTE" /begin SUB_GROUP /end SUB_GROUP /begin FUNCTION_LIST /end FUNCTION_LIST
 /begin REF_CHARACTERISTIC CalRegn03Rt01GroupA_Dummy_3.HysCmpFricWhlImbRejctnOnY.Ary1D /end REF_CHARACTERISTIC
 /begin REF_MEASUREMENT /end REF_MEASUREMENT
/end GROUP
/begin GROUP CalRegn03Rt01GroupA_Dummy_3.InertiaCmpVelAssiBasdDampgCoeffX.Ary1D "MICROSAR RTE" /begin SUB_GROUP /end SUB_GROUP /begin FUNCTION_LIST /end FUNCTION_LIST
 /begin REF_CHARACTERISTIC CalRegn03Rt01GroupA_Dummy_3.InertiaCmpVelAssiBasdDampgCoeffX.Ary1D /end REF_CHARACTERISTIC
 /begin REF_MEASUREMENT /end REF_MEASUREMENT
/end GROUP
/begin GROUP CalRegn03Rt01GroupA_Dummy_3.InertiaCmpVelAssiBasdDampgRollgY.Ary1D "MICROSAR RTE" /begin SUB_GROUP /end SUB_GROUP /begin FUNCTION_LIST /end FUNCTION_LIST
 /begin REF_CHARACTERISTIC CalRegn03Rt01GroupA_Dummy_3.InertiaCmpVelAssiBasdDampgRollgY.Ary1D /end REF_CHARACTERISTIC
 /begin REF_MEASUREMENT /end REF_MEASUREMENT
/end GROUP
/begin GROUP CalRegn03Rt01GroupA_Dummy_3.InertiaCmpVelAssiBasdDampgStatY.Ary1D "MICROSAR RTE" /begin SUB_GROUP /end SUB_GROUP /begin FUNCTION_LIST /end FUNCTION_LIST
 /begin REF_CHARACTERISTIC CalRegn03Rt01GroupA_Dummy_3.InertiaCmpVelAssiBasdDampgStatY.Ary1D /end REF_CHARACTERISTIC
 /begin REF_MEASUREMENT /end REF_MEASUREMENT
/end GROUP
/begin GROUP CalRegn03Rt01GroupA_Dummy_3.InertiaCmpVelDampgSpdBlndY.Ary1D "MICROSAR RTE" /begin SUB_GROUP /end SUB_GROUP /begin FUNCTION_LIST /end FUNCTION_LIST
 /begin REF_CHARACTERISTIC CalRegn03Rt01GroupA_Dummy_3.InertiaCmpVelDampgSpdBlndY.Ary1D /end REF_CHARACTERISTIC
 /begin REF_MEASUREMENT /end REF_MEASUREMENT
/end GROUP
/begin GROUP CalRegn03Rt01GroupA_Dummy_3.InertiaCmpVelNotchBlndY.Ary1D "MICROSAR RTE" /begin SUB_GROUP /end SUB_GROUP /begin FUNCTION_LIST /end FUNCTION_LIST /begin REF_CHARACTERISTIC CalRegn03Rt01GroupA_Dummy_3.InertiaCmpVelNotchBlndY.Ary1D /end REF_CHARACTERISTIC /begin REF_MEASUREMENT /end REF_MEASUREMENT /end GROUP
/begin GROUP CalRegn03Rt01GroupA_Dummy_3.RtnHwAgOffsCalcdX.Ary2D "MICROSAR RTE" /begin SUB_GROUP /end SUB_GROUP /begin FUNCTION_LIST /end FUNCTION_LIST /begin REF_CHARACTERISTIC CalRegn03Rt01GroupA_Dummy_3.RtnHwAgOffsCalcdX.Ary2D /end REF_CHARACTERISTIC /begin REF_MEASUREMENT /end REF_MEASUREMENT /end GROUP
/begin GROUP CalRegn03Rt01GroupA_Dummy_3.RtnHwAgOffsCalcdY.Ary2D "MICROSAR RTE" /begin SUB_GROUP /end SUB_GROUP /begin FUNCTION_LIST /end FUNCTION_LIST /begin REF_CHARACTERISTIC CalRegn03Rt01GroupA_Dummy_3.RtnHwAgOffsCalcdY.Ary2D /end REF_CHARACTERISTIC /begin REF_MEASUREMENT /end REF_MEASUREMENT /end GROUP
/begin GROUP CalRegn03Rt01GroupA_Dummy_3.RtnScaTqX.Ary2D "MICROSAR RTE" /begin SUB_GROUP /end SUB_GROUP /begin FUNCTION_LIST /end FUNCTION_LIST /begin REF_CHARACTERISTIC CalRegn03Rt01GroupA_Dummy_3.RtnScaTqX.Ary2D /end REF_CHARACTERISTIC /begin REF_MEASUREMENT /end REF_MEASUREMENT /end GROUP
/begin GROUP CalRegn03Rt01GroupA_Dummy_3.RtnScaTqY.Ary2D "MICROSAR RTE" /begin SUB_GROUP /end SUB_GROUP /begin FUNCTION_LIST /end FUNCTION_LIST /begin REF_CHARACTERISTIC CalRegn03Rt01GroupA_Dummy_3.RtnScaTqY.Ary2D /end REF_CHARACTERISTIC /begin REF_MEASUREMENT /end REF_MEASUREMENT /end GROUP
/begin GROUP CalRegn03Rt01GroupA_Dummy_3.RtnScaVelX.Ary2D "MICROSAR RTE" /begin SUB_GROUP /end SUB_GROUP /begin FUNCTION_LIST /end FUNCTION_LIST /begin REF_CHARACTERISTIC CalRegn03Rt01GroupA_Dummy_3.RtnScaVelX.Ary2D /end REF_CHARACTERISTIC /begin REF_MEASUREMENT /end REF_MEASUREMENT /end GROUP
/begin GROUP CalRegn03Rt01GroupA_Dummy_3.RtnScaVelY.Ary2D "MICROSAR RTE" /begin SUB_GROUP /end SUB_GROUP /begin FUNCTION_LIST /end FUNCTION_LIST /begin REF_CHARACTERISTIC CalRegn03Rt01GroupA_Dummy_3.RtnScaVelY.Ary2D /end REF_CHARACTERISTIC /begin REF_MEASUREMENT /end REF_MEASUREMENT /end GROUP
/begin GROUP CalRegn03Rt01GroupA_Dummy_4 "MICROSAR RTE" /begin SUB_GROUP CalRegn03Rt01GroupA_Dummy_4.CalibrationPorts /end SUB_GROUP /begin FUNCTION_LIST /end FUNCTION_LIST /begin REF_CHARACTERISTIC /end REF_CHARACTERISTIC /begin REF_MEASUREMENT /end REF_MEASUREMENT /end GROUP
/begin GROUP CalRegn03Rt01GroupA_Dummy_4.AssiHiFrqGainY.Ary2D "MICROSAR RTE" /begin SUB_GROUP /end SUB_GROUP /begin FUNCTION_LIST /end FUNCTION_LIST /begin REF_CHARACTERISTIC CalRegn03Rt01GroupA_Dummy_4.AssiHiFrqGainY.Ary2D /end REF_CHARACTERISTIC /begin REF_MEASUREMENT /end REF_MEASUREMENT /end GROUP
/begin GROUP CalRegn03Rt01GroupA_Dummy_4.AssiHiFrqTqX.Ary2D "MICROSAR RTE" /begin SUB_GROUP /end SUB_GROUP /begin FUNCTION_LIST /end FUNCTION_LIST /begin REF_CHARACTERISTIC CalRegn03Rt01GroupA_Dummy_4.AssiHiFrqTqX.Ary2D /end REF_CHARACTERISTIC /begin REF_MEASUREMENT /end REF_MEASUREMENT /end GROUP
/begin GROUP CalRegn03Rt01GroupA_Dummy_4.AssiMotTqWhlImbRejctnMinX.Ary2D "MICROSAR RTE" /begin SUB_GROUP /end SUB_GROUP /begin FUNCTION_LIST /end FUNCTION_LIST
 /begin REF_CHARACTERISTIC CalRegn03Rt01GroupA_Dummy_4.AssiMotTqWhlImbRejctnMinX.Ary2D /end REF_CHARACTERISTIC
 /begin REF_MEASUREMENT /end REF_MEASUREMENT
/end GROUP
/begin GROUP CalRegn03Rt01GroupA_Dummy_4.AssiMotTqWhlImbRejctnMinY.Ary2D "MICROSAR RTE" /begin SUB_GROUP /end SUB_GROUP /begin FUNCTION_LIST /end FUNCTION_LIST
 /begin REF_CHARACTERISTIC CalRegn03Rt01GroupA_Dummy_4.AssiMotTqWhlImbRejctnMinY.Ary2D /end REF_CHARACTERISTIC
 /begin REF_MEASUREMENT /end REF_MEASUREMENT
/end GROUP
/begin GROUP CalRegn03Rt01GroupA_Dummy_4.CalibrationPorts "MICROSAR RTE"
 /begin SUB_GROUP CalRegn03Rt01GroupA_Dummy_4.AssiHiFrqGainY.Ary2D CalRegn03Rt01GroupA_Dummy_4.AssiHiFrqTqX.Ary2D CalRegn03Rt01GroupA_Dummy_4.AssiMotTqWhlImbRejctnMinX.Ary2D CalRegn03Rt01GroupA_Dummy_4.AssiMotTqWhlImbRejctnMinY.Ary2D CalRegn03Rt01GroupA_Dummy_4.DampgHydCoeff1ScaY.Ary1D CalRegn03Rt01GroupA_Dummy_4.DampgHydCoeff2ScaY.Ary1D CalRegn03Rt01GroupA_Dummy_4.DampgHydCoeff3ScaY.Ary1D CalRegn03Rt01GroupA_Dummy_4.DampgHydCoeff4ScaY.Ary1D CalRegn03Rt01GroupA_Dummy_4.DampgMotVelX.Ary2D CalRegn03Rt01GroupA_Dummy_4.DampgMotVelY.Ary2D CalRegn03Rt01GroupA_Dummy_4.HysCmpFricWhlImbRejctnBlndX.Ary1D CalRegn03Rt01GroupA_Dummy_4.HysCmpFricWhlImbRejctnBlndY.Ary1D CalRegn03Rt01GroupA_Dummy_4.HysCmpFricWhlImbRejctnOffY.Ary1D CalRegn03Rt01GroupA_Dummy_4.HysCmpFricWhlImbRejctnOnY.Ary1D CalRegn03Rt01GroupA_Dummy_4.InertiaCmpVelAssiBasdDampgCoeffX.Ary1D CalRegn03Rt01GroupA_Dummy_4.InertiaCmpVelAssiBasdDampgRollgY.Ary1D CalRegn03Rt01GroupA_Dummy_4.InertiaCmpVelAssiBasdDampgStatY.Ary1D CalRegn03Rt01GroupA_Dummy_4.InertiaCmpVelDampgSpdBlndY.Ary1D CalRegn03Rt01GroupA_Dummy_4.InertiaCmpVelNotchBlndY.Ary1D CalRegn03Rt01GroupA_Dummy_4.RtnHwAgOffsCalcdX.Ary2D CalRegn03Rt01GroupA_Dummy_4.RtnHwAgOffsCalcdY.Ary2D CalRegn03Rt01GroupA_Dummy_4.RtnScaTqX.Ary2D CalRegn03Rt01GroupA_Dummy_4.RtnScaTqY.Ary2D CalRegn03Rt01GroupA_Dummy_4.RtnScaVelX.Ary2D CalRegn03Rt01GroupA_Dummy_4.RtnScaVelY.Ary2D /end SUB_GROUP
 /begin FUNCTION_LIST /end FUNCTION_LIST
 /begin REF_CHARACTERISTIC /end REF_CHARACTERISTIC
 /begin REF_MEASUREMENT /end REF_MEASUREMENT
/end GROUP
/begin GROUP CalRegn03Rt01GroupA_Dummy_4.DampgHydCoeff1ScaY.Ary1D "MICROSAR RTE" /begin SUB_GROUP /end SUB_GROUP /begin FUNCTION_LIST /end FUNCTION_LIST /begin REF_CHARACTERISTIC CalRegn03Rt01GroupA_Dummy_4.DampgHydCoeff1ScaY.Ary1D /end REF_CHARACTERISTIC /begin REF_MEASUREMENT /end REF_MEASUREMENT /end GROUP
/begin GROUP CalRegn03Rt01GroupA_Dummy_4.DampgHydCoeff2ScaY.Ary1D "MICROSAR RTE" /begin SUB_GROUP /end SUB_GROUP /begin FUNCTION_LIST /end FUNCTION_LIST /begin REF_CHARACTERISTIC CalRegn03Rt01GroupA_Dummy_4.DampgHydCoeff2ScaY.Ary1D /end REF_CHARACTERISTIC /begin REF_MEASUREMENT /end REF_MEASUREMENT /end GROUP
/begin GROUP CalRegn03Rt01GroupA_Dummy_4.DampgHydCoeff3ScaY.Ary1D "MICROSAR RTE" /begin SUB_GROUP /end SUB_GROUP /begin FUNCTION_LIST /end FUNCTION_LIST /begin REF_CHARACTERISTIC CalRegn03Rt01GroupA_Dummy_4.DampgHydCoeff3ScaY.Ary1D /end REF_CHARACTERISTIC /begin REF_MEASUREMENT /end REF_MEASUREMENT /end GROUP
/begin GROUP CalRegn03Rt01GroupA_Dummy_4.DampgHydCoeff4ScaY.Ary1D "MICROSAR RTE" /begin SUB_GROUP /end SUB_GROUP /begin FUNCTION_LIST /end FUNCTION_LIST /begin REF_CHARACTERISTIC CalRegn03Rt01GroupA_Dummy_4.DampgHydCoeff4ScaY.Ary1D /end REF_CHARACTERISTIC /begin REF_MEASUREMENT /end REF_MEASUREMENT /end GROUP
/begin GROUP CalRegn03Rt01GroupA_Dummy_4.DampgMotVelX.Ary2D "MICROSAR RTE" /begin SUB_GROUP /end SUB_GROUP /begin FUNCTION_LIST /end FUNCTION_LIST /begin REF_CHARACTERISTIC CalRegn03Rt01GroupA_Dummy_4.DampgMotVelX.Ary2D /end REF_CHARACTERISTIC /begin REF_MEASUREMENT /end REF_MEASUREMENT /end GROUP
/begin GROUP CalRegn03Rt01GroupA_Dummy_4.DampgMotVelY.Ary2D "MICROSAR RTE" /begin SUB_GROUP /end SUB_GROUP /begin FUNCTION_LIST /end FUNCTION_LIST /begin REF_CHARACTERISTIC CalRegn03Rt01GroupA_Dummy_4.DampgMotVelY.Ary2D /end REF_CHARACTERISTIC /begin REF_MEASUREMENT /end REF_MEASUREMENT /end GROUP
/begin GROUP CalRegn03Rt01GroupA_Dummy_4.HysCmpFricWhlImbRejctnBlndX.Ary1D "MICROSAR RTE" /begin SUB_GROUP /end SUB_GROUP /begin FUNCTION_LIST /end FUNCTION_LIST
 /begin REF_CHARACTERISTIC CalRegn03Rt01GroupA_Dummy_4.HysCmpFricWhlImbRejctnBlndX.Ary1D /end REF_CHARACTERISTIC
 /begin REF_MEASUREMENT /end REF_MEASUREMENT
/end GROUP
/begin GROUP CalRegn03Rt01GroupA_Dummy_4.HysCmpFricWhlImbRejctnBlndY.Ary1D "MICROSAR RTE" /begin SUB_GROUP /end SUB_GROUP /begin FUNCTION_LIST /end FUNCTION_LIST
 /begin REF_CHARACTERISTIC CalRegn03Rt01GroupA_Dummy_4.HysCmpFricWhlImbRejctnBlndY.Ary1D /end REF_CHARACTERISTIC
 /begin REF_MEASUREMENT /end REF_MEASUREMENT
/end GROUP
/begin GROUP CalRegn03Rt01GroupA_Dummy_4.HysCmpFricWhlImbRejctnOffY.Ary1D "MICROSAR RTE" /begin SUB_GROUP /end SUB_GROUP /begin FUNCTION_LIST /end FUNCTION_LIST
 /begin REF_CHARACTERISTIC CalRegn03Rt01GroupA_Dummy_4.HysCmpFricWhlImbRejctnOffY.Ary1D /end REF_CHARACTERISTIC
 /begin REF_MEASUREMENT /end REF_MEASUREMENT
/end GROUP
/begin GROUP CalRegn03Rt01GroupA_Dummy_4.HysCmpFricWhlImbRejctnOnY.Ary1D "MICROSAR RTE" /begin SUB_GROUP /end SUB_GROUP /begin FUNCTION_LIST /end FUNCTION_LIST
 /begin REF_CHARACTERISTIC CalRegn03Rt01GroupA_Dummy_4.HysCmpFricWhlImbRejctnOnY.Ary1D /end REF_CHARACTERISTIC
 /begin REF_MEASUREMENT /end REF_MEASUREMENT
/end GROUP
/begin GROUP CalRegn03Rt01GroupA_Dummy_4.InertiaCmpVelAssiBasdDampgCoeffX.Ary1D "MICROSAR RTE" /begin SUB_GROUP /end SUB_GROUP /begin FUNCTION_LIST /end FUNCTION_LIST
 /begin REF_CHARACTERISTIC CalRegn03Rt01GroupA_Dummy_4.InertiaCmpVelAssiBasdDampgCoeffX.Ary1D /end REF_CHARACTERISTIC
 /begin REF_MEASUREMENT /end REF_MEASUREMENT
/end GROUP
/begin GROUP CalRegn03Rt01GroupA_Dummy_4.InertiaCmpVelAssiBasdDampgRollgY.Ary1D "MICROSAR RTE" /begin SUB_GROUP /end SUB_GROUP /begin FUNCTION_LIST /end FUNCTION_LIST
 /begin REF_CHARACTERISTIC CalRegn03Rt01GroupA_Dummy_4.InertiaCmpVelAssiBasdDampgRollgY.Ary1D /end REF_CHARACTERISTIC
 /begin REF_MEASUREMENT /end REF_MEASUREMENT
/end GROUP
/begin GROUP CalRegn03Rt01GroupA_Dummy_4.InertiaCmpVelAssiBasdDampgStatY.Ary1D "MICROSAR RTE" /begin SUB_GROUP /end SUB_GROUP /begin FUNCTION_LIST /end FUNCTION_LIST
 /begin REF_CHARACTERISTIC CalRegn03Rt01GroupA_Dummy_4.InertiaCmpVelAssiBasdDampgStatY.Ary1D /end REF_CHARACTERISTIC
 /begin REF_MEASUREMENT /end REF_MEASUREMENT
/end GROUP
/begin GROUP CalRegn03Rt01GroupA_Dummy_4.InertiaCmpVelDampgSpdBlndY.Ary1D "MICROSAR RTE" /begin SUB_GROUP /end SUB_GROUP /begin FUNCTION_LIST /end FUNCTION_LIST
 /begin REF_CHARACTERISTIC CalRegn03Rt01GroupA_Dummy_4.InertiaCmpVelDampgSpdBlndY.Ary1D /end REF_CHARACTERISTIC
 /begin REF_MEASUREMENT /end REF_MEASUREMENT
/end GROUP
/begin GROUP CalRegn03Rt01GroupA_Dummy_4.InertiaCmpVelNotchBlndY.Ary1D "MICROSAR RTE" /begin SUB_GROUP /end SUB_GROUP /begin FUNCTION_LIST /end FUNCTION_LIST /begin REF_CHARACTERISTIC CalRegn03Rt01GroupA_Dummy_4.InertiaCmpVelNotchBlndY.Ary1D /end REF_CHARACTERISTIC /begin REF_MEASUREMENT /end REF_MEASUREMENT /end GROUP
/begin GROUP CalRegn03Rt01GroupA_Dummy_4.RtnHwAgOffsCalcdX.Ary2D "MICROSAR RTE" /begin SUB_GROUP /end SUB_GROUP /begin FUNCTION_LIST /end FUNCTION_LIST /begin REF_CHARACTERISTIC CalRegn03Rt01GroupA_Dummy_4.RtnHwAgOffsCalcdX.Ary2D /end REF_CHARACTERISTIC /begin REF_MEASUREMENT /end REF_MEASUREMENT /end GROUP
/begin GROUP CalRegn03Rt01GroupA_Dummy_4.RtnHwAgOffsCalcdY.Ary2D "MICROSAR RTE" /begin SUB_GROUP /end SUB_GROUP /begin FUNCTION_LIST /end FUNCTION_LIST /begin REF_CHARACTERISTIC CalRegn03Rt01GroupA_Dummy_4.RtnHwAgOffsCalcdY.Ary2D /end REF_CHARACTERISTIC /begin REF_MEASUREMENT /end REF_MEASUREMENT /end GROUP
/begin GROUP CalRegn03Rt01GroupA_Dummy_4.RtnScaTqX.Ary2D "MICROSAR RTE" /begin SUB_GROUP /end SUB_GROUP /begin FUNCTION_LIST /end FUNCTION_LIST /begin REF_CHARACTERISTIC CalRegn03Rt01GroupA_Dummy_4.RtnScaTqX.Ary2D /end REF_CHARACTERISTIC /begin REF_MEASUREMENT /end REF_MEASUREMENT /end GROUP
/begin GROUP CalRegn03Rt01GroupA_Dummy_4.RtnScaTqY.Ary2D "MICROSAR RTE" /begin SUB_GROUP /end SUB_GROUP /begin FUNCTION_LIST /end FUNCTION_LIST /begin REF_CHARACTERISTIC CalRegn03Rt01GroupA_Dummy_4.RtnScaTqY.Ary2D /end REF_CHARACTERISTIC /begin REF_MEASUREMENT /end REF_MEASUREMENT /end GROUP
/begin GROUP CalRegn03Rt01GroupA_Dummy_4.RtnScaVelX.Ary2D "MICROSAR RTE" /begin SUB_GROUP /end SUB_GROUP /begin FUNCTION_LIST /end FUNCTION_LIST /begin REF_CHARACTERISTIC CalRegn03Rt01GroupA_Dummy_4.RtnScaVelX.Ary2D /end REF_CHARACTERISTIC /begin REF_MEASUREMENT /end REF_MEASUREMENT /end GROUP
/begin GROUP CalRegn03Rt01GroupA_Dummy_4.RtnScaVelY.Ary2D "MICROSAR RTE" /begin SUB_GROUP /end SUB_GROUP /begin FUNCTION_LIST /end FUNCTION_LIST /begin REF_CHARACTERISTIC CalRegn03Rt01GroupA_Dummy_4.RtnScaVelY.Ary2D /end REF_CHARACTERISTIC /begin REF_MEASUREMENT /end REF_MEASUREMENT /end GROUP
/begin GROUP CalRegn03Rt01GroupB "MICROSAR RTE" /begin SUB_GROUP CalRegn03Rt01GroupB.CalibrationPorts /end SUB_GROUP /begin FUNCTION_LIST /end FUNCTION_LIST /begin REF_CHARACTERISTIC /end REF_CHARACTERISTIC /begin REF_MEASUREMENT /end REF_MEASUREMENT /end GROUP
/begin GROUP CalRegn03Rt01GroupB.AssiHiFrqTqWhlImbRejctnTqX.Ary2D "MICROSAR RTE" /begin SUB_GROUP /end SUB_GROUP /begin FUNCTION_LIST /end FUNCTION_LIST /begin REF_CHARACTERISTIC CalRegn03Rt01GroupB.AssiHiFrqTqWhlImbRejctnTqX.Ary2D /end REF_CHARACTERISTIC /begin REF_MEASUREMENT /end REF_MEASUREMENT /end GROUP
/begin GROUP CalRegn03Rt01GroupB.AssiHiFrqWhlImbRejctnGainY.Ary2D "MICROSAR RTE" /begin SUB_GROUP /end SUB_GROUP /begin FUNCTION_LIST /end FUNCTION_LIST /begin REF_CHARACTERISTIC CalRegn03Rt01GroupB.AssiHiFrqWhlImbRejctnGainY.Ary2D /end REF_CHARACTERISTIC /begin REF_MEASUREMENT /end REF_MEASUREMENT /end GROUP
/begin GROUP CalRegn03Rt01GroupB.AssiHiFrqWhlImbRejtcnBlndX.Ary2D "MICROSAR RTE" /begin SUB_GROUP /end SUB_GROUP /begin FUNCTION_LIST /end FUNCTION_LIST /begin REF_CHARACTERISTIC CalRegn03Rt01GroupB.AssiHiFrqWhlImbRejtcnBlndX.Ary2D /end REF_CHARACTERISTIC /begin REF_MEASUREMENT /end REF_MEASUREMENT /end GROUP
/begin GROUP CalRegn03Rt01GroupB.AssiHiFrqWhlImbRejtcnBlndY.Ary2D "MICROSAR RTE" /begin SUB_GROUP /end SUB_GROUP /begin FUNCTION_LIST /end FUNCTION_LIST /begin REF_CHARACTERISTIC CalRegn03Rt01GroupB.AssiHiFrqWhlImbRejtcnBlndY.Ary2D /end REF_CHARACTERISTIC /begin REF_MEASUREMENT /end REF_MEASUREMENT /end GROUP
/begin GROUP CalRegn03Rt01GroupB.AssiMotTqWhlImbRejctnMaxX.Ary2D "MICROSAR RTE" /begin SUB_GROUP /end SUB_GROUP /begin FUNCTION_LIST /end FUNCTION_LIST /begin REF_CHARACTERISTIC CalRegn03Rt01GroupB.AssiMotTqWhlImbRejctnMaxX.Ary2D /end REF_CHARACTERISTIC /begin REF_MEASUREMENT /end REF_MEASUREMENT /end GROUP
/begin GROUP CalRegn03Rt01GroupB.AssiMotTqWhlImbRejctnMaxY.Ary2D "MICROSAR RTE" /begin SUB_GROUP /end SUB_GROUP /begin FUNCTION_LIST /end FUNCTION_LIST /begin REF_CHARACTERISTIC CalRegn03Rt01GroupB.AssiMotTqWhlImbRejctnMaxY.Ary2D /end REF_CHARACTERISTIC /begin REF_MEASUREMENT /end REF_MEASUREMENT /end GROUP
/begin GROUP CalRegn03Rt01GroupB.AssiWhlImbRejctnBlndScaX.Ary2D "MICROSAR RTE" /begin SUB_GROUP /end SUB_GROUP /begin FUNCTION_LIST /end FUNCTION_LIST /begin REF_CHARACTERISTIC CalRegn03Rt01GroupB.AssiWhlImbRejctnBlndScaX.Ary2D /end REF_CHARACTERISTIC /begin REF_MEASUREMENT /end REF_MEASUREMENT /end GROUP
/begin GROUP CalRegn03Rt01GroupB.AssiWhlImbRejctnBlndScaY.Ary2D "MICROSAR RTE" /begin SUB_GROUP /end SUB_GROUP /begin FUNCTION_LIST /end FUNCTION_LIST /begin REF_CHARACTERISTIC CalRegn03Rt01GroupB.AssiWhlImbRejctnBlndScaY.Ary2D /end REF_CHARACTERISTIC /begin REF_MEASUREMENT /end REF_MEASUREMENT /end GROUP
/begin GROUP CalRegn03Rt01GroupB.CalibrationPorts "MICROSAR RTE"
 /begin SUB_GROUP CalRegn03Rt01GroupB.AssiHiFrqTqWhlImbRejctnTqX.Ary2D CalRegn03Rt01GroupB.AssiHiFrqWhlImbRejctnGainY.Ary2D CalRegn03Rt01GroupB.AssiHiFrqWhlImbRejtcnBlndX.Ary2D CalRegn03Rt01GroupB.AssiHiFrqWhlImbRejtcnBlndY.Ary2D CalRegn03Rt01GroupB.AssiMotTqWhlImbRejctnMaxX.Ary2D CalRegn03Rt01GroupB.AssiMotTqWhlImbRejctnMaxY.Ary2D CalRegn03Rt01GroupB.AssiWhlImbRejctnBlndScaX.Ary2D CalRegn03Rt01GroupB.AssiWhlImbRejctnBlndScaY.Ary2D CalRegn03Rt01GroupB.EotProtnDampgVehSpdTbl.Ary1D CalRegn03Rt01GroupB.EotProtnEntrGainVehSpdTbl.Ary1D CalRegn03Rt01GroupB.EotProtnEntrGainX.Ary2D CalRegn03Rt01GroupB.EotProtnEntrGainY.Ary2D CalRegn03Rt01GroupB.EotProtnExitDampgY.Ary2D CalRegn03Rt01GroupB.EotProtnHwDegDampgX.Ary2D CalRegn03Rt01GroupB.EotProtnNormDampgY.Ary2D CalRegn03Rt01GroupB.InertiaCmpVelAssiBasdDampgRollgWhlImbRejctnOnY.Ary1D /end SUB_GROUP
 /begin FUNCTION_LIST /end FUNCTION_LIST
 /begin REF_CHARACTERISTIC /end REF_CHARACTERISTIC
 /begin REF_MEASUREMENT /end REF_MEASUREMENT
/end GROUP
/begin GROUP CalRegn03Rt01GroupB.EotProtnDampgVehSpdTbl.Ary1D "MICROSAR RTE" /begin SUB_GROUP /end SUB_GROUP /begin FUNCTION_LIST /end FUNCTION_LIST /begin REF_CHARACTERISTIC CalRegn03Rt01GroupB.EotProtnDampgVehSpdTbl.Ary1D /end REF_CHARACTERISTIC /begin REF_MEASUREMENT /end REF_MEASUREMENT /end GROUP
/begin GROUP CalRegn03Rt01GroupB.EotProtnEntrGainVehSpdTbl.Ary1D "MICROSAR RTE" /begin SUB_GROUP /end SUB_GROUP /begin FUNCTION_LIST /end FUNCTION_LIST /begin REF_CHARACTERISTIC CalRegn03Rt01GroupB.EotProtnEntrGainVehSpdTbl.Ary1D /end REF_CHARACTERISTIC /begin REF_MEASUREMENT /end REF_MEASUREMENT /end GROUP
/begin GROUP CalRegn03Rt01GroupB.EotProtnEntrGainX.Ary2D "MICROSAR RTE" /begin SUB_GROUP /end SUB_GROUP /begin FUNCTION_LIST /end FUNCTION_LIST /begin REF_CHARACTERISTIC CalRegn03Rt01GroupB.EotProtnEntrGainX.Ary2D /end REF_CHARACTERISTIC /begin REF_MEASUREMENT /end REF_MEASUREMENT /end GROUP
/begin GROUP CalRegn03Rt01GroupB.EotProtnEntrGainY.Ary2D "MICROSAR RTE" /begin SUB_GROUP /end SUB_GROUP /begin FUNCTION_LIST /end FUNCTION_LIST /begin REF_CHARACTERISTIC CalRegn03Rt01GroupB.EotProtnEntrGainY.Ary2D /end REF_CHARACTERISTIC /begin REF_MEASUREMENT /end REF_MEASUREMENT /end GROUP
/begin GROUP CalRegn03Rt01GroupB.EotProtnExitDampgY.Ary2D "MICROSAR RTE" /begin SUB_GROUP /end SUB_GROUP /begin FUNCTION_LIST /end FUNCTION_LIST /begin REF_CHARACTERISTIC CalRegn03Rt01GroupB.EotProtnExitDampgY.Ary2D /end REF_CHARACTERISTIC /begin REF_MEASUREMENT /end REF_MEASUREMENT /end GROUP
/begin GROUP CalRegn03Rt01GroupB.EotProtnHwDegDampgX.Ary2D "MICROSAR RTE" /begin SUB_GROUP /end SUB_GROUP /begin FUNCTION_LIST /end FUNCTION_LIST /begin REF_CHARACTERISTIC CalRegn03Rt01GroupB.EotProtnHwDegDampgX.Ary2D /end REF_CHARACTERISTIC /begin REF_MEASUREMENT /end REF_MEASUREMENT /end GROUP
/begin GROUP CalRegn03Rt01GroupB.EotProtnNormDampgY.Ary2D "MICROSAR RTE" /begin SUB_GROUP /end SUB_GROUP /begin FUNCTION_LIST /end FUNCTION_LIST /begin REF_CHARACTERISTIC CalRegn03Rt01GroupB.EotProtnNormDampgY.Ary2D /end REF_CHARACTERISTIC /begin REF_MEASUREMENT /end REF_MEASUREMENT /end GROUP
/begin GROUP CalRegn03Rt01GroupB.InertiaCmpVelAssiBasdDampgRollgWhlImbRejctnOnY.Ary1D "MICROSAR RTE" /begin SUB_GROUP /end SUB_GROUP /begin FUNCTION_LIST /end FUNCTION_LIST
 /begin REF_CHARACTERISTIC CalRegn03Rt01GroupB.InertiaCmpVelAssiBasdDampgRollgWhlImbRejctnOnY.Ary1D /end REF_CHARACTERISTIC
 /begin REF_MEASUREMENT /end REF_MEASUREMENT
/end GROUP
/begin GROUP CalRegn03Rt01GroupB_Dummy "MICROSAR RTE" /begin SUB_GROUP CalRegn03Rt01GroupB_Dummy.CalibrationPorts /end SUB_GROUP /begin FUNCTION_LIST /end FUNCTION_LIST /begin REF_CHARACTERISTIC /end REF_CHARACTERISTIC /begin REF_MEASUREMENT /end REF_MEASUREMENT /end GROUP
/begin GROUP CalRegn03Rt01GroupB_Dummy.AssiHiFrqTqWhlImbRejctnTqX.Ary2D "MICROSAR RTE" /begin SUB_GROUP /end SUB_GROUP /begin FUNCTION_LIST /end FUNCTION_LIST /begin REF_CHARACTERISTIC CalRegn03Rt01GroupB_Dummy.AssiHiFrqTqWhlImbRejctnTqX.Ary2D /end REF_CHARACTERISTIC /begin REF_MEASUREMENT /end REF_MEASUREMENT /end GROUP
/begin GROUP CalRegn03Rt01GroupB_Dummy.AssiHiFrqWhlImbRejctnGainY.Ary2D "MICROSAR RTE" /begin SUB_GROUP /end SUB_GROUP /begin FUNCTION_LIST /end FUNCTION_LIST /begin REF_CHARACTERISTIC CalRegn03Rt01GroupB_Dummy.AssiHiFrqWhlImbRejctnGainY.Ary2D /end REF_CHARACTERISTIC /begin REF_MEASUREMENT /end REF_MEASUREMENT /end GROUP
/begin GROUP CalRegn03Rt01GroupB_Dummy.AssiHiFrqWhlImbRejtcnBlndX.Ary2D "MICROSAR RTE" /begin SUB_GROUP /end SUB_GROUP /begin FUNCTION_LIST /end FUNCTION_LIST /begin REF_CHARACTERISTIC CalRegn03Rt01GroupB_Dummy.AssiHiFrqWhlImbRejtcnBlndX.Ary2D /end REF_CHARACTERISTIC /begin REF_MEASUREMENT /end REF_MEASUREMENT /end GROUP
/begin GROUP CalRegn03Rt01GroupB_Dummy.AssiHiFrqWhlImbRejtcnBlndY.Ary2D "MICROSAR RTE" /begin SUB_GROUP /end SUB_GROUP /begin FUNCTION_LIST /end FUNCTION_LIST /begin REF_CHARACTERISTIC CalRegn03Rt01GroupB_Dummy.AssiHiFrqWhlImbRejtcnBlndY.Ary2D /end REF_CHARACTERISTIC /begin REF_MEASUREMENT /end REF_MEASUREMENT /end GROUP
/begin GROUP CalRegn03Rt01GroupB_Dummy.AssiMotTqWhlImbRejctnMaxX.Ary2D "MICROSAR RTE" /begin SUB_GROUP /end SUB_GROUP /begin FUNCTION_LIST /end FUNCTION_LIST /begin REF_CHARACTERISTIC CalRegn03Rt01GroupB_Dummy.AssiMotTqWhlImbRejctnMaxX.Ary2D /end REF_CHARACTERISTIC /begin REF_MEASUREMENT /end REF_MEASUREMENT /end GROUP
/begin GROUP CalRegn03Rt01GroupB_Dummy.AssiMotTqWhlImbRejctnMaxY.Ary2D "MICROSAR RTE" /begin SUB_GROUP /end SUB_GROUP /begin FUNCTION_LIST /end FUNCTION_LIST /begin REF_CHARACTERISTIC CalRegn03Rt01GroupB_Dummy.AssiMotTqWhlImbRejctnMaxY.Ary2D /end REF_CHARACTERISTIC /begin REF_MEASUREMENT /end REF_MEASUREMENT /end GROUP
/begin GROUP CalRegn03Rt01GroupB_Dummy.AssiWhlImbRejctnBlndScaX.Ary2D "MICROSAR RTE" /begin SUB_GROUP /end SUB_GROUP /begin FUNCTION_LIST /end FUNCTION_LIST /begin REF_CHARACTERISTIC CalRegn03Rt01GroupB_Dummy.AssiWhlImbRejctnBlndScaX.Ary2D /end REF_CHARACTERISTIC /begin REF_MEASUREMENT /end REF_MEASUREMENT /end GROUP
/begin GROUP CalRegn03Rt01GroupB_Dummy.AssiWhlImbRejctnBlndScaY.Ary2D "MICROSAR RTE" /begin SUB_GROUP /end SUB_GROUP /begin FUNCTION_LIST /end FUNCTION_LIST /begin REF_CHARACTERISTIC CalRegn03Rt01GroupB_Dummy.AssiWhlImbRejctnBlndScaY.Ary2D /end REF_CHARACTERISTIC /begin REF_MEASUREMENT /end REF_MEASUREMENT /end GROUP
/begin GROUP CalRegn03Rt01GroupB_Dummy.CalibrationPorts "MICROSAR RTE"
 /begin SUB_GROUP CalRegn03Rt01GroupB_Dummy.AssiHiFrqTqWhlImbRejctnTqX.Ary2D CalRegn03Rt01GroupB_Dummy.AssiHiFrqWhlImbRejctnGainY.Ary2D CalRegn03Rt01GroupB_Dummy.AssiHiFrqWhlImbRejtcnBlndX.Ary2D CalRegn03Rt01GroupB_Dummy.AssiHiFrqWhlImbRejtcnBlndY.Ary2D CalRegn03Rt01GroupB_Dummy.AssiMotTqWhlImbRejctnMaxX.Ary2D CalRegn03Rt01GroupB_Dummy.AssiMotTqWhlImbRejctnMaxY.Ary2D CalRegn03Rt01GroupB_Dummy.AssiWhlImbRejctnBlndScaX.Ary2D CalRegn03Rt01GroupB_Dummy.AssiWhlImbRejctnBlndScaY.Ary2D CalRegn03Rt01GroupB_Dummy.EotProtnDampgVehSpdTbl.Ary1D CalRegn03Rt01GroupB_Dummy.EotProtnEntrGainVehSpdTbl.Ary1D CalRegn03Rt01GroupB_Dummy.EotProtnEntrGainX.Ary2D CalRegn03Rt01GroupB_Dummy.EotProtnEntrGainY.Ary2D CalRegn03Rt01GroupB_Dummy.EotProtnExitDampgY.Ary2D CalRegn03Rt01GroupB_Dummy.EotProtnHwDegDampgX.Ary2D CalRegn03Rt01GroupB_Dummy.EotProtnNormDampgY.Ary2D CalRegn03Rt01GroupB_Dummy.InertiaCmpVelAssiBasdDampgRollgWhlImbRejctnOnY.Ary1D /end SUB_GROUP
 /begin FUNCTION_LIST /end FUNCTION_LIST
 /begin REF_CHARACTERISTIC /end REF_CHARACTERISTIC
 /begin REF_MEASUREMENT /end REF_MEASUREMENT
/end GROUP
/begin GROUP CalRegn03Rt01GroupB_Dummy.EotProtnDampgVehSpdTbl.Ary1D "MICROSAR RTE" /begin SUB_GROUP /end SUB_GROUP /begin FUNCTION_LIST /end FUNCTION_LIST /begin REF_CHARACTERISTIC CalRegn03Rt01GroupB_Dummy.EotProtnDampgVehSpdTbl.Ary1D /end REF_CHARACTERISTIC /begin REF_MEASUREMENT /end REF_MEASUREMENT /end GROUP
/begin GROUP CalRegn03Rt01GroupB_Dummy.EotProtnEntrGainVehSpdTbl.Ary1D "MICROSAR RTE" /begin SUB_GROUP /end SUB_GROUP /begin FUNCTION_LIST /end FUNCTION_LIST /begin REF_CHARACTERISTIC CalRegn03Rt01GroupB_Dummy.EotProtnEntrGainVehSpdTbl.Ary1D /end REF_CHARACTERISTIC /begin REF_MEASUREMENT /end REF_MEASUREMENT /end GROUP
/begin GROUP CalRegn03Rt01GroupB_Dummy.EotProtnEntrGainX.Ary2D "MICROSAR RTE" /begin SUB_GROUP /end SUB_GROUP /begin FUNCTION_LIST /end FUNCTION_LIST /begin REF_CHARACTERISTIC CalRegn03Rt01GroupB_Dummy.EotProtnEntrGainX.Ary2D /end REF_CHARACTERISTIC /begin REF_MEASUREMENT /end REF_MEASUREMENT /end GROUP
/begin GROUP CalRegn03Rt01GroupB_Dummy.EotProtnEntrGainY.Ary2D "MICROSAR RTE" /begin SUB_GROUP /end SUB_GROUP /begin FUNCTION_LIST /end FUNCTION_LIST /begin REF_CHARACTERISTIC CalRegn03Rt01GroupB_Dummy.EotProtnEntrGainY.Ary2D /end REF_CHARACTERISTIC /begin REF_MEASUREMENT /end REF_MEASUREMENT /end GROUP
/begin GROUP CalRegn03Rt01GroupB_Dummy.EotProtnExitDampgY.Ary2D "MICROSAR RTE" /begin SUB_GROUP /end SUB_GROUP /begin FUNCTION_LIST /end FUNCTION_LIST /begin REF_CHARACTERISTIC CalRegn03Rt01GroupB_Dummy.EotProtnExitDampgY.Ary2D /end REF_CHARACTERISTIC /begin REF_MEASUREMENT /end REF_MEASUREMENT /end GROUP
/begin GROUP CalRegn03Rt01GroupB_Dummy.EotProtnHwDegDampgX.Ary2D "MICROSAR RTE" /begin SUB_GROUP /end SUB_GROUP /begin FUNCTION_LIST /end FUNCTION_LIST /begin REF_CHARACTERISTIC CalRegn03Rt01GroupB_Dummy.EotProtnHwDegDampgX.Ary2D /end REF_CHARACTERISTIC /begin REF_MEASUREMENT /end REF_MEASUREMENT /end GROUP
/begin GROUP CalRegn03Rt01GroupB_Dummy.EotProtnNormDampgY.Ary2D "MICROSAR RTE" /begin SUB_GROUP /end SUB_GROUP /begin FUNCTION_LIST /end FUNCTION_LIST /begin REF_CHARACTERISTIC CalRegn03Rt01GroupB_Dummy.EotProtnNormDampgY.Ary2D /end REF_CHARACTERISTIC /begin REF_MEASUREMENT /end REF_MEASUREMENT /end GROUP
/begin GROUP CalRegn03Rt01GroupB_Dummy.InertiaCmpVelAssiBasdDampgRollgWhlImbRejctnOnY.Ary1D "MICROSAR RTE" /begin SUB_GROUP /end SUB_GROUP /begin FUNCTION_LIST /end FUNCTION_LIST
 /begin REF_CHARACTERISTIC CalRegn03Rt01GroupB_Dummy.InertiaCmpVelAssiBasdDampgRollgWhlImbRejctnOnY.Ary1D /end REF_CHARACTERISTIC
 /begin REF_MEASUREMENT /end REF_MEASUREMENT
/end GROUP
/begin GROUP CalRegn03Rt01GroupB_Dummy_1 "MICROSAR RTE" /begin SUB_GROUP CalRegn03Rt01GroupB_Dummy_1.CalibrationPorts /end SUB_GROUP /begin FUNCTION_LIST /end FUNCTION_LIST /begin REF_CHARACTERISTIC /end REF_CHARACTERISTIC /begin REF_MEASUREMENT /end REF_MEASUREMENT /end GROUP
/begin GROUP CalRegn03Rt01GroupB_Dummy_1.AssiHiFrqTqWhlImbRejctnTqX.Ary2D "MICROSAR RTE" /begin SUB_GROUP /end SUB_GROUP /begin FUNCTION_LIST /end FUNCTION_LIST
 /begin REF_CHARACTERISTIC CalRegn03Rt01GroupB_Dummy_1.AssiHiFrqTqWhlImbRejctnTqX.Ary2D /end REF_CHARACTERISTIC
 /begin REF_MEASUREMENT /end REF_MEASUREMENT
/end GROUP
/begin GROUP CalRegn03Rt01GroupB_Dummy_1.AssiHiFrqWhlImbRejctnGainY.Ary2D "MICROSAR RTE" /begin SUB_GROUP /end SUB_GROUP /begin FUNCTION_LIST /end FUNCTION_LIST
 /begin REF_CHARACTERISTIC CalRegn03Rt01GroupB_Dummy_1.AssiHiFrqWhlImbRejctnGainY.Ary2D /end REF_CHARACTERISTIC
 /begin REF_MEASUREMENT /end REF_MEASUREMENT
/end GROUP
/begin GROUP CalRegn03Rt01GroupB_Dummy_1.AssiHiFrqWhlImbRejtcnBlndX.Ary2D "MICROSAR RTE" /begin SUB_GROUP /end SUB_GROUP /begin FUNCTION_LIST /end FUNCTION_LIST
 /begin REF_CHARACTERISTIC CalRegn03Rt01GroupB_Dummy_1.AssiHiFrqWhlImbRejtcnBlndX.Ary2D /end REF_CHARACTERISTIC
 /begin REF_MEASUREMENT /end REF_MEASUREMENT
/end GROUP
/begin GROUP CalRegn03Rt01GroupB_Dummy_1.AssiHiFrqWhlImbRejtcnBlndY.Ary2D "MICROSAR RTE" /begin SUB_GROUP /end SUB_GROUP /begin FUNCTION_LIST /end FUNCTION_LIST
 /begin REF_CHARACTERISTIC CalRegn03Rt01GroupB_Dummy_1.AssiHiFrqWhlImbRejtcnBlndY.Ary2D /end REF_CHARACTERISTIC
 /begin REF_MEASUREMENT /end REF_MEASUREMENT
/end GROUP
/begin GROUP CalRegn03Rt01GroupB_Dummy_1.AssiMotTqWhlImbRejctnMaxX.Ary2D "MICROSAR RTE" /begin SUB_GROUP /end SUB_GROUP /begin FUNCTION_LIST /end FUNCTION_LIST
 /begin REF_CHARACTERISTIC CalRegn03Rt01GroupB_Dummy_1.AssiMotTqWhlImbRejctnMaxX.Ary2D /end REF_CHARACTERISTIC
 /begin REF_MEASUREMENT /end REF_MEASUREMENT
/end GROUP
/begin GROUP CalRegn03Rt01GroupB_Dummy_1.AssiMotTqWhlImbRejctnMaxY.Ary2D "MICROSAR RTE" /begin SUB_GROUP /end SUB_GROUP /begin FUNCTION_LIST /end FUNCTION_LIST
 /begin REF_CHARACTERISTIC CalRegn03Rt01GroupB_Dummy_1.AssiMotTqWhlImbRejctnMaxY.Ary2D /end REF_CHARACTERISTIC
 /begin REF_MEASUREMENT /end REF_MEASUREMENT
/end GROUP
/begin GROUP CalRegn03Rt01GroupB_Dummy_1.AssiWhlImbRejctnBlndScaX.Ary2D "MICROSAR RTE" /begin SUB_GROUP /end SUB_GROUP /begin FUNCTION_LIST /end FUNCTION_LIST /begin REF_CHARACTERISTIC CalRegn03Rt01GroupB_Dummy_1.AssiWhlImbRejctnBlndScaX.Ary2D /end REF_CHARACTERISTIC /begin REF_MEASUREMENT /end REF_MEASUREMENT /end GROUP
/begin GROUP CalRegn03Rt01GroupB_Dummy_1.AssiWhlImbRejctnBlndScaY.Ary2D "MICROSAR RTE" /begin SUB_GROUP /end SUB_GROUP /begin FUNCTION_LIST /end FUNCTION_LIST /begin REF_CHARACTERISTIC CalRegn03Rt01GroupB_Dummy_1.AssiWhlImbRejctnBlndScaY.Ary2D /end REF_CHARACTERISTIC /begin REF_MEASUREMENT /end REF_MEASUREMENT /end GROUP
/begin GROUP CalRegn03Rt01GroupB_Dummy_1.CalibrationPorts "MICROSAR RTE"
 /begin SUB_GROUP CalRegn03Rt01GroupB_Dummy_1.AssiHiFrqTqWhlImbRejctnTqX.Ary2D CalRegn03Rt01GroupB_Dummy_1.AssiHiFrqWhlImbRejctnGainY.Ary2D CalRegn03Rt01GroupB_Dummy_1.AssiHiFrqWhlImbRejtcnBlndX.Ary2D CalRegn03Rt01GroupB_Dummy_1.AssiHiFrqWhlImbRejtcnBlndY.Ary2D CalRegn03Rt01GroupB_Dummy_1.AssiMotTqWhlImbRejctnMaxX.Ary2D CalRegn03Rt01GroupB_Dummy_1.AssiMotTqWhlImbRejctnMaxY.Ary2D CalRegn03Rt01GroupB_Dummy_1.AssiWhlImbRejctnBlndScaX.Ary2D CalRegn03Rt01GroupB_Dummy_1.AssiWhlImbRejctnBlndScaY.Ary2D CalRegn03Rt01GroupB_Dummy_1.EotProtnDampgVehSpdTbl.Ary1D CalRegn03Rt01GroupB_Dummy_1.EotProtnEntrGainVehSpdTbl.Ary1D CalRegn03Rt01GroupB_Dummy_1.EotProtnEntrGainX.Ary2D CalRegn03Rt01GroupB_Dummy_1.EotProtnEntrGainY.Ary2D CalRegn03Rt01GroupB_Dummy_1.EotProtnExitDampgY.Ary2D CalRegn03Rt01GroupB_Dummy_1.EotProtnHwDegDampgX.Ary2D CalRegn03Rt01GroupB_Dummy_1.EotProtnNormDampgY.Ary2D CalRegn03Rt01GroupB_Dummy_1.InertiaCmpVelAssiBasdDampgRollgWhlImbRejctnOnY.Ary1D /end SUB_GROUP
 /begin FUNCTION_LIST /end FUNCTION_LIST
 /begin REF_CHARACTERISTIC /end REF_CHARACTERISTIC
 /begin REF_MEASUREMENT /end REF_MEASUREMENT
/end GROUP
/begin GROUP CalRegn03Rt01GroupB_Dummy_1.EotProtnDampgVehSpdTbl.Ary1D "MICROSAR RTE" /begin SUB_GROUP /end SUB_GROUP /begin FUNCTION_LIST /end FUNCTION_LIST /begin REF_CHARACTERISTIC CalRegn03Rt01GroupB_Dummy_1.EotProtnDampgVehSpdTbl.Ary1D /end REF_CHARACTERISTIC /begin REF_MEASUREMENT /end REF_MEASUREMENT /end GROUP
/begin GROUP CalRegn03Rt01GroupB_Dummy_1.EotProtnEntrGainVehSpdTbl.Ary1D "MICROSAR RTE" /begin SUB_GROUP /end SUB_GROUP /begin FUNCTION_LIST /end FUNCTION_LIST
 /begin REF_CHARACTERISTIC CalRegn03Rt01GroupB_Dummy_1.EotProtnEntrGainVehSpdTbl.Ary1D /end REF_CHARACTERISTIC
 /begin REF_MEASUREMENT /end REF_MEASUREMENT
/end GROUP
/begin GROUP CalRegn03Rt01GroupB_Dummy_1.EotProtnEntrGainX.Ary2D "MICROSAR RTE" /begin SUB_GROUP /end SUB_GROUP /begin FUNCTION_LIST /end FUNCTION_LIST /begin REF_CHARACTERISTIC CalRegn03Rt01GroupB_Dummy_1.EotProtnEntrGainX.Ary2D /end REF_CHARACTERISTIC /begin REF_MEASUREMENT /end REF_MEASUREMENT /end GROUP
/begin GROUP CalRegn03Rt01GroupB_Dummy_1.EotProtnEntrGainY.Ary2D "MICROSAR RTE" /begin SUB_GROUP /end SUB_GROUP /begin FUNCTION_LIST /end FUNCTION_LIST /begin REF_CHARACTERISTIC CalRegn03Rt01GroupB_Dummy_1.EotProtnEntrGainY.Ary2D /end REF_CHARACTERISTIC /begin REF_MEASUREMENT /end REF_MEASUREMENT /end GROUP
/begin GROUP CalRegn03Rt01GroupB_Dummy_1.EotProtnExitDampgY.Ary2D "MICROSAR RTE" /begin SUB_GROUP /end SUB_GROUP /begin FUNCTION_LIST /end FUNCTION_LIST /begin REF_CHARACTERISTIC CalRegn03Rt01GroupB_Dummy_1.EotProtnExitDampgY.Ary2D /end REF_CHARACTERISTIC /begin REF_MEASUREMENT /end REF_MEASUREMENT /end GROUP
/begin GROUP CalRegn03Rt01GroupB_Dummy_1.EotProtnHwDegDampgX.Ary2D "MICROSAR RTE" /begin SUB_GROUP /end SUB_GROUP /begin FUNCTION_LIST /end FUNCTION_LIST /begin REF_CHARACTERISTIC CalRegn03Rt01GroupB_Dummy_1.EotProtnHwDegDampgX.Ary2D /end REF_CHARACTERISTIC /begin REF_MEASUREMENT /end REF_MEASUREMENT /end GROUP
/begin GROUP CalRegn03Rt01GroupB_Dummy_1.EotProtnNormDampgY.Ary2D "MICROSAR RTE" /begin SUB_GROUP /end SUB_GROUP /begin FUNCTION_LIST /end FUNCTION_LIST /begin REF_CHARACTERISTIC CalRegn03Rt01GroupB_Dummy_1.EotProtnNormDampgY.Ary2D /end REF_CHARACTERISTIC /begin REF_MEASUREMENT /end REF_MEASUREMENT /end GROUP
/begin GROUP CalRegn03Rt01GroupB_Dummy_1.InertiaCmpVelAssiBasdDampgRollgWhlImbRejctnOnY.Ary1D "MICROSAR RTE" /begin SUB_GROUP /end SUB_GROUP /begin FUNCTION_LIST /end FUNCTION_LIST
 /begin REF_CHARACTERISTIC CalRegn03Rt01GroupB_Dummy_1.InertiaCmpVelAssiBasdDampgRollgWhlImbRejctnOnY.Ary1D /end REF_CHARACTERISTIC
 /begin REF_MEASUREMENT /end REF_MEASUREMENT
/end GROUP
/begin GROUP CalRegn03Rt01GroupB_Dummy_2 "MICROSAR RTE" /begin SUB_GROUP CalRegn03Rt01GroupB_Dummy_2.CalibrationPorts /end SUB_GROUP /begin FUNCTION_LIST /end FUNCTION_LIST /begin REF_CHARACTERISTIC /end REF_CHARACTERISTIC /begin REF_MEASUREMENT /end REF_MEASUREMENT /end GROUP
/begin GROUP CalRegn03Rt01GroupB_Dummy_2.AssiHiFrqTqWhlImbRejctnTqX.Ary2D "MICROSAR RTE" /begin SUB_GROUP /end SUB_GROUP /begin FUNCTION_LIST /end FUNCTION_LIST
 /begin REF_CHARACTERISTIC CalRegn03Rt01GroupB_Dummy_2.AssiHiFrqTqWhlImbRejctnTqX.Ary2D /end REF_CHARACTERISTIC
 /begin REF_MEASUREMENT /end REF_MEASUREMENT
/end GROUP
/begin GROUP CalRegn03Rt01GroupB_Dummy_2.AssiHiFrqWhlImbRejctnGainY.Ary2D "MICROSAR RTE" /begin SUB_GROUP /end SUB_GROUP /begin FUNCTION_LIST /end FUNCTION_LIST
 /begin REF_CHARACTERISTIC CalRegn03Rt01GroupB_Dummy_2.AssiHiFrqWhlImbRejctnGainY.Ary2D /end REF_CHARACTERISTIC
 /begin REF_MEASUREMENT /end REF_MEASUREMENT
/end GROUP
/begin GROUP CalRegn03Rt01GroupB_Dummy_2.AssiHiFrqWhlImbRejtcnBlndX.Ary2D "MICROSAR RTE" /begin SUB_GROUP /end SUB_GROUP /begin FUNCTION_LIST /end FUNCTION_LIST
 /begin REF_CHARACTERISTIC CalRegn03Rt01GroupB_Dummy_2.AssiHiFrqWhlImbRejtcnBlndX.Ary2D /end REF_CHARACTERISTIC
 /begin REF_MEASUREMENT /end REF_MEASUREMENT
/end GROUP
/begin GROUP CalRegn03Rt01GroupB_Dummy_2.AssiHiFrqWhlImbRejtcnBlndY.Ary2D "MICROSAR RTE" /begin SUB_GROUP /end SUB_GROUP /begin FUNCTION_LIST /end FUNCTION_LIST
 /begin REF_CHARACTERISTIC CalRegn03Rt01GroupB_Dummy_2.AssiHiFrqWhlImbRejtcnBlndY.Ary2D /end REF_CHARACTERISTIC
 /begin REF_MEASUREMENT /end REF_MEASUREMENT
/end GROUP
/begin GROUP CalRegn03Rt01GroupB_Dummy_2.AssiMotTqWhlImbRejctnMaxX.Ary2D "MICROSAR RTE" /begin SUB_GROUP /end SUB_GROUP /begin FUNCTION_LIST /end FUNCTION_LIST
 /begin REF_CHARACTERISTIC CalRegn03Rt01GroupB_Dummy_2.AssiMotTqWhlImbRejctnMaxX.Ary2D /end REF_CHARACTERISTIC
 /begin REF_MEASUREMENT /end REF_MEASUREMENT
/end GROUP
/begin GROUP CalRegn03Rt01GroupB_Dummy_2.AssiMotTqWhlImbRejctnMaxY.Ary2D "MICROSAR RTE" /begin SUB_GROUP /end SUB_GROUP /begin FUNCTION_LIST /end FUNCTION_LIST
 /begin REF_CHARACTERISTIC CalRegn03Rt01GroupB_Dummy_2.AssiMotTqWhlImbRejctnMaxY.Ary2D /end REF_CHARACTERISTIC
 /begin REF_MEASUREMENT /end REF_MEASUREMENT
/end GROUP
/begin GROUP CalRegn03Rt01GroupB_Dummy_2.AssiWhlImbRejctnBlndScaX.Ary2D "MICROSAR RTE" /begin SUB_GROUP /end SUB_GROUP /begin FUNCTION_LIST /end FUNCTION_LIST /begin REF_CHARACTERISTIC CalRegn03Rt01GroupB_Dummy_2.AssiWhlImbRejctnBlndScaX.Ary2D /end REF_CHARACTERISTIC /begin REF_MEASUREMENT /end REF_MEASUREMENT /end GROUP
/begin GROUP CalRegn03Rt01GroupB_Dummy_2.AssiWhlImbRejctnBlndScaY.Ary2D "MICROSAR RTE" /begin SUB_GROUP /end SUB_GROUP /begin FUNCTION_LIST /end FUNCTION_LIST /begin REF_CHARACTERISTIC CalRegn03Rt01GroupB_Dummy_2.AssiWhlImbRejctnBlndScaY.Ary2D /end REF_CHARACTERISTIC /begin REF_MEASUREMENT /end REF_MEASUREMENT /end GROUP
/begin GROUP CalRegn03Rt01GroupB_Dummy_2.CalibrationPorts "MICROSAR RTE"
 /begin SUB_GROUP CalRegn03Rt01GroupB_Dummy_2.AssiHiFrqTqWhlImbRejctnTqX.Ary2D CalRegn03Rt01GroupB_Dummy_2.AssiHiFrqWhlImbRejctnGainY.Ary2D CalRegn03Rt01GroupB_Dummy_2.AssiHiFrqWhlImbRejtcnBlndX.Ary2D CalRegn03Rt01GroupB_Dummy_2.AssiHiFrqWhlImbRejtcnBlndY.Ary2D CalRegn03Rt01GroupB_Dummy_2.AssiMotTqWhlImbRejctnMaxX.Ary2D CalRegn03Rt01GroupB_Dummy_2.AssiMotTqWhlImbRejctnMaxY.Ary2D CalRegn03Rt01GroupB_Dummy_2.AssiWhlImbRejctnBlndScaX.Ary2D CalRegn03Rt01GroupB_Dummy_2.AssiWhlImbRejctnBlndScaY.Ary2D CalRegn03Rt01GroupB_Dummy_2.EotProtnDampgVehSpdTbl.Ary1D CalRegn03Rt01GroupB_Dummy_2.EotProtnEntrGainVehSpdTbl.Ary1D CalRegn03Rt01GroupB_Dummy_2.EotProtnEntrGainX.Ary2D CalRegn03Rt01GroupB_Dummy_2.EotProtnEntrGainY.Ary2D CalRegn03Rt01GroupB_Dummy_2.EotProtnExitDampgY.Ary2D CalRegn03Rt01GroupB_Dummy_2.EotProtnHwDegDampgX.Ary2D CalRegn03Rt01GroupB_Dummy_2.EotProtnNormDampgY.Ary2D CalRegn03Rt01GroupB_Dummy_2.InertiaCmpVelAssiBasdDampgRollgWhlImbRejctnOnY.Ary1D /end SUB_GROUP
 /begin FUNCTION_LIST /end FUNCTION_LIST
 /begin REF_CHARACTERISTIC /end REF_CHARACTERISTIC
 /begin REF_MEASUREMENT /end REF_MEASUREMENT
/end GROUP
/begin GROUP CalRegn03Rt01GroupB_Dummy_2.EotProtnDampgVehSpdTbl.Ary1D "MICROSAR RTE" /begin SUB_GROUP /end SUB_GROUP /begin FUNCTION_LIST /end FUNCTION_LIST /begin REF_CHARACTERISTIC CalRegn03Rt01GroupB_Dummy_2.EotProtnDampgVehSpdTbl.Ary1D /end REF_CHARACTERISTIC /begin REF_MEASUREMENT /end REF_MEASUREMENT /end GROUP
/begin GROUP CalRegn03Rt01GroupB_Dummy_2.EotProtnEntrGainVehSpdTbl.Ary1D "MICROSAR RTE" /begin SUB_GROUP /end SUB_GROUP /begin FUNCTION_LIST /end FUNCTION_LIST
 /begin REF_CHARACTERISTIC CalRegn03Rt01GroupB_Dummy_2.EotProtnEntrGainVehSpdTbl.Ary1D /end REF_CHARACTERISTIC
 /begin REF_MEASUREMENT /end REF_MEASUREMENT
/end GROUP
/begin GROUP CalRegn03Rt01GroupB_Dummy_2.EotProtnEntrGainX.Ary2D "MICROSAR RTE" /begin SUB_GROUP /end SUB_GROUP /begin FUNCTION_LIST /end FUNCTION_LIST /begin REF_CHARACTERISTIC CalRegn03Rt01GroupB_Dummy_2.EotProtnEntrGainX.Ary2D /end REF_CHARACTERISTIC /begin REF_MEASUREMENT /end REF_MEASUREMENT /end GROUP
/begin GROUP CalRegn03Rt01GroupB_Dummy_2.EotProtnEntrGainY.Ary2D "MICROSAR RTE" /begin SUB_GROUP /end SUB_GROUP /begin FUNCTION_LIST /end FUNCTION_LIST /begin REF_CHARACTERISTIC CalRegn03Rt01GroupB_Dummy_2.EotProtnEntrGainY.Ary2D /end REF_CHARACTERISTIC /begin REF_MEASUREMENT /end REF_MEASUREMENT /end GROUP
/begin GROUP CalRegn03Rt01GroupB_Dummy_2.EotProtnExitDampgY.Ary2D "MICROSAR RTE" /begin SUB_GROUP /end SUB_GROUP /begin FUNCTION_LIST /end FUNCTION_LIST /begin REF_CHARACTERISTIC CalRegn03Rt01GroupB_Dummy_2.EotProtnExitDampgY.Ary2D /end REF_CHARACTERISTIC /begin REF_MEASUREMENT /end REF_MEASUREMENT /end GROUP
/begin GROUP CalRegn03Rt01GroupB_Dummy_2.EotProtnHwDegDampgX.Ary2D "MICROSAR RTE" /begin SUB_GROUP /end SUB_GROUP /begin FUNCTION_LIST /end FUNCTION_LIST /begin REF_CHARACTERISTIC CalRegn03Rt01GroupB_Dummy_2.EotProtnHwDegDampgX.Ary2D /end REF_CHARACTERISTIC /begin REF_MEASUREMENT /end REF_MEASUREMENT /end GROUP
/begin GROUP CalRegn03Rt01GroupB_Dummy_2.EotProtnNormDampgY.Ary2D "MICROSAR RTE" /begin SUB_GROUP /end SUB_GROUP /begin FUNCTION_LIST /end FUNCTION_LIST /begin REF_CHARACTERISTIC CalRegn03Rt01GroupB_Dummy_2.EotProtnNormDampgY.Ary2D /end REF_CHARACTERISTIC /begin REF_MEASUREMENT /end REF_MEASUREMENT /end GROUP
/begin GROUP CalRegn03Rt01GroupB_Dummy_2.InertiaCmpVelAssiBasdDampgRollgWhlImbRejctnOnY.Ary1D "MICROSAR RTE" /begin SUB_GROUP /end SUB_GROUP /begin FUNCTION_LIST /end FUNCTION_LIST
 /begin REF_CHARACTERISTIC CalRegn03Rt01GroupB_Dummy_2.InertiaCmpVelAssiBasdDampgRollgWhlImbRejctnOnY.Ary1D /end REF_CHARACTERISTIC
 /begin REF_MEASUREMENT /end REF_MEASUREMENT
/end GROUP
/begin GROUP CalRegn03Rt01GroupB_Dummy_3 "MICROSAR RTE" /begin SUB_GROUP CalRegn03Rt01GroupB_Dummy_3.CalibrationPorts /end SUB_GROUP /begin FUNCTION_LIST /end FUNCTION_LIST /begin REF_CHARACTERISTIC /end REF_CHARACTERISTIC /begin REF_MEASUREMENT /end REF_MEASUREMENT /end GROUP
/begin GROUP CalRegn03Rt01GroupB_Dummy_3.AssiHiFrqTqWhlImbRejctnTqX.Ary2D "MICROSAR RTE" /begin SUB_GROUP /end SUB_GROUP /begin FUNCTION_LIST /end FUNCTION_LIST
 /begin REF_CHARACTERISTIC CalRegn03Rt01GroupB_Dummy_3.AssiHiFrqTqWhlImbRejctnTqX.Ary2D /end REF_CHARACTERISTIC
 /begin REF_MEASUREMENT /end REF_MEASUREMENT
/end GROUP
/begin GROUP CalRegn03Rt01GroupB_Dummy_3.AssiHiFrqWhlImbRejctnGainY.Ary2D "MICROSAR RTE" /begin SUB_GROUP /end SUB_GROUP /begin FUNCTION_LIST /end FUNCTION_LIST
 /begin REF_CHARACTERISTIC CalRegn03Rt01GroupB_Dummy_3.AssiHiFrqWhlImbRejctnGainY.Ary2D /end REF_CHARACTERISTIC
 /begin REF_MEASUREMENT /end REF_MEASUREMENT
/end GROUP
/begin GROUP CalRegn03Rt01GroupB_Dummy_3.AssiHiFrqWhlImbRejtcnBlndX.Ary2D "MICROSAR RTE" /begin SUB_GROUP /end SUB_GROUP /begin FUNCTION_LIST /end FUNCTION_LIST
 /begin REF_CHARACTERISTIC CalRegn03Rt01GroupB_Dummy_3.AssiHiFrqWhlImbRejtcnBlndX.Ary2D /end REF_CHARACTERISTIC
 /begin REF_MEASUREMENT /end REF_MEASUREMENT
/end GROUP
/begin GROUP CalRegn03Rt01GroupB_Dummy_3.AssiHiFrqWhlImbRejtcnBlndY.Ary2D "MICROSAR RTE" /begin SUB_GROUP /end SUB_GROUP /begin FUNCTION_LIST /end FUNCTION_LIST
 /begin REF_CHARACTERISTIC CalRegn03Rt01GroupB_Dummy_3.AssiHiFrqWhlImbRejtcnBlndY.Ary2D /end REF_CHARACTERISTIC
 /begin REF_MEASUREMENT /end REF_MEASUREMENT
/end GROUP
/begin GROUP CalRegn03Rt01GroupB_Dummy_3.AssiMotTqWhlImbRejctnMaxX.Ary2D "MICROSAR RTE" /begin SUB_GROUP /end SUB_GROUP /begin FUNCTION_LIST /end FUNCTION_LIST
 /begin REF_CHARACTERISTIC CalRegn03Rt01GroupB_Dummy_3.AssiMotTqWhlImbRejctnMaxX.Ary2D /end REF_CHARACTERISTIC
 /begin REF_MEASUREMENT /end REF_MEASUREMENT
/end GROUP
/begin GROUP CalRegn03Rt01GroupB_Dummy_3.AssiMotTqWhlImbRejctnMaxY.Ary2D "MICROSAR RTE" /begin SUB_GROUP /end SUB_GROUP /begin FUNCTION_LIST /end FUNCTION_LIST
 /begin REF_CHARACTERISTIC CalRegn03Rt01GroupB_Dummy_3.AssiMotTqWhlImbRejctnMaxY.Ary2D /end REF_CHARACTERISTIC
 /begin REF_MEASUREMENT /end REF_MEASUREMENT
/end GROUP
/begin GROUP CalRegn03Rt01GroupB_Dummy_3.AssiWhlImbRejctnBlndScaX.Ary2D "MICROSAR RTE" /begin SUB_GROUP /end SUB_GROUP /begin FUNCTION_LIST /end FUNCTION_LIST /begin REF_CHARACTERISTIC CalRegn03Rt01GroupB_Dummy_3.AssiWhlImbRejctnBlndScaX.Ary2D /end REF_CHARACTERISTIC /begin REF_MEASUREMENT /end REF_MEASUREMENT /end GROUP
/begin GROUP CalRegn03Rt01GroupB_Dummy_3.AssiWhlImbRejctnBlndScaY.Ary2D "MICROSAR RTE" /begin SUB_GROUP /end SUB_GROUP /begin FUNCTION_LIST /end FUNCTION_LIST /begin REF_CHARACTERISTIC CalRegn03Rt01GroupB_Dummy_3.AssiWhlImbRejctnBlndScaY.Ary2D /end REF_CHARACTERISTIC /begin REF_MEASUREMENT /end REF_MEASUREMENT /end GROUP
/begin GROUP CalRegn03Rt01GroupB_Dummy_3.CalibrationPorts "MICROSAR RTE"
 /begin SUB_GROUP CalRegn03Rt01GroupB_Dummy_3.AssiHiFrqTqWhlImbRejctnTqX.Ary2D CalRegn03Rt01GroupB_Dummy_3.AssiHiFrqWhlImbRejctnGainY.Ary2D CalRegn03Rt01GroupB_Dummy_3.AssiHiFrqWhlImbRejtcnBlndX.Ary2D CalRegn03Rt01GroupB_Dummy_3.AssiHiFrqWhlImbRejtcnBlndY.Ary2D CalRegn03Rt01GroupB_Dummy_3.AssiMotTqWhlImbRejctnMaxX.Ary2D CalRegn03Rt01GroupB_Dummy_3.AssiMotTqWhlImbRejctnMaxY.Ary2D CalRegn03Rt01GroupB_Dummy_3.AssiWhlImbRejctnBlndScaX.Ary2D CalRegn03Rt01GroupB_Dummy_3.AssiWhlImbRejctnBlndScaY.Ary2D CalRegn03Rt01GroupB_Dummy_3.EotProtnDampgVehSpdTbl.Ary1D CalRegn03Rt01GroupB_Dummy_3.EotProtnEntrGainVehSpdTbl.Ary1D CalRegn03Rt01GroupB_Dummy_3.EotProtnEntrGainX.Ary2D CalRegn03Rt01GroupB_Dummy_3.EotProtnEntrGainY.Ary2D CalRegn03Rt01GroupB_Dummy_3.EotProtnExitDampgY.Ary2D CalRegn03Rt01GroupB_Dummy_3.EotProtnHwDegDampgX.Ary2D CalRegn03Rt01GroupB_Dummy_3.EotProtnNormDampgY.Ary2D CalRegn03Rt01GroupB_Dummy_3.InertiaCmpVelAssiBasdDampgRollgWhlImbRejctnOnY.Ary1D /end SUB_GROUP
 /begin FUNCTION_LIST /end FUNCTION_LIST
 /begin REF_CHARACTERISTIC /end REF_CHARACTERISTIC
 /begin REF_MEASUREMENT /end REF_MEASUREMENT
/end GROUP
/begin GROUP CalRegn03Rt01GroupB_Dummy_3.EotProtnDampgVehSpdTbl.Ary1D "MICROSAR RTE" /begin SUB_GROUP /end SUB_GROUP /begin FUNCTION_LIST /end FUNCTION_LIST /begin REF_CHARACTERISTIC CalRegn03Rt01GroupB_Dummy_3.EotProtnDampgVehSpdTbl.Ary1D /end REF_CHARACTERISTIC /begin REF_MEASUREMENT /end REF_MEASUREMENT /end GROUP
/begin GROUP CalRegn03Rt01GroupB_Dummy_3.EotProtnEntrGainVehSpdTbl.Ary1D "MICROSAR RTE" /begin SUB_GROUP /end SUB_GROUP /begin FUNCTION_LIST /end FUNCTION_LIST
 /begin REF_CHARACTERISTIC CalRegn03Rt01GroupB_Dummy_3.EotProtnEntrGainVehSpdTbl.Ary1D /end REF_CHARACTERISTIC
 /begin REF_MEASUREMENT /end REF_MEASUREMENT
/end GROUP
/begin GROUP CalRegn03Rt01GroupB_Dummy_3.EotProtnEntrGainX.Ary2D "MICROSAR RTE" /begin SUB_GROUP /end SUB_GROUP /begin FUNCTION_LIST /end FUNCTION_LIST /begin REF_CHARACTERISTIC CalRegn03Rt01GroupB_Dummy_3.EotProtnEntrGainX.Ary2D /end REF_CHARACTERISTIC /begin REF_MEASUREMENT /end REF_MEASUREMENT /end GROUP
/begin GROUP CalRegn03Rt01GroupB_Dummy_3.EotProtnEntrGainY.Ary2D "MICROSAR RTE" /begin SUB_GROUP /end SUB_GROUP /begin FUNCTION_LIST /end FUNCTION_LIST /begin REF_CHARACTERISTIC CalRegn03Rt01GroupB_Dummy_3.EotProtnEntrGainY.Ary2D /end REF_CHARACTERISTIC /begin REF_MEASUREMENT /end REF_MEASUREMENT /end GROUP
/begin GROUP CalRegn03Rt01GroupB_Dummy_3.EotProtnExitDampgY.Ary2D "MICROSAR RTE" /begin SUB_GROUP /end SUB_GROUP /begin FUNCTION_LIST /end FUNCTION_LIST /begin REF_CHARACTERISTIC CalRegn03Rt01GroupB_Dummy_3.EotProtnExitDampgY.Ary2D /end REF_CHARACTERISTIC /begin REF_MEASUREMENT /end REF_MEASUREMENT /end GROUP
/begin GROUP CalRegn03Rt01GroupB_Dummy_3.EotProtnHwDegDampgX.Ary2D "MICROSAR RTE" /begin SUB_GROUP /end SUB_GROUP /begin FUNCTION_LIST /end FUNCTION_LIST /begin REF_CHARACTERISTIC CalRegn03Rt01GroupB_Dummy_3.EotProtnHwDegDampgX.Ary2D /end REF_CHARACTERISTIC /begin REF_MEASUREMENT /end REF_MEASUREMENT /end GROUP
/begin GROUP CalRegn03Rt01GroupB_Dummy_3.EotProtnNormDampgY.Ary2D "MICROSAR RTE" /begin SUB_GROUP /end SUB_GROUP /begin FUNCTION_LIST /end FUNCTION_LIST /begin REF_CHARACTERISTIC CalRegn03Rt01GroupB_Dummy_3.EotProtnNormDampgY.Ary2D /end REF_CHARACTERISTIC /begin REF_MEASUREMENT /end REF_MEASUREMENT /end GROUP
/begin GROUP CalRegn03Rt01GroupB_Dummy_3.InertiaCmpVelAssiBasdDampgRollgWhlImbRejctnOnY.Ary1D "MICROSAR RTE" /begin SUB_GROUP /end SUB_GROUP /begin FUNCTION_LIST /end FUNCTION_LIST
 /begin REF_CHARACTERISTIC CalRegn03Rt01GroupB_Dummy_3.InertiaCmpVelAssiBasdDampgRollgWhlImbRejctnOnY.Ary1D /end REF_CHARACTERISTIC
 /begin REF_MEASUREMENT /end REF_MEASUREMENT
/end GROUP
/begin GROUP CalRegn03Rt01GroupB_Dummy_4 "MICROSAR RTE" /begin SUB_GROUP CalRegn03Rt01GroupB_Dummy_4.CalibrationPorts /end SUB_GROUP /begin FUNCTION_LIST /end FUNCTION_LIST /begin REF_CHARACTERISTIC /end REF_CHARACTERISTIC /begin REF_MEASUREMENT /end REF_MEASUREMENT /end GROUP
/begin GROUP CalRegn03Rt01GroupB_Dummy_4.AssiHiFrqTqWhlImbRejctnTqX.Ary2D "MICROSAR RTE" /begin SUB_GROUP /end SUB_GROUP /begin FUNCTION_LIST /end FUNCTION_LIST
 /begin REF_CHARACTERISTIC CalRegn03Rt01GroupB_Dummy_4.AssiHiFrqTqWhlImbRejctnTqX.Ary2D /end REF_CHARACTERISTIC
 /begin REF_MEASUREMENT /end REF_MEASUREMENT
/end GROUP
/begin GROUP CalRegn03Rt01GroupB_Dummy_4.AssiHiFrqWhlImbRejctnGainY.Ary2D "MICROSAR RTE" /begin SUB_GROUP /end SUB_GROUP /begin FUNCTION_LIST /end FUNCTION_LIST
 /begin REF_CHARACTERISTIC CalRegn03Rt01GroupB_Dummy_4.AssiHiFrqWhlImbRejctnGainY.Ary2D /end REF_CHARACTERISTIC
 /begin REF_MEASUREMENT /end REF_MEASUREMENT
/end GROUP
/begin GROUP CalRegn03Rt01GroupB_Dummy_4.AssiHiFrqWhlImbRejtcnBlndX.Ary2D "MICROSAR RTE" /begin SUB_GROUP /end SUB_GROUP /begin FUNCTION_LIST /end FUNCTION_LIST
 /begin REF_CHARACTERISTIC CalRegn03Rt01GroupB_Dummy_4.AssiHiFrqWhlImbRejtcnBlndX.Ary2D /end REF_CHARACTERISTIC
 /begin REF_MEASUREMENT /end REF_MEASUREMENT
/end GROUP
/begin GROUP CalRegn03Rt01GroupB_Dummy_4.AssiHiFrqWhlImbRejtcnBlndY.Ary2D "MICROSAR RTE" /begin SUB_GROUP /end SUB_GROUP /begin FUNCTION_LIST /end FUNCTION_LIST
 /begin REF_CHARACTERISTIC CalRegn03Rt01GroupB_Dummy_4.AssiHiFrqWhlImbRejtcnBlndY.Ary2D /end REF_CHARACTERISTIC
 /begin REF_MEASUREMENT /end REF_MEASUREMENT
/end GROUP
/begin GROUP CalRegn03Rt01GroupB_Dummy_4.AssiMotTqWhlImbRejctnMaxX.Ary2D "MICROSAR RTE" /begin SUB_GROUP /end SUB_GROUP /begin FUNCTION_LIST /end FUNCTION_LIST
 /begin REF_CHARACTERISTIC CalRegn03Rt01GroupB_Dummy_4.AssiMotTqWhlImbRejctnMaxX.Ary2D /end REF_CHARACTERISTIC
 /begin REF_MEASUREMENT /end REF_MEASUREMENT
/end GROUP
/begin GROUP CalRegn03Rt01GroupB_Dummy_4.AssiMotTqWhlImbRejctnMaxY.Ary2D "MICROSAR RTE" /begin SUB_GROUP /end SUB_GROUP /begin FUNCTION_LIST /end FUNCTION_LIST
 /begin REF_CHARACTERISTIC CalRegn03Rt01GroupB_Dummy_4.AssiMotTqWhlImbRejctnMaxY.Ary2D /end REF_CHARACTERISTIC
 /begin REF_MEASUREMENT /end REF_MEASUREMENT
/end GROUP
/begin GROUP CalRegn03Rt01GroupB_Dummy_4.AssiWhlImbRejctnBlndScaX.Ary2D "MICROSAR RTE" /begin SUB_GROUP /end SUB_GROUP /begin FUNCTION_LIST /end FUNCTION_LIST /begin REF_CHARACTERISTIC CalRegn03Rt01GroupB_Dummy_4.AssiWhlImbRejctnBlndScaX.Ary2D /end REF_CHARACTERISTIC /begin REF_MEASUREMENT /end REF_MEASUREMENT /end GROUP
/begin GROUP CalRegn03Rt01GroupB_Dummy_4.AssiWhlImbRejctnBlndScaY.Ary2D "MICROSAR RTE" /begin SUB_GROUP /end SUB_GROUP /begin FUNCTION_LIST /end FUNCTION_LIST /begin REF_CHARACTERISTIC CalRegn03Rt01GroupB_Dummy_4.AssiWhlImbRejctnBlndScaY.Ary2D /end REF_CHARACTERISTIC /begin REF_MEASUREMENT /end REF_MEASUREMENT /end GROUP
/begin GROUP CalRegn03Rt01GroupB_Dummy_4.CalibrationPorts "MICROSAR RTE"
 /begin SUB_GROUP CalRegn03Rt01GroupB_Dummy_4.AssiHiFrqTqWhlImbRejctnTqX.Ary2D CalRegn03Rt01GroupB_Dummy_4.AssiHiFrqWhlImbRejctnGainY.Ary2D CalRegn03Rt01GroupB_Dummy_4.AssiHiFrqWhlImbRejtcnBlndX.Ary2D CalRegn03Rt01GroupB_Dummy_4.AssiHiFrqWhlImbRejtcnBlndY.Ary2D CalRegn03Rt01GroupB_Dummy_4.AssiMotTqWhlImbRejctnMaxX.Ary2D CalRegn03Rt01GroupB_Dummy_4.AssiMotTqWhlImbRejctnMaxY.Ary2D CalRegn03Rt01GroupB_Dummy_4.AssiWhlImbRejctnBlndScaX.Ary2D CalRegn03Rt01GroupB_Dummy_4.AssiWhlImbRejctnBlndScaY.Ary2D CalRegn03Rt01GroupB_Dummy_4.EotProtnDampgVehSpdTbl.Ary1D CalRegn03Rt01GroupB_Dummy_4.EotProtnEntrGainVehSpdTbl.Ary1D CalRegn03Rt01GroupB_Dummy_4.EotProtnEntrGainX.Ary2D CalRegn03Rt01GroupB_Dummy_4.EotProtnEntrGainY.Ary2D CalRegn03Rt01GroupB_Dummy_4.EotProtnExitDampgY.Ary2D CalRegn03Rt01GroupB_Dummy_4.EotProtnHwDegDampgX.Ary2D CalRegn03Rt01GroupB_Dummy_4.EotProtnNormDampgY.Ary2D CalRegn03Rt01GroupB_Dummy_4.InertiaCmpVelAssiBasdDampgRollgWhlImbRejctnOnY.Ary1D /end SUB_GROUP
 /begin FUNCTION_LIST /end FUNCTION_LIST
 /begin REF_CHARACTERISTIC /end REF_CHARACTERISTIC
 /begin REF_MEASUREMENT /end REF_MEASUREMENT
/end GROUP
/begin GROUP CalRegn03Rt01GroupB_Dummy_4.EotProtnDampgVehSpdTbl.Ary1D "MICROSAR RTE" /begin SUB_GROUP /end SUB_GROUP /begin FUNCTION_LIST /end FUNCTION_LIST /begin REF_CHARACTERISTIC CalRegn03Rt01GroupB_Dummy_4.EotProtnDampgVehSpdTbl.Ary1D /end REF_CHARACTERISTIC /begin REF_MEASUREMENT /end REF_MEASUREMENT /end GROUP
/begin GROUP CalRegn03Rt01GroupB_Dummy_4.EotProtnEntrGainVehSpdTbl.Ary1D "MICROSAR RTE" /begin SUB_GROUP /end SUB_GROUP /begin FUNCTION_LIST /end FUNCTION_LIST
 /begin REF_CHARACTERISTIC CalRegn03Rt01GroupB_Dummy_4.EotProtnEntrGainVehSpdTbl.Ary1D /end REF_CHARACTERISTIC
 /begin REF_MEASUREMENT /end REF_MEASUREMENT
/end GROUP
/begin GROUP CalRegn03Rt01GroupB_Dummy_4.EotProtnEntrGainX.Ary2D "MICROSAR RTE" /begin SUB_GROUP /end SUB_GROUP /begin FUNCTION_LIST /end FUNCTION_LIST /begin REF_CHARACTERISTIC CalRegn03Rt01GroupB_Dummy_4.EotProtnEntrGainX.Ary2D /end REF_CHARACTERISTIC /begin REF_MEASUREMENT /end REF_MEASUREMENT /end GROUP
/begin GROUP CalRegn03Rt01GroupB_Dummy_4.EotProtnEntrGainY.Ary2D "MICROSAR RTE" /begin SUB_GROUP /end SUB_GROUP /begin FUNCTION_LIST /end FUNCTION_LIST /begin REF_CHARACTERISTIC CalRegn03Rt01GroupB_Dummy_4.EotProtnEntrGainY.Ary2D /end REF_CHARACTERISTIC /begin REF_MEASUREMENT /end REF_MEASUREMENT /end GROUP
/begin GROUP CalRegn03Rt01GroupB_Dummy_4.EotProtnExitDampgY.Ary2D "MICROSAR RTE" /begin SUB_GROUP /end SUB_GROUP /begin FUNCTION_LIST /end FUNCTION_LIST /begin REF_CHARACTERISTIC CalRegn03Rt01GroupB_Dummy_4.EotProtnExitDampgY.Ary2D /end REF_CHARACTERISTIC /begin REF_MEASUREMENT /end REF_MEASUREMENT /end GROUP
/begin GROUP CalRegn03Rt01GroupB_Dummy_4.EotProtnHwDegDampgX.Ary2D "MICROSAR RTE" /begin SUB_GROUP /end SUB_GROUP /begin FUNCTION_LIST /end FUNCTION_LIST /begin REF_CHARACTERISTIC CalRegn03Rt01GroupB_Dummy_4.EotProtnHwDegDampgX.Ary2D /end REF_CHARACTERISTIC /begin REF_MEASUREMENT /end REF_MEASUREMENT /end GROUP
/begin GROUP CalRegn03Rt01GroupB_Dummy_4.EotProtnNormDampgY.Ary2D "MICROSAR RTE" /begin SUB_GROUP /end SUB_GROUP /begin FUNCTION_LIST /end FUNCTION_LIST /begin REF_CHARACTERISTIC CalRegn03Rt01GroupB_Dummy_4.EotProtnNormDampgY.Ary2D /end REF_CHARACTERISTIC /begin REF_MEASUREMENT /end REF_MEASUREMENT /end GROUP
/begin GROUP CalRegn03Rt01GroupB_Dummy_4.InertiaCmpVelAssiBasdDampgRollgWhlImbRejctnOnY.Ary1D "MICROSAR RTE" /begin SUB_GROUP /end SUB_GROUP /begin FUNCTION_LIST /end FUNCTION_LIST
 /begin REF_CHARACTERISTIC CalRegn03Rt01GroupB_Dummy_4.InertiaCmpVelAssiBasdDampgRollgWhlImbRejctnOnY.Ary1D /end REF_CHARACTERISTIC
 /begin REF_MEASUREMENT /end REF_MEASUREMENT
/end GROUP
/begin GROUP CalRegn03Rt01_Dummy "MICROSAR RTE" /begin SUB_GROUP CalRegn03Rt01_Dummy.CalibrationPorts /end SUB_GROUP /begin FUNCTION_LIST /end FUNCTION_LIST /begin REF_CHARACTERISTIC /end REF_CHARACTERISTIC /begin REF_MEASUREMENT /end REF_MEASUREMENT /end GROUP
/begin GROUP CalRegn03Rt01_Dummy.CalibrationPorts "MICROSAR RTE"
 /begin SUB_GROUP CalRegn03Rt01_Dummy.InertiaCmpVelDampgFilFrq.Ary1D CalRegn03Rt01_Dummy.InertiaCmpVelDampgFilFrqWhlImbRejctnOn.Ary1D /end SUB_GROUP
 /begin FUNCTION_LIST /end FUNCTION_LIST
 /begin REF_CHARACTERISTIC /end REF_CHARACTERISTIC
 /begin REF_MEASUREMENT /end REF_MEASUREMENT
/end GROUP
/begin GROUP CalRegn03Rt01_Dummy.InertiaCmpVelDampgFilFrq.Ary1D "MICROSAR RTE" /begin SUB_GROUP /end SUB_GROUP /begin FUNCTION_LIST /end FUNCTION_LIST /begin REF_CHARACTERISTIC CalRegn03Rt01_Dummy.InertiaCmpVelDampgFilFrq.Ary1D /end REF_CHARACTERISTIC /begin REF_MEASUREMENT /end REF_MEASUREMENT /end GROUP
/begin GROUP CalRegn03Rt01_Dummy.InertiaCmpVelDampgFilFrqWhlImbRejctnOn.Ary1D "MICROSAR RTE" /begin SUB_GROUP /end SUB_GROUP /begin FUNCTION_LIST /end FUNCTION_LIST
 /begin REF_CHARACTERISTIC CalRegn03Rt01_Dummy.InertiaCmpVelDampgFilFrqWhlImbRejctnOn.Ary1D /end REF_CHARACTERISTIC
 /begin REF_MEASUREMENT /end REF_MEASUREMENT
/end GROUP
/begin GROUP CalRegn03Rt01_Dummy_1 "MICROSAR RTE" /begin SUB_GROUP CalRegn03Rt01_Dummy_1.CalibrationPorts /end SUB_GROUP /begin FUNCTION_LIST /end FUNCTION_LIST /begin REF_CHARACTERISTIC /end REF_CHARACTERISTIC /begin REF_MEASUREMENT /end REF_MEASUREMENT /end GROUP
/begin GROUP CalRegn03Rt01_Dummy_1.CalibrationPorts "MICROSAR RTE"
 /begin SUB_GROUP CalRegn03Rt01_Dummy_1.InertiaCmpVelDampgFilFrq.Ary1D CalRegn03Rt01_Dummy_1.InertiaCmpVelDampgFilFrqWhlImbRejctnOn.Ary1D /end SUB_GROUP
 /begin FUNCTION_LIST /end FUNCTION_LIST
 /begin REF_CHARACTERISTIC /end REF_CHARACTERISTIC
 /begin REF_MEASUREMENT /end REF_MEASUREMENT
/end GROUP
/begin GROUP CalRegn03Rt01_Dummy_1.InertiaCmpVelDampgFilFrq.Ary1D "MICROSAR RTE" /begin SUB_GROUP /end SUB_GROUP /begin FUNCTION_LIST /end FUNCTION_LIST /begin REF_CHARACTERISTIC CalRegn03Rt01_Dummy_1.InertiaCmpVelDampgFilFrq.Ary1D /end REF_CHARACTERISTIC /begin REF_MEASUREMENT /end REF_MEASUREMENT /end GROUP
/begin GROUP CalRegn03Rt01_Dummy_1.InertiaCmpVelDampgFilFrqWhlImbRejctnOn.Ary1D "MICROSAR RTE" /begin SUB_GROUP /end SUB_GROUP /begin FUNCTION_LIST /end FUNCTION_LIST
 /begin REF_CHARACTERISTIC CalRegn03Rt01_Dummy_1.InertiaCmpVelDampgFilFrqWhlImbRejctnOn.Ary1D /end REF_CHARACTERISTIC
 /begin REF_MEASUREMENT /end REF_MEASUREMENT
/end GROUP
/begin GROUP CalRegn03Rt01_Dummy_2 "MICROSAR RTE" /begin SUB_GROUP CalRegn03Rt01_Dummy_2.CalibrationPorts /end SUB_GROUP /begin FUNCTION_LIST /end FUNCTION_LIST /begin REF_CHARACTERISTIC /end REF_CHARACTERISTIC /begin REF_MEASUREMENT /end REF_MEASUREMENT /end GROUP
/begin GROUP CalRegn03Rt01_Dummy_2.CalibrationPorts "MICROSAR RTE"
 /begin SUB_GROUP CalRegn03Rt01_Dummy_2.InertiaCmpVelDampgFilFrq.Ary1D CalRegn03Rt01_Dummy_2.InertiaCmpVelDampgFilFrqWhlImbRejctnOn.Ary1D /end SUB_GROUP
 /begin FUNCTION_LIST /end FUNCTION_LIST
 /begin REF_CHARACTERISTIC /end REF_CHARACTERISTIC
 /begin REF_MEASUREMENT /end REF_MEASUREMENT
/end GROUP
/begin GROUP CalRegn03Rt01_Dummy_2.InertiaCmpVelDampgFilFrq.Ary1D "MICROSAR RTE" /begin SUB_GROUP /end SUB_GROUP /begin FUNCTION_LIST /end FUNCTION_LIST /begin REF_CHARACTERISTIC CalRegn03Rt01_Dummy_2.InertiaCmpVelDampgFilFrq.Ary1D /end REF_CHARACTERISTIC /begin REF_MEASUREMENT /end REF_MEASUREMENT /end GROUP
/begin GROUP CalRegn03Rt01_Dummy_2.InertiaCmpVelDampgFilFrqWhlImbRejctnOn.Ary1D "MICROSAR RTE" /begin SUB_GROUP /end SUB_GROUP /begin FUNCTION_LIST /end FUNCTION_LIST
 /begin REF_CHARACTERISTIC CalRegn03Rt01_Dummy_2.InertiaCmpVelDampgFilFrqWhlImbRejctnOn.Ary1D /end REF_CHARACTERISTIC
 /begin REF_MEASUREMENT /end REF_MEASUREMENT
/end GROUP
/begin GROUP CalRegn03Rt01_Dummy_3 "MICROSAR RTE" /begin SUB_GROUP CalRegn03Rt01_Dummy_3.CalibrationPorts /end SUB_GROUP /begin FUNCTION_LIST /end FUNCTION_LIST /begin REF_CHARACTERISTIC /end REF_CHARACTERISTIC /begin REF_MEASUREMENT /end REF_MEASUREMENT /end GROUP
/begin GROUP CalRegn03Rt01_Dummy_3.CalibrationPorts "MICROSAR RTE"
 /begin SUB_GROUP CalRegn03Rt01_Dummy_3.InertiaCmpVelDampgFilFrq.Ary1D CalRegn03Rt01_Dummy_3.InertiaCmpVelDampgFilFrqWhlImbRejctnOn.Ary1D /end SUB_GROUP
 /begin FUNCTION_LIST /end FUNCTION_LIST
 /begin REF_CHARACTERISTIC /end REF_CHARACTERISTIC
 /begin REF_MEASUREMENT /end REF_MEASUREMENT
/end GROUP
/begin GROUP CalRegn03Rt01_Dummy_3.InertiaCmpVelDampgFilFrq.Ary1D "MICROSAR RTE" /begin SUB_GROUP /end SUB_GROUP /begin FUNCTION_LIST /end FUNCTION_LIST /begin REF_CHARACTERISTIC CalRegn03Rt01_Dummy_3.InertiaCmpVelDampgFilFrq.Ary1D /end REF_CHARACTERISTIC /begin REF_MEASUREMENT /end REF_MEASUREMENT /end GROUP
/begin GROUP CalRegn03Rt01_Dummy_3.InertiaCmpVelDampgFilFrqWhlImbRejctnOn.Ary1D "MICROSAR RTE" /begin SUB_GROUP /end SUB_GROUP /begin FUNCTION_LIST /end FUNCTION_LIST
 /begin REF_CHARACTERISTIC CalRegn03Rt01_Dummy_3.InertiaCmpVelDampgFilFrqWhlImbRejctnOn.Ary1D /end REF_CHARACTERISTIC
 /begin REF_MEASUREMENT /end REF_MEASUREMENT
/end GROUP
/begin GROUP CalRegn03Rt01_Dummy_4 "MICROSAR RTE" /begin SUB_GROUP CalRegn03Rt01_Dummy_4.CalibrationPorts /end SUB_GROUP /begin FUNCTION_LIST /end FUNCTION_LIST /begin REF_CHARACTERISTIC /end REF_CHARACTERISTIC /begin REF_MEASUREMENT /end REF_MEASUREMENT /end GROUP
/begin GROUP CalRegn03Rt01_Dummy_4.CalibrationPorts "MICROSAR RTE"
 /begin SUB_GROUP CalRegn03Rt01_Dummy_4.InertiaCmpVelDampgFilFrq.Ary1D CalRegn03Rt01_Dummy_4.InertiaCmpVelDampgFilFrqWhlImbRejctnOn.Ary1D /end SUB_GROUP
 /begin FUNCTION_LIST /end FUNCTION_LIST
 /begin REF_CHARACTERISTIC /end REF_CHARACTERISTIC
 /begin REF_MEASUREMENT /end REF_MEASUREMENT
/end GROUP
/begin GROUP CalRegn03Rt01_Dummy_4.InertiaCmpVelDampgFilFrq.Ary1D "MICROSAR RTE" /begin SUB_GROUP /end SUB_GROUP /begin FUNCTION_LIST /end FUNCTION_LIST /begin REF_CHARACTERISTIC CalRegn03Rt01_Dummy_4.InertiaCmpVelDampgFilFrq.Ary1D /end REF_CHARACTERISTIC /begin REF_MEASUREMENT /end REF_MEASUREMENT /end GROUP
/begin GROUP CalRegn03Rt01_Dummy_4.InertiaCmpVelDampgFilFrqWhlImbRejctnOn.Ary1D "MICROSAR RTE" /begin SUB_GROUP /end SUB_GROUP /begin FUNCTION_LIST /end FUNCTION_LIST
 /begin REF_CHARACTERISTIC CalRegn03Rt01_Dummy_4.InertiaCmpVelDampgFilFrqWhlImbRejctnOn.Ary1D /end REF_CHARACTERISTIC
 /begin REF_MEASUREMENT /end REF_MEASUREMENT
/end GROUP
/begin GROUP CalRegn03Rt02 "MICROSAR RTE" /begin SUB_GROUP CalRegn03Rt02.CalibrationPorts /end SUB_GROUP /begin FUNCTION_LIST /end FUNCTION_LIST /begin REF_CHARACTERISTIC /end REF_CHARACTERISTIC /begin REF_MEASUREMENT /end REF_MEASUREMENT /end GROUP
/begin GROUP CalRegn03Rt02.CalibrationPorts "MICROSAR RTE"
 /begin SUB_GROUP CalRegn03Rt02.InertiaCmpVelDampgFilFrq.Ary1D CalRegn03Rt02.InertiaCmpVelDampgFilFrqWhlImbRejctnOn.Ary1D /end SUB_GROUP
 /begin FUNCTION_LIST /end FUNCTION_LIST
 /begin REF_CHARACTERISTIC /end REF_CHARACTERISTIC
 /begin REF_MEASUREMENT /end REF_MEASUREMENT
/end GROUP
/begin GROUP CalRegn03Rt02.InertiaCmpVelDampgFilFrq.Ary1D "MICROSAR RTE" /begin SUB_GROUP /end SUB_GROUP /begin FUNCTION_LIST /end FUNCTION_LIST /begin REF_CHARACTERISTIC CalRegn03Rt02.InertiaCmpVelDampgFilFrq.Ary1D /end REF_CHARACTERISTIC /begin REF_MEASUREMENT /end REF_MEASUREMENT /end GROUP
/begin GROUP CalRegn03Rt02.InertiaCmpVelDampgFilFrqWhlImbRejctnOn.Ary1D "MICROSAR RTE" /begin SUB_GROUP /end SUB_GROUP /begin FUNCTION_LIST /end FUNCTION_LIST /begin REF_CHARACTERISTIC CalRegn03Rt02.InertiaCmpVelDampgFilFrqWhlImbRejctnOn.Ary1D /end REF_CHARACTERISTIC /begin REF_MEASUREMENT /end REF_MEASUREMENT /end GROUP
/begin GROUP CalRegn03Rt02GroupA "MICROSAR RTE" /begin SUB_GROUP CalRegn03Rt02GroupA.CalibrationPorts /end SUB_GROUP /begin FUNCTION_LIST /end FUNCTION_LIST /begin REF_CHARACTERISTIC /end REF_CHARACTERISTIC /begin REF_MEASUREMENT /end REF_MEASUREMENT /end GROUP
/begin GROUP CalRegn03Rt02GroupA.AssiHiFrqGainY.Ary2D "MICROSAR RTE" /begin SUB_GROUP /end SUB_GROUP /begin FUNCTION_LIST /end FUNCTION_LIST /begin REF_CHARACTERISTIC CalRegn03Rt02GroupA.AssiHiFrqGainY.Ary2D /end REF_CHARACTERISTIC /begin REF_MEASUREMENT /end REF_MEASUREMENT /end GROUP
/begin GROUP CalRegn03Rt02GroupA.AssiHiFrqTqX.Ary2D "MICROSAR RTE" /begin SUB_GROUP /end SUB_GROUP /begin FUNCTION_LIST /end FUNCTION_LIST /begin REF_CHARACTERISTIC CalRegn03Rt02GroupA.AssiHiFrqTqX.Ary2D /end REF_CHARACTERISTIC /begin REF_MEASUREMENT /end REF_MEASUREMENT /end GROUP
/begin GROUP CalRegn03Rt02GroupA.AssiMotTqWhlImbRejctnMinX.Ary2D "MICROSAR RTE" /begin SUB_GROUP /end SUB_GROUP /begin FUNCTION_LIST /end FUNCTION_LIST /begin REF_CHARACTERISTIC CalRegn03Rt02GroupA.AssiMotTqWhlImbRejctnMinX.Ary2D /end REF_CHARACTERISTIC /begin REF_MEASUREMENT /end REF_MEASUREMENT /end GROUP
/begin GROUP CalRegn03Rt02GroupA.AssiMotTqWhlImbRejctnMinY.Ary2D "MICROSAR RTE" /begin SUB_GROUP /end SUB_GROUP /begin FUNCTION_LIST /end FUNCTION_LIST /begin REF_CHARACTERISTIC CalRegn03Rt02GroupA.AssiMotTqWhlImbRejctnMinY.Ary2D /end REF_CHARACTERISTIC /begin REF_MEASUREMENT /end REF_MEASUREMENT /end GROUP
/begin GROUP CalRegn03Rt02GroupA.CalibrationPorts "MICROSAR RTE"
 /begin SUB_GROUP CalRegn03Rt02GroupA.AssiHiFrqGainY.Ary2D CalRegn03Rt02GroupA.AssiHiFrqTqX.Ary2D CalRegn03Rt02GroupA.AssiMotTqWhlImbRejctnMinX.Ary2D CalRegn03Rt02GroupA.AssiMotTqWhlImbRejctnMinY.Ary2D CalRegn03Rt02GroupA.DampgHydCoeff1ScaY.Ary1D CalRegn03Rt02GroupA.DampgHydCoeff2ScaY.Ary1D CalRegn03Rt02GroupA.DampgHydCoeff3ScaY.Ary1D CalRegn03Rt02GroupA.DampgHydCoeff4ScaY.Ary1D CalRegn03Rt02GroupA.DampgMotVelX.Ary2D CalRegn03Rt02GroupA.DampgMotVelY.Ary2D CalRegn03Rt02GroupA.HysCmpFricWhlImbRejctnBlndX.Ary1D CalRegn03Rt02GroupA.HysCmpFricWhlImbRejctnBlndY.Ary1D CalRegn03Rt02GroupA.HysCmpFricWhlImbRejctnOffY.Ary1D CalRegn03Rt02GroupA.HysCmpFricWhlImbRejctnOnY.Ary1D CalRegn03Rt02GroupA.InertiaCmpVelAssiBasdDampgCoeffX.Ary1D CalRegn03Rt02GroupA.InertiaCmpVelAssiBasdDampgRollgY.Ary1D CalRegn03Rt02GroupA.InertiaCmpVelAssiBasdDampgStatY.Ary1D CalRegn03Rt02GroupA.InertiaCmpVelDampgSpdBlndY.Ary1D CalRegn03Rt02GroupA.InertiaCmpVelNotchBlndY.Ary1D CalRegn03Rt02GroupA.RtnHwAgOffsCalcdX.Ary2D CalRegn03Rt02GroupA.RtnHwAgOffsCalcdY.Ary2D CalRegn03Rt02GroupA.RtnScaTqX.Ary2D CalRegn03Rt02GroupA.RtnScaTqY.Ary2D CalRegn03Rt02GroupA.RtnScaVelX.Ary2D CalRegn03Rt02GroupA.RtnScaVelY.Ary2D /end SUB_GROUP
 /begin FUNCTION_LIST /end FUNCTION_LIST
 /begin REF_CHARACTERISTIC /end REF_CHARACTERISTIC
 /begin REF_MEASUREMENT /end REF_MEASUREMENT
/end GROUP
/begin GROUP CalRegn03Rt02GroupA.DampgHydCoeff1ScaY.Ary1D "MICROSAR RTE" /begin SUB_GROUP /end SUB_GROUP /begin FUNCTION_LIST /end FUNCTION_LIST /begin REF_CHARACTERISTIC CalRegn03Rt02GroupA.DampgHydCoeff1ScaY.Ary1D /end REF_CHARACTERISTIC /begin REF_MEASUREMENT /end REF_MEASUREMENT /end GROUP
/begin GROUP CalRegn03Rt02GroupA.DampgHydCoeff2ScaY.Ary1D "MICROSAR RTE" /begin SUB_GROUP /end SUB_GROUP /begin FUNCTION_LIST /end FUNCTION_LIST /begin REF_CHARACTERISTIC CalRegn03Rt02GroupA.DampgHydCoeff2ScaY.Ary1D /end REF_CHARACTERISTIC /begin REF_MEASUREMENT /end REF_MEASUREMENT /end GROUP
/begin GROUP CalRegn03Rt02GroupA.DampgHydCoeff3ScaY.Ary1D "MICROSAR RTE" /begin SUB_GROUP /end SUB_GROUP /begin FUNCTION_LIST /end FUNCTION_LIST /begin REF_CHARACTERISTIC CalRegn03Rt02GroupA.DampgHydCoeff3ScaY.Ary1D /end REF_CHARACTERISTIC /begin REF_MEASUREMENT /end REF_MEASUREMENT /end GROUP
/begin GROUP CalRegn03Rt02GroupA.DampgHydCoeff4ScaY.Ary1D "MICROSAR RTE" /begin SUB_GROUP /end SUB_GROUP /begin FUNCTION_LIST /end FUNCTION_LIST /begin REF_CHARACTERISTIC CalRegn03Rt02GroupA.DampgHydCoeff4ScaY.Ary1D /end REF_CHARACTERISTIC /begin REF_MEASUREMENT /end REF_MEASUREMENT /end GROUP
/begin GROUP CalRegn03Rt02GroupA.DampgMotVelX.Ary2D "MICROSAR RTE" /begin SUB_GROUP /end SUB_GROUP /begin FUNCTION_LIST /end FUNCTION_LIST /begin REF_CHARACTERISTIC CalRegn03Rt02GroupA.DampgMotVelX.Ary2D /end REF_CHARACTERISTIC /begin REF_MEASUREMENT /end REF_MEASUREMENT /end GROUP
/begin GROUP CalRegn03Rt02GroupA.DampgMotVelY.Ary2D "MICROSAR RTE" /begin SUB_GROUP /end SUB_GROUP /begin FUNCTION_LIST /end FUNCTION_LIST /begin REF_CHARACTERISTIC CalRegn03Rt02GroupA.DampgMotVelY.Ary2D /end REF_CHARACTERISTIC /begin REF_MEASUREMENT /end REF_MEASUREMENT /end GROUP
/begin RECORD_LAYOUT RTE_RL_UWORD FNC_VALUES 1 UWORD ROW_DIR DIRECT /end RECORD_LAYOUT
/begin RECORD_LAYOUT RTE_RL_SWORD FNC_VALUES 1 SWORD ROW_DIR DIRECT /end RECORD_LAYOUT
