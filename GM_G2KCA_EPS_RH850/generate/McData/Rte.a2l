/begin CHARACTERISTIC DutyCycThermProtn.DutyCycThermProtnMplr1NonStallTblY.Ary1D "MICROSAR RTE" VAL_BLK 0x0 RTE_RL_UWORD 0 NO_COMPU_METHOD 0 65535 MATRIX_DIM 5 1 1 SYMBOL_LINK "Rte_CalprmRom_CalRegn01Cmn_DEFAULT_RTE_CALPRM_GROUP.DutyCycThermProtnMplr1NonStallTblY_Ary1D" 0 DISPLAY_IDENTIFIER DutyCycThermProtn.CalibrationPorts.DutyCycThermProtnMplr1NonStallTblY.Ary1D /end CHARACTERISTIC
/begin CHARACTERISTIC DutyCycThermProtn.DutyCycThermProtnMplr1StallTblY.Ary1D "MICROSAR RTE" VAL_BLK 0x0 RTE_RL_UWORD 0 NO_COMPU_METHOD 0 65535 MATRIX_DIM 5 1 1 SYMBOL_LINK "Rte_CalprmRom_CalRegn01Cmn_DEFAULT_RTE_CALPRM_GROUP.DutyCycThermProtnMplr1StallTblY_Ary1D" 0 DISPLAY_IDENTIFIER DutyCycThermProtn.CalibrationPorts.DutyCycThermProtnMplr1StallTblY.Ary1D /end CHARACTERISTIC
/begin CHARACTERISTIC DutyCycThermProtn.DutyCycThermProtnMplr2NonStallTblY.Ary1D "MICROSAR RTE" VAL_BLK 0x0 RTE_RL_UWORD 0 NO_COMPU_METHOD 0 65535 MATRIX_DIM 5 1 1 SYMBOL_LINK "Rte_CalprmRom_CalRegn01Cmn_DEFAULT_RTE_CALPRM_GROUP.DutyCycThermProtnMplr2NonStallTblY_Ary1D" 0 DISPLAY_IDENTIFIER DutyCycThermProtn.CalibrationPorts.DutyCycThermProtnMplr2NonStallTblY.Ary1D /end CHARACTERISTIC
/begin CHARACTERISTIC DutyCycThermProtn.DutyCycThermProtnMplr2StallTblY.Ary1D "MICROSAR RTE" VAL_BLK 0x0 RTE_RL_UWORD 0 NO_COMPU_METHOD 0 65535 MATRIX_DIM 5 1 1 SYMBOL_LINK "Rte_CalprmRom_CalRegn01Cmn_DEFAULT_RTE_CALPRM_GROUP.DutyCycThermProtnMplr2StallTblY_Ary1D" 0 DISPLAY_IDENTIFIER DutyCycThermProtn.CalibrationPorts.DutyCycThermProtnMplr2StallTblY.Ary1D /end CHARACTERISTIC
/begin CHARACTERISTIC DutyCycThermProtn.DutyCycThermProtnMplr3NonStallTblY.Ary1D "MICROSAR RTE" VAL_BLK 0x0 RTE_RL_UWORD 0 NO_COMPU_METHOD 0 65535 MATRIX_DIM 5 1 1 SYMBOL_LINK "Rte_CalprmRom_CalRegn01Cmn_DEFAULT_RTE_CALPRM_GROUP.DutyCycThermProtnMplr3NonStallTblY_Ary1D" 0 DISPLAY_IDENTIFIER DutyCycThermProtn.CalibrationPorts.DutyCycThermProtnMplr3NonStallTblY.Ary1D /end CHARACTERISTIC
/begin CHARACTERISTIC DutyCycThermProtn.DutyCycThermProtnMplr3StallTblY.Ary1D "MICROSAR RTE" VAL_BLK 0x0 RTE_RL_UWORD 0 NO_COMPU_METHOD 0 65535 MATRIX_DIM 5 1 1 SYMBOL_LINK "Rte_CalprmRom_CalRegn01Cmn_DEFAULT_RTE_CALPRM_GROUP.DutyCycThermProtnMplr3StallTblY_Ary1D" 0 DISPLAY_IDENTIFIER DutyCycThermProtn.CalibrationPorts.DutyCycThermProtnMplr3StallTblY.Ary1D /end CHARACTERISTIC
/begin CHARACTERISTIC DutyCycThermProtn.DutyCycThermProtnMplr4NonStallTblY.Ary1D "MICROSAR RTE" VAL_BLK 0x0 RTE_RL_UWORD 0 NO_COMPU_METHOD 0 65535 MATRIX_DIM 5 1 1 SYMBOL_LINK "Rte_CalprmRom_CalRegn01Cmn_DEFAULT_RTE_CALPRM_GROUP.DutyCycThermProtnMplr4NonStallTblY_Ary1D" 0 DISPLAY_IDENTIFIER DutyCycThermProtn.CalibrationPorts.DutyCycThermProtnMplr4NonStallTblY.Ary1D /end CHARACTERISTIC
/begin CHARACTERISTIC DutyCycThermProtn.DutyCycThermProtnMplr4StallTblY.Ary1D "MICROSAR RTE" VAL_BLK 0x0 RTE_RL_UWORD 0 NO_COMPU_METHOD 0 65535 MATRIX_DIM 5 1 1 SYMBOL_LINK "Rte_CalprmRom_CalRegn01Cmn_DEFAULT_RTE_CALPRM_GROUP.DutyCycThermProtnMplr4StallTblY_Ary1D" 0 DISPLAY_IDENTIFIER DutyCycThermProtn.CalibrationPorts.DutyCycThermProtnMplr4StallTblY.Ary1D /end CHARACTERISTIC
/begin CHARACTERISTIC DutyCycThermProtn.DutyCycThermProtnMplr5NonStallTblY.Ary1D "MICROSAR RTE" VAL_BLK 0x0 RTE_RL_UWORD 0 NO_COMPU_METHOD 0 65535 MATRIX_DIM 5 1 1 SYMBOL_LINK "Rte_CalprmRom_CalRegn01Cmn_DEFAULT_RTE_CALPRM_GROUP.DutyCycThermProtnMplr5NonStallTblY_Ary1D" 0 DISPLAY_IDENTIFIER DutyCycThermProtn.CalibrationPorts.DutyCycThermProtnMplr5NonStallTblY.Ary1D /end CHARACTERISTIC
/begin CHARACTERISTIC DutyCycThermProtn.DutyCycThermProtnMplr5StallTblY.Ary1D "MICROSAR RTE" VAL_BLK 0x0 RTE_RL_UWORD 0 NO_COMPU_METHOD 0 65535 MATRIX_DIM 5 1 1 SYMBOL_LINK "Rte_CalprmRom_CalRegn01Cmn_DEFAULT_RTE_CALPRM_GROUP.DutyCycThermProtnMplr5StallTblY_Ary1D" 0 DISPLAY_IDENTIFIER DutyCycThermProtn.CalibrationPorts.DutyCycThermProtnMplr5StallTblY.Ary1D /end CHARACTERISTIC
/begin CHARACTERISTIC DutyCycThermProtn.DutyCycThermProtnMplr6NonStallTblY.Ary1D "MICROSAR RTE" VAL_BLK 0x0 RTE_RL_UWORD 0 NO_COMPU_METHOD 0 65535 MATRIX_DIM 5 1 1 SYMBOL_LINK "Rte_CalprmRom_CalRegn01Cmn_DEFAULT_RTE_CALPRM_GROUP.DutyCycThermProtnMplr6NonStallTblY_Ary1D" 0 DISPLAY_IDENTIFIER DutyCycThermProtn.CalibrationPorts.DutyCycThermProtnMplr6NonStallTblY.Ary1D /end CHARACTERISTIC
/begin CHARACTERISTIC DutyCycThermProtn.DutyCycThermProtnMplr6StallTblY.Ary1D "MICROSAR RTE" VAL_BLK 0x0 RTE_RL_UWORD 0 NO_COMPU_METHOD 0 65535 MATRIX_DIM 5 1 1 SYMBOL_LINK "Rte_CalprmRom_CalRegn01Cmn_DEFAULT_RTE_CALPRM_GROUP.DutyCycThermProtnMplr6StallTblY_Ary1D" 0 DISPLAY_IDENTIFIER DutyCycThermProtn.CalibrationPorts.DutyCycThermProtnMplr6StallTblY.Ary1D /end CHARACTERISTIC
/begin CHARACTERISTIC DutyCycThermProtn.DutyCycThermProtnMplrTSeln.Logl "MICROSAR RTE" VALUE 0x0 RTE_RL_BOOLEAN 0 RTE_CM_BOOLEAN 0 255 SYMBOL_LINK "Rte_CalprmRom_CalRegn01Cmn_DEFAULT_RTE_CALPRM_GROUP.DutyCycThermProtnMplrTSeln_Logl" 0 DISPLAY_IDENTIFIER DutyCycThermProtn.CalibrationPorts.DutyCycThermProtnMplrTSeln.Logl /end CHARACTERISTIC
/begin CHARACTERISTIC DutyCycThermProtn.DutyCycThermProtnMplrTblX.Ary1D "MICROSAR RTE" VAL_BLK 0x0 RTE_RL_SWORD 0 NO_COMPU_METHOD -32768 32767 MATRIX_DIM 5 1 1 SYMBOL_LINK "Rte_CalprmRom_CalRegn01Cmn_DEFAULT_RTE_CALPRM_GROUP.DutyCycThermProtnMplrTblX_Ary1D" 0 DISPLAY_IDENTIFIER DutyCycThermProtn.CalibrationPorts.DutyCycThermProtnMplrTblX.Ary1D /end CHARACTERISTIC
/begin CHARACTERISTIC DutyCycThermProtn.DutyCycThermProtnSlowFilTSeln.Logl "MICROSAR RTE" VALUE 0x0 RTE_RL_BOOLEAN 0 RTE_CM_BOOLEAN 0 255 SYMBOL_LINK "Rte_CalprmRom_CalRegn01Cmn_DEFAULT_RTE_CALPRM_GROUP.DutyCycThermProtnSlowFilTSeln_Logl" 0 DISPLAY_IDENTIFIER DutyCycThermProtn.CalibrationPorts.DutyCycThermProtnSlowFilTSeln.Logl /end CHARACTERISTIC
/begin CHARACTERISTIC DutyCycThermProtn.DutyCycThermProtnThermLimScaFac.Val "MICROSAR RTE" VALUE 0x0 RTE_RL_FLOAT32_IEEE 0 NO_COMPU_METHOD -3.402823466e+38 3.402823466e+38 SYMBOL_LINK "Rte_CalprmRom_CalRegn01Cmn_DEFAULT_RTE_CALPRM_GROUP.DutyCycThermProtnThermLimScaFac_Val" 0 DISPLAY_IDENTIFIER DutyCycThermProtn.CalibrationPorts.DutyCycThermProtnThermLimScaFac.Val /end CHARACTERISTIC
/begin CHARACTERISTIC DutyCycThermProtn.DutyCycThermProtnThermLoadLimTblX.Ary1D "MICROSAR RTE" VAL_BLK 0x0 RTE_RL_UWORD 0 NO_COMPU_METHOD 0 65535 MATRIX_DIM 8 1 1 SYMBOL_LINK "Rte_CalprmRom_CalRegn01Cmn_DEFAULT_RTE_CALPRM_GROUP.DutyCycThermProtnThermLoadLimTblX_Ary1D" 0 DISPLAY_IDENTIFIER DutyCycThermProtn.CalibrationPorts.DutyCycThermProtnThermLoadLimTblX.Ary1D /end CHARACTERISTIC
/begin CHARACTERISTIC DutyCycThermProtn.DutyCycThermProtnThermLoadLimTblY.Ary1D "MICROSAR RTE" VAL_BLK 0x0 RTE_RL_UWORD 0 NO_COMPU_METHOD 0 65535 MATRIX_DIM 8 1 1 SYMBOL_LINK "Rte_CalprmRom_CalRegn01Cmn_DEFAULT_RTE_CALPRM_GROUP.DutyCycThermProtnThermLoadLimTblY_Ary1D" 0 DISPLAY_IDENTIFIER DutyCycThermProtn.CalibrationPorts.DutyCycThermProtnThermLoadLimTblY.Ary1D /end CHARACTERISTIC
/begin CHARACTERISTIC DutyCycThermProtn.DutyCycThermProtnTqCmdSlewDwn.Val "MICROSAR RTE" VALUE 0x0 RTE_RL_FLOAT32_IEEE 0 NO_COMPU_METHOD -3.402823466e+38 3.402823466e+38 SYMBOL_LINK "Rte_CalprmRom_CalRegn01Cmn_DEFAULT_RTE_CALPRM_GROUP.DutyCycThermProtnTqCmdSlewDwn_Val" 0 DISPLAY_IDENTIFIER DutyCycThermProtn.CalibrationPorts.DutyCycThermProtnTqCmdSlewDwn.Val /end CHARACTERISTIC
/begin CHARACTERISTIC DutyCycThermProtn.DutyCycThermProtnTqCmdSlewUp.Val "MICROSAR RTE" VALUE 0x0 RTE_RL_FLOAT32_IEEE 0 NO_COMPU_METHOD -3.402823466e+38 3.402823466e+38 SYMBOL_LINK "Rte_CalprmRom_CalRegn01Cmn_DEFAULT_RTE_CALPRM_GROUP.DutyCycThermProtnTqCmdSlewUp_Val" 0 DISPLAY_IDENTIFIER DutyCycThermProtn.CalibrationPorts.DutyCycThermProtnTqCmdSlewUp.Val /end CHARACTERISTIC
/begin CHARACTERISTIC EcuTMeas.EcuTMeasDftT.Val "MICROSAR RTE" VALUE 0x0 RTE_RL_FLOAT32_IEEE 0 NO_COMPU_METHOD -50.0 150.0 SYMBOL_LINK "Rte_CalprmRom_CalRegn01Cmn_DEFAULT_RTE_CALPRM_GROUP.EcuTMeasDftT_Val" 0 DISPLAY_IDENTIFIER EcuTMeas.CalibrationPorts.EcuTMeasDftT.Val /end CHARACTERISTIC
/begin CHARACTERISTIC EcuTMeas.EcuTMeasFilTau.Val "MICROSAR RTE" VALUE 0x0 RTE_RL_FLOAT32_IEEE 0 NO_COMPU_METHOD 0.1 10.0 SYMBOL_LINK "Rte_CalprmRom_CalRegn01Cmn_DEFAULT_RTE_CALPRM_GROUP.EcuTMeasFilTau_Val" 0 DISPLAY_IDENTIFIER EcuTMeas.CalibrationPorts.EcuTMeasFilTau.Val /end CHARACTERISTIC
/begin CHARACTERISTIC EcuTMeas.EcuTMeasNtc0x045FailStep.Val "MICROSAR RTE" VALUE 0x0 RTE_RL_UWORD 0 NO_COMPU_METHOD 0 65535 SYMBOL_LINK "Rte_CalprmRom_CalRegn01Cmn_DEFAULT_RTE_CALPRM_GROUP.EcuTMeasNtc0x045FailStep_Val" 0 DISPLAY_IDENTIFIER EcuTMeas.CalibrationPorts.EcuTMeasNtc0x045FailStep.Val /end CHARACTERISTIC
/begin CHARACTERISTIC EcuTMeas.EcuTMeasNtc0x045PassStep.Val "MICROSAR RTE" VALUE 0x0 RTE_RL_UWORD 0 NO_COMPU_METHOD 0 65535 SYMBOL_LINK "Rte_CalprmRom_CalRegn01Cmn_DEFAULT_RTE_CALPRM_GROUP.EcuTMeasNtc0x045PassStep_Val" 0 DISPLAY_IDENTIFIER EcuTMeas.CalibrationPorts.EcuTMeasNtc0x045PassStep.Val /end CHARACTERISTIC
/begin CHARACTERISTIC EcuTMeas.EcuTMeasRngDiagcMax.Val "MICROSAR RTE" VALUE 0x0 RTE_RL_FLOAT32_IEEE 0 NO_COMPU_METHOD -50.0 200.0 SYMBOL_LINK "Rte_CalprmRom_CalRegn01Cmn_DEFAULT_RTE_CALPRM_GROUP.EcuTMeasRngDiagcMax_Val" 0 DISPLAY_IDENTIFIER EcuTMeas.CalibrationPorts.EcuTMeasRngDiagcMax.Val /end CHARACTERISTIC
/begin CHARACTERISTIC EcuTMeas.EcuTMeasRngDiagcMin.Val "MICROSAR RTE" VALUE 0x0 RTE_RL_FLOAT32_IEEE 0 NO_COMPU_METHOD -50.0 200.0 SYMBOL_LINK "Rte_CalprmRom_CalRegn01Cmn_DEFAULT_RTE_CALPRM_GROUP.EcuTMeasRngDiagcMin_Val" 0 DISPLAY_IDENTIFIER EcuTMeas.CalibrationPorts.EcuTMeasRngDiagcMin.Val /end CHARACTERISTIC
/begin CHARACTERISTIC EcuTMeas.EcuTMeasScag.Val "MICROSAR RTE" VALUE 0x0 RTE_RL_FLOAT32_IEEE 0 NO_COMPU_METHOD 0.0 200.0 SYMBOL_LINK "Rte_CalprmRom_CalRegn01Cmn_DEFAULT_RTE_CALPRM_GROUP.EcuTMeasScag_Val" 0 DISPLAY_IDENTIFIER EcuTMeas.CalibrationPorts.EcuTMeasScag.Val /end CHARACTERISTIC
/begin CHARACTERISTIC EcuTMeas.EcuTMeasScagOffs.Val "MICROSAR RTE" VALUE 0x0 RTE_RL_FLOAT32_IEEE 0 NO_COMPU_METHOD -100.0 150.0 SYMBOL_LINK "Rte_CalprmRom_CalRegn01Cmn_DEFAULT_RTE_CALPRM_GROUP.EcuTMeasScagOffs_Val" 0 DISPLAY_IDENTIFIER EcuTMeas.CalibrationPorts.EcuTMeasScagOffs.Val /end CHARACTERISTIC
/begin CHARACTERISTIC ElecPwrCns.ElecPwrCnsCtrlrInpR.Val "MICROSAR RTE" VALUE 0x0 RTE_RL_FLOAT32_IEEE 0 NO_COMPU_METHOD -3.402823466e+38 3.402823466e+38 SYMBOL_LINK "Rte_CalRegn01Cmn_ElecPwrCnsCtrlrInpR_Val" 0 DISPLAY_IDENTIFIER ElecPwrCns.CalibrationPorts.ElecPwrCnsCtrlrInpR.Val /end CHARACTERISTIC
/begin CHARACTERISTIC ElecPwrCns.ElecPwrCnsPrstcPwrLoss.Val "MICROSAR RTE" VALUE 0x0 RTE_RL_FLOAT32_IEEE 0 NO_COMPU_METHOD -3.402823466e+38 3.402823466e+38 SYMBOL_LINK "Rte_CalRegn01CmnGroupA_ElecPwrCnsPrstcPwrLoss_Val" 0 DISPLAY_IDENTIFIER ElecPwrCns.CalibrationPorts.ElecPwrCnsPrstcPwrLoss.Val /end CHARACTERISTIC
/begin CHARACTERISTIC EotLrng.EotLrngAuthyStrtLrn.Val "MICROSAR RTE" VALUE 0x0 RTE_RL_FLOAT32_IEEE 0 NO_COMPU_METHOD -3.402823466e+38 3.402823466e+38 SYMBOL_LINK "Rte_CalprmRom_CalRegn03Inin00_DEFAULT_RTE_CALPRM_GROUP.EotLrngAuthyStrtLrn_Val" 0 DISPLAY_IDENTIFIER EotLrng.CalibrationPorts.EotLrngAuthyStrtLrn.Val /end CHARACTERISTIC
/begin CHARACTERISTIC EotLrng.EotLrngEotLrnTmr.Val "MICROSAR RTE" VALUE 0x0 RTE_RL_UWORD 0 NO_COMPU_METHOD 0 65535 SYMBOL_LINK "Rte_CalprmRom_CalRegn03Inin00_DEFAULT_RTE_CALPRM_GROUP.EotLrngEotLrnTmr_Val" 0 DISPLAY_IDENTIFIER EotLrng.CalibrationPorts.EotLrngEotLrnTmr.Val /end CHARACTERISTIC
/begin CHARACTERISTIC EotLrng.EotLrngHwAgOverTrvlCnt.Val "MICROSAR RTE" VALUE 0x0 RTE_RL_UBYTE 0 NO_COMPU_METHOD 0 255 SYMBOL_LINK "Rte_CalprmRom_CalRegn01Cmn_DEFAULT_RTE_CALPRM_GROUP.EotLrngHwAgOverTrvlCnt_Val" 0 DISPLAY_IDENTIFIER EotLrng.CalibrationPorts.EotLrngHwAgOverTrvlCnt.Val /end CHARACTERISTIC
/begin CHARACTERISTIC EotLrng.EotLrngHwAgOverTrvlEntr.Val "MICROSAR RTE" VALUE 0x0 RTE_RL_FLOAT32_IEEE 0 NO_COMPU_METHOD -3.402823466e+38 3.402823466e+38 SYMBOL_LINK "Rte_CalprmRom_CalRegn03Cmn_DEFAULT_RTE_CALPRM_GROUP.EotLrngHwAgOverTrvlEntr_Val" 0 DISPLAY_IDENTIFIER EotLrng.CalibrationPorts.EotLrngHwAgOverTrvlEntr.Val /end CHARACTERISTIC
/begin CHARACTERISTIC EotLrng.EotLrngHwAgOverTrvlExit.Val "MICROSAR RTE" VALUE 0x0 RTE_RL_FLOAT32_IEEE 0 NO_COMPU_METHOD -3.402823466e+38 3.402823466e+38 SYMBOL_LINK "Rte_CalprmRom_CalRegn03Cmn_DEFAULT_RTE_CALPRM_GROUP.EotLrngHwAgOverTrvlExit_Val" 0 DISPLAY_IDENTIFIER EotLrng.CalibrationPorts.EotLrngHwAgOverTrvlExit.Val /end CHARACTERISTIC
/begin CHARACTERISTIC EotLrng.EotLrngHwTqEotLrn.Val "MICROSAR RTE" VALUE 0x0 RTE_RL_FLOAT32_IEEE 0 NO_COMPU_METHOD -3.402823466e+38 3.402823466e+38 SYMBOL_LINK "Rte_CalprmRom_CalRegn03Inin00_DEFAULT_RTE_CALPRM_GROUP.EotLrngHwTqEotLrn_Val" 0 DISPLAY_IDENTIFIER EotLrng.CalibrationPorts.EotLrngHwTqEotLrn.Val /end CHARACTERISTIC
/begin CHARACTERISTIC EotLrng.EotLrngMotVelEotLrn.Val "MICROSAR RTE" VALUE 0x0 RTE_RL_FLOAT32_IEEE 0 NO_COMPU_METHOD -3.402823466e+38 3.402823466e+38 SYMBOL_LINK "Rte_CalprmRom_CalRegn03Inin00_DEFAULT_RTE_CALPRM_GROUP.EotLrngMotVelEotLrn_Val" 0 DISPLAY_IDENTIFIER EotLrng.CalibrationPorts.EotLrngMotVelEotLrn.Val /end CHARACTERISTIC
/begin CHARACTERISTIC EotLrng.EotLrngRackTrvlMax.Val "MICROSAR RTE" VALUE 0x0 RTE_RL_FLOAT32_IEEE 0 NO_COMPU_METHOD -3.402823466e+38 3.402823466e+38 SYMBOL_LINK "Rte_CalprmRom_CalRegn03Inin00_DEFAULT_RTE_CALPRM_GROUP.EotLrngRackTrvlMax_Val" 0 DISPLAY_IDENTIFIER EotLrng.CalibrationPorts.EotLrngRackTrvlMax.Val /end CHARACTERISTIC
/begin CHARACTERISTIC EotLrng.EotLrngRackTrvlMin.Val "MICROSAR RTE" VALUE 0x0 RTE_RL_FLOAT32_IEEE 0 NO_COMPU_METHOD -3.402823466e+38 3.402823466e+38 SYMBOL_LINK "Rte_CalprmRom_CalRegn03Inin00_DEFAULT_RTE_CALPRM_GROUP.EotLrngRackTrvlMin_Val" 0 DISPLAY_IDENTIFIER EotLrng.CalibrationPorts.EotLrngRackTrvlMin.Val /end CHARACTERISTIC
/begin CHARACTERISTIC EotLrng.EotLrngRstAuthyMin.Val "MICROSAR RTE" VALUE 0x0 RTE_RL_FLOAT32_IEEE 0 NO_COMPU_METHOD -3.402823466e+38 3.402823466e+38 SYMBOL_LINK "Rte_CalprmRom_CalRegn03Inin00_DEFAULT_RTE_CALPRM_GROUP.EotLrngRstAuthyMin_Val" 0 DISPLAY_IDENTIFIER EotLrng.CalibrationPorts.EotLrngRstAuthyMin.Val /end CHARACTERISTIC
/begin CHARACTERISTIC EotLrng.EotNvmDataDft.CcwEot "MICROSAR RTE" VALUE 0x0 RTE_RL_FLOAT32_IEEE 0 NO_COMPU_METHOD -3.402823466e+38 3.402823466e+38 SYMBOL_LINK "Rte_CalprmRom_EotLrng_DEFAULT_RTE_CDATA_GROUP.EotNvmDataDft.CcwEot" 0 DISPLAY_IDENTIFIER EotLrng.CalibrationParameters.EotNvmDataDft.CcwEot /end CHARACTERISTIC
/begin CHARACTERISTIC EotLrng.EotNvmDataDft.CcwEotDetd "MICROSAR RTE" VALUE 0x0 RTE_RL_BOOLEAN 0 RTE_CM_BOOLEAN 0 255 SYMBOL_LINK "Rte_CalprmRom_EotLrng_DEFAULT_RTE_CDATA_GROUP.EotNvmDataDft.CcwEotDetd" 0 DISPLAY_IDENTIFIER EotLrng.CalibrationParameters.EotNvmDataDft.CcwEotDetd /end CHARACTERISTIC
/begin CHARACTERISTIC EotLrng.EotNvmDataDft.CwEot "MICROSAR RTE" VALUE 0x0 RTE_RL_FLOAT32_IEEE 0 NO_COMPU_METHOD -3.402823466e+38 3.402823466e+38 SYMBOL_LINK "Rte_CalprmRom_EotLrng_DEFAULT_RTE_CDATA_GROUP.EotNvmDataDft.CwEot" 0 DISPLAY_IDENTIFIER EotLrng.CalibrationParameters.EotNvmDataDft.CwEot /end CHARACTERISTIC
/begin CHARACTERISTIC EotLrng.EotNvmDataDft.CwEotDetd "MICROSAR RTE" VALUE 0x0 RTE_RL_BOOLEAN 0 RTE_CM_BOOLEAN 0 255 SYMBOL_LINK "Rte_CalprmRom_EotLrng_DEFAULT_RTE_CDATA_GROUP.EotNvmDataDft.CwEotDetd" 0 DISPLAY_IDENTIFIER EotLrng.CalibrationParameters.EotNvmDataDft.CwEotDetd /end CHARACTERISTIC
/begin CHARACTERISTIC EotLrng.EotProtnRackTrvlLimrEna.Logl "MICROSAR RTE" VALUE 0x0 RTE_RL_BOOLEAN 0 RTE_CM_BOOLEAN 0 255 SYMBOL_LINK "Rte_CalprmRom_CalRegn03Inin00_DEFAULT_RTE_CALPRM_GROUP.EotProtnRackTrvlLimrEna_Logl" 0 DISPLAY_IDENTIFIER EotLrng.CalibrationPorts.EotProtnRackTrvlLimrEna.Logl /end CHARACTERISTIC
/begin CHARACTERISTIC EotProtn.EotProtnActvRegnBypMaxThd.Val "MICROSAR RTE" VALUE 0x0 RTE_RL_FLOAT32_IEEE 0 NO_COMPU_METHOD -3.402823466e+38 3.402823466e+38 SYMBOL_LINK "Rte_CalprmRom_CalRegn03CmnGroupB_DEFAULT_RTE_CALPRM_GROUP.EotProtnActvRegnBypMaxThd_Val" 0 DISPLAY_IDENTIFIER EotProtn.CalibrationPorts.EotProtnActvRegnBypMaxThd.Val /end CHARACTERISTIC
/begin CHARACTERISTIC EotProtn.EotProtnDampgSlew.Val "MICROSAR RTE" VALUE 0x0 RTE_RL_FLOAT32_IEEE 0 NO_COMPU_METHOD -3.402823466e+38 3.402823466e+38 SYMBOL_LINK "Rte_CalprmRom_CalRegn03Inin00GroupB_DEFAULT_RTE_CALPRM_GROUP.EotProtnDampgSlew_Val" 0 DISPLAY_IDENTIFIER EotProtn.CalibrationPorts.EotProtnDampgSlew.Val /end CHARACTERISTIC
/begin CHARACTERISTIC EotProtn.EotProtnDampgVehSpdTbl.Ary1D "MICROSAR RTE" VAL_BLK 0x0 RTE_RL_UWORD 0 NO_COMPU_METHOD 0 65535 MATRIX_DIM 4 1 1 SYMBOL_LINK "Rte_CalprmRom_CalRegn03Rt00GroupB_DEFAULT_RTE_CALPRM_GROUP.EotProtnDampgVehSpdTbl_Ary1D" 0 DISPLAY_IDENTIFIER EotProtn.CalibrationPorts.EotProtnDampgVehSpdTbl.Ary1D /end CHARACTERISTIC
/begin CHARACTERISTIC EotProtn.EotProtnDeltaTqThd.Val "MICROSAR RTE" VALUE 0x0 RTE_RL_FLOAT32_IEEE 0 NO_COMPU_METHOD -3.402823466e+38 3.402823466e+38 SYMBOL_LINK "Rte_CalprmRom_CalRegn03CmnGroupB_DEFAULT_RTE_CALPRM_GROUP.EotProtnDeltaTqThd_Val" 0 DISPLAY_IDENTIFIER EotProtn.CalibrationPorts.EotProtnDeltaTqThd.Val /end CHARACTERISTIC
/begin CHARACTERISTIC EotProtn.EotProtnDftPosn.Val "MICROSAR RTE" VALUE 0x0 RTE_RL_FLOAT32_IEEE 0 NO_COMPU_METHOD -3.402823466e+38 3.402823466e+38 SYMBOL_LINK "Rte_CalprmRom_CalRegn03Inin00_DEFAULT_RTE_CALPRM_GROUP.EotProtnDftPosn_Val" 0 DISPLAY_IDENTIFIER EotProtn.CalibrationPorts.EotProtnDftPosn.Val /end CHARACTERISTIC
/begin CHARACTERISTIC EotProtn.EotProtnEntrGainVehSpdTbl.Ary1D "MICROSAR RTE" VAL_BLK 0x0 RTE_RL_UWORD 0 NO_COMPU_METHOD 0 65535 MATRIX_DIM 5 1 1 SYMBOL_LINK "Rte_CalprmRom_CalRegn03Rt00GroupB_DEFAULT_RTE_CALPRM_GROUP.EotProtnEntrGainVehSpdTbl_Ary1D" 0 DISPLAY_IDENTIFIER EotProtn.CalibrationPorts.EotProtnEntrGainVehSpdTbl.Ary1D /end CHARACTERISTIC
/begin CHARACTERISTIC EotProtn.EotProtnEntrGainX.Ary2D "MICROSAR RTE" VAL_BLK 0x0 RTE_RL_UWORD 0 NO_COMPU_METHOD 0 65535 MATRIX_DIM 4 5 1 SYMBOL_LINK "Rte_CalprmRom_CalRegn03Rt00GroupB_DEFAULT_RTE_CALPRM_GROUP.EotProtnEntrGainX_Ary2D" 0 DISPLAY_IDENTIFIER EotProtn.CalibrationPorts.EotProtnEntrGainX.Ary2D /end CHARACTERISTIC
/begin CHARACTERISTIC EotProtn.EotProtnEntrGainY.Ary2D "MICROSAR RTE" VAL_BLK 0x0 RTE_RL_UWORD 0 NO_COMPU_METHOD 0 65535 MATRIX_DIM 4 5 1 SYMBOL_LINK "Rte_CalprmRom_CalRegn03Rt00GroupB_DEFAULT_RTE_CALPRM_GROUP.EotProtnEntrGainY_Ary2D" 0 DISPLAY_IDENTIFIER EotProtn.CalibrationPorts.EotProtnEntrGainY.Ary2D /end CHARACTERISTIC
/begin CHARACTERISTIC EotProtn.EotProtnEntrStLpFilFrq.Val "MICROSAR RTE" VALUE 0x0 RTE_RL_FLOAT32_IEEE 0 NO_COMPU_METHOD -3.402823466e+38 3.402823466e+38 SYMBOL_LINK "Rte_CalprmRom_CalRegn03Inin00_DEFAULT_RTE_CALPRM_GROUP.EotProtnEntrStLpFilFrq_Val" 0 DISPLAY_IDENTIFIER EotProtn.CalibrationPorts.EotProtnEntrStLpFilFrq.Val /end CHARACTERISTIC
/begin CHARACTERISTIC EotProtn.EotProtnExitDampgY.Ary2D "MICROSAR RTE" VAL_BLK 0x0 RTE_RL_UWORD 0 NO_COMPU_METHOD 0 65535 MATRIX_DIM 2 4 1 SYMBOL_LINK "Rte_CalprmRom_CalRegn03Rt00GroupB_DEFAULT_RTE_CALPRM_GROUP.EotProtnExitDampgY_Ary2D" 0 DISPLAY_IDENTIFIER EotProtn.CalibrationPorts.EotProtnExitDampgY.Ary2D /end CHARACTERISTIC
/begin CHARACTERISTIC EotProtn.EotProtnExitStLpFilFrq.Val "MICROSAR RTE" VALUE 0x0 RTE_RL_FLOAT32_IEEE 0 NO_COMPU_METHOD -3.402823466e+38 3.402823466e+38 SYMBOL_LINK "Rte_CalprmRom_CalRegn03Inin00_DEFAULT_RTE_CALPRM_GROUP.EotProtnExitStLpFilFrq_Val" 0 DISPLAY_IDENTIFIER EotProtn.CalibrationPorts.EotProtnExitStLpFilFrq.Val /end CHARACTERISTIC
/begin CHARACTERISTIC EotProtn.EotProtnHwAgGain.Val "MICROSAR RTE" VALUE 0x0 RTE_RL_FLOAT32_IEEE 0 NO_COMPU_METHOD -3.402823466e+38 3.402823466e+38 SYMBOL_LINK "Rte_CalprmRom_CalRegn03Inin00GroupB_DEFAULT_RTE_CALPRM_GROUP.EotProtnHwAgGain_Val" 0 DISPLAY_IDENTIFIER EotProtn.CalibrationPorts.EotProtnHwAgGain.Val /end CHARACTERISTIC
/begin CHARACTERISTIC EotProtn.EotProtnHwAgMax.Val "MICROSAR RTE" VALUE 0x0 RTE_RL_FLOAT32_IEEE 0 NO_COMPU_METHOD -3.402823466e+38 3.402823466e+38 SYMBOL_LINK "Rte_CalprmRom_CalRegn03Inin00_DEFAULT_RTE_CALPRM_GROUP.EotProtnHwAgMax_Val" 0 DISPLAY_IDENTIFIER EotProtn.CalibrationPorts.EotProtnHwAgMax.Val /end CHARACTERISTIC
/begin CHARACTERISTIC EotProtn.EotProtnHwAgMin.Val "MICROSAR RTE" VALUE 0x0 RTE_RL_FLOAT32_IEEE 0 NO_COMPU_METHOD -3.402823466e+38 3.402823466e+38 SYMBOL_LINK "Rte_CalprmRom_CalRegn03Inin00_DEFAULT_RTE_CALPRM_GROUP.EotProtnHwAgMin_Val" 0 DISPLAY_IDENTIFIER EotProtn.CalibrationPorts.EotProtnHwAgMin.Val /end CHARACTERISTIC
/begin CHARACTERISTIC EotProtn.EotProtnHwDegDampgX.Ary2D "MICROSAR RTE" VAL_BLK 0x0 RTE_RL_UWORD 0 NO_COMPU_METHOD 0 65535 MATRIX_DIM 2 4 1 SYMBOL_LINK "Rte_CalprmRom_CalRegn03Rt00GroupB_DEFAULT_RTE_CALPRM_GROUP.EotProtnHwDegDampgX_Ary2D" 0 DISPLAY_IDENTIFIER EotProtn.CalibrationPorts.EotProtnHwDegDampgX.Ary2D /end CHARACTERISTIC
/begin CHARACTERISTIC EotProtn.EotProtnHwTqLpFilFrq.Val "MICROSAR RTE" VALUE 0x0 RTE_RL_FLOAT32_IEEE 0 NO_COMPU_METHOD -3.402823466e+38 3.402823466e+38 SYMBOL_LINK "Rte_CalprmRom_CalRegn03Inin00_DEFAULT_RTE_CALPRM_GROUP.EotProtnHwTqLpFilFrq_Val" 0 DISPLAY_IDENTIFIER EotProtn.CalibrationPorts.EotProtnHwTqLpFilFrq.Val /end CHARACTERISTIC
/begin CHARACTERISTIC EotProtn.EotProtnHwTqScaX.Ary1D "MICROSAR RTE" VAL_BLK 0x0 RTE_RL_UWORD 0 NO_COMPU_METHOD 0 65535 MATRIX_DIM 2 1 1 SYMBOL_LINK "Rte_CalprmRom_CalRegn03Inin00GroupB_DEFAULT_RTE_CALPRM_GROUP.EotProtnHwTqScaX_Ary1D" 0 DISPLAY_IDENTIFIER EotProtn.CalibrationPorts.EotProtnHwTqScaX.Ary1D /end CHARACTERISTIC
/begin CHARACTERISTIC EotProtn.EotProtnMotSpdIncptSca.Val "MICROSAR RTE" VALUE 0x0 RTE_RL_FLOAT32_IEEE 0 NO_COMPU_METHOD -3.402823466e+38 3.402823466e+38 SYMBOL_LINK "Rte_CalprmRom_CalRegn03Inin00_DEFAULT_RTE_CALPRM_GROUP.EotProtnMotSpdIncptSca_Val" 0 DISPLAY_IDENTIFIER EotProtn.CalibrationPorts.EotProtnMotSpdIncptSca.Val /end CHARACTERISTIC
/begin CHARACTERISTIC EotProtn.EotProtnMotSpdIncptX.Ary1D "MICROSAR RTE" VAL_BLK 0x0 RTE_RL_UWORD 0 NO_COMPU_METHOD 0 65535 MATRIX_DIM 2 1 1 SYMBOL_LINK "Rte_CalprmRom_CalRegn03Inin00_DEFAULT_RTE_CALPRM_GROUP.EotProtnMotSpdIncptX_Ary1D" 0 DISPLAY_IDENTIFIER EotProtn.CalibrationPorts.EotProtnMotSpdIncptX.Ary1D /end CHARACTERISTIC
/begin CHARACTERISTIC EotProtn.EotProtnMotSpdIncptY.Ary1D "MICROSAR RTE" VAL_BLK 0x0 RTE_RL_UWORD 0 NO_COMPU_METHOD 0 65535 MATRIX_DIM 2 1 1 SYMBOL_LINK "Rte_CalprmRom_CalRegn03CmnGroupB_DEFAULT_RTE_CALPRM_GROUP.EotProtnMotSpdIncptY_Ary1D" 0 DISPLAY_IDENTIFIER EotProtn.CalibrationPorts.EotProtnMotSpdIncptY.Ary1D /end CHARACTERISTIC
/begin CHARACTERISTIC EotProtn.EotProtnMotVelGain.Val "MICROSAR RTE" VALUE 0x0 RTE_RL_FLOAT32_IEEE 0 NO_COMPU_METHOD -3.402823466e+38 3.402823466e+38 SYMBOL_LINK "Rte_CalprmRom_CalRegn03Inin00GroupB_DEFAULT_RTE_CALPRM_GROUP.EotProtnMotVelGain_Val" 0 DISPLAY_IDENTIFIER EotProtn.CalibrationPorts.EotProtnMotVelGain.Val /end CHARACTERISTIC
/begin CHARACTERISTIC EotProtn.EotProtnNormDampgY.Ary2D "MICROSAR RTE" VAL_BLK 0x0 RTE_RL_UWORD 0 NO_COMPU_METHOD 0 65535 MATRIX_DIM 2 4 1 SYMBOL_LINK "Rte_CalprmRom_CalRegn03Rt00GroupB_DEFAULT_RTE_CALPRM_GROUP.EotProtnNormDampgY_Ary2D" 0 DISPLAY_IDENTIFIER EotProtn.CalibrationPorts.EotProtnNormDampgY.Ary2D /end CHARACTERISTIC
/begin CHARACTERISTIC EotProtn.EotProtnPosnRampStep.Val "MICROSAR RTE" VALUE 0x0 RTE_RL_FLOAT32_IEEE 0 NO_COMPU_METHOD -3.402823466e+38 3.402823466e+38 SYMBOL_LINK "Rte_CalprmRom_CalRegn03Inin00_DEFAULT_RTE_CALPRM_GROUP.EotProtnPosnRampStep_Val" 0 DISPLAY_IDENTIFIER EotProtn.CalibrationPorts.EotProtnPosnRampStep.Val /end CHARACTERISTIC
/begin CHARACTERISTIC EotProtn.EotProtnRackTrvlLimrAuthyThd.Val "MICROSAR RTE" VALUE 0x0 RTE_RL_FLOAT32_IEEE 0 NO_COMPU_METHOD -3.402823466e+38 3.402823466e+38 SYMBOL_LINK "Rte_CalprmRom_CalRegn03Inin00_DEFAULT_RTE_CALPRM_GROUP.EotProtnRackTrvlLimrAuthyThd_Val" 0 DISPLAY_IDENTIFIER EotProtn.CalibrationPorts.EotProtnRackTrvlLimrAuthyThd.Val /end CHARACTERISTIC
/begin CHARACTERISTIC EotProtn.EotProtnRackTrvlLimrAuthyThdLimd.Val "MICROSAR RTE" VALUE 0x0 RTE_RL_FLOAT32_IEEE 0 NO_COMPU_METHOD -3.402823466e+38 3.402823466e+38 SYMBOL_LINK "Rte_CalprmRom_CalRegn03Inin00_DEFAULT_RTE_CALPRM_GROUP.EotProtnRackTrvlLimrAuthyThdLimd_Val" 0 DISPLAY_IDENTIFIER EotProtn.CalibrationPorts.EotProtnRackTrvlLimrAuthyThdLimd.Val /end CHARACTERISTIC
/begin CHARACTERISTIC EotProtn.EotProtnRackTrvlLimrEna.Logl "MICROSAR RTE" VALUE 0x0 RTE_RL_BOOLEAN 0 RTE_CM_BOOLEAN 0 255 SYMBOL_LINK "Rte_CalprmRom_CalRegn03Inin00_DEFAULT_RTE_CALPRM_GROUP.EotProtnRackTrvlLimrEna_Logl" 0 DISPLAY_IDENTIFIER EotProtn.CalibrationPorts.EotProtnRackTrvlLimrEna.Logl /end CHARACTERISTIC
/begin CHARACTERISTIC EotProtn.EotProtnRackTrvlLimrRng.Val "MICROSAR RTE" VALUE 0x0 RTE_RL_FLOAT32_IEEE 0 NO_COMPU_METHOD -3.402823466e+38 3.402823466e+38 SYMBOL_LINK "Rte_CalprmRom_CalRegn03Inin00GroupB_DEFAULT_RTE_CALPRM_GROUP.EotProtnRackTrvlLimrRng_Val" 0 DISPLAY_IDENTIFIER EotProtn.CalibrationPorts.EotProtnRackTrvlLimrRng.Val /end CHARACTERISTIC
/begin CHARACTERISTIC EotProtn.EotProtnRackTrvlLimrRngLimd.Val "MICROSAR RTE" VALUE 0x0 RTE_RL_FLOAT32_IEEE 0 NO_COMPU_METHOD -3.402823466e+38 3.402823466e+38 SYMBOL_LINK "Rte_CalprmRom_CalRegn03Inin00GroupB_DEFAULT_RTE_CALPRM_GROUP.EotProtnRackTrvlLimrRngLimd_Val" 0 DISPLAY_IDENTIFIER EotProtn.CalibrationPorts.EotProtnRackTrvlLimrRngLimd.Val /end CHARACTERISTIC
/begin CHARACTERISTIC EotProtn.EotProtnRackTrvlLimrVehSpdThd.Val "MICROSAR RTE" VALUE 0x0 RTE_RL_FLOAT32_IEEE 0 NO_COMPU_METHOD -3.402823466e+38 3.402823466e+38 SYMBOL_LINK "Rte_CalprmRom_CalRegn03Inin00GroupB_DEFAULT_RTE_CALPRM_GROUP.EotProtnRackTrvlLimrVehSpdThd_Val" 0 DISPLAY_IDENTIFIER EotProtn.CalibrationPorts.EotProtnRackTrvlLimrVehSpdThd.Val /end CHARACTERISTIC
/begin CHARACTERISTIC EotProtn.EotProtnRunEotVelImpctAndSoftEndStop.Logl "MICROSAR RTE" VALUE 0x0 RTE_RL_BOOLEAN 0 RTE_CM_BOOLEAN 0 255 SYMBOL_LINK "Rte_CalprmRom_CalRegn03Inin00_DEFAULT_RTE_CALPRM_GROUP.EotProtnRunEotVelImpctAndSoftEndStop_Logl" 0 DISPLAY_IDENTIFIER EotProtn.CalibrationPorts.EotProtnRunEotVelImpctAndSoftEndStop.Logl /end CHARACTERISTIC
/begin CHARACTERISTIC EotProtn.EotProtnSoftEndStopAuthyThd.Val "MICROSAR RTE" VALUE 0x0 RTE_RL_FLOAT32_IEEE 0 NO_COMPU_METHOD -3.402823466e+38 3.402823466e+38 SYMBOL_LINK "Rte_CalprmRom_CalRegn03Cmn_DEFAULT_RTE_CALPRM_GROUP.EotProtnSoftEndStopAuthyThd_Val" 0 DISPLAY_IDENTIFIER EotProtn.CalibrationPorts.EotProtnSoftEndStopAuthyThd.Val /end CHARACTERISTIC
/begin CHARACTERISTIC EotProtn.EotProtnSoftEndStopEna.Logl "MICROSAR RTE" VALUE 0x0 RTE_RL_BOOLEAN 0 RTE_CM_BOOLEAN 0 255 SYMBOL_LINK "Rte_CalprmRom_CalRegn03Inin00_DEFAULT_RTE_CALPRM_GROUP.EotProtnSoftEndStopEna_Logl" 0 DISPLAY_IDENTIFIER EotProtn.CalibrationPorts.EotProtnSoftEndStopEna.Logl /end CHARACTERISTIC
/begin CHARACTERISTIC EotProtn.EotProtnSoftEndStopVehSpdThd.Val "MICROSAR RTE" VALUE 0x0 RTE_RL_FLOAT32_IEEE 0 NO_COMPU_METHOD -3.402823466e+38 3.402823466e+38 SYMBOL_LINK "Rte_CalprmRom_CalRegn03Inin00GroupB_DEFAULT_RTE_CALPRM_GROUP.EotProtnSoftEndStopVehSpdThd_Val" 0 DISPLAY_IDENTIFIER EotProtn.CalibrationPorts.EotProtnSoftEndStopVehSpdThd.Val /end CHARACTERISTIC
/begin CHARACTERISTIC EotProtnFwl.EotProtnFwlActvCmdLowrBnd.Ary1D "MICROSAR RTE" VAL_BLK 0x0 RTE_RL_SWORD 0 NO_COMPU_METHOD -32768 32767 MATRIX_DIM 5 1 1 SYMBOL_LINK "Rte_CalprmRom_CalRegn01Inin00_DEFAULT_RTE_CALPRM_GROUP.EotProtnFwlActvCmdLowrBnd_Ary1D" 0 DISPLAY_IDENTIFIER EotProtnFwl.CalibrationPorts.EotProtnFwlActvCmdLowrBnd.Ary1D /end CHARACTERISTIC
/begin CHARACTERISTIC EotProtnFwl.EotProtnFwlActvCmdUpprBnd.Ary1D "MICROSAR RTE" VAL_BLK 0x0 RTE_RL_SWORD 0 NO_COMPU_METHOD -32768 32767 MATRIX_DIM 5 1 1 SYMBOL_LINK "Rte_CalprmRom_CalRegn01Inin00_DEFAULT_RTE_CALPRM_GROUP.EotProtnFwlActvCmdUpprBnd_Ary1D" 0 DISPLAY_IDENTIFIER EotProtnFwl.CalibrationPorts.EotProtnFwlActvCmdUpprBnd.Ary1D /end CHARACTERISTIC
/begin CHARACTERISTIC EotProtnFwl.EotProtnFwlEotDampgActvBndX.Ary1D "MICROSAR RTE" VAL_BLK 0x0 RTE_RL_SWORD 0 NO_COMPU_METHOD -32768 32767 MATRIX_DIM 5 1 1 SYMBOL_LINK "Rte_CalprmRom_CalRegn01Cmn_DEFAULT_RTE_CALPRM_GROUP.EotProtnFwlEotDampgActvBndX_Ary1D" 0 DISPLAY_IDENTIFIER EotProtnFwl.CalibrationPorts.EotProtnFwlEotDampgActvBndX.Ary1D /end CHARACTERISTIC
/begin CHARACTERISTIC EotProtnFwl.EotProtnFwlEotDampgActvBndY.Ary2D "MICROSAR RTE" VAL_BLK 0x0 RTE_RL_SWORD 0 NO_COMPU_METHOD -32768 32767 MATRIX_DIM 5 4 1 SYMBOL_LINK "Rte_CalprmRom_CalRegn01Inin00GroupC_DEFAULT_RTE_CALPRM_GROUP.EotProtnFwlEotDampgActvBndY_Ary2D" 0 DISPLAY_IDENTIFIER EotProtnFwl.CalibrationPorts.EotProtnFwlEotDampgActvBndY.Ary2D /end CHARACTERISTIC
/begin CHARACTERISTIC EotProtnFwl.EotProtnFwlInactvLim.Val "MICROSAR RTE" VALUE 0x0 RTE_RL_FLOAT32_IEEE 0 NO_COMPU_METHOD -3.402823466e+38 3.402823466e+38 SYMBOL_LINK "Rte_CalprmRom_CalRegn01Cmn_DEFAULT_RTE_CALPRM_GROUP.EotProtnFwlInactvLim_Val" 0 DISPLAY_IDENTIFIER EotProtnFwl.CalibrationPorts.EotProtnFwlInactvLim.Val /end CHARACTERISTIC
/begin CHARACTERISTIC EotProtnFwl.EotProtnFwlVehSpd.Ary1D "MICROSAR RTE" VAL_BLK 0x0 RTE_RL_UWORD 0 NO_COMPU_METHOD 0 65535 MATRIX_DIM 4 1 1 SYMBOL_LINK "Rte_CalprmRom_CalRegn01Cmn_DEFAULT_RTE_CALPRM_GROUP.EotProtnFwlVehSpd_Ary1D" 0 DISPLAY_IDENTIFIER EotProtnFwl.CalibrationPorts.EotProtnFwlVehSpd.Ary1D /end CHARACTERISTIC
/begin CHARACTERISTIC EotProtnFwl.EotProtnHwAgMin.Val "MICROSAR RTE" VALUE 0x0 RTE_RL_FLOAT32_IEEE 0 NO_COMPU_METHOD -3.402823466e+38 3.402823466e+38 SYMBOL_LINK "Rte_CalprmRom_CalRegn03Inin00_DEFAULT_RTE_CALPRM_GROUP.EotProtnHwAgMin_Val" 0 DISPLAY_IDENTIFIER EotProtnFwl.CalibrationPorts.EotProtnHwAgMin.Val /end CHARACTERISTIC
/begin CHARACTERISTIC EotProtnFwl.EotProtnHwDegDampgX.Ary2D "MICROSAR RTE" VAL_BLK 0x0 RTE_RL_UWORD 0 NO_COMPU_METHOD 0 65535 MATRIX_DIM 2 4 1 SYMBOL_LINK "Rte_CalprmRom_CalRegn03Rt00GroupB_DEFAULT_RTE_CALPRM_GROUP.EotProtnHwDegDampgX_Ary2D" 0 DISPLAY_IDENTIFIER EotProtnFwl.CalibrationPorts.EotProtnHwDegDampgX.Ary2D /end CHARACTERISTIC
/begin CHARACTERISTIC EotProtnFwl.EotProtnRackTrvlLimrRng.Val "MICROSAR RTE" VALUE 0x0 RTE_RL_FLOAT32_IEEE 0 NO_COMPU_METHOD -3.402823466e+38 3.402823466e+38 SYMBOL_LINK "Rte_CalprmRom_CalRegn03Inin00GroupB_DEFAULT_RTE_CALPRM_GROUP.EotProtnRackTrvlLimrRng_Val" 0 DISPLAY_IDENTIFIER EotProtnFwl.CalibrationPorts.EotProtnRackTrvlLimrRng.Val /end CHARACTERISTIC
/begin CHARACTERISTIC EotProtnFwl.EotProtnSoftEndStopAuthyThd.Val "MICROSAR RTE" VALUE 0x0 RTE_RL_FLOAT32_IEEE 0 NO_COMPU_METHOD -3.402823466e+38 3.402823466e+38 SYMBOL_LINK "Rte_CalprmRom_CalRegn03Cmn_DEFAULT_RTE_CALPRM_GROUP.EotProtnSoftEndStopAuthyThd_Val" 0 DISPLAY_IDENTIFIER EotProtnFwl.CalibrationPorts.EotProtnSoftEndStopAuthyThd.Val /end CHARACTERISTIC
/begin CHARACTERISTIC GateDrv0Ctrl.GateDrv0CtrlNtcNr0x050FailStep.Val "MICROSAR RTE" VALUE 0x0 RTE_RL_UWORD 0 NO_COMPU_METHOD 0 65535 SYMBOL_LINK "Rte_CalprmRom_CalRegn01Cmn_DEFAULT_RTE_CALPRM_GROUP.GateDrv0CtrlNtcNr0x050FailStep_Val" 0 DISPLAY_IDENTIFIER GateDrv0Ctrl.CalibrationPorts.GateDrv0CtrlNtcNr0x050FailStep.Val /end CHARACTERISTIC
/begin CHARACTERISTIC GateDrv0Ctrl.GateDrv0CtrlNtcNr0x050PassStep.Val "MICROSAR RTE" VALUE 0x0 RTE_RL_UWORD 0 NO_COMPU_METHOD 0 65535 SYMBOL_LINK "Rte_CalprmRom_CalRegn01Cmn_DEFAULT_RTE_CALPRM_GROUP.GateDrv0CtrlNtcNr0x050PassStep_Val" 0 DISPLAY_IDENTIFIER GateDrv0Ctrl.CalibrationPorts.GateDrv0CtrlNtcNr0x050PassStep.Val /end CHARACTERISTIC
/begin CHARACTERISTIC GateDrv0Ctrl.GateDrv0CtrlNtcNr0x051FailStep.Val "MICROSAR RTE" VALUE 0x0 RTE_RL_UWORD 0 NO_COMPU_METHOD 0 65535 SYMBOL_LINK "Rte_CalprmRom_CalRegn01Cmn_DEFAULT_RTE_CALPRM_GROUP.GateDrv0CtrlNtcNr0x051FailStep_Val" 0 DISPLAY_IDENTIFIER GateDrv0Ctrl.CalibrationPorts.GateDrv0CtrlNtcNr0x051FailStep.Val /end CHARACTERISTIC
/begin CHARACTERISTIC GateDrv0Ctrl.GateDrv0CtrlNtcNr0x051PassStep.Val "MICROSAR RTE" VALUE 0x0 RTE_RL_UWORD 0 NO_COMPU_METHOD 0 65535 SYMBOL_LINK "Rte_CalprmRom_CalRegn01Cmn_DEFAULT_RTE_CALPRM_GROUP.GateDrv0CtrlNtcNr0x051PassStep_Val" 0 DISPLAY_IDENTIFIER GateDrv0Ctrl.CalibrationPorts.GateDrv0CtrlNtcNr0x051PassStep.Val /end CHARACTERISTIC
/begin CHARACTERISTIC GateDrv0Ctrl.GateDrv0CtrlNtcNr0x055FailStep.Val "MICROSAR RTE" VALUE 0x0 RTE_RL_UWORD 0 NO_COMPU_METHOD 0 65535 SYMBOL_LINK "Rte_CalprmRom_CalRegn01Cmn_DEFAULT_RTE_CALPRM_GROUP.GateDrv0CtrlNtcNr0x055FailStep_Val" 0 DISPLAY_IDENTIFIER GateDrv0Ctrl.CalibrationPorts.GateDrv0CtrlNtcNr0x055FailStep.Val /end CHARACTERISTIC
/begin CHARACTERISTIC GateDrv0Ctrl.GateDrv0CtrlNtcNr0x055PassStep.Val "MICROSAR RTE" VALUE 0x0 RTE_RL_UWORD 0 NO_COMPU_METHOD 0 65535 SYMBOL_LINK "Rte_CalprmRom_CalRegn01Cmn_DEFAULT_RTE_CALPRM_GROUP.GateDrv0CtrlNtcNr0x055PassStep_Val" 0 DISPLAY_IDENTIFIER GateDrv0Ctrl.CalibrationPorts.GateDrv0CtrlNtcNr0x055PassStep.Val /end CHARACTERISTIC
/begin CHARACTERISTIC GateDrv0Ctrl.GateDrv0CtrlUnit0Cfg2WrVal.Val "MICROSAR RTE" VALUE 0x0 RTE_RL_UWORD 0 NO_COMPU_METHOD 0 65535 SYMBOL_LINK "Rte_CalprmRom_CalRegn01Cmn_DEFAULT_RTE_CALPRM_GROUP.GateDrv0CtrlUnit0Cfg2WrVal_Val" 0 DISPLAY_IDENTIFIER GateDrv0Ctrl.CalibrationPorts.GateDrv0CtrlUnit0Cfg2WrVal.Val /end CHARACTERISTIC
/begin CHARACTERISTIC GateDrv0Ctrl.GateDrv0CtrlUnit0Cfg3WrVal.Val "MICROSAR RTE" VALUE 0x0 RTE_RL_UWORD 0 NO_COMPU_METHOD 0 65535 SYMBOL_LINK "Rte_CalprmRom_CalRegn01Cmn_DEFAULT_RTE_CALPRM_GROUP.GateDrv0CtrlUnit0Cfg3WrVal_Val" 0 DISPLAY_IDENTIFIER GateDrv0Ctrl.CalibrationPorts.GateDrv0CtrlUnit0Cfg3WrVal.Val /end CHARACTERISTIC
/begin CHARACTERISTIC GateDrv0Ctrl.GateDrv0CtrlUnit0Cfg4WrVal.Val "MICROSAR RTE" VALUE 0x0 RTE_RL_UWORD 0 NO_COMPU_METHOD 0 65535 SYMBOL_LINK "Rte_CalprmRom_CalRegn01Cmn_DEFAULT_RTE_CALPRM_GROUP.GateDrv0CtrlUnit0Cfg4WrVal_Val" 0 DISPLAY_IDENTIFIER GateDrv0Ctrl.CalibrationPorts.GateDrv0CtrlUnit0Cfg4WrVal.Val /end CHARACTERISTIC
/begin CHARACTERISTIC GateDrv0Ctrl.GateDrv0CtrlUnit0Cfg7WrVal.Val "MICROSAR RTE" VALUE 0x0 RTE_RL_UWORD 0 NO_COMPU_METHOD 0 65535 SYMBOL_LINK "Rte_CalprmRom_CalRegn01Cmn_DEFAULT_RTE_CALPRM_GROUP.GateDrv0CtrlUnit0Cfg7WrVal_Val" 0 DISPLAY_IDENTIFIER GateDrv0Ctrl.CalibrationPorts.GateDrv0CtrlUnit0Cfg7WrVal.Val /end CHARACTERISTIC
/begin CHARACTERISTIC GmFctDiArbn.GmFctDiArbnEotHwAgThd.Val "MICROSAR RTE" VALUE 0x0 RTE_RL_FLOAT32_IEEE 0 NO_COMPU_METHOD -3.402823466e+38 3.402823466e+38 SYMBOL_LINK "Rte_CalprmRom_CalRegn01Cmn_DEFAULT_RTE_CALPRM_GROUP.GmFctDiArbnEotHwAgThd_Val" 0 DISPLAY_IDENTIFIER GmFctDiArbn.CalibrationPorts.GmFctDiArbnEotHwAgThd.Val /end CHARACTERISTIC
/begin CHARACTERISTIC GmFctDiArbn.GmFctDiArbnEotTi.Val "MICROSAR RTE" VALUE 0x0 RTE_RL_FLOAT32_IEEE 0 NO_COMPU_METHOD -3.402823466e+38 3.402823466e+38 SYMBOL_LINK "Rte_CalprmRom_CalRegn01Cmn_DEFAULT_RTE_CALPRM_GROUP.GmFctDiArbnEotTi_Val" 0 DISPLAY_IDENTIFIER GmFctDiArbn.CalibrationPorts.GmFctDiArbnEotTi.Val /end CHARACTERISTIC
/begin CHARACTERISTIC GmFctDiArbn.GmFctDiArbnOnCentrHwAgThd.Val "MICROSAR RTE" VALUE 0x0 RTE_RL_FLOAT32_IEEE 0 NO_COMPU_METHOD -3.402823466e+38 3.402823466e+38 SYMBOL_LINK "Rte_CalprmRom_CalRegn01Cmn_DEFAULT_RTE_CALPRM_GROUP.GmFctDiArbnOnCentrHwAgThd_Val" 0 DISPLAY_IDENTIFIER GmFctDiArbn.CalibrationPorts.GmFctDiArbnOnCentrHwAgThd.Val /end CHARACTERISTIC
/begin CHARACTERISTIC GmFctDiArbn.GmFctDiArbnOnCentrHwTqThd.Val "MICROSAR RTE" VALUE 0x0 RTE_RL_FLOAT32_IEEE 0 NO_COMPU_METHOD -3.402823466e+38 3.402823466e+38 SYMBOL_LINK "Rte_CalprmRom_CalRegn01Cmn_DEFAULT_RTE_CALPRM_GROUP.GmFctDiArbnOnCentrHwTqThd_Val" 0 DISPLAY_IDENTIFIER GmFctDiArbn.CalibrationPorts.GmFctDiArbnOnCentrHwTqThd.Val /end CHARACTERISTIC
/begin CHARACTERISTIC GmFctDiArbn.GmFctDiArbnOnCentrTi.Val "MICROSAR RTE" VALUE 0x0 RTE_RL_FLOAT32_IEEE 0 NO_COMPU_METHOD -3.402823466e+38 3.402823466e+38 SYMBOL_LINK "Rte_CalprmRom_CalRegn01Cmn_DEFAULT_RTE_CALPRM_GROUP.GmFctDiArbnOnCentrTi_Val" 0 DISPLAY_IDENTIFIER GmFctDiArbn.CalibrationPorts.GmFctDiArbnOnCentrTi.Val /end CHARACTERISTIC
/begin CHARACTERISTIC GmFctDiArbn.GmFctDiArbnSrvTi.Val "MICROSAR RTE" VALUE 0x0 RTE_RL_FLOAT32_IEEE 0 NO_COMPU_METHOD -3.402823466e+38 3.402823466e+38 SYMBOL_LINK "Rte_CalprmRom_CalRegn01Cmn_DEFAULT_RTE_CALPRM_GROUP.GmFctDiArbnSrvTi_Val" 0 DISPLAY_IDENTIFIER GmFctDiArbn.CalibrationPorts.GmFctDiArbnSrvTi.Val /end CHARACTERISTIC
/begin MEASUREMENT DutyCycThermProtn.EcuTFild.Val "MICROSAR RTE" FLOAT32_IEEE NO_COMPU_METHOD 0 0 -3.402823466e+38 3.402823466e+38 ECU_ADDRESS 0 SYMBOL_LINK "Rte_EcuTMeas_EcuTFild_Val" 0 DISPLAY_IDENTIFIER DutyCycThermProtn.ReceiverPorts.EcuTFild.Val /end MEASUREMENT
/begin MEASUREMENT DutyCycThermProtn.Fil1ValStVari.FilGain "MICROSAR RTE" FLOAT32_IEEE NO_COMPU_METHOD 0 0 -3.402823466e+38 3.402823466e+38 ECU_ADDRESS 0 SYMBOL_LINK "Rte_DutyCycThermProtn_Fil1ValStVari.FilGain" 0 DISPLAY_IDENTIFIER DutyCycThermProtn.PerInstanceMemories.Fil1ValStVari.FilGain /end MEASUREMENT
/begin MEASUREMENT DutyCycThermProtn.Fil1ValStVari.FilSt "MICROSAR RTE" FLOAT32_IEEE NO_COMPU_METHOD 0 0 -3.402823466e+38 3.402823466e+38 ECU_ADDRESS 0 SYMBOL_LINK "Rte_DutyCycThermProtn_Fil1ValStVari.FilSt" 0 DISPLAY_IDENTIFIER DutyCycThermProtn.PerInstanceMemories.Fil1ValStVari.FilSt /end MEASUREMENT
/begin MEASUREMENT DutyCycThermProtn.Fil2ValStVari.FilGain "MICROSAR RTE" FLOAT32_IEEE NO_COMPU_METHOD 0 0 -3.402823466e+38 3.402823466e+38 ECU_ADDRESS 0 SYMBOL_LINK "Rte_DutyCycThermProtn_Fil2ValStVari.FilGain" 0 DISPLAY_IDENTIFIER DutyCycThermProtn.PerInstanceMemories.Fil2ValStVari.FilGain /end MEASUREMENT
/begin MEASUREMENT DutyCycThermProtn.Fil2ValStVari.FilSt "MICROSAR RTE" FLOAT32_IEEE NO_COMPU_METHOD 0 0 -3.402823466e+38 3.402823466e+38 ECU_ADDRESS 0 SYMBOL_LINK "Rte_DutyCycThermProtn_Fil2ValStVari.FilSt" 0 DISPLAY_IDENTIFIER DutyCycThermProtn.PerInstanceMemories.Fil2ValStVari.FilSt /end MEASUREMENT
/begin MEASUREMENT DutyCycThermProtn.Fil3ValPwrUp "MICROSAR RTE" UBYTE NO_COMPU_METHOD 0 0 0 255 ECU_ADDRESS 0 SYMBOL_LINK "Rte_DutyCycThermProtn_Fil3ValPwrUp" 0 DISPLAY_IDENTIFIER DutyCycThermProtn.PerInstanceMemories.Fil3ValPwrUp /end MEASUREMENT
/begin MEASUREMENT DutyCycThermProtn.Fil4ValPwrUp "MICROSAR RTE" UBYTE NO_COMPU_METHOD 0 0 0 255 ECU_ADDRESS 0 SYMBOL_LINK "Rte_DutyCycThermProtn_Fil4ValPwrUp" 0 DISPLAY_IDENTIFIER DutyCycThermProtn.PerInstanceMemories.Fil4ValPwrUp /end MEASUREMENT
/begin MEASUREMENT DutyCycThermProtn.Fil5ValPwrUp "MICROSAR RTE" UBYTE NO_COMPU_METHOD 0 0 0 255 ECU_ADDRESS 0 SYMBOL_LINK "Rte_DutyCycThermProtn_Fil5ValPwrUp" 0 DISPLAY_IDENTIFIER DutyCycThermProtn.PerInstanceMemories.Fil5ValPwrUp /end MEASUREMENT
/begin MEASUREMENT DutyCycThermProtn.Fil6ValPwrUp "MICROSAR RTE" UBYTE NO_COMPU_METHOD 0 0 0 255 ECU_ADDRESS 0 SYMBOL_LINK "Rte_DutyCycThermProtn_Fil6ValPwrUp" 0 DISPLAY_IDENTIFIER DutyCycThermProtn.PerInstanceMemories.Fil6ValPwrUp /end MEASUREMENT
/begin MEASUREMENT DutyCycThermProtn.FilStVal.Fil3StVal "MICROSAR RTE" UBYTE NO_COMPU_METHOD 0 0 0 255 ECU_ADDRESS 0 SYMBOL_LINK "Rte_DutyCycThermProtn_FilStVal.Fil3StVal" 0 DISPLAY_IDENTIFIER DutyCycThermProtn.PerInstanceMemories.FilStVal.Fil3StVal /end MEASUREMENT
/begin MEASUREMENT DutyCycThermProtn.FilStVal.Fil4StVal "MICROSAR RTE" UBYTE NO_COMPU_METHOD 0 0 0 255 ECU_ADDRESS 0 SYMBOL_LINK "Rte_DutyCycThermProtn_FilStVal.Fil4StVal" 0 DISPLAY_IDENTIFIER DutyCycThermProtn.PerInstanceMemories.FilStVal.Fil4StVal /end MEASUREMENT
/begin MEASUREMENT DutyCycThermProtn.FilStVal.Fil5StVal "MICROSAR RTE" UBYTE NO_COMPU_METHOD 0 0 0 255 ECU_ADDRESS 0 SYMBOL_LINK "Rte_DutyCycThermProtn_FilStVal.Fil5StVal" 0 DISPLAY_IDENTIFIER DutyCycThermProtn.PerInstanceMemories.FilStVal.Fil5StVal /end MEASUREMENT
/begin MEASUREMENT DutyCycThermProtn.FilStVal.Fil6StVal "MICROSAR RTE" UBYTE NO_COMPU_METHOD 0 0 0 255 ECU_ADDRESS 0 SYMBOL_LINK "Rte_DutyCycThermProtn_FilStVal.Fil6StVal" 0 DISPLAY_IDENTIFIER DutyCycThermProtn.PerInstanceMemories.FilStVal.Fil6StVal /end MEASUREMENT
/begin MEASUREMENT DutyCycThermProtn.Fild3Val.FilGain "MICROSAR RTE" FLOAT32_IEEE NO_COMPU_METHOD 0 0 -3.402823466e+38 3.402823466e+38 ECU_ADDRESS 0 SYMBOL_LINK "Rte_DutyCycThermProtn_Fild3Val.FilGain" 0 DISPLAY_IDENTIFIER DutyCycThermProtn.PerInstanceMemories.Fild3Val.FilGain /end MEASUREMENT
/begin MEASUREMENT DutyCycThermProtn.Fild3Val.FilSt "MICROSAR RTE" FLOAT32_IEEE NO_COMPU_METHOD 0 0 -3.402823466e+38 3.402823466e+38 ECU_ADDRESS 0 SYMBOL_LINK "Rte_DutyCycThermProtn_Fild3Val.FilSt" 0 DISPLAY_IDENTIFIER DutyCycThermProtn.PerInstanceMemories.Fild3Val.FilSt /end MEASUREMENT
/begin MEASUREMENT DutyCycThermProtn.Fild4Val.FilGain "MICROSAR RTE" FLOAT32_IEEE NO_COMPU_METHOD 0 0 -3.402823466e+38 3.402823466e+38 ECU_ADDRESS 0 SYMBOL_LINK "Rte_DutyCycThermProtn_Fild4Val.FilGain" 0 DISPLAY_IDENTIFIER DutyCycThermProtn.PerInstanceMemories.Fild4Val.FilGain /end MEASUREMENT
/begin MEASUREMENT DutyCycThermProtn.Fild4Val.FilSt "MICROSAR RTE" FLOAT32_IEEE NO_COMPU_METHOD 0 0 -3.402823466e+38 3.402823466e+38 ECU_ADDRESS 0 SYMBOL_LINK "Rte_DutyCycThermProtn_Fild4Val.FilSt" 0 DISPLAY_IDENTIFIER DutyCycThermProtn.PerInstanceMemories.Fild4Val.FilSt /end MEASUREMENT
/begin MEASUREMENT DutyCycThermProtn.Fild5Val.FilGain "MICROSAR RTE" FLOAT32_IEEE NO_COMPU_METHOD 0 0 -3.402823466e+38 3.402823466e+38 ECU_ADDRESS 0 SYMBOL_LINK "Rte_DutyCycThermProtn_Fild5Val.FilGain" 0 DISPLAY_IDENTIFIER DutyCycThermProtn.PerInstanceMemories.Fild5Val.FilGain /end MEASUREMENT
/begin MEASUREMENT DutyCycThermProtn.Fild5Val.FilSt "MICROSAR RTE" FLOAT32_IEEE NO_COMPU_METHOD 0 0 -3.402823466e+38 3.402823466e+38 ECU_ADDRESS 0 SYMBOL_LINK "Rte_DutyCycThermProtn_Fild5Val.FilSt" 0 DISPLAY_IDENTIFIER DutyCycThermProtn.PerInstanceMemories.Fild5Val.FilSt /end MEASUREMENT
/begin MEASUREMENT DutyCycThermProtn.Fild6Val.FilGain "MICROSAR RTE" FLOAT32_IEEE NO_COMPU_METHOD 0 0 -3.402823466e+38 3.402823466e+38 ECU_ADDRESS 0 SYMBOL_LINK "Rte_DutyCycThermProtn_Fild6Val.FilGain" 0 DISPLAY_IDENTIFIER DutyCycThermProtn.PerInstanceMemories.Fild6Val.FilGain /end MEASUREMENT
/begin MEASUREMENT DutyCycThermProtn.Fild6Val.FilSt "MICROSAR RTE" FLOAT32_IEEE NO_COMPU_METHOD 0 0 -3.402823466e+38 3.402823466e+38 ECU_ADDRESS 0 SYMBOL_LINK "Rte_DutyCycThermProtn_Fild6Val.FilSt" 0 DISPLAY_IDENTIFIER DutyCycThermProtn.PerInstanceMemories.Fild6Val.FilSt /end MEASUREMENT
/begin MEASUREMENT DutyCycThermProtn.IgnTiOff.Val "MICROSAR RTE" ULONG NO_COMPU_METHOD 0 0 0 4294967295 ECU_ADDRESS 0 SYMBOL_LINK "Rte_DutyCycThermProtn_IgnTiOff_Val" 0 DISPLAY_IDENTIFIER DutyCycThermProtn.ReceiverPorts.IgnTiOff.Val /end MEASUREMENT
/begin MEASUREMENT DutyCycThermProtn.IvtrLoaMtgtnEna.Logl "MICROSAR RTE" UBYTE RTE_CM_BOOLEAN 0 0 0 255 ECU_ADDRESS 0 SYMBOL_LINK "Rte_LoaMgr_IvtrLoaMtgtnEna_Logl" 0 DISPLAY_IDENTIFIER DutyCycThermProtn.ReceiverPorts.IvtrLoaMtgtnEna.Logl /end MEASUREMENT
/begin MEASUREMENT DutyCycThermProtn.LstTblValRateLimrStVari "MICROSAR RTE" FLOAT32_IEEE NO_COMPU_METHOD 0 0 -3.402823466e+38 3.402823466e+38 ECU_ADDRESS 0 SYMBOL_LINK "Rte_DutyCycThermProtn_LstTblValRateLimrStVari" 0 DISPLAY_IDENTIFIER DutyCycThermProtn.PerInstanceMemories.LstTblValRateLimrStVari /end MEASUREMENT
/begin MEASUREMENT DutyCycThermProtn.MotCurrPeakEstimd.Val "MICROSAR RTE" FLOAT32_IEEE NO_COMPU_METHOD 0 0 -3.402823466e+38 3.402823466e+38 ECU_ADDRESS 0 SYMBOL_LINK "Rte_MotCurrPeakEstimn_MotCurrPeakEstimd_Val" 0 DISPLAY_IDENTIFIER DutyCycThermProtn.ReceiverPorts.MotCurrPeakEstimd.Val /end MEASUREMENT
/begin MEASUREMENT DutyCycThermProtn.MotCurrPeakEstimdFild.Val "MICROSAR RTE" FLOAT32_IEEE NO_COMPU_METHOD 0 0 -3.402823466e+38 3.402823466e+38 ECU_ADDRESS 0 SYMBOL_LINK "Rte_MotCurrPeakEstimn_MotCurrPeakEstimdFild_Val" 0 DISPLAY_IDENTIFIER DutyCycThermProtn.ReceiverPorts.MotCurrPeakEstimdFild.Val /end MEASUREMENT
/begin MEASUREMENT DutyCycThermProtn.MotFetT.Val "MICROSAR RTE" FLOAT32_IEEE NO_COMPU_METHOD 0 0 -3.402823466e+38 3.402823466e+38 ECU_ADDRESS 0 SYMBOL_LINK "Rte_TEstimn_MotFetT_Val" 0 DISPLAY_IDENTIFIER DutyCycThermProtn.ReceiverPorts.MotFetT.Val /end MEASUREMENT
/begin MEASUREMENT DutyCycThermProtn.MotMagT.Val "MICROSAR RTE" FLOAT32_IEEE NO_COMPU_METHOD 0 0 -3.402823466e+38 3.402823466e+38 ECU_ADDRESS 0 SYMBOL_LINK "Rte_TEstimn_MotMagT_Val" 0 DISPLAY_IDENTIFIER DutyCycThermProtn.ReceiverPorts.MotMagT.Val /end MEASUREMENT
/begin MEASUREMENT DutyCycThermProtn.MotVelCrf.Val "MICROSAR RTE" FLOAT32_IEEE NO_COMPU_METHOD 0 0 -3.402823466e+38 3.402823466e+38 ECU_ADDRESS 0 SYMBOL_LINK "Rte_CDD_MotVel_MotVelCrf_Val" 0 DISPLAY_IDENTIFIER DutyCycThermProtn.ReceiverPorts.MotVelCrf.Val /end MEASUREMENT
/begin MEASUREMENT DutyCycThermProtn.MotWidgT.Val "MICROSAR RTE" FLOAT32_IEEE NO_COMPU_METHOD 0 0 -3.402823466e+38 3.402823466e+38 ECU_ADDRESS 0 SYMBOL_LINK "Rte_TEstimn_MotWidgT_Val" 0 DISPLAY_IDENTIFIER DutyCycThermProtn.ReceiverPorts.MotWidgT.Val /end MEASUREMENT
/begin MEASUREMENT DutyCycThermProtn.ReInitCntrFlg "MICROSAR RTE" UBYTE RTE_CM_BOOLEAN 0 0 0 255 ECU_ADDRESS 0 SYMBOL_LINK "Rte_DutyCycThermProtn_ReInitCntrFlg" 0 DISPLAY_IDENTIFIER DutyCycThermProtn.PerInstanceMemories.ReInitCntrFlg /end MEASUREMENT
/begin MEASUREMENT DutyCycThermProtn.ReInitCntrVal "MICROSAR RTE" FLOAT32_IEEE NO_COMPU_METHOD 0 0 -3.402823466e+38 3.402823466e+38 ECU_ADDRESS 0 SYMBOL_LINK "Rte_DutyCycThermProtn_ReInitCntrVal" 0 DISPLAY_IDENTIFIER DutyCycThermProtn.PerInstanceMemories.ReInitCntrVal /end MEASUREMENT
/begin MEASUREMENT DutyCycThermProtn.ThermDutyCycProtnLoadDptLim.Val "MICROSAR RTE" FLOAT32_IEEE NO_COMPU_METHOD 0 0 -3.402823466e+38 3.402823466e+38 ECU_ADDRESS 0 SYMBOL_LINK "Rte_DutyCycThermProtn_ThermDutyCycProtnLoadDptLim_Val" 0 DISPLAY_IDENTIFIER DutyCycThermProtn.SenderPorts.ThermDutyCycProtnLoadDptLim.Val /end MEASUREMENT
/begin MEASUREMENT DutyCycThermProtn.ThermDutyCycProtnTDptLim.Val "MICROSAR RTE" FLOAT32_IEEE NO_COMPU_METHOD 0 0 -3.402823466e+38 3.402823466e+38 ECU_ADDRESS 0 SYMBOL_LINK "Rte_DutyCycThermProtn_ThermDutyCycProtnTDptLim_Val" 0 DISPLAY_IDENTIFIER DutyCycThermProtn.SenderPorts.ThermDutyCycProtnTDptLim.Val /end MEASUREMENT
/begin MEASUREMENT DutyCycThermProtn.ThermLimSlowFilMax.Val "MICROSAR RTE" FLOAT32_IEEE NO_COMPU_METHOD 0 0 -3.402823466e+38 3.402823466e+38 ECU_ADDRESS 0 SYMBOL_LINK "Rte_DutyCycThermProtn_ThermLimSlowFilMax_Val" 0 DISPLAY_IDENTIFIER DutyCycThermProtn.SenderPorts.ThermLimSlowFilMax.Val /end MEASUREMENT
/begin MEASUREMENT DutyCycThermProtn.ThermMotTqLim.Val "MICROSAR RTE" FLOAT32_IEEE NO_COMPU_METHOD 0 0 -3.402823466e+38 3.402823466e+38 ECU_ADDRESS 0 SYMBOL_LINK "Rte_DutyCycThermProtn_ThermMotTqLim_Val" 0 DISPLAY_IDENTIFIER DutyCycThermProtn.SenderPorts.ThermMotTqLim.Val /end MEASUREMENT
/begin MEASUREMENT DutyCycThermProtn.ThermRednFac.Val "MICROSAR RTE" FLOAT32_IEEE NO_COMPU_METHOD 0 0 -3.402823466e+38 3.402823466e+38 ECU_ADDRESS 0 SYMBOL_LINK "Rte_DutyCycThermProtn_ThermRednFac_Val" 0 DISPLAY_IDENTIFIER DutyCycThermProtn.SenderPorts.ThermRednFac.Val /end MEASUREMENT
/begin MEASUREMENT DutyCycThermProtn.VehTiVld.Logl "MICROSAR RTE" UBYTE RTE_CM_BOOLEAN 0 0 0 255 ECU_ADDRESS 0 SYMBOL_LINK "Rte_DutyCycThermProtn_VehTiVld_Logl" 0 DISPLAY_IDENTIFIER DutyCycThermProtn.ReceiverPorts.VehTiVld.Logl /end MEASUREMENT
/begin MEASUREMENT DutyCycThermProtn.dDutyCycThermProtnAbsltCtrlrTTqLim "MICROSAR RTE" FLOAT32_IEEE NO_COMPU_METHOD 0 0 -3.402823466e+38 3.402823466e+38 ECU_ADDRESS 0 SYMBOL_LINK "Rte_DutyCycThermProtn_dDutyCycThermProtnAbsltCtrlrTTqLim" 0 DISPLAY_IDENTIFIER DutyCycThermProtn.PerInstanceMemories.dDutyCycThermProtnAbsltCtrlrTTqLim /end MEASUREMENT
/begin MEASUREMENT DutyCycThermProtn.dDutyCycThermProtnAbsltCuTTqLim "MICROSAR RTE" FLOAT32_IEEE NO_COMPU_METHOD 0 0 -3.402823466e+38 3.402823466e+38 ECU_ADDRESS 0 SYMBOL_LINK "Rte_DutyCycThermProtn_dDutyCycThermProtnAbsltCuTTqLim" 0 DISPLAY_IDENTIFIER DutyCycThermProtn.PerInstanceMemories.dDutyCycThermProtnAbsltCuTTqLim /end MEASUREMENT
/begin MEASUREMENT DutyCycThermProtn.dDutyCycThermProtnAbsltTTqLim "MICROSAR RTE" FLOAT32_IEEE NO_COMPU_METHOD 0 0 -3.402823466e+38 3.402823466e+38 ECU_ADDRESS 0 SYMBOL_LINK "Rte_DutyCycThermProtn_dDutyCycThermProtnAbsltTTqLim" 0 DISPLAY_IDENTIFIER DutyCycThermProtn.PerInstanceMemories.dDutyCycThermProtnAbsltTTqLim /end MEASUREMENT
/begin MEASUREMENT DutyCycThermProtn.dDutyCycThermProtnLstTblVal "MICROSAR RTE" UWORD NO_COMPU_METHOD 0 0 0 65535 ECU_ADDRESS 0 SYMBOL_LINK "Rte_DutyCycThermProtn_dDutyCycThermProtnLstTblVal" 0 DISPLAY_IDENTIFIER DutyCycThermProtn.PerInstanceMemories.dDutyCycThermProtnLstTblVal /end MEASUREMENT
/begin MEASUREMENT DutyCycThermProtn.dDutyCycThermProtnLstTblValSlew "MICROSAR RTE" UWORD NO_COMPU_METHOD 0 0 0 65535 ECU_ADDRESS 0 SYMBOL_LINK "Rte_DutyCycThermProtn_dDutyCycThermProtnLstTblValSlew" 0 DISPLAY_IDENTIFIER DutyCycThermProtn.PerInstanceMemories.dDutyCycThermProtnLstTblValSlew /end MEASUREMENT
/begin MEASUREMENT DutyCycThermProtn.dDutyCycThermProtnMplr1 "MICROSAR RTE" UWORD NO_COMPU_METHOD 0 0 0 65535 ECU_ADDRESS 0 SYMBOL_LINK "Rte_DutyCycThermProtn_dDutyCycThermProtnMplr1" 0 DISPLAY_IDENTIFIER DutyCycThermProtn.PerInstanceMemories.dDutyCycThermProtnMplr1 /end MEASUREMENT
/begin MEASUREMENT DutyCycThermProtn.dDutyCycThermProtnMplr12T "MICROSAR RTE" FLOAT32_IEEE NO_COMPU_METHOD 0 0 -3.402823466e+38 3.402823466e+38 ECU_ADDRESS 0 SYMBOL_LINK "Rte_DutyCycThermProtn_dDutyCycThermProtnMplr12T" 0 DISPLAY_IDENTIFIER DutyCycThermProtn.PerInstanceMemories.dDutyCycThermProtnMplr12T /end MEASUREMENT
/begin MEASUREMENT DutyCycThermProtn.dDutyCycThermProtnMplr2 "MICROSAR RTE" UWORD NO_COMPU_METHOD 0 0 0 65535 ECU_ADDRESS 0 SYMBOL_LINK "Rte_DutyCycThermProtn_dDutyCycThermProtnMplr2" 0 DISPLAY_IDENTIFIER DutyCycThermProtn.PerInstanceMemories.dDutyCycThermProtnMplr2 /end MEASUREMENT
/begin MEASUREMENT DutyCycThermProtn.dDutyCycThermProtnMplr3 "MICROSAR RTE" UWORD NO_COMPU_METHOD 0 0 0 65535 ECU_ADDRESS 0 SYMBOL_LINK "Rte_DutyCycThermProtn_dDutyCycThermProtnMplr3" 0 DISPLAY_IDENTIFIER DutyCycThermProtn.PerInstanceMemories.dDutyCycThermProtnMplr3 /end MEASUREMENT
/begin MEASUREMENT DutyCycThermProtn.dDutyCycThermProtnMplr36T "MICROSAR RTE" FLOAT32_IEEE NO_COMPU_METHOD 0 0 -3.402823466e+38 3.402823466e+38 ECU_ADDRESS 0 SYMBOL_LINK "Rte_DutyCycThermProtn_dDutyCycThermProtnMplr36T" 0 DISPLAY_IDENTIFIER DutyCycThermProtn.PerInstanceMemories.dDutyCycThermProtnMplr36T /end MEASUREMENT
/begin MEASUREMENT DutyCycThermProtn.dDutyCycThermProtnMplr4 "MICROSAR RTE" UWORD NO_COMPU_METHOD 0 0 0 65535 ECU_ADDRESS 0 SYMBOL_LINK "Rte_DutyCycThermProtn_dDutyCycThermProtnMplr4" 0 DISPLAY_IDENTIFIER DutyCycThermProtn.PerInstanceMemories.dDutyCycThermProtnMplr4 /end MEASUREMENT
/begin MEASUREMENT DutyCycThermProtn.dDutyCycThermProtnMplr5 "MICROSAR RTE" UWORD NO_COMPU_METHOD 0 0 0 65535 ECU_ADDRESS 0 SYMBOL_LINK "Rte_DutyCycThermProtn_dDutyCycThermProtnMplr5" 0 DISPLAY_IDENTIFIER DutyCycThermProtn.PerInstanceMemories.dDutyCycThermProtnMplr5 /end MEASUREMENT
/begin MEASUREMENT DutyCycThermProtn.dDutyCycThermProtnMplr6 "MICROSAR RTE" UWORD NO_COMPU_METHOD 0 0 0 65535 ECU_ADDRESS 0 SYMBOL_LINK "Rte_DutyCycThermProtn_dDutyCycThermProtnMplr6" 0 DISPLAY_IDENTIFIER DutyCycThermProtn.PerInstanceMemories.dDutyCycThermProtnMplr6 /end MEASUREMENT
/begin MEASUREMENT DutyCycThermProtn.dDutyCycThermProtnThermLoadLim "MICROSAR RTE" FLOAT32_IEEE NO_COMPU_METHOD 0 0 -3.402823466e+38 3.402823466e+38 ECU_ADDRESS 0 SYMBOL_LINK "Rte_DutyCycThermProtn_dDutyCycThermProtnThermLoadLim" 0 DISPLAY_IDENTIFIER DutyCycThermProtn.PerInstanceMemories.dDutyCycThermProtnThermLoadLim /end MEASUREMENT
/begin MEASUREMENT DutyCycThermProtn.dDutyCycThermProtnThermLoadLimTblYVal "MICROSAR RTE" FLOAT32_IEEE NO_COMPU_METHOD 0 0 -3.402823466e+38 3.402823466e+38 ECU_ADDRESS 0 SYMBOL_LINK "Rte_DutyCycThermProtn_dDutyCycThermProtnThermLoadLimTblYVal" 0 DISPLAY_IDENTIFIER DutyCycThermProtn.PerInstanceMemories.dDutyCycThermProtnThermLoadLimTblYVal /end MEASUREMENT
/begin MEASUREMENT EcuTMeas.DiagcStsLimdTPrfmnc.Logl "MICROSAR RTE" UBYTE RTE_CM_BOOLEAN 0 0 0 255 ECU_ADDRESS 0 SYMBOL_LINK "Rte_DiagcMgr_DiagcStsLimdTPrfmnc_Logl" 0 DISPLAY_IDENTIFIER EcuTMeas.ReceiverPorts.DiagcStsLimdTPrfmnc.Logl /end MEASUREMENT
/begin MEASUREMENT EcuTMeas.EcuT.Val "MICROSAR RTE" FLOAT32_IEEE NO_COMPU_METHOD 0 0 0.0 5.0 ECU_ADDRESS 0 SYMBOL_LINK "Rte_CDD_GmG2kcaMcuCfg_EcuT_Val" 0 DISPLAY_IDENTIFIER EcuTMeas.ReceiverPorts.EcuT.Val /end MEASUREMENT
/begin MEASUREMENT EcuTMeas.EcuTAdcFaild.Logl "MICROSAR RTE" UBYTE RTE_CM_BOOLEAN 0 0 0 255 ECU_ADDRESS 0 SYMBOL_LINK "Rte_CDD_GmG2kcaMcuCfg_EcuTAdcFaild_Logl" 0 DISPLAY_IDENTIFIER EcuTMeas.ReceiverPorts.EcuTAdcFaild.Logl /end MEASUREMENT
/begin MEASUREMENT EcuTMeas.EcuTFild.Val "MICROSAR RTE" FLOAT32_IEEE NO_COMPU_METHOD 0 0 -50.0 150.0 ECU_ADDRESS 0 SYMBOL_LINK "Rte_EcuTMeas_EcuTFild_Val" 0 DISPLAY_IDENTIFIER EcuTMeas.SenderPorts.EcuTFild.Val /end MEASUREMENT
/begin MEASUREMENT EcuTMeas.EcuTMeasFilStVarPrev.FilGain "MICROSAR RTE" FLOAT32_IEEE NO_COMPU_METHOD 0 0 -3.402823466e+38 3.402823466e+38 ECU_ADDRESS 0 SYMBOL_LINK "Rte_EcuTMeas_EcuTMeasFilStVarPrev.FilGain" 0 DISPLAY_IDENTIFIER EcuTMeas.PerInstanceMemories.EcuTMeasFilStVarPrev.FilGain /end MEASUREMENT
/begin MEASUREMENT EcuTMeas.EcuTMeasFilStVarPrev.FilSt "MICROSAR RTE" FLOAT32_IEEE NO_COMPU_METHOD 0 0 -3.402823466e+38 3.402823466e+38 ECU_ADDRESS 0 SYMBOL_LINK "Rte_EcuTMeas_EcuTMeasFilStVarPrev.FilSt" 0 DISPLAY_IDENTIFIER EcuTMeas.PerInstanceMemories.EcuTMeasFilStVarPrev.FilSt /end MEASUREMENT
/begin MEASUREMENT ElecPwrCns.BrdgVltg.Val "MICROSAR RTE" FLOAT32_IEEE NO_COMPU_METHOD 0 0 -3.402823466e+38 3.402823466e+38 ECU_ADDRESS 0 SYMBOL_LINK "Rte_BattVltg_BrdgVltg_Val" 0 DISPLAY_IDENTIFIER ElecPwrCns.ReceiverPorts.BrdgVltg.Val /end MEASUREMENT
/begin MEASUREMENT ElecPwrCns.CurrMeasLoaMtgtnEna.Logl "MICROSAR RTE" UBYTE RTE_CM_BOOLEAN 0 0 0 255 ECU_ADDRESS 0 SYMBOL_LINK "Rte_LoaMgr_CurrMeasLoaMtgtnEna_Logl" 0 DISPLAY_IDENTIFIER ElecPwrCns.ReceiverPorts.CurrMeasLoaMtgtnEna.Logl /end MEASUREMENT
/begin MEASUREMENT ElecPwrCns.ElecInpPwrEstim.Val "MICROSAR RTE" FLOAT32_IEEE NO_COMPU_METHOD 0 0 -3.402823466e+38 3.402823466e+38 ECU_ADDRESS 0 SYMBOL_LINK "Rte_ElecPwrCns_ElecInpPwrEstim_Val" 0 DISPLAY_IDENTIFIER ElecPwrCns.SenderPorts.ElecInpPwrEstim.Val /end MEASUREMENT
/begin MEASUREMENT ElecPwrCns.IvtrLoaMtgtnEna.Logl "MICROSAR RTE" UBYTE RTE_CM_BOOLEAN 0 0 0 255 ECU_ADDRESS 0 SYMBOL_LINK "Rte_LoaMgr_IvtrLoaMtgtnEna_Logl" 0 DISPLAY_IDENTIFIER ElecPwrCns.ReceiverPorts.IvtrLoaMtgtnEna.Logl /end MEASUREMENT
/begin MEASUREMENT ElecPwrCns.MotCtrlMotCurrDax.Val "MICROSAR RTE" FLOAT32_IEEE NO_COMPU_METHOD 0 0 -3.402823466e+38 3.402823466e+38 ECU_ADDRESS 0 SYMBOL_LINK "Rte_CDD_MotCtrlMgr_MotCurrDax_Val" 0 DISPLAY_IDENTIFIER ElecPwrCns.ReceiverPorts.MotCtrlMotCurrDax.Val /end MEASUREMENT
/begin MEASUREMENT ElecPwrCns.MotCtrlMotCurrQax.Val "MICROSAR RTE" FLOAT32_IEEE NO_COMPU_METHOD 0 0 -3.402823466e+38 3.402823466e+38 ECU_ADDRESS 0 SYMBOL_LINK "Rte_CDD_MotCtrlMgr_MotCurrQax_Val" 0 DISPLAY_IDENTIFIER ElecPwrCns.ReceiverPorts.MotCtrlMotCurrQax.Val /end MEASUREMENT
/begin MEASUREMENT ElecPwrCns.MotCtrlMotVltgDax.Val "MICROSAR RTE" FLOAT32_IEEE NO_COMPU_METHOD 0 0 -3.402823466e+38 3.402823466e+38 ECU_ADDRESS 0 SYMBOL_LINK "Rte_ElecPwrCns_MotCtrlMotVltgDax_Val" 0 DISPLAY_IDENTIFIER ElecPwrCns.ReceiverPorts.MotCtrlMotVltgDax.Val /end MEASUREMENT
/begin MEASUREMENT ElecPwrCns.MotCtrlMotVltgQax.Val "MICROSAR RTE" FLOAT32_IEEE NO_COMPU_METHOD 0 0 -3.402823466e+38 3.402823466e+38 ECU_ADDRESS 0 SYMBOL_LINK "Rte_ElecPwrCns_MotCtrlMotVltgQax_Val" 0 DISPLAY_IDENTIFIER ElecPwrCns.ReceiverPorts.MotCtrlMotVltgQax.Val /end MEASUREMENT
/begin MEASUREMENT ElecPwrCns.MotCurrDaxCmd.Val "MICROSAR RTE" FLOAT32_IEEE NO_COMPU_METHOD 0 0 -3.402823466e+38 3.402823466e+38 ECU_ADDRESS 0 SYMBOL_LINK "Rte_MotRefMdl_MotCurrDaxCmd_Val" 0 DISPLAY_IDENTIFIER ElecPwrCns.ReceiverPorts.MotCurrDaxCmd.Val /end MEASUREMENT
/begin MEASUREMENT ElecPwrCns.MotCurrQaxCmd.Val "MICROSAR RTE" FLOAT32_IEEE NO_COMPU_METHOD 0 0 -3.402823466e+38 3.402823466e+38 ECU_ADDRESS 0 SYMBOL_LINK "Rte_MotRefMdl_MotCurrQaxCmd_Val" 0 DISPLAY_IDENTIFIER ElecPwrCns.ReceiverPorts.MotCurrQaxCmd.Val /end MEASUREMENT
/begin MEASUREMENT ElecPwrCns.SplyCurrEstim.Val "MICROSAR RTE" FLOAT32_IEEE NO_COMPU_METHOD 0 0 -3.402823466e+38 3.402823466e+38 ECU_ADDRESS 0 SYMBOL_LINK "Rte_ElecPwrCns_SplyCurrEstim_Val" 0 DISPLAY_IDENTIFIER ElecPwrCns.SenderPorts.SplyCurrEstim.Val /end MEASUREMENT
/begin MEASUREMENT ElecPwrCns.dElecPwrCnsDrpInpPwr "MICROSAR RTE" FLOAT32_IEEE NO_COMPU_METHOD 0 0 -3.402823466e+38 3.402823466e+38 ECU_ADDRESS 0 SYMBOL_LINK "Rte_ElecPwrCns_dElecPwrCnsDrpInpPwr" 0 DISPLAY_IDENTIFIER ElecPwrCns.PerInstanceMemories.dElecPwrCnsDrpInpPwr /end MEASUREMENT
/begin MEASUREMENT ElecPwrCns.dElecPwrCnsModInpPwr "MICROSAR RTE" FLOAT32_IEEE NO_COMPU_METHOD 0 0 -3.402823466e+38 3.402823466e+38 ECU_ADDRESS 0 SYMBOL_LINK "Rte_ElecPwrCns_dElecPwrCnsModInpPwr" 0 DISPLAY_IDENTIFIER ElecPwrCns.PerInstanceMemories.dElecPwrCnsModInpPwr /end MEASUREMENT
/begin MEASUREMENT ElecPwrCns.dElecPwrCnsMotCurrDaxEstim "MICROSAR RTE" FLOAT32_IEEE NO_COMPU_METHOD 0 0 -3.402823466e+38 3.402823466e+38 ECU_ADDRESS 0 SYMBOL_LINK "Rte_ElecPwrCns_dElecPwrCnsMotCurrDaxEstim" 0 DISPLAY_IDENTIFIER ElecPwrCns.PerInstanceMemories.dElecPwrCnsMotCurrDaxEstim /end MEASUREMENT
/begin MEASUREMENT ElecPwrCns.dElecPwrCnsMotCurrQaxEstim "MICROSAR RTE" FLOAT32_IEEE NO_COMPU_METHOD 0 0 -3.402823466e+38 3.402823466e+38 ECU_ADDRESS 0 SYMBOL_LINK "Rte_ElecPwrCns_dElecPwrCnsMotCurrQaxEstim" 0 DISPLAY_IDENTIFIER ElecPwrCns.PerInstanceMemories.dElecPwrCnsMotCurrQaxEstim /end MEASUREMENT
/begin MEASUREMENT EotLrng.CcwEotRefTmr "MICROSAR RTE" ULONG NO_COMPU_METHOD 0 0 0 4294967295 ECU_ADDRESS 0 SYMBOL_LINK "Rte_EotLrng_CcwEotRefTmr" 0 DISPLAY_IDENTIFIER EotLrng.PerInstanceMemories.CcwEotRefTmr /end MEASUREMENT
/begin MEASUREMENT EotLrng.CwEotRefTmr "MICROSAR RTE" ULONG NO_COMPU_METHOD 0 0 0 4294967295 ECU_ADDRESS 0 SYMBOL_LINK "Rte_EotLrng_CwEotRefTmr" 0 DISPLAY_IDENTIFIER EotLrng.PerInstanceMemories.CwEotRefTmr /end MEASUREMENT
/begin MEASUREMENT EotLrng.EotNvmData.CcwEot "MICROSAR RTE" FLOAT32_IEEE NO_COMPU_METHOD 0 0 -3.402823466e+38 3.402823466e+38 ECU_ADDRESS 0 SYMBOL_LINK "Rte_EotLrng_EotNvmData.CcwEot" 0 DISPLAY_IDENTIFIER EotLrng.PerInstanceMemories.EotNvmData.CcwEot /end MEASUREMENT
/begin MEASUREMENT EotLrng.EotNvmData.CcwEotDetd "MICROSAR RTE" UBYTE RTE_CM_BOOLEAN 0 0 0 255 ECU_ADDRESS 0 SYMBOL_LINK "Rte_EotLrng_EotNvmData.CcwEotDetd" 0 DISPLAY_IDENTIFIER EotLrng.PerInstanceMemories.EotNvmData.CcwEotDetd /end MEASUREMENT
/begin MEASUREMENT EotLrng.EotNvmData.CwEot "MICROSAR RTE" FLOAT32_IEEE NO_COMPU_METHOD 0 0 -3.402823466e+38 3.402823466e+38 ECU_ADDRESS 0 SYMBOL_LINK "Rte_EotLrng_EotNvmData.CwEot" 0 DISPLAY_IDENTIFIER EotLrng.PerInstanceMemories.EotNvmData.CwEot /end MEASUREMENT
/begin MEASUREMENT EotLrng.EotNvmData.CwEotDetd "MICROSAR RTE" UBYTE RTE_CM_BOOLEAN 0 0 0 255 ECU_ADDRESS 0 SYMBOL_LINK "Rte_EotLrng_EotNvmData.CwEotDetd" 0 DISPLAY_IDENTIFIER EotLrng.PerInstanceMemories.EotNvmData.CwEotDetd /end MEASUREMENT
/begin MEASUREMENT EotLrng.HwAg.Val "MICROSAR RTE" FLOAT32_IEEE NO_COMPU_METHOD 0 0 -3.402823466e+38 3.402823466e+38 ECU_ADDRESS 0 SYMBOL_LINK "Rte_HwAgSysArbn_HwAgNotCorrd_Val" 0 DISPLAY_IDENTIFIER EotLrng.ReceiverPorts.HwAg.Val /end MEASUREMENT
/begin MEASUREMENT EotLrng.HwAgAuthy.Val "MICROSAR RTE" FLOAT32_IEEE NO_COMPU_METHOD 0 0 -3.402823466e+38 3.402823466e+38 ECU_ADDRESS 0 SYMBOL_LINK "Rte_HwAgSysArbn_PinionAgConf_Val" 0 DISPLAY_IDENTIFIER EotLrng.ReceiverPorts.HwAgAuthy.Val /end MEASUREMENT
/begin MEASUREMENT EotLrng.HwAgCcwDetd.Logl "MICROSAR RTE" UBYTE RTE_CM_BOOLEAN 0 0 0 255 ECU_ADDRESS 0 SYMBOL_LINK "Rte_EotLrng_HwAgCcwDetd_Logl" 0 DISPLAY_IDENTIFIER EotLrng.SenderPorts.HwAgCcwDetd.Logl /end MEASUREMENT
/begin MEASUREMENT EotLrng.HwAgCwDetd.Logl "MICROSAR RTE" UBYTE RTE_CM_BOOLEAN 0 0 0 255 ECU_ADDRESS 0 SYMBOL_LINK "Rte_EotLrng_HwAgCwDetd_Logl" 0 DISPLAY_IDENTIFIER EotLrng.SenderPorts.HwAgCwDetd.Logl /end MEASUREMENT
/begin MEASUREMENT EotLrng.HwAgDiDiagSts.Logl "MICROSAR RTE" UBYTE RTE_CM_BOOLEAN 0 0 0 255 ECU_ADDRESS 0 SYMBOL_LINK "Rte_EotLrng_HwAgDiDiagSts_Logl" 0 DISPLAY_IDENTIFIER EotLrng.ReceiverPorts.HwAgDiDiagSts.Logl /end MEASUREMENT
/begin MEASUREMENT EotLrng.HwAgEotCcw.Val "MICROSAR RTE" FLOAT32_IEEE NO_COMPU_METHOD 0 0 -3.402823466e+38 3.402823466e+38 ECU_ADDRESS 0 SYMBOL_LINK "Rte_EotLrng_HwAgEotCcw_Val" 0 DISPLAY_IDENTIFIER EotLrng.SenderPorts.HwAgEotCcw.Val /end MEASUREMENT
/begin MEASUREMENT EotLrng.HwAgEotCw.Val "MICROSAR RTE" FLOAT32_IEEE NO_COMPU_METHOD 0 0 -3.402823466e+38 3.402823466e+38 ECU_ADDRESS 0 SYMBOL_LINK "Rte_EotLrng_HwAgEotCw_Val" 0 DISPLAY_IDENTIFIER EotLrng.SenderPorts.HwAgEotCw.Val /end MEASUREMENT
/begin MEASUREMENT EotLrng.HwAgEotSig0Avl.Logl "MICROSAR RTE" UBYTE RTE_CM_BOOLEAN 0 0 0 255 ECU_ADDRESS 0 SYMBOL_LINK "Rte_CDD_HwTq0Meas_RackLimrEotSig0Avl_Logl" 0 DISPLAY_IDENTIFIER EotLrng.ReceiverPorts.HwAgEotSig0Avl.Logl /end MEASUREMENT
/begin MEASUREMENT EotLrng.HwAgEotSig0Ccw.Val "MICROSAR RTE" FLOAT32_IEEE NO_COMPU_METHOD 0 0 -3.402823466e+38 3.402823466e+38 ECU_ADDRESS 0 SYMBOL_LINK "Rte_CDD_HwTq0Meas_RackLimrCcwEotSig0_Val" 0 DISPLAY_IDENTIFIER EotLrng.ReceiverPorts.HwAgEotSig0Ccw.Val /end MEASUREMENT
/begin MEASUREMENT EotLrng.HwAgEotSig0Cw.Val "MICROSAR RTE" FLOAT32_IEEE NO_COMPU_METHOD 0 0 -3.402823466e+38 3.402823466e+38 ECU_ADDRESS 0 SYMBOL_LINK "Rte_CDD_HwTq0Meas_RackLimrCwEotSig0_Val" 0 DISPLAY_IDENTIFIER EotLrng.ReceiverPorts.HwAgEotSig0Cw.Val /end MEASUREMENT
/begin MEASUREMENT EotLrng.HwAgEotSig1Avl.Logl "MICROSAR RTE" UBYTE RTE_CM_BOOLEAN 0 0 0 255 ECU_ADDRESS 0 SYMBOL_LINK "Rte_CDD_HwTq1Meas_RackLimrEotSig1Avl_Logl" 0 DISPLAY_IDENTIFIER EotLrng.ReceiverPorts.HwAgEotSig1Avl.Logl /end MEASUREMENT
/begin MEASUREMENT EotLrng.HwAgEotSig1Ccw.Val "MICROSAR RTE" FLOAT32_IEEE NO_COMPU_METHOD 0 0 -3.402823466e+38 3.402823466e+38 ECU_ADDRESS 0 SYMBOL_LINK "Rte_CDD_HwTq1Meas_RackLimrCcwEotSig1_Val" 0 DISPLAY_IDENTIFIER EotLrng.ReceiverPorts.HwAgEotSig1Ccw.Val /end MEASUREMENT
/begin MEASUREMENT EotLrng.HwAgEotSig1Cw.Val "MICROSAR RTE" FLOAT32_IEEE NO_COMPU_METHOD 0 0 -3.402823466e+38 3.402823466e+38 ECU_ADDRESS 0 SYMBOL_LINK "Rte_CDD_HwTq1Meas_RackLimrCwEotSig1_Val" 0 DISPLAY_IDENTIFIER EotLrng.ReceiverPorts.HwAgEotSig1Cw.Val /end MEASUREMENT
/begin MEASUREMENT EotLrng.HwAgOverTrvlCntrDi "MICROSAR RTE" UBYTE RTE_CM_BOOLEAN 0 0 0 255 ECU_ADDRESS 0 SYMBOL_LINK "Rte_EotLrng_HwAgOverTrvlCntrDi" 0 DISPLAY_IDENTIFIER EotLrng.PerInstanceMemories.HwAgOverTrvlCntrDi /end MEASUREMENT
/begin MEASUREMENT EotLrng.HwTq.Val "MICROSAR RTE" FLOAT32_IEEE NO_COMPU_METHOD 0 0 -3.402823466e+38 3.402823466e+38 ECU_ADDRESS 0 SYMBOL_LINK "Rte_Swp_HwTqSwp_Val" 0 DISPLAY_IDENTIFIER EotLrng.ReceiverPorts.HwTq.Val /end MEASUREMENT
/begin MEASUREMENT EotLrng.MaxHwAgCwAndCcw.HwAgCcwMax "MICROSAR RTE" FLOAT32_IEEE NO_COMPU_METHOD 0 0 -3.402823466e+38 3.402823466e+38 ECU_ADDRESS 0 SYMBOL_LINK "Rte_EotLrng_MaxHwAgCwAndCcw.HwAgCcwMax" 0 DISPLAY_IDENTIFIER EotLrng.PerInstanceMemories.MaxHwAgCwAndCcw.HwAgCcwMax /end MEASUREMENT
/begin MEASUREMENT EotLrng.MaxHwAgCwAndCcw.HwAgCwMax "MICROSAR RTE" FLOAT32_IEEE NO_COMPU_METHOD 0 0 -3.402823466e+38 3.402823466e+38 ECU_ADDRESS 0 SYMBOL_LINK "Rte_EotLrng_MaxHwAgCwAndCcw.HwAgCwMax" 0 DISPLAY_IDENTIFIER EotLrng.PerInstanceMemories.MaxHwAgCwAndCcw.HwAgCwMax /end MEASUREMENT
/begin MEASUREMENT EotLrng.MaxHwAgCwAndCcw.HwAgOverTrvlCnt "MICROSAR RTE" UBYTE NO_COMPU_METHOD 0 0 0 255 ECU_ADDRESS 0 SYMBOL_LINK "Rte_EotLrng_MaxHwAgCwAndCcw.HwAgOverTrvlCnt" 0 DISPLAY_IDENTIFIER EotLrng.PerInstanceMemories.MaxHwAgCwAndCcw.HwAgOverTrvlCnt /end MEASUREMENT
/begin MEASUREMENT EotLrng.MotVelCrf.Val "MICROSAR RTE" FLOAT32_IEEE NO_COMPU_METHOD 0 0 -3.402823466e+38 3.402823466e+38 ECU_ADDRESS 0 SYMBOL_LINK "Rte_CDD_MotVel_MotVelCrf_Val" 0 DISPLAY_IDENTIFIER EotLrng.ReceiverPorts.MotVelCrf.Val /end MEASUREMENT
/begin MEASUREMENT EotLrng.PrevCcwEot "MICROSAR RTE" FLOAT32_IEEE NO_COMPU_METHOD 0 0 -3.402823466e+38 3.402823466e+38 ECU_ADDRESS 0 SYMBOL_LINK "Rte_EotLrng_PrevCcwEot" 0 DISPLAY_IDENTIFIER EotLrng.PerInstanceMemories.PrevCcwEot /end MEASUREMENT
/begin MEASUREMENT EotLrng.PrevCwEot "MICROSAR RTE" FLOAT32_IEEE NO_COMPU_METHOD 0 0 -3.402823466e+38 3.402823466e+38 ECU_ADDRESS 0 SYMBOL_LINK "Rte_EotLrng_PrevCwEot" 0 DISPLAY_IDENTIFIER EotLrng.PerInstanceMemories.PrevCwEot /end MEASUREMENT
/begin MEASUREMENT EotLrng.RstLimReq "MICROSAR RTE" UBYTE RTE_CM_BOOLEAN 0 0 0 255 ECU_ADDRESS 0 SYMBOL_LINK "Rte_EotLrng_RstLimReq" 0 DISPLAY_IDENTIFIER EotLrng.PerInstanceMemories.RstLimReq /end MEASUREMENT
/begin MEASUREMENT EotProtn.EotActvCmd.Val "MICROSAR RTE" FLOAT32_IEEE NO_COMPU_METHOD 0 0 -3.402823466e+38 3.402823466e+38 ECU_ADDRESS 0 SYMBOL_LINK "Rte_EotProtn_EotActvCmd_Val" 0 DISPLAY_IDENTIFIER EotProtn.SenderPorts.EotActvCmd.Val /end MEASUREMENT
/begin MEASUREMENT EotProtn.EotAssiSca.Val "MICROSAR RTE" FLOAT32_IEEE NO_COMPU_METHOD 0 0 -3.402823466e+38 3.402823466e+38 ECU_ADDRESS 0 SYMBOL_LINK "Rte_EotProtn_EotAssiSca_Val" 0 DISPLAY_IDENTIFIER EotProtn.SenderPorts.EotAssiSca.Val /end MEASUREMENT
/begin MEASUREMENT EotProtn.EotAssiScaLpFil.FilGain "MICROSAR RTE" FLOAT32_IEEE NO_COMPU_METHOD 0 0 -3.402823466e+38 3.402823466e+38 ECU_ADDRESS 0 SYMBOL_LINK "Rte_EotProtn_EotAssiScaLpFil.FilGain" 0 DISPLAY_IDENTIFIER EotProtn.PerInstanceMemories.EotAssiScaLpFil.FilGain /end MEASUREMENT
/begin MEASUREMENT EotProtn.EotAssiScaLpFil.FilSt "MICROSAR RTE" FLOAT32_IEEE NO_COMPU_METHOD 0 0 -3.402823466e+38 3.402823466e+38 ECU_ADDRESS 0 SYMBOL_LINK "Rte_EotProtn_EotAssiScaLpFil.FilSt" 0 DISPLAY_IDENTIFIER EotProtn.PerInstanceMemories.EotAssiScaLpFil.FilSt /end MEASUREMENT
/begin MEASUREMENT EotProtn.EotDampgCmd.Val "MICROSAR RTE" FLOAT32_IEEE NO_COMPU_METHOD 0 0 -3.402823466e+38 3.402823466e+38 ECU_ADDRESS 0 SYMBOL_LINK "Rte_EotProtn_EotDampgCmd_Val" 0 DISPLAY_IDENTIFIER EotProtn.SenderPorts.EotDampgCmd.Val /end MEASUREMENT
/begin MEASUREMENT EotProtn.EotMotTqLim.Val "MICROSAR RTE" FLOAT32_IEEE NO_COMPU_METHOD 0 0 -3.402823466e+38 3.402823466e+38 ECU_ADDRESS 0 SYMBOL_LINK "Rte_EotProtn_EotMotTqLim_Val" 0 DISPLAY_IDENTIFIER EotProtn.SenderPorts.EotMotTqLim.Val /end MEASUREMENT
/begin MEASUREMENT EotProtn.EotProtnDi.Logl "MICROSAR RTE" UBYTE RTE_CM_BOOLEAN 0 0 0 255 ECU_ADDRESS 0 SYMBOL_LINK "Rte_CmnMfgSrv_EotProtnDi_Logl" 0 DISPLAY_IDENTIFIER EotProtn.ReceiverPorts.EotProtnDi.Logl /end MEASUREMENT
/begin MEASUREMENT EotProtn.HwAg.Val "MICROSAR RTE" FLOAT32_IEEE NO_COMPU_METHOD 0 0 -3.402823466e+38 3.402823466e+38 ECU_ADDRESS 0 SYMBOL_LINK "Rte_HwAgSysArbn_HwAgNotCorrd_Val" 0 DISPLAY_IDENTIFIER EotProtn.ReceiverPorts.HwAg.Val /end MEASUREMENT
/begin MEASUREMENT EotProtn.HwAgAuthy.Val "MICROSAR RTE" FLOAT32_IEEE NO_COMPU_METHOD 0 0 -3.402823466e+38 3.402823466e+38 ECU_ADDRESS 0 SYMBOL_LINK "Rte_HwAgSysArbn_PinionAgConf_Val" 0 DISPLAY_IDENTIFIER EotProtn.ReceiverPorts.HwAgAuthy.Val /end MEASUREMENT
/begin MEASUREMENT EotProtn.HwAgCcwDetd.Logl "MICROSAR RTE" UBYTE RTE_CM_BOOLEAN 0 0 0 255 ECU_ADDRESS 0 SYMBOL_LINK "Rte_EotLrng_HwAgCcwDetd_Logl" 0 DISPLAY_IDENTIFIER EotProtn.ReceiverPorts.HwAgCcwDetd.Logl /end MEASUREMENT
/begin MEASUREMENT EotProtn.HwAgCwDetd.Logl "MICROSAR RTE" UBYTE RTE_CM_BOOLEAN 0 0 0 255 ECU_ADDRESS 0 SYMBOL_LINK "Rte_EotLrng_HwAgCwDetd_Logl" 0 DISPLAY_IDENTIFIER EotProtn.ReceiverPorts.HwAgCwDetd.Logl /end MEASUREMENT
/begin MEASUREMENT EotProtn.HwAgEotCcw.Val "MICROSAR RTE" FLOAT32_IEEE NO_COMPU_METHOD 0 0 -3.402823466e+38 3.402823466e+38 ECU_ADDRESS 0 SYMBOL_LINK "Rte_EotLrng_HwAgEotCcw_Val" 0 DISPLAY_IDENTIFIER EotProtn.ReceiverPorts.HwAgEotCcw.Val /end MEASUREMENT
/begin MEASUREMENT EotProtn.HwAgEotCw.Val "MICROSAR RTE" FLOAT32_IEEE NO_COMPU_METHOD 0 0 -3.402823466e+38 3.402823466e+38 ECU_ADDRESS 0 SYMBOL_LINK "Rte_EotLrng_HwAgEotCw_Val" 0 DISPLAY_IDENTIFIER EotProtn.ReceiverPorts.HwAgEotCw.Val /end MEASUREMENT
/begin MEASUREMENT EotProtn.HwTq.Val "MICROSAR RTE" FLOAT32_IEEE NO_COMPU_METHOD 0 0 -3.402823466e+38 3.402823466e+38 ECU_ADDRESS 0 SYMBOL_LINK "Rte_Swp_HwTqSwp_Val" 0 DISPLAY_IDENTIFIER EotProtn.ReceiverPorts.HwTq.Val /end MEASUREMENT
/begin MEASUREMENT EotProtn.HwTqLpFil.FilGain "MICROSAR RTE" FLOAT32_IEEE NO_COMPU_METHOD 0 0 -3.402823466e+38 3.402823466e+38 ECU_ADDRESS 0 SYMBOL_LINK "Rte_EotProtn_HwTqLpFil.FilGain" 0 DISPLAY_IDENTIFIER EotProtn.PerInstanceMemories.HwTqLpFil.FilGain /end MEASUREMENT
/begin MEASUREMENT EotProtn.HwTqLpFil.FilSt "MICROSAR RTE" FLOAT32_IEEE NO_COMPU_METHOD 0 0 -3.402823466e+38 3.402823466e+38 ECU_ADDRESS 0 SYMBOL_LINK "Rte_EotProtn_HwTqLpFil.FilSt" 0 DISPLAY_IDENTIFIER EotProtn.PerInstanceMemories.HwTqLpFil.FilSt /end MEASUREMENT
/begin MEASUREMENT EotProtn.MotVelCrf.Val "MICROSAR RTE" FLOAT32_IEEE NO_COMPU_METHOD 0 0 -3.402823466e+38 3.402823466e+38 ECU_ADDRESS 0 SYMBOL_LINK "Rte_CDD_MotVel_MotVelCrf_Val" 0 DISPLAY_IDENTIFIER EotProtn.ReceiverPorts.MotVelCrf.Val /end MEASUREMENT
/begin MEASUREMENT EotProtn.NewSoftEndStopSt "MICROSAR RTE" UBYTE NO_COMPU_METHOD 0 0 0 255 ECU_ADDRESS 0 SYMBOL_LINK "Rte_EotProtn_NewSoftEndStopSt" 0 DISPLAY_IDENTIFIER EotProtn.PerInstanceMemories.NewSoftEndStopSt /end MEASUREMENT
/begin MEASUREMENT EotProtn.PrevEotAssiSca "MICROSAR RTE" FLOAT32_IEEE NO_COMPU_METHOD 0 0 -3.402823466e+38 3.402823466e+38 ECU_ADDRESS 0 SYMBOL_LINK "Rte_EotProtn_PrevEotAssiSca" 0 DISPLAY_IDENTIFIER EotProtn.PerInstanceMemories.PrevEotAssiSca /end MEASUREMENT
/begin MEASUREMENT EotProtn.PrevEotDampg "MICROSAR RTE" FLOAT32_IEEE NO_COMPU_METHOD 0 0 -3.402823466e+38 3.402823466e+38 ECU_ADDRESS 0 SYMBOL_LINK "Rte_EotProtn_PrevEotDampg" 0 DISPLAY_IDENTIFIER EotProtn.PerInstanceMemories.PrevEotDampg /end MEASUREMENT
/begin MEASUREMENT EotProtn.PrevImpctPosn "MICROSAR RTE" FLOAT32_IEEE NO_COMPU_METHOD 0 0 -3.402823466e+38 3.402823466e+38 ECU_ADDRESS 0 SYMBOL_LINK "Rte_EotProtn_PrevImpctPosn" 0 DISPLAY_IDENTIFIER EotProtn.PerInstanceMemories.PrevImpctPosn /end MEASUREMENT
/begin MEASUREMENT EotProtn.PrevRackTrvlLimrEna "MICROSAR RTE" UBYTE RTE_CM_BOOLEAN 0 0 0 255 ECU_ADDRESS 0 SYMBOL_LINK "Rte_EotProtn_PrevRackTrvlLimrEna" 0 DISPLAY_IDENTIFIER EotProtn.PerInstanceMemories.PrevRackTrvlLimrEna /end MEASUREMENT
/begin MEASUREMENT EotProtn.PrevRackTrvlLimrInin "MICROSAR RTE" UBYTE RTE_CM_BOOLEAN 0 0 0 255 ECU_ADDRESS 0 SYMBOL_LINK "Rte_EotProtn_PrevRackTrvlLimrInin" 0 DISPLAY_IDENTIFIER EotProtn.PerInstanceMemories.PrevRackTrvlLimrInin /end MEASUREMENT
/begin MEASUREMENT EotProtn.PrevSoftEndStopSt "MICROSAR RTE" UBYTE NO_COMPU_METHOD 0 0 0 255 ECU_ADDRESS 0 SYMBOL_LINK "Rte_EotProtn_PrevSoftEndStopSt" 0 DISPLAY_IDENTIFIER EotProtn.PerInstanceMemories.PrevSoftEndStopSt /end MEASUREMENT
/begin MEASUREMENT EotProtn.SysMotTqCmdSca.Val "MICROSAR RTE" FLOAT32_IEEE NO_COMPU_METHOD 0 0 -3.402823466e+38 3.402823466e+38 ECU_ADDRESS 0 SYMBOL_LINK "Rte_StOutpCtrl_SysMotTqCmdSca_Val" 0 DISPLAY_IDENTIFIER EotProtn.ReceiverPorts.SysMotTqCmdSca.Val /end MEASUREMENT
/begin MEASUREMENT EotProtn.VehSpd.Val "MICROSAR RTE" FLOAT32_IEEE NO_COMPU_METHOD 0 0 -3.402823466e+38 3.402823466e+38 ECU_ADDRESS 0 SYMBOL_LINK "Rte_VehSigCdng_VehSpd_Val" 0 DISPLAY_IDENTIFIER EotProtn.ReceiverPorts.VehSpd.Val /end MEASUREMENT
/begin MEASUREMENT EotProtn.dEotProtnDampg "MICROSAR RTE" FLOAT32_IEEE NO_COMPU_METHOD 0 0 -3.402823466e+38 3.402823466e+38 ECU_ADDRESS 0 SYMBOL_LINK "Rte_EotProtn_dEotProtnDampg" 0 DISPLAY_IDENTIFIER EotProtn.PerInstanceMemories.dEotProtnDampg /end MEASUREMENT
/begin MEASUREMENT EotProtn.dEotProtnDetd "MICROSAR RTE" UBYTE RTE_CM_BOOLEAN 0 0 0 255 ECU_ADDRESS 0 SYMBOL_LINK "Rte_EotProtn_dEotProtnDetd" 0 DISPLAY_IDENTIFIER EotProtn.PerInstanceMemories.dEotProtnDetd /end MEASUREMENT
/begin MEASUREMENT EotProtn.dEotProtnEntrGain "MICROSAR RTE" FLOAT32_IEEE NO_COMPU_METHOD 0 0 -3.402823466e+38 3.402823466e+38 ECU_ADDRESS 0 SYMBOL_LINK "Rte_EotProtn_dEotProtnEntrGain" 0 DISPLAY_IDENTIFIER EotProtn.PerInstanceMemories.dEotProtnEntrGain /end MEASUREMENT
/begin MEASUREMENT EotProtn.dEotProtnEotAssiSca "MICROSAR RTE" FLOAT32_IEEE NO_COMPU_METHOD 0 0 -3.402823466e+38 3.402823466e+38 ECU_ADDRESS 0 SYMBOL_LINK "Rte_EotProtn_dEotProtnEotAssiSca" 0 DISPLAY_IDENTIFIER EotProtn.PerInstanceMemories.dEotProtnEotAssiSca /end MEASUREMENT
/begin MEASUREMENT EotProtn.dEotProtnEotGain "MICROSAR RTE" FLOAT32_IEEE NO_COMPU_METHOD 0 0 -3.402823466e+38 3.402823466e+38 ECU_ADDRESS 0 SYMBOL_LINK "Rte_EotProtn_dEotProtnEotGain" 0 DISPLAY_IDENTIFIER EotProtn.PerInstanceMemories.dEotProtnEotGain /end MEASUREMENT
/begin MEASUREMENT EotProtn.dEotProtnExitGain "MICROSAR RTE" FLOAT32_IEEE NO_COMPU_METHOD 0 0 -3.402823466e+38 3.402823466e+38 ECU_ADDRESS 0 SYMBOL_LINK "Rte_EotProtn_dEotProtnExitGain" 0 DISPLAY_IDENTIFIER EotProtn.PerInstanceMemories.dEotProtnExitGain /end MEASUREMENT
/begin MEASUREMENT EotProtn.dEotProtnLimPosn "MICROSAR RTE" FLOAT32_IEEE NO_COMPU_METHOD 0 0 -3.402823466e+38 3.402823466e+38 ECU_ADDRESS 0 SYMBOL_LINK "Rte_EotProtn_dEotProtnLimPosn" 0 DISPLAY_IDENTIFIER EotProtn.PerInstanceMemories.dEotProtnLimPosn /end MEASUREMENT
/begin MEASUREMENT EotProtn.dEotProtnRackTrvlLimrDi "MICROSAR RTE" UBYTE RTE_CM_BOOLEAN 0 0 0 255 ECU_ADDRESS 0 SYMBOL_LINK "Rte_EotProtn_dEotProtnRackTrvlLimrDi" 0 DISPLAY_IDENTIFIER EotProtn.PerInstanceMemories.dEotProtnRackTrvlLimrDi /end MEASUREMENT
/begin MEASUREMENT EotProtnFwl.EotActvCmd.Val "MICROSAR RTE" FLOAT32_IEEE NO_COMPU_METHOD 0 0 -3.402823466e+38 3.402823466e+38 ECU_ADDRESS 0 SYMBOL_LINK "Rte_EotProtn_EotActvCmd_Val" 0 DISPLAY_IDENTIFIER EotProtnFwl.ReceiverPorts.EotActvCmd.Val /end MEASUREMENT
/begin MEASUREMENT EotProtnFwl.EotActvCmdLimd.Val "MICROSAR RTE" FLOAT32_IEEE NO_COMPU_METHOD 0 0 -3.402823466e+38 3.402823466e+38 ECU_ADDRESS 0 SYMBOL_LINK "Rte_EotProtnFwl_EotActvCmdLimd_Val" 0 DISPLAY_IDENTIFIER EotProtnFwl.SenderPorts.EotActvCmdLimd.Val /end MEASUREMENT
/begin MEASUREMENT EotProtnFwl.EotDampgCmd.Val "MICROSAR RTE" FLOAT32_IEEE NO_COMPU_METHOD 0 0 -3.402823466e+38 3.402823466e+38 ECU_ADDRESS 0 SYMBOL_LINK "Rte_EotProtn_EotDampgCmd_Val" 0 DISPLAY_IDENTIFIER EotProtnFwl.ReceiverPorts.EotDampgCmd.Val /end MEASUREMENT
/begin MEASUREMENT EotProtnFwl.EotDampgCmdLimd.Val "MICROSAR RTE" FLOAT32_IEEE NO_COMPU_METHOD 0 0 -3.402823466e+38 3.402823466e+38 ECU_ADDRESS 0 SYMBOL_LINK "Rte_EotProtnFwl_EotDampgCmdLimd_Val" 0 DISPLAY_IDENTIFIER EotProtnFwl.SenderPorts.EotDampgCmdLimd.Val /end MEASUREMENT
/begin MEASUREMENT EotProtnFwl.EotProtnDi.Logl "MICROSAR RTE" UBYTE RTE_CM_BOOLEAN 0 0 0 255 ECU_ADDRESS 0 SYMBOL_LINK "Rte_CmnMfgSrv_EotProtnDi_Logl" 0 DISPLAY_IDENTIFIER EotProtnFwl.ReceiverPorts.EotProtnDi.Logl /end MEASUREMENT
/begin MEASUREMENT EotProtnFwl.HwAg.Val "MICROSAR RTE" FLOAT32_IEEE NO_COMPU_METHOD 0 0 -3.402823466e+38 3.402823466e+38 ECU_ADDRESS 0 SYMBOL_LINK "Rte_HwAgSysArbn_HwAgNotCorrd_Val" 0 DISPLAY_IDENTIFIER EotProtnFwl.ReceiverPorts.HwAg.Val /end MEASUREMENT
/begin MEASUREMENT EotProtnFwl.MotVelCrf.Val "MICROSAR RTE" FLOAT32_IEEE NO_COMPU_METHOD 0 0 -3.402823466e+38 3.402823466e+38 ECU_ADDRESS 0 SYMBOL_LINK "Rte_CDD_MotVel_MotVelCrf_Val" 0 DISPLAY_IDENTIFIER EotProtnFwl.ReceiverPorts.MotVelCrf.Val /end MEASUREMENT
/begin MEASUREMENT EotProtnFwl.PinionAgConf.Val "MICROSAR RTE" FLOAT32_IEEE NO_COMPU_METHOD 0 0 -3.402823466e+38 3.402823466e+38 ECU_ADDRESS 0 SYMBOL_LINK "Rte_HwAgSysArbn_PinionAgConf_Val" 0 DISPLAY_IDENTIFIER EotProtnFwl.ReceiverPorts.PinionAgConf.Val /end MEASUREMENT
/begin MEASUREMENT EotProtnFwl.VehSpd.Val "MICROSAR RTE" FLOAT32_IEEE NO_COMPU_METHOD 0 0 -3.402823466e+38 3.402823466e+38 ECU_ADDRESS 0 SYMBOL_LINK "Rte_VehSigCdng_VehSpd_Val" 0 DISPLAY_IDENTIFIER EotProtnFwl.ReceiverPorts.VehSpd.Val /end MEASUREMENT
/begin MEASUREMENT EotProtnFwl.dEotProtnFwlEotActvCmdActvLowrBnd "MICROSAR RTE" FLOAT32_IEEE NO_COMPU_METHOD 0 0 -3.402823466e+38 3.402823466e+38 ECU_ADDRESS 0 SYMBOL_LINK "Rte_EotProtnFwl_dEotProtnFwlEotActvCmdActvLowrBnd" 0 DISPLAY_IDENTIFIER EotProtnFwl.PerInstanceMemories.dEotProtnFwlEotActvCmdActvLowrBnd /end MEASUREMENT
/begin MEASUREMENT EotProtnFwl.dEotProtnFwlEotActvCmdActvUpprBnd "MICROSAR RTE" FLOAT32_IEEE NO_COMPU_METHOD 0 0 -3.402823466e+38 3.402823466e+38 ECU_ADDRESS 0 SYMBOL_LINK "Rte_EotProtnFwl_dEotProtnFwlEotActvCmdActvUpprBnd" 0 DISPLAY_IDENTIFIER EotProtnFwl.PerInstanceMemories.dEotProtnFwlEotActvCmdActvUpprBnd /end MEASUREMENT
/begin MEASUREMENT EotProtnFwl.dEotProtnFwlEotActvCmdMod "MICROSAR RTE" UBYTE NO_COMPU_METHOD 0 0 0 255 ECU_ADDRESS 0 SYMBOL_LINK "Rte_EotProtnFwl_dEotProtnFwlEotActvCmdMod" 0 DISPLAY_IDENTIFIER EotProtnFwl.PerInstanceMemories.dEotProtnFwlEotActvCmdMod /end MEASUREMENT
/begin MEASUREMENT EotProtnFwl.dEotProtnFwlEotActvCmdOverActvLim "MICROSAR RTE" UBYTE RTE_CM_BOOLEAN 0 0 0 255 ECU_ADDRESS 0 SYMBOL_LINK "Rte_EotProtnFwl_dEotProtnFwlEotActvCmdOverActvLim" 0 DISPLAY_IDENTIFIER EotProtnFwl.PerInstanceMemories.dEotProtnFwlEotActvCmdOverActvLim /end MEASUREMENT
/begin MEASUREMENT EotProtnFwl.dEotProtnFwlEotActvCmdOverInactvLim "MICROSAR RTE" UBYTE RTE_CM_BOOLEAN 0 0 0 255 ECU_ADDRESS 0 SYMBOL_LINK "Rte_EotProtnFwl_dEotProtnFwlEotActvCmdOverInactvLim" 0 DISPLAY_IDENTIFIER EotProtnFwl.PerInstanceMemories.dEotProtnFwlEotActvCmdOverInactvLim /end MEASUREMENT
/begin MEASUREMENT EotProtnFwl.dEotProtnFwlEotDampgActvLowrBnd "MICROSAR RTE" FLOAT32_IEEE NO_COMPU_METHOD 0 0 -3.402823466e+38 3.402823466e+38 ECU_ADDRESS 0 SYMBOL_LINK "Rte_EotProtnFwl_dEotProtnFwlEotDampgActvLowrBnd" 0 DISPLAY_IDENTIFIER EotProtnFwl.PerInstanceMemories.dEotProtnFwlEotDampgActvLowrBnd /end MEASUREMENT
/begin MEASUREMENT EotProtnFwl.dEotProtnFwlEotDampgActvUpprBnd "MICROSAR RTE" FLOAT32_IEEE NO_COMPU_METHOD 0 0 -3.402823466e+38 3.402823466e+38 ECU_ADDRESS 0 SYMBOL_LINK "Rte_EotProtnFwl_dEotProtnFwlEotDampgActvUpprBnd" 0 DISPLAY_IDENTIFIER EotProtnFwl.PerInstanceMemories.dEotProtnFwlEotDampgActvUpprBnd /end MEASUREMENT
/begin MEASUREMENT EotProtnFwl.dEotProtnFwlEotDampgFwX0 "MICROSAR RTE" FLOAT32_IEEE NO_COMPU_METHOD 0 0 -3.402823466e+38 3.402823466e+38 ECU_ADDRESS 0 SYMBOL_LINK "Rte_EotProtnFwl_dEotProtnFwlEotDampgFwX0" 0 DISPLAY_IDENTIFIER EotProtnFwl.PerInstanceMemories.dEotProtnFwlEotDampgFwX0 /end MEASUREMENT
/begin MEASUREMENT EotProtnFwl.dEotProtnFwlEotDampgMod "MICROSAR RTE" UBYTE NO_COMPU_METHOD 0 0 0 255 ECU_ADDRESS 0 SYMBOL_LINK "Rte_EotProtnFwl_dEotProtnFwlEotDampgMod" 0 DISPLAY_IDENTIFIER EotProtnFwl.PerInstanceMemories.dEotProtnFwlEotDampgMod /end MEASUREMENT
/begin MEASUREMENT EotProtnFwl.dEotProtnFwlEotDampgOverActvLim "MICROSAR RTE" UBYTE RTE_CM_BOOLEAN 0 0 0 255 ECU_ADDRESS 0 SYMBOL_LINK "Rte_EotProtnFwl_dEotProtnFwlEotDampgOverActvLim" 0 DISPLAY_IDENTIFIER EotProtnFwl.PerInstanceMemories.dEotProtnFwlEotDampgOverActvLim /end MEASUREMENT
/begin MEASUREMENT EotProtnFwl.dEotProtnFwlEotDampgOverInactvLim "MICROSAR RTE" UBYTE RTE_CM_BOOLEAN 0 0 0 255 ECU_ADDRESS 0 SYMBOL_LINK "Rte_EotProtnFwl_dEotProtnFwlEotDampgOverInactvLim" 0 DISPLAY_IDENTIFIER EotProtnFwl.PerInstanceMemories.dEotProtnFwlEotDampgOverInactvLim /end MEASUREMENT
/begin MEASUREMENT EotProtnFwl.dEotProtnFwlPinionAgConfSts "MICROSAR RTE" UBYTE RTE_CM_BOOLEAN 0 0 0 255 ECU_ADDRESS 0 SYMBOL_LINK "Rte_EotProtnFwl_dEotProtnFwlPinionAgConfSts" 0 DISPLAY_IDENTIFIER EotProtnFwl.PerInstanceMemories.dEotProtnFwlPinionAgConfSts /end MEASUREMENT
/begin MEASUREMENT FltInj.HwVel.Val "MICROSAR RTE" FLOAT32_IEEE NO_COMPU_METHOD 0 0 -3.402823466e+38 3.402823466e+38 ECU_ADDRESS 0 SYMBOL_LINK "Rte_CDD_MotVel_HwVel_Val" 0 DISPLAY_IDENTIFIER FltInj.ReceiverPorts.HwVel.Val /end MEASUREMENT
/begin MEASUREMENT GateDrv0Ctrl.DiagcStsIvtr1Inactv.Logl "MICROSAR RTE" UBYTE RTE_CM_BOOLEAN 0 0 0 255 ECU_ADDRESS 0 SYMBOL_LINK "Rte_DiagcMgr_DiagcStsIvtr1Inactv_Logl" 0 DISPLAY_IDENTIFIER GateDrv0Ctrl.ReceiverPorts.DiagcStsIvtr1Inactv.Logl /end MEASUREMENT
/begin MEASUREMENT GateDrv0Ctrl.GateDrv0CfgCnt "MICROSAR RTE" UBYTE NO_COMPU_METHOD 0 0 0 255 ECU_ADDRESS 0 SYMBOL_LINK "Rte_GateDrv0Ctrl_GateDrv0CfgCnt" 0 DISPLAY_IDENTIFIER GateDrv0Ctrl.PerInstanceMemories.GateDrv0CfgCnt /end MEASUREMENT
/begin MEASUREMENT GateDrv0Ctrl.GateDrv0CfgSecAtmpt "MICROSAR RTE" UBYTE RTE_CM_BOOLEAN 0 0 0 255 ECU_ADDRESS 0 SYMBOL_LINK "Rte_GateDrv0Ctrl_GateDrv0CfgSecAtmpt" 0 DISPLAY_IDENTIFIER GateDrv0Ctrl.PerInstanceMemories.GateDrv0CfgSecAtmpt /end MEASUREMENT
/begin MEASUREMENT GateDrv0Ctrl.GateDrv0Diag0Val "MICROSAR RTE" UWORD NO_COMPU_METHOD 0 0 0 65535 ECU_ADDRESS 0 SYMBOL_LINK "Rte_GateDrv0Ctrl_GateDrv0Diag0Val" 0 DISPLAY_IDENTIFIER GateDrv0Ctrl.PerInstanceMemories.GateDrv0Diag0Val /end MEASUREMENT
/begin MEASUREMENT GateDrv0Ctrl.GateDrv0Diag1Val "MICROSAR RTE" UWORD NO_COMPU_METHOD 0 0 0 65535 ECU_ADDRESS 0 SYMBOL_LINK "Rte_GateDrv0Ctrl_GateDrv0Diag1Val" 0 DISPLAY_IDENTIFIER GateDrv0Ctrl.PerInstanceMemories.GateDrv0Diag1Val /end MEASUREMENT
/begin MEASUREMENT GateDrv0Ctrl.GateDrv0Diag2Val "MICROSAR RTE" UWORD NO_COMPU_METHOD 0 0 0 65535 ECU_ADDRESS 0 SYMBOL_LINK "Rte_GateDrv0Ctrl_GateDrv0Diag2Val" 0 DISPLAY_IDENTIFIER GateDrv0Ctrl.PerInstanceMemories.GateDrv0Diag2Val /end MEASUREMENT
/begin MEASUREMENT GateDrv0Ctrl.GateDrv0OffStChkIdx "MICROSAR RTE" UBYTE NO_COMPU_METHOD 0 0 0 255 ECU_ADDRESS 0 SYMBOL_LINK "Rte_GateDrv0Ctrl_GateDrv0OffStChkIdx" 0 DISPLAY_IDENTIFIER GateDrv0Ctrl.PerInstanceMemories.GateDrv0OffStChkIdx /end MEASUREMENT
/begin MEASUREMENT GateDrv0Ctrl.GateDrv0OffStChkSecAtmpt "MICROSAR RTE" UBYTE RTE_CM_BOOLEAN 0 0 0 255 ECU_ADDRESS 0 SYMBOL_LINK "Rte_GateDrv0Ctrl_GateDrv0OffStChkSecAtmpt" 0 DISPLAY_IDENTIFIER GateDrv0Ctrl.PerInstanceMemories.GateDrv0OffStChkSecAtmpt /end MEASUREMENT
/begin MEASUREMENT GateDrv0Ctrl.GateDrv0OffStCnt "MICROSAR RTE" UBYTE NO_COMPU_METHOD 0 0 0 255 ECU_ADDRESS 0 SYMBOL_LINK "Rte_GateDrv0Ctrl_GateDrv0OffStCnt" 0 DISPLAY_IDENTIFIER GateDrv0Ctrl.PerInstanceMemories.GateDrv0OffStCnt /end MEASUREMENT
/begin MEASUREMENT GateDrv0Ctrl.GateDrv0St "MICROSAR RTE" UBYTE NO_COMPU_METHOD 0 0 0 255 ECU_ADDRESS 0 SYMBOL_LINK "Rte_GateDrv0Ctrl_GateDrv0St" 0 DISPLAY_IDENTIFIER GateDrv0Ctrl.PerInstanceMemories.GateDrv0St /end MEASUREMENT
/begin MEASUREMENT GateDrv0Ctrl.GateDrv0StsVal "MICROSAR RTE" UWORD NO_COMPU_METHOD 0 0 0 65535 ECU_ADDRESS 0 SYMBOL_LINK "Rte_GateDrv0Ctrl_GateDrv0StsVal" 0 DISPLAY_IDENTIFIER GateDrv0Ctrl.PerInstanceMemories.GateDrv0StsVal /end MEASUREMENT
/begin MEASUREMENT GateDrv0Ctrl.GateDrv0VrfyRes0Val "MICROSAR RTE" UWORD NO_COMPU_METHOD 0 0 0 65535 ECU_ADDRESS 0 SYMBOL_LINK "Rte_GateDrv0Ctrl_GateDrv0VrfyRes0Val" 0 DISPLAY_IDENTIFIER GateDrv0Ctrl.PerInstanceMemories.GateDrv0VrfyRes0Val /end MEASUREMENT
/begin MEASUREMENT GateDrv0Ctrl.GateDrv0VrfyRes1Val "MICROSAR RTE" UWORD NO_COMPU_METHOD 0 0 0 65535 ECU_ADDRESS 0 SYMBOL_LINK "Rte_GateDrv0Ctrl_GateDrv0VrfyRes1Val" 0 DISPLAY_IDENTIFIER GateDrv0Ctrl.PerInstanceMemories.GateDrv0VrfyRes1Val /end MEASUREMENT
/begin MEASUREMENT GateDrv0Ctrl.Ivtr0BootstrpSplyFltPrmVal "MICROSAR RTE" UBYTE NO_COMPU_METHOD 0 0 0 255 ECU_ADDRESS 0 SYMBOL_LINK "Rte_GateDrv0Ctrl_Ivtr0BootstrpSplyFltPrmVal" 0 DISPLAY_IDENTIFIER GateDrv0Ctrl.PerInstanceMemories.Ivtr0BootstrpSplyFltPrmVal /end MEASUREMENT
/begin MEASUREMENT GateDrv0Ctrl.Ivtr0GenericFltPrmVal "MICROSAR RTE" UBYTE NO_COMPU_METHOD 0 0 0 255 ECU_ADDRESS 0 SYMBOL_LINK "Rte_GateDrv0Ctrl_Ivtr0GenericFltPrmVal" 0 DISPLAY_IDENTIFIER GateDrv0Ctrl.PerInstanceMemories.Ivtr0GenericFltPrmVal /end MEASUREMENT
/begin MEASUREMENT GateDrv0Ctrl.Ivtr0OffStChkCmpl "MICROSAR RTE" UBYTE RTE_CM_BOOLEAN 0 0 0 255 ECU_ADDRESS 0 SYMBOL_LINK "Rte_GateDrv0Ctrl_Ivtr0OffStChkCmpl" 0 DISPLAY_IDENTIFIER GateDrv0Ctrl.PerInstanceMemories.Ivtr0OffStChkCmpl /end MEASUREMENT
/begin MEASUREMENT GateDrv0Ctrl.MotDrvr0IninTestCmpl.Logl "MICROSAR RTE" UBYTE RTE_CM_BOOLEAN 0 0 0 255 ECU_ADDRESS 0 SYMBOL_LINK "Rte_GateDrv0Ctrl_MotDrvr0IninTestCmpl_Logl" 0 DISPLAY_IDENTIFIER GateDrv0Ctrl.SenderPorts.MotDrvr0IninTestCmpl.Logl /end MEASUREMENT
/begin MEASUREMENT GateDrv0Ctrl.StrtUpSt.Val "MICROSAR RTE" UBYTE NO_COMPU_METHOD 0 0 0 255 ECU_ADDRESS 0 SYMBOL_LINK "Rte_PwrUpSeq_StrtUpSt_Val" 0 DISPLAY_IDENTIFIER GateDrv0Ctrl.ReceiverPorts.StrtUpSt.Val /end MEASUREMENT
/begin MEASUREMENT GateDrv0Ctrl.SysSt.Val "MICROSAR RTE" UBYTE RTE_CM_ENUM_SysSt1 0 0 0 255 ECU_ADDRESS 0 SYMBOL_LINK "Rte_SysStMod_SysSt_Val" 0 DISPLAY_IDENTIFIER GateDrv0Ctrl.ReceiverPorts.SysSt.Val /end MEASUREMENT
/begin MEASUREMENT GateDrv0Ctrl.dGateDrv0CtrlGateDrv0Diag0Val "MICROSAR RTE" UWORD NO_COMPU_METHOD 0 0 0 65535 ECU_ADDRESS 0 SYMBOL_LINK "Rte_GateDrv0Ctrl_dGateDrv0CtrlGateDrv0Diag0Val" 0 DISPLAY_IDENTIFIER GateDrv0Ctrl.PerInstanceMemories.dGateDrv0CtrlGateDrv0Diag0Val /end MEASUREMENT
/begin MEASUREMENT GateDrv0Ctrl.dGateDrv0CtrlGateDrv0Diag1Val "MICROSAR RTE" UWORD NO_COMPU_METHOD 0 0 0 65535 ECU_ADDRESS 0 SYMBOL_LINK "Rte_GateDrv0Ctrl_dGateDrv0CtrlGateDrv0Diag1Val" 0 DISPLAY_IDENTIFIER GateDrv0Ctrl.PerInstanceMemories.dGateDrv0CtrlGateDrv0Diag1Val /end MEASUREMENT
/begin MEASUREMENT GateDrv0Ctrl.dGateDrv0CtrlGateDrv0Diag2Val "MICROSAR RTE" UWORD NO_COMPU_METHOD 0 0 0 65535 ECU_ADDRESS 0 SYMBOL_LINK "Rte_GateDrv0Ctrl_dGateDrv0CtrlGateDrv0Diag2Val" 0 DISPLAY_IDENTIFIER GateDrv0Ctrl.PerInstanceMemories.dGateDrv0CtrlGateDrv0Diag2Val /end MEASUREMENT
/begin MEASUREMENT GateDrv0Ctrl.dGateDrv0CtrlGateDrv0OffsStVrfyPrmBitIdx "MICROSAR RTE" UBYTE NO_COMPU_METHOD 0 0 0 255 ECU_ADDRESS 0 SYMBOL_LINK "Rte_GateDrv0Ctrl_dGateDrv0CtrlGateDrv0OffsStVrfyPrmBitIdx" 0 DISPLAY_IDENTIFIER GateDrv0Ctrl.PerInstanceMemories.dGateDrv0CtrlGateDrv0OffsStVrfyPrmBitIdx /end MEASUREMENT
/begin MEASUREMENT GateDrv0Ctrl.dGateDrv0CtrlGateDrv0StsVal "MICROSAR RTE" UWORD NO_COMPU_METHOD 0 0 0 65535 ECU_ADDRESS 0 SYMBOL_LINK "Rte_GateDrv0Ctrl_dGateDrv0CtrlGateDrv0StsVal" 0 DISPLAY_IDENTIFIER GateDrv0Ctrl.PerInstanceMemories.dGateDrv0CtrlGateDrv0StsVal /end MEASUREMENT
/begin MEASUREMENT GateDrv0Ctrl.dGateDrv0CtrlGateDrv0VrfyRes0Val "MICROSAR RTE" UWORD NO_COMPU_METHOD 0 0 0 65535 ECU_ADDRESS 0 SYMBOL_LINK "Rte_GateDrv0Ctrl_dGateDrv0CtrlGateDrv0VrfyRes0Val" 0 DISPLAY_IDENTIFIER GateDrv0Ctrl.PerInstanceMemories.dGateDrv0CtrlGateDrv0VrfyRes0Val /end MEASUREMENT
/begin MEASUREMENT GateDrv0Ctrl.dGateDrv0CtrlGateDrv0VrfyRes1Val "MICROSAR RTE" UWORD NO_COMPU_METHOD 0 0 0 65535 ECU_ADDRESS 0 SYMBOL_LINK "Rte_GateDrv0Ctrl_dGateDrv0CtrlGateDrv0VrfyRes1Val" 0 DISPLAY_IDENTIFIER GateDrv0Ctrl.PerInstanceMemories.dGateDrv0CtrlGateDrv0VrfyRes1Val /end MEASUREMENT
/begin MEASUREMENT GmFctDiArbn.ApaEna.Logl "MICROSAR RTE" UBYTE RTE_CM_BOOLEAN 0 0 0 255 ECU_ADDRESS 0 SYMBOL_LINK "Rte_GmMsg337BusChassisExp_ApaReqActv_Logl" 0 DISPLAY_IDENTIFIER GmFctDiArbn.ReceiverPorts.ApaEna.Logl /end MEASUREMENT
/begin MEASUREMENT GmFctDiArbn.ApaEnaArbn.Logl "MICROSAR RTE" UBYTE RTE_CM_BOOLEAN 0 0 0 255 ECU_ADDRESS 0 SYMBOL_LINK "Rte_GmFctDiArbn_ApaEnaArbn_Logl" 0 DISPLAY_IDENTIFIER GmFctDiArbn.SenderPorts.ApaEnaArbn.Logl /end MEASUREMENT
/begin MEASUREMENT GmFctDiArbn.CcwEotEnad "MICROSAR RTE" UBYTE RTE_CM_BOOLEAN 0 0 0 255 ECU_ADDRESS 0 SYMBOL_LINK "Rte_GmFctDiArbn_CcwEotEnad" 0 DISPLAY_IDENTIFIER GmFctDiArbn.PerInstanceMemories.CcwEotEnad /end MEASUREMENT
/begin MEASUREMENT GmFctDiArbn.CwEotEnad "MICROSAR RTE" UBYTE RTE_CM_BOOLEAN 0 0 0 255 ECU_ADDRESS 0 SYMBOL_LINK "Rte_GmFctDiArbn_CwEotEnad" 0 DISPLAY_IDENTIFIER GmFctDiArbn.PerInstanceMemories.CwEotEnad /end MEASUREMENT
/begin MEASUREMENT GmFctDiArbn.EscEna.Logl "MICROSAR RTE" UBYTE RTE_CM_BOOLEAN 0 0 0 255 ECU_ADDRESS 0 SYMBOL_LINK "Rte_GmMsg180BusChassisExp_EscReqActv_Logl" 0 DISPLAY_IDENTIFIER GmFctDiArbn.ReceiverPorts.EscEna.Logl /end MEASUREMENT
/begin MEASUREMENT GmFctDiArbn.EscEnaArbn.Logl "MICROSAR RTE" UBYTE RTE_CM_BOOLEAN 0 0 0 255 ECU_ADDRESS 0 SYMBOL_LINK "Rte_GmFctDiArbn_EscEnaArbn_Logl" 0 DISPLAY_IDENTIFIER GmFctDiArbn.SenderPorts.EscEnaArbn.Logl /end MEASUREMENT
/begin MEASUREMENT GmFctDiArbn.FctDiLtch "MICROSAR RTE" UBYTE RTE_CM_BOOLEAN 0 0 0 255 ECU_ADDRESS 0 SYMBOL_LINK "Rte_GmFctDiArbn_FctDiLtch" 0 DISPLAY_IDENTIFIER GmFctDiArbn.PerInstanceMemories.FctDiLtch /end MEASUREMENT
/begin MEASUREMENT GmFctDiArbn.GmFctDiSts.Val "MICROSAR RTE" UBYTE RTE_CM_ENUM_GmFctDiArbnSts1 0 0 0 255 ECU_ADDRESS 0 SYMBOL_LINK "Rte_GmFctDiArbn_GmFctDiSts_Val" 0 DISPLAY_IDENTIFIER GmFctDiArbn.SenderPorts.GmFctDiSts.Val /end MEASUREMENT
/begin MEASUREMENT GmFctDiArbn.HwAg.Val "MICROSAR RTE" FLOAT32_IEEE NO_COMPU_METHOD 0 0 -3.402823466e+38 3.402823466e+38 ECU_ADDRESS 0 SYMBOL_LINK "Rte_HwAgSysArbn_PinionAg_Val" 0 DISPLAY_IDENTIFIER GmFctDiArbn.ReceiverPorts.HwAg.Val /end MEASUREMENT
/begin GROUP DutyCycThermProtn.DutyCycThermProtnMplr1NonStallTblY.Ary1D "MICROSAR RTE" /begin SUB_GROUP /end SUB_GROUP /begin FUNCTION_LIST /end FUNCTION_LIST /begin REF_CHARACTERISTIC DutyCycThermProtn.DutyCycThermProtnMplr1NonStallTblY.Ary1D /end REF_CHARACTERISTIC /begin REF_MEASUREMENT /end REF_MEASUREMENT /end GROUP
/begin GROUP DutyCycThermProtn.DutyCycThermProtnMplr1StallTblY.Ary1D "MICROSAR RTE" /begin SUB_GROUP /end SUB_GROUP /begin FUNCTION_LIST /end FUNCTION_LIST /begin REF_CHARACTERISTIC DutyCycThermProtn.DutyCycThermProtnMplr1StallTblY.Ary1D /end REF_CHARACTERISTIC /begin REF_MEASUREMENT /end REF_MEASUREMENT /end GROUP
/begin GROUP DutyCycThermProtn.DutyCycThermProtnMplr2NonStallTblY.Ary1D "MICROSAR RTE" /begin SUB_GROUP /end SUB_GROUP /begin FUNCTION_LIST /end FUNCTION_LIST /begin REF_CHARACTERISTIC DutyCycThermProtn.DutyCycThermProtnMplr2NonStallTblY.Ary1D /end REF_CHARACTERISTIC /begin REF_MEASUREMENT /end REF_MEASUREMENT /end GROUP
/begin GROUP DutyCycThermProtn.DutyCycThermProtnMplr2StallTblY.Ary1D "MICROSAR RTE" /begin SUB_GROUP /end SUB_GROUP /begin FUNCTION_LIST /end FUNCTION_LIST /begin REF_CHARACTERISTIC DutyCycThermProtn.DutyCycThermProtnMplr2StallTblY.Ary1D /end REF_CHARACTERISTIC /begin REF_MEASUREMENT /end REF_MEASUREMENT /end GROUP
/begin GROUP DutyCycThermProtn.DutyCycThermProtnMplr3NonStallTblY.Ary1D "MICROSAR RTE" /begin SUB_GROUP /end SUB_GROUP /begin FUNCTION_LIST /end FUNCTION_LIST /begin REF_CHARACTERISTIC DutyCycThermProtn.DutyCycThermProtnMplr3NonStallTblY.Ary1D /end REF_CHARACTERISTIC /begin REF_MEASUREMENT /end REF_MEASUREMENT /end GROUP
/begin GROUP DutyCycThermProtn.DutyCycThermProtnMplr3StallTblY.Ary1D "MICROSAR RTE" /begin SUB_GROUP /end SUB_GROUP /begin FUNCTION_LIST /end FUNCTION_LIST /begin REF_CHARACTERISTIC DutyCycThermProtn.DutyCycThermProtnMplr3StallTblY.Ary1D /end REF_CHARACTERISTIC /begin REF_MEASUREMENT /end REF_MEASUREMENT /end GROUP
/begin GROUP DutyCycThermProtn.DutyCycThermProtnMplr4NonStallTblY.Ary1D "MICROSAR RTE" /begin SUB_GROUP /end SUB_GROUP /begin FUNCTION_LIST /end FUNCTION_LIST /begin REF_CHARACTERISTIC DutyCycThermProtn.DutyCycThermProtnMplr4NonStallTblY.Ary1D /end REF_CHARACTERISTIC /begin REF_MEASUREMENT /end REF_MEASUREMENT /end GROUP
/begin GROUP DutyCycThermProtn.DutyCycThermProtnMplr4StallTblY.Ary1D "MICROSAR RTE" /begin SUB_GROUP /end SUB_GROUP /begin FUNCTION_LIST /end FUNCTION_LIST /begin REF_CHARACTERISTIC DutyCycThermProtn.DutyCycThermProtnMplr4StallTblY.Ary1D /end REF_CHARACTERISTIC /begin REF_MEASUREMENT /end REF_MEASUREMENT /end GROUP
/begin GROUP DutyCycThermProtn.DutyCycThermProtnMplr5NonStallTblY.Ary1D "MICROSAR RTE" /begin SUB_GROUP /end SUB_GROUP /begin FUNCTION_LIST /end FUNCTION_LIST /begin REF_CHARACTERISTIC DutyCycThermProtn.DutyCycThermProtnMplr5NonStallTblY.Ary1D /end REF_CHARACTERISTIC /begin REF_MEASUREMENT /end REF_MEASUREMENT /end GROUP
/begin GROUP DutyCycThermProtn.DutyCycThermProtnMplr5StallTblY.Ary1D "MICROSAR RTE" /begin SUB_GROUP /end SUB_GROUP /begin FUNCTION_LIST /end FUNCTION_LIST /begin REF_CHARACTERISTIC DutyCycThermProtn.DutyCycThermProtnMplr5StallTblY.Ary1D /end REF_CHARACTERISTIC /begin REF_MEASUREMENT /end REF_MEASUREMENT /end GROUP
/begin GROUP DutyCycThermProtn.DutyCycThermProtnMplr6NonStallTblY.Ary1D "MICROSAR RTE" /begin SUB_GROUP /end SUB_GROUP /begin FUNCTION_LIST /end FUNCTION_LIST /begin REF_CHARACTERISTIC DutyCycThermProtn.DutyCycThermProtnMplr6NonStallTblY.Ary1D /end REF_CHARACTERISTIC /begin REF_MEASUREMENT /end REF_MEASUREMENT /end GROUP
/begin GROUP DutyCycThermProtn.DutyCycThermProtnMplr6StallTblY.Ary1D "MICROSAR RTE" /begin SUB_GROUP /end SUB_GROUP /begin FUNCTION_LIST /end FUNCTION_LIST /begin REF_CHARACTERISTIC DutyCycThermProtn.DutyCycThermProtnMplr6StallTblY.Ary1D /end REF_CHARACTERISTIC /begin REF_MEASUREMENT /end REF_MEASUREMENT /end GROUP
/begin GROUP DutyCycThermProtn.DutyCycThermProtnMplrTSeln.Logl "MICROSAR RTE" /begin SUB_GROUP /end SUB_GROUP /begin FUNCTION_LIST /end FUNCTION_LIST /begin REF_CHARACTERISTIC DutyCycThermProtn.DutyCycThermProtnMplrTSeln.Logl /end REF_CHARACTERISTIC /begin REF_MEASUREMENT /end REF_MEASUREMENT /end GROUP
/begin GROUP DutyCycThermProtn.DutyCycThermProtnMplrTblX.Ary1D "MICROSAR RTE" /begin SUB_GROUP /end SUB_GROUP /begin FUNCTION_LIST /end FUNCTION_LIST /begin REF_CHARACTERISTIC DutyCycThermProtn.DutyCycThermProtnMplrTblX.Ary1D /end REF_CHARACTERISTIC /begin REF_MEASUREMENT /end REF_MEASUREMENT /end GROUP
/begin GROUP DutyCycThermProtn.DutyCycThermProtnSlowFilTSeln.Logl "MICROSAR RTE" /begin SUB_GROUP /end SUB_GROUP /begin FUNCTION_LIST /end FUNCTION_LIST /begin REF_CHARACTERISTIC DutyCycThermProtn.DutyCycThermProtnSlowFilTSeln.Logl /end REF_CHARACTERISTIC /begin REF_MEASUREMENT /end REF_MEASUREMENT /end GROUP
/begin GROUP DutyCycThermProtn.DutyCycThermProtnThermLimScaFac.Val "MICROSAR RTE" /begin SUB_GROUP /end SUB_GROUP /begin FUNCTION_LIST /end FUNCTION_LIST /begin REF_CHARACTERISTIC DutyCycThermProtn.DutyCycThermProtnThermLimScaFac.Val /end REF_CHARACTERISTIC /begin REF_MEASUREMENT /end REF_MEASUREMENT /end GROUP
/begin GROUP DutyCycThermProtn.DutyCycThermProtnThermLoadLimTblX.Ary1D "MICROSAR RTE" /begin SUB_GROUP /end SUB_GROUP /begin FUNCTION_LIST /end FUNCTION_LIST /begin REF_CHARACTERISTIC DutyCycThermProtn.DutyCycThermProtnThermLoadLimTblX.Ary1D /end REF_CHARACTERISTIC /begin REF_MEASUREMENT /end REF_MEASUREMENT /end GROUP
/begin GROUP DutyCycThermProtn.DutyCycThermProtnThermLoadLimTblY.Ary1D "MICROSAR RTE" /begin SUB_GROUP /end SUB_GROUP /begin FUNCTION_LIST /end FUNCTION_LIST /begin REF_CHARACTERISTIC DutyCycThermProtn.DutyCycThermProtnThermLoadLimTblY.Ary1D /end REF_CHARACTERISTIC /begin REF_MEASUREMENT /end REF_MEASUREMENT /end GROUP
/begin GROUP DutyCycThermProtn.DutyCycThermProtnTqCmdSlewDwn.Val "MICROSAR RTE" /begin SUB_GROUP /end SUB_GROUP /begin FUNCTION_LIST /end FUNCTION_LIST /begin REF_CHARACTERISTIC DutyCycThermProtn.DutyCycThermProtnTqCmdSlewDwn.Val /end REF_CHARACTERISTIC /begin REF_MEASUREMENT /end REF_MEASUREMENT /end GROUP
/begin GROUP DutyCycThermProtn.DutyCycThermProtnTqCmdSlewUp.Val "MICROSAR RTE" /begin SUB_GROUP /end SUB_GROUP /begin FUNCTION_LIST /end FUNCTION_LIST /begin REF_CHARACTERISTIC DutyCycThermProtn.DutyCycThermProtnTqCmdSlewUp.Val /end REF_CHARACTERISTIC /begin REF_MEASUREMENT /end REF_MEASUREMENT /end GROUP
/begin GROUP DutyCycThermProtn.EcuTFild.Val "MICROSAR RTE" /begin SUB_GROUP /end SUB_GROUP /begin FUNCTION_LIST /end FUNCTION_LIST /begin REF_CHARACTERISTIC /end REF_CHARACTERISTIC /begin REF_MEASUREMENT DutyCycThermProtn.EcuTFild.Val /end REF_MEASUREMENT /end GROUP
/begin GROUP DutyCycThermProtn.Fil1ValStVari "MICROSAR RTE" /begin SUB_GROUP /end SUB_GROUP /begin FUNCTION_LIST /end FUNCTION_LIST /begin REF_CHARACTERISTIC /end REF_CHARACTERISTIC
 /begin REF_MEASUREMENT DutyCycThermProtn.Fil1ValStVari.FilGain DutyCycThermProtn.Fil1ValStVari.FilSt /end REF_MEASUREMENT
/end GROUP
/begin GROUP DutyCycThermProtn.Fil2ValStVari "MICROSAR RTE" /begin SUB_GROUP /end SUB_GROUP /begin FUNCTION_LIST /end FUNCTION_LIST /begin REF_CHARACTERISTIC /end REF_CHARACTERISTIC
 /begin REF_MEASUREMENT DutyCycThermProtn.Fil2ValStVari.FilGain DutyCycThermProtn.Fil2ValStVari.FilSt /end REF_MEASUREMENT
/end GROUP
/begin GROUP DutyCycThermProtn.Fil3ValPwrUp "MICROSAR RTE" /begin SUB_GROUP /end SUB_GROUP /begin FUNCTION_LIST /end FUNCTION_LIST /begin REF_CHARACTERISTIC /end REF_CHARACTERISTIC /begin REF_MEASUREMENT DutyCycThermProtn.Fil3ValPwrUp /end REF_MEASUREMENT /end GROUP
/begin GROUP DutyCycThermProtn.Fil4ValPwrUp "MICROSAR RTE" /begin SUB_GROUP /end SUB_GROUP /begin FUNCTION_LIST /end FUNCTION_LIST /begin REF_CHARACTERISTIC /end REF_CHARACTERISTIC /begin REF_MEASUREMENT DutyCycThermProtn.Fil4ValPwrUp /end REF_MEASUREMENT /end GROUP
/begin GROUP DutyCycThermProtn.Fil5ValPwrUp "MICROSAR RTE" /begin SUB_GROUP /end SUB_GROUP /begin FUNCTION_LIST /end FUNCTION_LIST /begin REF_CHARACTERISTIC /end REF_CHARACTERISTIC /begin REF_MEASUREMENT DutyCycThermProtn.Fil5ValPwrUp /end REF_MEASUREMENT /end GROUP
/begin GROUP DutyCycThermProtn.Fil6ValPwrUp "MICROSAR RTE" /begin SUB_GROUP /end SUB_GROUP /begin FUNCTION_LIST /end FUNCTION_LIST /begin REF_CHARACTERISTIC /end REF_CHARACTERISTIC /begin REF_MEASUREMENT DutyCycThermProtn.Fil6ValPwrUp /end REF_MEASUREMENT /end GROUP
/begin GROUP DutyCycThermProtn.FilStVal "MICROSAR RTE" /begin SUB_GROUP /end SUB_GROUP /begin FUNCTION_LIST /end FUNCTION_LIST /begin REF_CHARACTERISTIC /end REF_CHARACTERISTIC
 /begin REF_MEASUREMENT DutyCycThermProtn.FilStVal.Fil3StVal DutyCycThermProtn.FilStVal.Fil4StVal DutyCycThermProtn.FilStVal.Fil5StVal DutyCycThermProtn.FilStVal.Fil6StVal /end REF_MEASUREMENT
/end GROUP
/begin GROUP DutyCycThermProtn.Fild3Val "MICROSAR RTE" /begin SUB_GROUP /end SUB_GROUP /begin FUNCTION_LIST /end FUNCTION_LIST /begin REF_CHARACTERISTIC /end REF_CHARACTERISTIC
 /begin REF_MEASUREMENT DutyCycThermProtn.Fild3Val.FilGain DutyCycThermProtn.Fild3Val.FilSt /end REF_MEASUREMENT
/end GROUP
/begin GROUP DutyCycThermProtn.Fild4Val "MICROSAR RTE" /begin SUB_GROUP /end SUB_GROUP /begin FUNCTION_LIST /end FUNCTION_LIST /begin REF_CHARACTERISTIC /end REF_CHARACTERISTIC
 /begin REF_MEASUREMENT DutyCycThermProtn.Fild4Val.FilGain DutyCycThermProtn.Fild4Val.FilSt /end REF_MEASUREMENT
/end GROUP
/begin GROUP DutyCycThermProtn.Fild5Val "MICROSAR RTE" /begin SUB_GROUP /end SUB_GROUP /begin FUNCTION_LIST /end FUNCTION_LIST /begin REF_CHARACTERISTIC /end REF_CHARACTERISTIC
 /begin REF_MEASUREMENT DutyCycThermProtn.Fild5Val.FilGain DutyCycThermProtn.Fild5Val.FilSt /end REF_MEASUREMENT
/end GROUP
/begin GROUP DutyCycThermProtn.Fild6Val "MICROSAR RTE" /begin SUB_GROUP /end SUB_GROUP /begin FUNCTION_LIST /end FUNCTION_LIST /begin REF_CHARACTERISTIC /end REF_CHARACTERISTIC
 /begin REF_MEASUREMENT DutyCycThermProtn.Fild6Val.FilGain DutyCycThermProtn.Fild6Val.FilSt /end REF_MEASUREMENT
/end GROUP
/begin GROUP DutyCycThermProtn.IgnTiOff.Val "MICROSAR RTE" /begin SUB_GROUP /end SUB_GROUP /begin FUNCTION_LIST /end FUNCTION_LIST /begin REF_CHARACTERISTIC /end REF_CHARACTERISTIC /begin REF_MEASUREMENT DutyCycThermProtn.IgnTiOff.Val /end REF_MEASUREMENT /end GROUP
/begin GROUP DutyCycThermProtn.IvtrLoaMtgtnEna.Logl "MICROSAR RTE" /begin SUB_GROUP /end SUB_GROUP /begin FUNCTION_LIST /end FUNCTION_LIST /begin REF_CHARACTERISTIC /end REF_CHARACTERISTIC /begin REF_MEASUREMENT DutyCycThermProtn.IvtrLoaMtgtnEna.Logl /end REF_MEASUREMENT /end GROUP
/begin GROUP DutyCycThermProtn.LstTblValRateLimrStVari "MICROSAR RTE" /begin SUB_GROUP /end SUB_GROUP /begin FUNCTION_LIST /end FUNCTION_LIST /begin REF_CHARACTERISTIC /end REF_CHARACTERISTIC /begin REF_MEASUREMENT DutyCycThermProtn.LstTblValRateLimrStVari /end REF_MEASUREMENT /end GROUP
/begin GROUP DutyCycThermProtn.MotCurrPeakEstimd.Val "MICROSAR RTE" /begin SUB_GROUP /end SUB_GROUP /begin FUNCTION_LIST /end FUNCTION_LIST /begin REF_CHARACTERISTIC /end REF_CHARACTERISTIC /begin REF_MEASUREMENT DutyCycThermProtn.MotCurrPeakEstimd.Val /end REF_MEASUREMENT /end GROUP
/begin GROUP DutyCycThermProtn.MotCurrPeakEstimdFild.Val "MICROSAR RTE" /begin SUB_GROUP /end SUB_GROUP /begin FUNCTION_LIST /end FUNCTION_LIST /begin REF_CHARACTERISTIC /end REF_CHARACTERISTIC /begin REF_MEASUREMENT DutyCycThermProtn.MotCurrPeakEstimdFild.Val /end REF_MEASUREMENT /end GROUP
/begin GROUP DutyCycThermProtn.MotFetT.Val "MICROSAR RTE" /begin SUB_GROUP /end SUB_GROUP /begin FUNCTION_LIST /end FUNCTION_LIST /begin REF_CHARACTERISTIC /end REF_CHARACTERISTIC /begin REF_MEASUREMENT DutyCycThermProtn.MotFetT.Val /end REF_MEASUREMENT /end GROUP
/begin GROUP DutyCycThermProtn.MotMagT.Val "MICROSAR RTE" /begin SUB_GROUP /end SUB_GROUP /begin FUNCTION_LIST /end FUNCTION_LIST /begin REF_CHARACTERISTIC /end REF_CHARACTERISTIC /begin REF_MEASUREMENT DutyCycThermProtn.MotMagT.Val /end REF_MEASUREMENT /end GROUP
/begin GROUP DutyCycThermProtn.MotVelCrf.Val "MICROSAR RTE" /begin SUB_GROUP /end SUB_GROUP /begin FUNCTION_LIST /end FUNCTION_LIST /begin REF_CHARACTERISTIC /end REF_CHARACTERISTIC /begin REF_MEASUREMENT DutyCycThermProtn.MotVelCrf.Val /end REF_MEASUREMENT /end GROUP
/begin GROUP DutyCycThermProtn.MotWidgT.Val "MICROSAR RTE" /begin SUB_GROUP /end SUB_GROUP /begin FUNCTION_LIST /end FUNCTION_LIST /begin REF_CHARACTERISTIC /end REF_CHARACTERISTIC /begin REF_MEASUREMENT DutyCycThermProtn.MotWidgT.Val /end REF_MEASUREMENT /end GROUP
/begin GROUP DutyCycThermProtn.PerInstanceMemories "MICROSAR RTE"
 /begin SUB_GROUP DutyCycThermProtn.AbsltTLimSlewStVari DutyCycThermProtn.Fil1ValStVari DutyCycThermProtn.Fil2ValStVari DutyCycThermProtn.Fil3ValPwrUp DutyCycThermProtn.Fil4ValPwrUp DutyCycThermProtn.Fil5ValPwrUp DutyCycThermProtn.Fil6ValPwrUp DutyCycThermProtn.FilStVal DutyCycThermProtn.Fild3Val DutyCycThermProtn.Fild4Val DutyCycThermProtn.Fild5Val DutyCycThermProtn.Fild6Val DutyCycThermProtn.LstTblValRateLimrStVari DutyCycThermProtn.ReInitCntrFlg DutyCycThermProtn.ReInitCntrVal DutyCycThermProtn.dDutyCycThermProtnAbsltCtrlrTTqLim DutyCycThermProtn.dDutyCycThermProtnAbsltCuTTqLim DutyCycThermProtn.dDutyCycThermProtnAbsltTTqLim DutyCycThermProtn.dDutyCycThermProtnLstTblVal DutyCycThermProtn.dDutyCycThermProtnLstTblValSlew DutyCycThermProtn.dDutyCycThermProtnMplr1 DutyCycThermProtn.dDutyCycThermProtnMplr12T DutyCycThermProtn.dDutyCycThermProtnMplr2 DutyCycThermProtn.dDutyCycThermProtnMplr3 DutyCycThermProtn.dDutyCycThermProtnMplr36T DutyCycThermProtn.dDutyCycThermProtnMplr4 DutyCycThermProtn.dDutyCycThermProtnMplr5 DutyCycThermProtn.dDutyCycThermProtnMplr6 DutyCycThermProtn.dDutyCycThermProtnThermLoadLim DutyCycThermProtn.dDutyCycThermProtnThermLoadLimTblYVal /end SUB_GROUP
 /begin FUNCTION_LIST /end FUNCTION_LIST
 /begin REF_CHARACTERISTIC /end REF_CHARACTERISTIC
 /begin REF_MEASUREMENT /end REF_MEASUREMENT
/end GROUP
/begin GROUP DutyCycThermProtn.ReInitCntrFlg "MICROSAR RTE" /begin SUB_GROUP /end SUB_GROUP /begin FUNCTION_LIST /end FUNCTION_LIST /begin REF_CHARACTERISTIC /end REF_CHARACTERISTIC /begin REF_MEASUREMENT DutyCycThermProtn.ReInitCntrFlg /end REF_MEASUREMENT /end GROUP
/begin GROUP DutyCycThermProtn.ReInitCntrVal "MICROSAR RTE" /begin SUB_GROUP /end SUB_GROUP /begin FUNCTION_LIST /end FUNCTION_LIST /begin REF_CHARACTERISTIC /end REF_CHARACTERISTIC /begin REF_MEASUREMENT DutyCycThermProtn.ReInitCntrVal /end REF_MEASUREMENT /end GROUP
/begin GROUP DutyCycThermProtn.ReceiverPorts "MICROSAR RTE"
 /begin SUB_GROUP DutyCycThermProtn.DiagcStsLimdTPrfmnc.Logl DutyCycThermProtn.DualEcuFltMtgtnEna.Logl DutyCycThermProtn.DutyCycThermProtnDi.Logl DutyCycThermProtn.EcuTFild.Val DutyCycThermProtn.IgnTiOff.Val DutyCycThermProtn.IvtrLoaMtgtnEna.Logl DutyCycThermProtn.MotCurrPeakEstimd.Val DutyCycThermProtn.MotCurrPeakEstimdFild.Val DutyCycThermProtn.MotFetT.Val DutyCycThermProtn.MotMagT.Val DutyCycThermProtn.MotVelCrf.Val DutyCycThermProtn.MotWidgT.Val DutyCycThermProtn.VehTiVld.Logl /end SUB_GROUP
 /begin FUNCTION_LIST /end FUNCTION_LIST
 /begin REF_CHARACTERISTIC /end REF_CHARACTERISTIC
 /begin REF_MEASUREMENT /end REF_MEASUREMENT
/end GROUP
/begin GROUP DutyCycThermProtn.SenderPorts "MICROSAR RTE"
 /begin SUB_GROUP DutyCycThermProtn.DutyCycThermProtnMaxOutp.Val DutyCycThermProtn.ThermDutyCycProtnLoadDptLim.Val DutyCycThermProtn.ThermDutyCycProtnTDptLim.Val DutyCycThermProtn.ThermLimSlowFilMax.Val DutyCycThermProtn.ThermMotTqLim.Val DutyCycThermProtn.ThermRednFac.Val /end SUB_GROUP
 /begin FUNCTION_LIST /end FUNCTION_LIST
 /begin REF_CHARACTERISTIC /end REF_CHARACTERISTIC
 /begin REF_MEASUREMENT /end REF_MEASUREMENT
/end GROUP
/begin GROUP DutyCycThermProtn.ThermDutyCycProtnLoadDptLim.Val "MICROSAR RTE" /begin SUB_GROUP /end SUB_GROUP /begin FUNCTION_LIST /end FUNCTION_LIST /begin REF_CHARACTERISTIC /end REF_CHARACTERISTIC /begin REF_MEASUREMENT DutyCycThermProtn.ThermDutyCycProtnLoadDptLim.Val /end REF_MEASUREMENT /end GROUP
/begin GROUP DutyCycThermProtn.ThermDutyCycProtnTDptLim.Val "MICROSAR RTE" /begin SUB_GROUP /end SUB_GROUP /begin FUNCTION_LIST /end FUNCTION_LIST /begin REF_CHARACTERISTIC /end REF_CHARACTERISTIC /begin REF_MEASUREMENT DutyCycThermProtn.ThermDutyCycProtnTDptLim.Val /end REF_MEASUREMENT /end GROUP
/begin GROUP DutyCycThermProtn.ThermLimSlowFilMax.Val "MICROSAR RTE" /begin SUB_GROUP /end SUB_GROUP /begin FUNCTION_LIST /end FUNCTION_LIST /begin REF_CHARACTERISTIC /end REF_CHARACTERISTIC /begin REF_MEASUREMENT DutyCycThermProtn.ThermLimSlowFilMax.Val /end REF_MEASUREMENT /end GROUP
/begin GROUP DutyCycThermProtn.ThermMotTqLim.Val "MICROSAR RTE" /begin SUB_GROUP /end SUB_GROUP /begin FUNCTION_LIST /end FUNCTION_LIST /begin REF_CHARACTERISTIC /end REF_CHARACTERISTIC /begin REF_MEASUREMENT DutyCycThermProtn.ThermMotTqLim.Val /end REF_MEASUREMENT /end GROUP
/begin GROUP DutyCycThermProtn.ThermRednFac.Val "MICROSAR RTE" /begin SUB_GROUP /end SUB_GROUP /begin FUNCTION_LIST /end FUNCTION_LIST /begin REF_CHARACTERISTIC /end REF_CHARACTERISTIC /begin REF_MEASUREMENT DutyCycThermProtn.ThermRednFac.Val /end REF_MEASUREMENT /end GROUP
/begin GROUP DutyCycThermProtn.VehTiVld.Logl "MICROSAR RTE" /begin SUB_GROUP /end SUB_GROUP /begin FUNCTION_LIST /end FUNCTION_LIST /begin REF_CHARACTERISTIC /end REF_CHARACTERISTIC /begin REF_MEASUREMENT DutyCycThermProtn.VehTiVld.Logl /end REF_MEASUREMENT /end GROUP
/begin GROUP DutyCycThermProtn.dDutyCycThermProtnAbsltCtrlrTTqLim "MICROSAR RTE" /begin SUB_GROUP /end SUB_GROUP /begin FUNCTION_LIST /end FUNCTION_LIST /begin REF_CHARACTERISTIC /end REF_CHARACTERISTIC /begin REF_MEASUREMENT DutyCycThermProtn.dDutyCycThermProtnAbsltCtrlrTTqLim /end REF_MEASUREMENT /end GROUP
/begin GROUP DutyCycThermProtn.dDutyCycThermProtnAbsltCuTTqLim "MICROSAR RTE" /begin SUB_GROUP /end SUB_GROUP /begin FUNCTION_LIST /end FUNCTION_LIST /begin REF_CHARACTERISTIC /end REF_CHARACTERISTIC /begin REF_MEASUREMENT DutyCycThermProtn.dDutyCycThermProtnAbsltCuTTqLim /end REF_MEASUREMENT /end GROUP
/begin GROUP DutyCycThermProtn.dDutyCycThermProtnAbsltTTqLim "MICROSAR RTE" /begin SUB_GROUP /end SUB_GROUP /begin FUNCTION_LIST /end FUNCTION_LIST /begin REF_CHARACTERISTIC /end REF_CHARACTERISTIC /begin REF_MEASUREMENT DutyCycThermProtn.dDutyCycThermProtnAbsltTTqLim /end REF_MEASUREMENT /end GROUP
/begin GROUP DutyCycThermProtn.dDutyCycThermProtnLstTblVal "MICROSAR RTE" /begin SUB_GROUP /end SUB_GROUP /begin FUNCTION_LIST /end FUNCTION_LIST /begin REF_CHARACTERISTIC /end REF_CHARACTERISTIC /begin REF_MEASUREMENT DutyCycThermProtn.dDutyCycThermProtnLstTblVal /end REF_MEASUREMENT /end GROUP
/begin GROUP DutyCycThermProtn.dDutyCycThermProtnLstTblValSlew "MICROSAR RTE" /begin SUB_GROUP /end SUB_GROUP /begin FUNCTION_LIST /end FUNCTION_LIST /begin REF_CHARACTERISTIC /end REF_CHARACTERISTIC /begin REF_MEASUREMENT DutyCycThermProtn.dDutyCycThermProtnLstTblValSlew /end REF_MEASUREMENT /end GROUP
/begin GROUP DutyCycThermProtn.dDutyCycThermProtnMplr1 "MICROSAR RTE" /begin SUB_GROUP /end SUB_GROUP /begin FUNCTION_LIST /end FUNCTION_LIST /begin REF_CHARACTERISTIC /end REF_CHARACTERISTIC /begin REF_MEASUREMENT DutyCycThermProtn.dDutyCycThermProtnMplr1 /end REF_MEASUREMENT /end GROUP
/begin GROUP DutyCycThermProtn.dDutyCycThermProtnMplr12T "MICROSAR RTE" /begin SUB_GROUP /end SUB_GROUP /begin FUNCTION_LIST /end FUNCTION_LIST /begin REF_CHARACTERISTIC /end REF_CHARACTERISTIC /begin REF_MEASUREMENT DutyCycThermProtn.dDutyCycThermProtnMplr12T /end REF_MEASUREMENT /end GROUP
/begin GROUP DutyCycThermProtn.dDutyCycThermProtnMplr2 "MICROSAR RTE" /begin SUB_GROUP /end SUB_GROUP /begin FUNCTION_LIST /end FUNCTION_LIST /begin REF_CHARACTERISTIC /end REF_CHARACTERISTIC /begin REF_MEASUREMENT DutyCycThermProtn.dDutyCycThermProtnMplr2 /end REF_MEASUREMENT /end GROUP
/begin GROUP DutyCycThermProtn.dDutyCycThermProtnMplr3 "MICROSAR RTE" /begin SUB_GROUP /end SUB_GROUP /begin FUNCTION_LIST /end FUNCTION_LIST /begin REF_CHARACTERISTIC /end REF_CHARACTERISTIC /begin REF_MEASUREMENT DutyCycThermProtn.dDutyCycThermProtnMplr3 /end REF_MEASUREMENT /end GROUP
/begin GROUP DutyCycThermProtn.dDutyCycThermProtnMplr36T "MICROSAR RTE" /begin SUB_GROUP /end SUB_GROUP /begin FUNCTION_LIST /end FUNCTION_LIST /begin REF_CHARACTERISTIC /end REF_CHARACTERISTIC /begin REF_MEASUREMENT DutyCycThermProtn.dDutyCycThermProtnMplr36T /end REF_MEASUREMENT /end GROUP
/begin GROUP DutyCycThermProtn.dDutyCycThermProtnMplr4 "MICROSAR RTE" /begin SUB_GROUP /end SUB_GROUP /begin FUNCTION_LIST /end FUNCTION_LIST /begin REF_CHARACTERISTIC /end REF_CHARACTERISTIC /begin REF_MEASUREMENT DutyCycThermProtn.dDutyCycThermProtnMplr4 /end REF_MEASUREMENT /end GROUP
/begin GROUP DutyCycThermProtn.dDutyCycThermProtnMplr5 "MICROSAR RTE" /begin SUB_GROUP /end SUB_GROUP /begin FUNCTION_LIST /end FUNCTION_LIST /begin REF_CHARACTERISTIC /end REF_CHARACTERISTIC /begin REF_MEASUREMENT DutyCycThermProtn.dDutyCycThermProtnMplr5 /end REF_MEASUREMENT /end GROUP
/begin GROUP DutyCycThermProtn.dDutyCycThermProtnMplr6 "MICROSAR RTE" /begin SUB_GROUP /end SUB_GROUP /begin FUNCTION_LIST /end FUNCTION_LIST /begin REF_CHARACTERISTIC /end REF_CHARACTERISTIC /begin REF_MEASUREMENT DutyCycThermProtn.dDutyCycThermProtnMplr6 /end REF_MEASUREMENT /end GROUP
/begin GROUP DutyCycThermProtn.dDutyCycThermProtnThermLoadLim "MICROSAR RTE" /begin SUB_GROUP /end SUB_GROUP /begin FUNCTION_LIST /end FUNCTION_LIST /begin REF_CHARACTERISTIC /end REF_CHARACTERISTIC /begin REF_MEASUREMENT DutyCycThermProtn.dDutyCycThermProtnThermLoadLim /end REF_MEASUREMENT /end GROUP
/begin GROUP DutyCycThermProtn.dDutyCycThermProtnThermLoadLimTblYVal "MICROSAR RTE" /begin SUB_GROUP /end SUB_GROUP /begin FUNCTION_LIST /end FUNCTION_LIST /begin REF_CHARACTERISTIC /end REF_CHARACTERISTIC /begin REF_MEASUREMENT DutyCycThermProtn.dDutyCycThermProtnThermLoadLimTblYVal /end REF_MEASUREMENT /end GROUP
/begin GROUP EcuTMeas "MICROSAR RTE"
 /begin SUB_GROUP EcuTMeas.CalibrationPorts EcuTMeas.PerInstanceMemories EcuTMeas.ReceiverPorts EcuTMeas.SenderPorts /end SUB_GROUP
 /begin FUNCTION_LIST /end FUNCTION_LIST
 /begin REF_CHARACTERISTIC /end REF_CHARACTERISTIC
 /begin REF_MEASUREMENT /end REF_MEASUREMENT
/end GROUP
/begin GROUP EcuTMeas.CalibrationPorts "MICROSAR RTE"
 /begin SUB_GROUP EcuTMeas.EcuTMeasDftT.Val EcuTMeas.EcuTMeasFilTau.Val EcuTMeas.EcuTMeasNtc0x045FailStep.Val EcuTMeas.EcuTMeasNtc0x045PassStep.Val EcuTMeas.EcuTMeasRngDiagcMax.Val EcuTMeas.EcuTMeasRngDiagcMin.Val EcuTMeas.EcuTMeasScag.Val EcuTMeas.EcuTMeasScagOffs.Val /end SUB_GROUP
 /begin FUNCTION_LIST /end FUNCTION_LIST
 /begin REF_CHARACTERISTIC /end REF_CHARACTERISTIC
 /begin REF_MEASUREMENT /end REF_MEASUREMENT
/end GROUP
/begin GROUP EcuTMeas.DiagcStsLimdTPrfmnc.Logl "MICROSAR RTE" /begin SUB_GROUP /end SUB_GROUP /begin FUNCTION_LIST /end FUNCTION_LIST /begin REF_CHARACTERISTIC /end REF_CHARACTERISTIC /begin REF_MEASUREMENT EcuTMeas.DiagcStsLimdTPrfmnc.Logl /end REF_MEASUREMENT /end GROUP
/begin GROUP EcuTMeas.EcuT.Val "MICROSAR RTE" /begin SUB_GROUP /end SUB_GROUP /begin FUNCTION_LIST /end FUNCTION_LIST /begin REF_CHARACTERISTIC /end REF_CHARACTERISTIC /begin REF_MEASUREMENT EcuTMeas.EcuT.Val /end REF_MEASUREMENT /end GROUP
/begin GROUP EcuTMeas.EcuTAdcFaild.Logl "MICROSAR RTE" /begin SUB_GROUP /end SUB_GROUP /begin FUNCTION_LIST /end FUNCTION_LIST /begin REF_CHARACTERISTIC /end REF_CHARACTERISTIC /begin REF_MEASUREMENT EcuTMeas.EcuTAdcFaild.Logl /end REF_MEASUREMENT /end GROUP
/begin GROUP EcuTMeas.EcuTFild.Val "MICROSAR RTE" /begin SUB_GROUP /end SUB_GROUP /begin FUNCTION_LIST /end FUNCTION_LIST /begin REF_CHARACTERISTIC /end REF_CHARACTERISTIC /begin REF_MEASUREMENT EcuTMeas.EcuTFild.Val /end REF_MEASUREMENT /end GROUP
/begin GROUP EcuTMeas.EcuTMeasDftT.Val "MICROSAR RTE" /begin SUB_GROUP /end SUB_GROUP /begin FUNCTION_LIST /end FUNCTION_LIST /begin REF_CHARACTERISTIC EcuTMeas.EcuTMeasDftT.Val /end REF_CHARACTERISTIC /begin REF_MEASUREMENT /end REF_MEASUREMENT /end GROUP
/begin GROUP EcuTMeas.EcuTMeasFilStVarPrev "MICROSAR RTE" /begin SUB_GROUP /end SUB_GROUP /begin FUNCTION_LIST /end FUNCTION_LIST /begin REF_CHARACTERISTIC /end REF_CHARACTERISTIC
 /begin REF_MEASUREMENT EcuTMeas.EcuTMeasFilStVarPrev.FilGain EcuTMeas.EcuTMeasFilStVarPrev.FilSt /end REF_MEASUREMENT
/end GROUP
/begin GROUP EcuTMeas.EcuTMeasFilTau.Val "MICROSAR RTE" /begin SUB_GROUP /end SUB_GROUP /begin FUNCTION_LIST /end FUNCTION_LIST /begin REF_CHARACTERISTIC EcuTMeas.EcuTMeasFilTau.Val /end REF_CHARACTERISTIC /begin REF_MEASUREMENT /end REF_MEASUREMENT /end GROUP
/begin GROUP EcuTMeas.EcuTMeasNtc0x045FailStep.Val "MICROSAR RTE" /begin SUB_GROUP /end SUB_GROUP /begin FUNCTION_LIST /end FUNCTION_LIST /begin REF_CHARACTERISTIC EcuTMeas.EcuTMeasNtc0x045FailStep.Val /end REF_CHARACTERISTIC /begin REF_MEASUREMENT /end REF_MEASUREMENT /end GROUP
/begin GROUP EcuTMeas.EcuTMeasNtc0x045PassStep.Val "MICROSAR RTE" /begin SUB_GROUP /end SUB_GROUP /begin FUNCTION_LIST /end FUNCTION_LIST /begin REF_CHARACTERISTIC EcuTMeas.EcuTMeasNtc0x045PassStep.Val /end REF_CHARACTERISTIC /begin REF_MEASUREMENT /end REF_MEASUREMENT /end GROUP
/begin GROUP EcuTMeas.EcuTMeasRngDiagcMax.Val "MICROSAR RTE" /begin SUB_GROUP /end SUB_GROUP /begin FUNCTION_LIST /end FUNCTION_LIST /begin REF_CHARACTERISTIC EcuTMeas.EcuTMeasRngDiagcMax.Val /end REF_CHARACTERISTIC /begin REF_MEASUREMENT /end REF_MEASUREMENT /end GROUP
/begin GROUP EcuTMeas.EcuTMeasRngDiagcMin.Val "MICROSAR RTE" /begin SUB_GROUP /end SUB_GROUP /begin FUNCTION_LIST /end FUNCTION_LIST /begin REF_CHARACTERISTIC EcuTMeas.EcuTMeasRngDiagcMin.Val /end REF_CHARACTERISTIC /begin REF_MEASUREMENT /end REF_MEASUREMENT /end GROUP
/begin GROUP EcuTMeas.EcuTMeasScag.Val "MICROSAR RTE" /begin SUB_GROUP /end SUB_GROUP /begin FUNCTION_LIST /end FUNCTION_LIST /begin REF_CHARACTERISTIC EcuTMeas.EcuTMeasScag.Val /end REF_CHARACTERISTIC /begin REF_MEASUREMENT /end REF_MEASUREMENT /end GROUP
/begin GROUP EcuTMeas.EcuTMeasScagOffs.Val "MICROSAR RTE" /begin SUB_GROUP /end SUB_GROUP /begin FUNCTION_LIST /end FUNCTION_LIST /begin REF_CHARACTERISTIC EcuTMeas.EcuTMeasScagOffs.Val /end REF_CHARACTERISTIC /begin REF_MEASUREMENT /end REF_MEASUREMENT /end GROUP
/begin GROUP EcuTMeas.PerInstanceMemories "MICROSAR RTE" /begin SUB_GROUP EcuTMeas.EcuTMeasFilStVarPrev /end SUB_GROUP /begin FUNCTION_LIST /end FUNCTION_LIST /begin REF_CHARACTERISTIC /end REF_CHARACTERISTIC /begin REF_MEASUREMENT /end REF_MEASUREMENT /end GROUP
/begin GROUP EcuTMeas.ReceiverPorts "MICROSAR RTE"
 /begin SUB_GROUP EcuTMeas.DiagcStsLimdTPrfmnc.Logl EcuTMeas.EcuT.Val EcuTMeas.EcuTAdcFaild.Logl /end SUB_GROUP
 /begin FUNCTION_LIST /end FUNCTION_LIST
 /begin REF_CHARACTERISTIC /end REF_CHARACTERISTIC
 /begin REF_MEASUREMENT /end REF_MEASUREMENT
/end GROUP
/begin GROUP EcuTMeas.SenderPorts "MICROSAR RTE" /begin SUB_GROUP EcuTMeas.EcuTFild.Val /end SUB_GROUP /begin FUNCTION_LIST /end FUNCTION_LIST /begin REF_CHARACTERISTIC /end REF_CHARACTERISTIC /begin REF_MEASUREMENT /end REF_MEASUREMENT /end GROUP
/begin GROUP ElecPwrCns "MICROSAR RTE"
 /begin SUB_GROUP ElecPwrCns.CalibrationPorts ElecPwrCns.PerInstanceMemories ElecPwrCns.ReceiverPorts ElecPwrCns.SenderPorts /end SUB_GROUP
 /begin FUNCTION_LIST /end FUNCTION_LIST
 /begin REF_CHARACTERISTIC /end REF_CHARACTERISTIC
 /begin REF_MEASUREMENT /end REF_MEASUREMENT
/end GROUP
/begin GROUP ElecPwrCns.BrdgVltg.Val "MICROSAR RTE" /begin SUB_GROUP /end SUB_GROUP /begin FUNCTION_LIST /end FUNCTION_LIST /begin REF_CHARACTERISTIC /end REF_CHARACTERISTIC /begin REF_MEASUREMENT ElecPwrCns.BrdgVltg.Val /end REF_MEASUREMENT /end GROUP
/begin GROUP ElecPwrCns.CalibrationPorts "MICROSAR RTE"
 /begin SUB_GROUP ElecPwrCns.ElecPwrCnsCtrlrInpR.Val ElecPwrCns.ElecPwrCnsPrstcPwrLoss.Val /end SUB_GROUP
 /begin FUNCTION_LIST /end FUNCTION_LIST
 /begin REF_CHARACTERISTIC /end REF_CHARACTERISTIC
 /begin REF_MEASUREMENT /end REF_MEASUREMENT
/end GROUP
/begin GROUP ElecPwrCns.CurrMeasLoaMtgtnEna.Logl "MICROSAR RTE" /begin SUB_GROUP /end SUB_GROUP /begin FUNCTION_LIST /end FUNCTION_LIST /begin REF_CHARACTERISTIC /end REF_CHARACTERISTIC /begin REF_MEASUREMENT ElecPwrCns.CurrMeasLoaMtgtnEna.Logl /end REF_MEASUREMENT /end GROUP
/begin GROUP ElecPwrCns.ElecInpPwrEstim.Val "MICROSAR RTE" /begin SUB_GROUP /end SUB_GROUP /begin FUNCTION_LIST /end FUNCTION_LIST /begin REF_CHARACTERISTIC /end REF_CHARACTERISTIC /begin REF_MEASUREMENT ElecPwrCns.ElecInpPwrEstim.Val /end REF_MEASUREMENT /end GROUP
/begin GROUP ElecPwrCns.ElecPwrCnsCtrlrInpR.Val "MICROSAR RTE" /begin SUB_GROUP /end SUB_GROUP /begin FUNCTION_LIST /end FUNCTION_LIST /begin REF_CHARACTERISTIC ElecPwrCns.ElecPwrCnsCtrlrInpR.Val /end REF_CHARACTERISTIC /begin REF_MEASUREMENT /end REF_MEASUREMENT /end GROUP
/begin GROUP ElecPwrCns.ElecPwrCnsPrstcPwrLoss.Val "MICROSAR RTE" /begin SUB_GROUP /end SUB_GROUP /begin FUNCTION_LIST /end FUNCTION_LIST /begin REF_CHARACTERISTIC ElecPwrCns.ElecPwrCnsPrstcPwrLoss.Val /end REF_CHARACTERISTIC /begin REF_MEASUREMENT /end REF_MEASUREMENT /end GROUP
/begin GROUP ElecPwrCns.IvtrLoaMtgtnEna.Logl "MICROSAR RTE" /begin SUB_GROUP /end SUB_GROUP /begin FUNCTION_LIST /end FUNCTION_LIST /begin REF_CHARACTERISTIC /end REF_CHARACTERISTIC /begin REF_MEASUREMENT ElecPwrCns.IvtrLoaMtgtnEna.Logl /end REF_MEASUREMENT /end GROUP
/begin GROUP ElecPwrCns.MotCtrlMotCurrDax.Val "MICROSAR RTE" /begin SUB_GROUP /end SUB_GROUP /begin FUNCTION_LIST /end FUNCTION_LIST /begin REF_CHARACTERISTIC /end REF_CHARACTERISTIC /begin REF_MEASUREMENT ElecPwrCns.MotCtrlMotCurrDax.Val /end REF_MEASUREMENT /end GROUP
/begin GROUP ElecPwrCns.MotCtrlMotCurrQax.Val "MICROSAR RTE" /begin SUB_GROUP /end SUB_GROUP /begin FUNCTION_LIST /end FUNCTION_LIST /begin REF_CHARACTERISTIC /end REF_CHARACTERISTIC /begin REF_MEASUREMENT ElecPwrCns.MotCtrlMotCurrQax.Val /end REF_MEASUREMENT /end GROUP
/begin GROUP ElecPwrCns.MotCtrlMotVltgDax.Val "MICROSAR RTE" /begin SUB_GROUP /end SUB_GROUP /begin FUNCTION_LIST /end FUNCTION_LIST /begin REF_CHARACTERISTIC /end REF_CHARACTERISTIC /begin REF_MEASUREMENT ElecPwrCns.MotCtrlMotVltgDax.Val /end REF_MEASUREMENT /end GROUP
/begin GROUP ElecPwrCns.MotCtrlMotVltgQax.Val "MICROSAR RTE" /begin SUB_GROUP /end SUB_GROUP /begin FUNCTION_LIST /end FUNCTION_LIST /begin REF_CHARACTERISTIC /end REF_CHARACTERISTIC /begin REF_MEASUREMENT ElecPwrCns.MotCtrlMotVltgQax.Val /end REF_MEASUREMENT /end GROUP
/begin GROUP ElecPwrCns.MotCurrDaxCmd.Val "MICROSAR RTE" /begin SUB_GROUP /end SUB_GROUP /begin FUNCTION_LIST /end FUNCTION_LIST /begin REF_CHARACTERISTIC /end REF_CHARACTERISTIC /begin REF_MEASUREMENT ElecPwrCns.MotCurrDaxCmd.Val /end REF_MEASUREMENT /end GROUP
/begin GROUP ElecPwrCns.MotCurrQaxCmd.Val "MICROSAR RTE" /begin SUB_GROUP /end SUB_GROUP /begin FUNCTION_LIST /end FUNCTION_LIST /begin REF_CHARACTERISTIC /end REF_CHARACTERISTIC /begin REF_MEASUREMENT ElecPwrCns.MotCurrQaxCmd.Val /end REF_MEASUREMENT /end GROUP
/begin GROUP ElecPwrCns.PerInstanceMemories "MICROSAR RTE"
 /begin SUB_GROUP ElecPwrCns.dElecPwrCnsDrpInpPwr ElecPwrCns.dElecPwrCnsModInpPwr ElecPwrCns.dElecPwrCnsMotCurrDaxEstim ElecPwrCns.dElecPwrCnsMotCurrQaxEstim /end SUB_GROUP
 /begin FUNCTION_LIST /end FUNCTION_LIST
 /begin REF_CHARACTERISTIC /end REF_CHARACTERISTIC
 /begin REF_MEASUREMENT /end REF_MEASUREMENT
/end GROUP
/begin GROUP ElecPwrCns.ReceiverPorts "MICROSAR RTE"
 /begin SUB_GROUP ElecPwrCns.BrdgVltg.Val ElecPwrCns.CurrMeasLoaMtgtnEna.Logl ElecPwrCns.IvtrLoaMtgtnEna.Logl ElecPwrCns.MotCtrlMotCurrDax.Val ElecPwrCns.MotCtrlMotCurrQax.Val ElecPwrCns.MotCtrlMotVltgDax.Val ElecPwrCns.MotCtrlMotVltgQax.Val ElecPwrCns.MotCurrDaxCmd.Val ElecPwrCns.MotCurrQaxCmd.Val /end SUB_GROUP
 /begin FUNCTION_LIST /end FUNCTION_LIST
 /begin REF_CHARACTERISTIC /end REF_CHARACTERISTIC
 /begin REF_MEASUREMENT /end REF_MEASUREMENT
/end GROUP
/begin GROUP ElecPwrCns.SenderPorts "MICROSAR RTE"
 /begin SUB_GROUP ElecPwrCns.ElecInpPwrEstim.Val ElecPwrCns.SplyCurrEstim.Val /end SUB_GROUP
 /begin FUNCTION_LIST /end FUNCTION_LIST
 /begin REF_CHARACTERISTIC /end REF_CHARACTERISTIC
 /begin REF_MEASUREMENT /end REF_MEASUREMENT
/end GROUP
/begin GROUP ElecPwrCns.SplyCurrEstim.Val "MICROSAR RTE" /begin SUB_GROUP /end SUB_GROUP /begin FUNCTION_LIST /end FUNCTION_LIST /begin REF_CHARACTERISTIC /end REF_CHARACTERISTIC /begin REF_MEASUREMENT ElecPwrCns.SplyCurrEstim.Val /end REF_MEASUREMENT /end GROUP
/begin GROUP ElecPwrCns.dElecPwrCnsDrpInpPwr "MICROSAR RTE" /begin SUB_GROUP /end SUB_GROUP /begin FUNCTION_LIST /end FUNCTION_LIST /begin REF_CHARACTERISTIC /end REF_CHARACTERISTIC /begin REF_MEASUREMENT ElecPwrCns.dElecPwrCnsDrpInpPwr /end REF_MEASUREMENT /end GROUP
/begin GROUP ElecPwrCns.dElecPwrCnsModInpPwr "MICROSAR RTE" /begin SUB_GROUP /end SUB_GROUP /begin FUNCTION_LIST /end FUNCTION_LIST /begin REF_CHARACTERISTIC /end REF_CHARACTERISTIC /begin REF_MEASUREMENT ElecPwrCns.dElecPwrCnsModInpPwr /end REF_MEASUREMENT /end GROUP
/begin GROUP ElecPwrCns.dElecPwrCnsMotCurrDaxEstim "MICROSAR RTE" /begin SUB_GROUP /end SUB_GROUP /begin FUNCTION_LIST /end FUNCTION_LIST /begin REF_CHARACTERISTIC /end REF_CHARACTERISTIC /begin REF_MEASUREMENT ElecPwrCns.dElecPwrCnsMotCurrDaxEstim /end REF_MEASUREMENT /end GROUP
/begin GROUP ElecPwrCns.dElecPwrCnsMotCurrQaxEstim "MICROSAR RTE" /begin SUB_GROUP /end SUB_GROUP /begin FUNCTION_LIST /end FUNCTION_LIST /begin REF_CHARACTERISTIC /end REF_CHARACTERISTIC /begin REF_MEASUREMENT ElecPwrCns.dElecPwrCnsMotCurrQaxEstim /end REF_MEASUREMENT /end GROUP
/begin GROUP EotLrng "MICROSAR RTE"
 /begin SUB_GROUP EotLrng.CalibrationParameters EotLrng.CalibrationPorts EotLrng.PerInstanceMemories EotLrng.ReceiverPorts EotLrng.SenderPorts /end SUB_GROUP
 /begin FUNCTION_LIST /end FUNCTION_LIST
 /begin REF_CHARACTERISTIC /end REF_CHARACTERISTIC
 /begin REF_MEASUREMENT /end REF_MEASUREMENT
/end GROUP
/begin GROUP EotLrng.CalibrationParameters "MICROSAR RTE" /begin SUB_GROUP EotLrng.EotNvmDataDft /end SUB_GROUP /begin FUNCTION_LIST /end FUNCTION_LIST /begin REF_CHARACTERISTIC /end REF_CHARACTERISTIC /begin REF_MEASUREMENT /end REF_MEASUREMENT /end GROUP
/begin GROUP EotLrng.CalibrationPorts "MICROSAR RTE"
 /begin SUB_GROUP EotLrng.EotLrngAuthyStrtLrn.Val EotLrng.EotLrngEotLrnTmr.Val EotLrng.EotLrngHwAgOverTrvlCnt.Val EotLrng.EotLrngHwAgOverTrvlEntr.Val EotLrng.EotLrngHwAgOverTrvlExit.Val EotLrng.EotLrngHwTqEotLrn.Val EotLrng.EotLrngMotVelEotLrn.Val EotLrng.EotLrngRackTrvlMax.Val EotLrng.EotLrngRackTrvlMin.Val EotLrng.EotLrngRstAuthyMin.Val EotLrng.EotProtnRackTrvlLimrEna.Logl /end SUB_GROUP
 /begin FUNCTION_LIST /end FUNCTION_LIST
 /begin REF_CHARACTERISTIC /end REF_CHARACTERISTIC
 /begin REF_MEASUREMENT /end REF_MEASUREMENT
/end GROUP
/begin GROUP EotLrng.CcwEotRefTmr "MICROSAR RTE" /begin SUB_GROUP /end SUB_GROUP /begin FUNCTION_LIST /end FUNCTION_LIST /begin REF_CHARACTERISTIC /end REF_CHARACTERISTIC /begin REF_MEASUREMENT EotLrng.CcwEotRefTmr /end REF_MEASUREMENT /end GROUP
/begin GROUP EotLrng.CwEotRefTmr "MICROSAR RTE" /begin SUB_GROUP /end SUB_GROUP /begin FUNCTION_LIST /end FUNCTION_LIST /begin REF_CHARACTERISTIC /end REF_CHARACTERISTIC /begin REF_MEASUREMENT EotLrng.CwEotRefTmr /end REF_MEASUREMENT /end GROUP
/begin GROUP EotLrng.EotLrngAuthyStrtLrn.Val "MICROSAR RTE" /begin SUB_GROUP /end SUB_GROUP /begin FUNCTION_LIST /end FUNCTION_LIST /begin REF_CHARACTERISTIC EotLrng.EotLrngAuthyStrtLrn.Val /end REF_CHARACTERISTIC /begin REF_MEASUREMENT /end REF_MEASUREMENT /end GROUP
/begin GROUP EotLrng.EotLrngEotLrnTmr.Val "MICROSAR RTE" /begin SUB_GROUP /end SUB_GROUP /begin FUNCTION_LIST /end FUNCTION_LIST /begin REF_CHARACTERISTIC EotLrng.EotLrngEotLrnTmr.Val /end REF_CHARACTERISTIC /begin REF_MEASUREMENT /end REF_MEASUREMENT /end GROUP
/begin GROUP EotLrng.EotLrngHwAgOverTrvlCnt.Val "MICROSAR RTE" /begin SUB_GROUP /end SUB_GROUP /begin FUNCTION_LIST /end FUNCTION_LIST /begin REF_CHARACTERISTIC EotLrng.EotLrngHwAgOverTrvlCnt.Val /end REF_CHARACTERISTIC /begin REF_MEASUREMENT /end REF_MEASUREMENT /end GROUP
/begin GROUP EotLrng.EotLrngHwAgOverTrvlEntr.Val "MICROSAR RTE" /begin SUB_GROUP /end SUB_GROUP /begin FUNCTION_LIST /end FUNCTION_LIST /begin REF_CHARACTERISTIC EotLrng.EotLrngHwAgOverTrvlEntr.Val /end REF_CHARACTERISTIC /begin REF_MEASUREMENT /end REF_MEASUREMENT /end GROUP
/begin GROUP EotLrng.EotLrngHwAgOverTrvlExit.Val "MICROSAR RTE" /begin SUB_GROUP /end SUB_GROUP /begin FUNCTION_LIST /end FUNCTION_LIST /begin REF_CHARACTERISTIC EotLrng.EotLrngHwAgOverTrvlExit.Val /end REF_CHARACTERISTIC /begin REF_MEASUREMENT /end REF_MEASUREMENT /end GROUP
/begin GROUP EotLrng.EotLrngHwTqEotLrn.Val "MICROSAR RTE" /begin SUB_GROUP /end SUB_GROUP /begin FUNCTION_LIST /end FUNCTION_LIST /begin REF_CHARACTERISTIC EotLrng.EotLrngHwTqEotLrn.Val /end REF_CHARACTERISTIC /begin REF_MEASUREMENT /end REF_MEASUREMENT /end GROUP
/begin GROUP EotLrng.EotLrngMotVelEotLrn.Val "MICROSAR RTE" /begin SUB_GROUP /end SUB_GROUP /begin FUNCTION_LIST /end FUNCTION_LIST /begin REF_CHARACTERISTIC EotLrng.EotLrngMotVelEotLrn.Val /end REF_CHARACTERISTIC /begin REF_MEASUREMENT /end REF_MEASUREMENT /end GROUP
/begin GROUP EotLrng.EotLrngRackTrvlMax.Val "MICROSAR RTE" /begin SUB_GROUP /end SUB_GROUP /begin FUNCTION_LIST /end FUNCTION_LIST /begin REF_CHARACTERISTIC EotLrng.EotLrngRackTrvlMax.Val /end REF_CHARACTERISTIC /begin REF_MEASUREMENT /end REF_MEASUREMENT /end GROUP
/begin GROUP EotLrng.EotLrngRackTrvlMin.Val "MICROSAR RTE" /begin SUB_GROUP /end SUB_GROUP /begin FUNCTION_LIST /end FUNCTION_LIST /begin REF_CHARACTERISTIC EotLrng.EotLrngRackTrvlMin.Val /end REF_CHARACTERISTIC /begin REF_MEASUREMENT /end REF_MEASUREMENT /end GROUP
/begin GROUP EotLrng.EotLrngRstAuthyMin.Val "MICROSAR RTE" /begin SUB_GROUP /end SUB_GROUP /begin FUNCTION_LIST /end FUNCTION_LIST /begin REF_CHARACTERISTIC EotLrng.EotLrngRstAuthyMin.Val /end REF_CHARACTERISTIC /begin REF_MEASUREMENT /end REF_MEASUREMENT /end GROUP
/begin GROUP EotLrng.EotNvmData "MICROSAR RTE" /begin SUB_GROUP /end SUB_GROUP /begin FUNCTION_LIST /end FUNCTION_LIST /begin REF_CHARACTERISTIC /end REF_CHARACTERISTIC
 /begin REF_MEASUREMENT EotLrng.EotNvmData.CcwEot EotLrng.EotNvmData.CcwEotDetd EotLrng.EotNvmData.CwEot EotLrng.EotNvmData.CwEotDetd /end REF_MEASUREMENT
/end GROUP
/begin GROUP EotLrng.EotNvmDataDft "MICROSAR RTE" /begin SUB_GROUP /end SUB_GROUP /begin FUNCTION_LIST /end FUNCTION_LIST
 /begin REF_CHARACTERISTIC EotLrng.EotNvmDataDft.CcwEot EotLrng.EotNvmDataDft.CcwEotDetd EotLrng.EotNvmDataDft.CwEot EotLrng.EotNvmDataDft.CwEotDetd /end REF_CHARACTERISTIC
 /begin REF_MEASUREMENT /end REF_MEASUREMENT
/end GROUP
/begin GROUP EotLrng.EotProtnRackTrvlLimrEna.Logl "MICROSAR RTE" /begin SUB_GROUP /end SUB_GROUP /begin FUNCTION_LIST /end FUNCTION_LIST /begin REF_CHARACTERISTIC EotLrng.EotProtnRackTrvlLimrEna.Logl /end REF_CHARACTERISTIC /begin REF_MEASUREMENT /end REF_MEASUREMENT /end GROUP
/begin GROUP EotLrng.HwAg.Val "MICROSAR RTE" /begin SUB_GROUP /end SUB_GROUP /begin FUNCTION_LIST /end FUNCTION_LIST /begin REF_CHARACTERISTIC /end REF_CHARACTERISTIC /begin REF_MEASUREMENT EotLrng.HwAg.Val /end REF_MEASUREMENT /end GROUP
/begin GROUP EotLrng.HwAgAuthy.Val "MICROSAR RTE" /begin SUB_GROUP /end SUB_GROUP /begin FUNCTION_LIST /end FUNCTION_LIST /begin REF_CHARACTERISTIC /end REF_CHARACTERISTIC /begin REF_MEASUREMENT EotLrng.HwAgAuthy.Val /end REF_MEASUREMENT /end GROUP
/begin GROUP EotLrng.HwAgCcwDetd.Logl "MICROSAR RTE" /begin SUB_GROUP /end SUB_GROUP /begin FUNCTION_LIST /end FUNCTION_LIST /begin REF_CHARACTERISTIC /end REF_CHARACTERISTIC /begin REF_MEASUREMENT EotLrng.HwAgCcwDetd.Logl /end REF_MEASUREMENT /end GROUP
/begin GROUP EotLrng.HwAgCwDetd.Logl "MICROSAR RTE" /begin SUB_GROUP /end SUB_GROUP /begin FUNCTION_LIST /end FUNCTION_LIST /begin REF_CHARACTERISTIC /end REF_CHARACTERISTIC /begin REF_MEASUREMENT EotLrng.HwAgCwDetd.Logl /end REF_MEASUREMENT /end GROUP
/begin GROUP EotLrng.HwAgDiDiagSts.Logl "MICROSAR RTE" /begin SUB_GROUP /end SUB_GROUP /begin FUNCTION_LIST /end FUNCTION_LIST /begin REF_CHARACTERISTIC /end REF_CHARACTERISTIC /begin REF_MEASUREMENT EotLrng.HwAgDiDiagSts.Logl /end REF_MEASUREMENT /end GROUP
/begin GROUP EotLrng.HwAgEotCcw.Val "MICROSAR RTE" /begin SUB_GROUP /end SUB_GROUP /begin FUNCTION_LIST /end FUNCTION_LIST /begin REF_CHARACTERISTIC /end REF_CHARACTERISTIC /begin REF_MEASUREMENT EotLrng.HwAgEotCcw.Val /end REF_MEASUREMENT /end GROUP
/begin GROUP EotLrng.HwAgEotCw.Val "MICROSAR RTE" /begin SUB_GROUP /end SUB_GROUP /begin FUNCTION_LIST /end FUNCTION_LIST /begin REF_CHARACTERISTIC /end REF_CHARACTERISTIC /begin REF_MEASUREMENT EotLrng.HwAgEotCw.Val /end REF_MEASUREMENT /end GROUP
/begin GROUP EotLrng.HwAgEotSig0Avl.Logl "MICROSAR RTE" /begin SUB_GROUP /end SUB_GROUP /begin FUNCTION_LIST /end FUNCTION_LIST /begin REF_CHARACTERISTIC /end REF_CHARACTERISTIC /begin REF_MEASUREMENT EotLrng.HwAgEotSig0Avl.Logl /end REF_MEASUREMENT /end GROUP
/begin GROUP EotLrng.HwAgEotSig0Ccw.Val "MICROSAR RTE" /begin SUB_GROUP /end SUB_GROUP /begin FUNCTION_LIST /end FUNCTION_LIST /begin REF_CHARACTERISTIC /end REF_CHARACTERISTIC /begin REF_MEASUREMENT EotLrng.HwAgEotSig0Ccw.Val /end REF_MEASUREMENT /end GROUP
/begin GROUP EotLrng.HwAgEotSig0Cw.Val "MICROSAR RTE" /begin SUB_GROUP /end SUB_GROUP /begin FUNCTION_LIST /end FUNCTION_LIST /begin REF_CHARACTERISTIC /end REF_CHARACTERISTIC /begin REF_MEASUREMENT EotLrng.HwAgEotSig0Cw.Val /end REF_MEASUREMENT /end GROUP
/begin GROUP EotLrng.HwAgEotSig1Avl.Logl "MICROSAR RTE" /begin SUB_GROUP /end SUB_GROUP /begin FUNCTION_LIST /end FUNCTION_LIST /begin REF_CHARACTERISTIC /end REF_CHARACTERISTIC /begin REF_MEASUREMENT EotLrng.HwAgEotSig1Avl.Logl /end REF_MEASUREMENT /end GROUP
/begin GROUP EotLrng.HwAgEotSig1Ccw.Val "MICROSAR RTE" /begin SUB_GROUP /end SUB_GROUP /begin FUNCTION_LIST /end FUNCTION_LIST /begin REF_CHARACTERISTIC /end REF_CHARACTERISTIC /begin REF_MEASUREMENT EotLrng.HwAgEotSig1Ccw.Val /end REF_MEASUREMENT /end GROUP
/begin GROUP EotLrng.HwAgEotSig1Cw.Val "MICROSAR RTE" /begin SUB_GROUP /end SUB_GROUP /begin FUNCTION_LIST /end FUNCTION_LIST /begin REF_CHARACTERISTIC /end REF_CHARACTERISTIC /begin REF_MEASUREMENT EotLrng.HwAgEotSig1Cw.Val /end REF_MEASUREMENT /end GROUP
/begin GROUP EotLrng.HwAgOverTrvlCntrDi "MICROSAR RTE" /begin SUB_GROUP /end SUB_GROUP /begin FUNCTION_LIST /end FUNCTION_LIST /begin REF_CHARACTERISTIC /end REF_CHARACTERISTIC /begin REF_MEASUREMENT EotLrng.HwAgOverTrvlCntrDi /end REF_MEASUREMENT /end GROUP
/begin GROUP EotLrng.HwTq.Val "MICROSAR RTE" /begin SUB_GROUP /end SUB_GROUP /begin FUNCTION_LIST /end FUNCTION_LIST /begin REF_CHARACTERISTIC /end REF_CHARACTERISTIC /begin REF_MEASUREMENT EotLrng.HwTq.Val /end REF_MEASUREMENT /end GROUP
/begin GROUP EotLrng.MaxHwAgCwAndCcw "MICROSAR RTE" /begin SUB_GROUP /end SUB_GROUP /begin FUNCTION_LIST /end FUNCTION_LIST /begin REF_CHARACTERISTIC /end REF_CHARACTERISTIC
 /begin REF_MEASUREMENT EotLrng.MaxHwAgCwAndCcw.HwAgCcwMax EotLrng.MaxHwAgCwAndCcw.HwAgCwMax EotLrng.MaxHwAgCwAndCcw.HwAgOverTrvlCnt /end REF_MEASUREMENT
/end GROUP
/begin GROUP EotLrng.MotVelCrf.Val "MICROSAR RTE" /begin SUB_GROUP /end SUB_GROUP /begin FUNCTION_LIST /end FUNCTION_LIST /begin REF_CHARACTERISTIC /end REF_CHARACTERISTIC /begin REF_MEASUREMENT EotLrng.MotVelCrf.Val /end REF_MEASUREMENT /end GROUP
/begin GROUP EotLrng.PerInstanceMemories "MICROSAR RTE"
 /begin SUB_GROUP EotLrng.CcwEotRefTmr EotLrng.CwEotRefTmr EotLrng.EotNvmData EotLrng.HwAgOverTrvlCntrDi EotLrng.MaxHwAgCwAndCcw EotLrng.PrevCcwEot EotLrng.PrevCwEot EotLrng.RstLimReq /end SUB_GROUP
 /begin FUNCTION_LIST /end FUNCTION_LIST
 /begin REF_CHARACTERISTIC /end REF_CHARACTERISTIC
 /begin REF_MEASUREMENT /end REF_MEASUREMENT
/end GROUP
/begin GROUP EotLrng.PrevCcwEot "MICROSAR RTE" /begin SUB_GROUP /end SUB_GROUP /begin FUNCTION_LIST /end FUNCTION_LIST /begin REF_CHARACTERISTIC /end REF_CHARACTERISTIC /begin REF_MEASUREMENT EotLrng.PrevCcwEot /end REF_MEASUREMENT /end GROUP
/begin GROUP EotLrng.PrevCwEot "MICROSAR RTE" /begin SUB_GROUP /end SUB_GROUP /begin FUNCTION_LIST /end FUNCTION_LIST /begin REF_CHARACTERISTIC /end REF_CHARACTERISTIC /begin REF_MEASUREMENT EotLrng.PrevCwEot /end REF_MEASUREMENT /end GROUP
/begin GROUP EotLrng.ReceiverPorts "MICROSAR RTE"
 /begin SUB_GROUP EotLrng.HwAg.Val EotLrng.HwAgAuthy.Val EotLrng.HwAgDiDiagSts.Logl EotLrng.HwAgEotSig0Avl.Logl EotLrng.HwAgEotSig0Ccw.Val EotLrng.HwAgEotSig0Cw.Val EotLrng.HwAgEotSig1Avl.Logl EotLrng.HwAgEotSig1Ccw.Val EotLrng.HwAgEotSig1Cw.Val EotLrng.HwTq.Val EotLrng.MotVelCrf.Val /end SUB_GROUP
 /begin FUNCTION_LIST /end FUNCTION_LIST
 /begin REF_CHARACTERISTIC /end REF_CHARACTERISTIC
 /begin REF_MEASUREMENT /end REF_MEASUREMENT
/end GROUP
/begin GROUP EotLrng.RstLimReq "MICROSAR RTE" /begin SUB_GROUP /end SUB_GROUP /begin FUNCTION_LIST /end FUNCTION_LIST /begin REF_CHARACTERISTIC /end REF_CHARACTERISTIC /begin REF_MEASUREMENT EotLrng.RstLimReq /end REF_MEASUREMENT /end GROUP
/begin GROUP EotLrng.SenderPorts "MICROSAR RTE"
 /begin SUB_GROUP EotLrng.HwAgCcwDetd.Logl EotLrng.HwAgCwDetd.Logl EotLrng.HwAgEotCcw.Val EotLrng.HwAgEotCw.Val /end SUB_GROUP
 /begin FUNCTION_LIST /end FUNCTION_LIST
 /begin REF_CHARACTERISTIC /end REF_CHARACTERISTIC
 /begin REF_MEASUREMENT /end REF_MEASUREMENT
/end GROUP
/begin GROUP EotProtn "MICROSAR RTE"
 /begin SUB_GROUP EotProtn.CalibrationPorts EotProtn.PerInstanceMemories EotProtn.ReceiverPorts EotProtn.SenderPorts /end SUB_GROUP
 /begin FUNCTION_LIST /end FUNCTION_LIST
 /begin REF_CHARACTERISTIC /end REF_CHARACTERISTIC
 /begin REF_MEASUREMENT /end REF_MEASUREMENT
/end GROUP
/begin GROUP EotProtn.CalibrationPorts "MICROSAR RTE"
 /begin SUB_GROUP EotProtn.EotProtnActvRegnBypMaxThd.Val EotProtn.EotProtnDampgSlew.Val EotProtn.EotProtnDampgVehSpdTbl.Ary1D EotProtn.EotProtnDeltaTqThd.Val EotProtn.EotProtnDftPosn.Val EotProtn.EotProtnEntrGainVehSpdTbl.Ary1D EotProtn.EotProtnEntrGainX.Ary2D EotProtn.EotProtnEntrGainY.Ary2D EotProtn.EotProtnEntrStLpFilFrq.Val EotProtn.EotProtnExitDampgY.Ary2D EotProtn.EotProtnExitStLpFilFrq.Val EotProtn.EotProtnHwAgGain.Val EotProtn.EotProtnHwAgMax.Val EotProtn.EotProtnHwAgMin.Val EotProtn.EotProtnHwDegDampgX.Ary2D EotProtn.EotProtnHwTqLpFilFrq.Val EotProtn.EotProtnHwTqScaX.Ary1D EotProtn.EotProtnMotSpdIncptSca.Val EotProtn.EotProtnMotSpdIncptX.Ary1D EotProtn.EotProtnMotSpdIncptY.Ary1D EotProtn.EotProtnMotVelGain.Val EotProtn.EotProtnNormDampgY.Ary2D EotProtn.EotProtnPosnRampStep.Val EotProtn.EotProtnRackTrvlLimrAuthyThd.Val EotProtn.EotProtnRackTrvlLimrAuthyThdLimd.Val EotProtn.EotProtnRackTrvlLimrEna.Logl EotProtn.EotProtnRackTrvlLimrRng.Val EotProtn.EotProtnRackTrvlLimrRngLimd.Val EotProtn.EotProtnRackTrvlLimrVehSpdThd.Val EotProtn.EotProtnRunEotVelImpctAndSoftEndStop.Logl EotProtn.EotProtnSoftEndStopAuthyThd.Val EotProtn.EotProtnSoftEndStopEna.Logl EotProtn.EotProtnSoftEndStopVehSpdThd.Val /end SUB_GROUP
 /begin FUNCTION_LIST /end FUNCTION_LIST
 /begin REF_CHARACTERISTIC /end REF_CHARACTERISTIC
 /begin REF_MEASUREMENT /end REF_MEASUREMENT
/end GROUP
/begin GROUP EotProtn.EotActvCmd.Val "MICROSAR RTE" /begin SUB_GROUP /end SUB_GROUP /begin FUNCTION_LIST /end FUNCTION_LIST /begin REF_CHARACTERISTIC /end REF_CHARACTERISTIC /begin REF_MEASUREMENT EotProtn.EotActvCmd.Val /end REF_MEASUREMENT /end GROUP
/begin GROUP EotProtn.EotAssiSca.Val "MICROSAR RTE" /begin SUB_GROUP /end SUB_GROUP /begin FUNCTION_LIST /end FUNCTION_LIST /begin REF_CHARACTERISTIC /end REF_CHARACTERISTIC /begin REF_MEASUREMENT EotProtn.EotAssiSca.Val /end REF_MEASUREMENT /end GROUP
/begin GROUP EotProtn.EotAssiScaLpFil "MICROSAR RTE" /begin SUB_GROUP /end SUB_GROUP /begin FUNCTION_LIST /end FUNCTION_LIST /begin REF_CHARACTERISTIC /end REF_CHARACTERISTIC
 /begin REF_MEASUREMENT EotProtn.EotAssiScaLpFil.FilGain EotProtn.EotAssiScaLpFil.FilSt /end REF_MEASUREMENT
/end GROUP
/begin GROUP EotProtn.EotDampgCmd.Val "MICROSAR RTE" /begin SUB_GROUP /end SUB_GROUP /begin FUNCTION_LIST /end FUNCTION_LIST /begin REF_CHARACTERISTIC /end REF_CHARACTERISTIC /begin REF_MEASUREMENT EotProtn.EotDampgCmd.Val /end REF_MEASUREMENT /end GROUP
/begin GROUP EotProtn.EotMotTqLim.Val "MICROSAR RTE" /begin SUB_GROUP /end SUB_GROUP /begin FUNCTION_LIST /end FUNCTION_LIST /begin REF_CHARACTERISTIC /end REF_CHARACTERISTIC /begin REF_MEASUREMENT EotProtn.EotMotTqLim.Val /end REF_MEASUREMENT /end GROUP
/begin GROUP EotProtn.EotProtnActvRegnBypMaxThd.Val "MICROSAR RTE" /begin SUB_GROUP /end SUB_GROUP /begin FUNCTION_LIST /end FUNCTION_LIST /begin REF_CHARACTERISTIC EotProtn.EotProtnActvRegnBypMaxThd.Val /end REF_CHARACTERISTIC /begin REF_MEASUREMENT /end REF_MEASUREMENT /end GROUP
/begin GROUP EotProtn.EotProtnDampgSlew.Val "MICROSAR RTE" /begin SUB_GROUP /end SUB_GROUP /begin FUNCTION_LIST /end FUNCTION_LIST /begin REF_CHARACTERISTIC EotProtn.EotProtnDampgSlew.Val /end REF_CHARACTERISTIC /begin REF_MEASUREMENT /end REF_MEASUREMENT /end GROUP
/begin GROUP EotProtn.EotProtnDampgVehSpdTbl.Ary1D "MICROSAR RTE" /begin SUB_GROUP /end SUB_GROUP /begin FUNCTION_LIST /end FUNCTION_LIST /begin REF_CHARACTERISTIC EotProtn.EotProtnDampgVehSpdTbl.Ary1D /end REF_CHARACTERISTIC /begin REF_MEASUREMENT /end REF_MEASUREMENT /end GROUP
/begin GROUP EotProtn.EotProtnDeltaTqThd.Val "MICROSAR RTE" /begin SUB_GROUP /end SUB_GROUP /begin FUNCTION_LIST /end FUNCTION_LIST /begin REF_CHARACTERISTIC EotProtn.EotProtnDeltaTqThd.Val /end REF_CHARACTERISTIC /begin REF_MEASUREMENT /end REF_MEASUREMENT /end GROUP
/begin GROUP EotProtn.EotProtnDftPosn.Val "MICROSAR RTE" /begin SUB_GROUP /end SUB_GROUP /begin FUNCTION_LIST /end FUNCTION_LIST /begin REF_CHARACTERISTIC EotProtn.EotProtnDftPosn.Val /end REF_CHARACTERISTIC /begin REF_MEASUREMENT /end REF_MEASUREMENT /end GROUP
/begin GROUP EotProtn.EotProtnDi.Logl "MICROSAR RTE" /begin SUB_GROUP /end SUB_GROUP /begin FUNCTION_LIST /end FUNCTION_LIST /begin REF_CHARACTERISTIC /end REF_CHARACTERISTIC /begin REF_MEASUREMENT EotProtn.EotProtnDi.Logl /end REF_MEASUREMENT /end GROUP
/begin GROUP EotProtn.EotProtnEntrGainVehSpdTbl.Ary1D "MICROSAR RTE" /begin SUB_GROUP /end SUB_GROUP /begin FUNCTION_LIST /end FUNCTION_LIST /begin REF_CHARACTERISTIC EotProtn.EotProtnEntrGainVehSpdTbl.Ary1D /end REF_CHARACTERISTIC /begin REF_MEASUREMENT /end REF_MEASUREMENT /end GROUP
/begin GROUP EotProtn.EotProtnEntrGainX.Ary2D "MICROSAR RTE" /begin SUB_GROUP /end SUB_GROUP /begin FUNCTION_LIST /end FUNCTION_LIST /begin REF_CHARACTERISTIC EotProtn.EotProtnEntrGainX.Ary2D /end REF_CHARACTERISTIC /begin REF_MEASUREMENT /end REF_MEASUREMENT /end GROUP
/begin GROUP EotProtn.EotProtnEntrGainY.Ary2D "MICROSAR RTE" /begin SUB_GROUP /end SUB_GROUP /begin FUNCTION_LIST /end FUNCTION_LIST /begin REF_CHARACTERISTIC EotProtn.EotProtnEntrGainY.Ary2D /end REF_CHARACTERISTIC /begin REF_MEASUREMENT /end REF_MEASUREMENT /end GROUP
/begin GROUP EotProtn.EotProtnEntrStLpFilFrq.Val "MICROSAR RTE" /begin SUB_GROUP /end SUB_GROUP /begin FUNCTION_LIST /end FUNCTION_LIST /begin REF_CHARACTERISTIC EotProtn.EotProtnEntrStLpFilFrq.Val /end REF_CHARACTERISTIC /begin REF_MEASUREMENT /end REF_MEASUREMENT /end GROUP
/begin GROUP EotProtn.EotProtnExitDampgY.Ary2D "MICROSAR RTE" /begin SUB_GROUP /end SUB_GROUP /begin FUNCTION_LIST /end FUNCTION_LIST /begin REF_CHARACTERISTIC EotProtn.EotProtnExitDampgY.Ary2D /end REF_CHARACTERISTIC /begin REF_MEASUREMENT /end REF_MEASUREMENT /end GROUP
/begin GROUP EotProtn.EotProtnExitStLpFilFrq.Val "MICROSAR RTE" /begin SUB_GROUP /end SUB_GROUP /begin FUNCTION_LIST /end FUNCTION_LIST /begin REF_CHARACTERISTIC EotProtn.EotProtnExitStLpFilFrq.Val /end REF_CHARACTERISTIC /begin REF_MEASUREMENT /end REF_MEASUREMENT /end GROUP
/begin GROUP EotProtn.EotProtnHwAgGain.Val "MICROSAR RTE" /begin SUB_GROUP /end SUB_GROUP /begin FUNCTION_LIST /end FUNCTION_LIST /begin REF_CHARACTERISTIC EotProtn.EotProtnHwAgGain.Val /end REF_CHARACTERISTIC /begin REF_MEASUREMENT /end REF_MEASUREMENT /end GROUP
/begin GROUP EotProtn.EotProtnHwAgMax.Val "MICROSAR RTE" /begin SUB_GROUP /end SUB_GROUP /begin FUNCTION_LIST /end FUNCTION_LIST /begin REF_CHARACTERISTIC EotProtn.EotProtnHwAgMax.Val /end REF_CHARACTERISTIC /begin REF_MEASUREMENT /end REF_MEASUREMENT /end GROUP
/begin GROUP EotProtn.EotProtnHwAgMin.Val "MICROSAR RTE" /begin SUB_GROUP /end SUB_GROUP /begin FUNCTION_LIST /end FUNCTION_LIST /begin REF_CHARACTERISTIC EotProtn.EotProtnHwAgMin.Val /end REF_CHARACTERISTIC /begin REF_MEASUREMENT /end REF_MEASUREMENT /end GROUP
/begin GROUP EotProtn.EotProtnHwDegDampgX.Ary2D "MICROSAR RTE" /begin SUB_GROUP /end SUB_GROUP /begin FUNCTION_LIST /end FUNCTION_LIST /begin REF_CHARACTERISTIC EotProtn.EotProtnHwDegDampgX.Ary2D /end REF_CHARACTERISTIC /begin REF_MEASUREMENT /end REF_MEASUREMENT /end GROUP
/begin GROUP EotProtn.EotProtnHwTqLpFilFrq.Val "MICROSAR RTE" /begin SUB_GROUP /end SUB_GROUP /begin FUNCTION_LIST /end FUNCTION_LIST /begin REF_CHARACTERISTIC EotProtn.EotProtnHwTqLpFilFrq.Val /end REF_CHARACTERISTIC /begin REF_MEASUREMENT /end REF_MEASUREMENT /end GROUP
/begin GROUP EotProtn.EotProtnHwTqScaX.Ary1D "MICROSAR RTE" /begin SUB_GROUP /end SUB_GROUP /begin FUNCTION_LIST /end FUNCTION_LIST /begin REF_CHARACTERISTIC EotProtn.EotProtnHwTqScaX.Ary1D /end REF_CHARACTERISTIC /begin REF_MEASUREMENT /end REF_MEASUREMENT /end GROUP
/begin GROUP EotProtn.EotProtnMotSpdIncptSca.Val "MICROSAR RTE" /begin SUB_GROUP /end SUB_GROUP /begin FUNCTION_LIST /end FUNCTION_LIST /begin REF_CHARACTERISTIC EotProtn.EotProtnMotSpdIncptSca.Val /end REF_CHARACTERISTIC /begin REF_MEASUREMENT /end REF_MEASUREMENT /end GROUP
/begin GROUP EotProtn.EotProtnMotSpdIncptX.Ary1D "MICROSAR RTE" /begin SUB_GROUP /end SUB_GROUP /begin FUNCTION_LIST /end FUNCTION_LIST /begin REF_CHARACTERISTIC EotProtn.EotProtnMotSpdIncptX.Ary1D /end REF_CHARACTERISTIC /begin REF_MEASUREMENT /end REF_MEASUREMENT /end GROUP
/begin GROUP EotProtn.EotProtnMotSpdIncptY.Ary1D "MICROSAR RTE" /begin SUB_GROUP /end SUB_GROUP /begin FUNCTION_LIST /end FUNCTION_LIST /begin REF_CHARACTERISTIC EotProtn.EotProtnMotSpdIncptY.Ary1D /end REF_CHARACTERISTIC /begin REF_MEASUREMENT /end REF_MEASUREMENT /end GROUP
/begin GROUP EotProtn.EotProtnMotVelGain.Val "MICROSAR RTE" /begin SUB_GROUP /end SUB_GROUP /begin FUNCTION_LIST /end FUNCTION_LIST /begin REF_CHARACTERISTIC EotProtn.EotProtnMotVelGain.Val /end REF_CHARACTERISTIC /begin REF_MEASUREMENT /end REF_MEASUREMENT /end GROUP
/begin GROUP EotProtn.EotProtnNormDampgY.Ary2D "MICROSAR RTE" /begin SUB_GROUP /end SUB_GROUP /begin FUNCTION_LIST /end FUNCTION_LIST /begin REF_CHARACTERISTIC EotProtn.EotProtnNormDampgY.Ary2D /end REF_CHARACTERISTIC /begin REF_MEASUREMENT /end REF_MEASUREMENT /end GROUP
/begin GROUP EotProtn.EotProtnPosnRampStep.Val "MICROSAR RTE" /begin SUB_GROUP /end SUB_GROUP /begin FUNCTION_LIST /end FUNCTION_LIST /begin REF_CHARACTERISTIC EotProtn.EotProtnPosnRampStep.Val /end REF_CHARACTERISTIC /begin REF_MEASUREMENT /end REF_MEASUREMENT /end GROUP
/begin GROUP EotProtn.EotProtnRackTrvlLimrAuthyThd.Val "MICROSAR RTE" /begin SUB_GROUP /end SUB_GROUP /begin FUNCTION_LIST /end FUNCTION_LIST /begin REF_CHARACTERISTIC EotProtn.EotProtnRackTrvlLimrAuthyThd.Val /end REF_CHARACTERISTIC /begin REF_MEASUREMENT /end REF_MEASUREMENT /end GROUP
/begin GROUP EotProtn.EotProtnRackTrvlLimrAuthyThdLimd.Val "MICROSAR RTE" /begin SUB_GROUP /end SUB_GROUP /begin FUNCTION_LIST /end FUNCTION_LIST /begin REF_CHARACTERISTIC EotProtn.EotProtnRackTrvlLimrAuthyThdLimd.Val /end REF_CHARACTERISTIC /begin REF_MEASUREMENT /end REF_MEASUREMENT /end GROUP
/begin GROUP EotProtn.EotProtnRackTrvlLimrEna.Logl "MICROSAR RTE" /begin SUB_GROUP /end SUB_GROUP /begin FUNCTION_LIST /end FUNCTION_LIST /begin REF_CHARACTERISTIC EotProtn.EotProtnRackTrvlLimrEna.Logl /end REF_CHARACTERISTIC /begin REF_MEASUREMENT /end REF_MEASUREMENT /end GROUP
/begin GROUP EotProtn.EotProtnRackTrvlLimrRng.Val "MICROSAR RTE" /begin SUB_GROUP /end SUB_GROUP /begin FUNCTION_LIST /end FUNCTION_LIST /begin REF_CHARACTERISTIC EotProtn.EotProtnRackTrvlLimrRng.Val /end REF_CHARACTERISTIC /begin REF_MEASUREMENT /end REF_MEASUREMENT /end GROUP
/begin GROUP EotProtn.EotProtnRackTrvlLimrRngLimd.Val "MICROSAR RTE" /begin SUB_GROUP /end SUB_GROUP /begin FUNCTION_LIST /end FUNCTION_LIST /begin REF_CHARACTERISTIC EotProtn.EotProtnRackTrvlLimrRngLimd.Val /end REF_CHARACTERISTIC /begin REF_MEASUREMENT /end REF_MEASUREMENT /end GROUP
/begin GROUP EotProtn.EotProtnRackTrvlLimrVehSpdThd.Val "MICROSAR RTE" /begin SUB_GROUP /end SUB_GROUP /begin FUNCTION_LIST /end FUNCTION_LIST /begin REF_CHARACTERISTIC EotProtn.EotProtnRackTrvlLimrVehSpdThd.Val /end REF_CHARACTERISTIC /begin REF_MEASUREMENT /end REF_MEASUREMENT /end GROUP
/begin GROUP EotProtn.EotProtnRunEotVelImpctAndSoftEndStop.Logl "MICROSAR RTE" /begin SUB_GROUP /end SUB_GROUP /begin FUNCTION_LIST /end FUNCTION_LIST /begin REF_CHARACTERISTIC EotProtn.EotProtnRunEotVelImpctAndSoftEndStop.Logl /end REF_CHARACTERISTIC /begin REF_MEASUREMENT /end REF_MEASUREMENT /end GROUP
/begin GROUP EotProtn.EotProtnSoftEndStopAuthyThd.Val "MICROSAR RTE" /begin SUB_GROUP /end SUB_GROUP /begin FUNCTION_LIST /end FUNCTION_LIST /begin REF_CHARACTERISTIC EotProtn.EotProtnSoftEndStopAuthyThd.Val /end REF_CHARACTERISTIC /begin REF_MEASUREMENT /end REF_MEASUREMENT /end GROUP
/begin GROUP EotProtn.EotProtnSoftEndStopEna.Logl "MICROSAR RTE" /begin SUB_GROUP /end SUB_GROUP /begin FUNCTION_LIST /end FUNCTION_LIST /begin REF_CHARACTERISTIC EotProtn.EotProtnSoftEndStopEna.Logl /end REF_CHARACTERISTIC /begin REF_MEASUREMENT /end REF_MEASUREMENT /end GROUP
/begin GROUP EotProtn.EotProtnSoftEndStopVehSpdThd.Val "MICROSAR RTE" /begin SUB_GROUP /end SUB_GROUP /begin FUNCTION_LIST /end FUNCTION_LIST /begin REF_CHARACTERISTIC EotProtn.EotProtnSoftEndStopVehSpdThd.Val /end REF_CHARACTERISTIC /begin REF_MEASUREMENT /end REF_MEASUREMENT /end GROUP
/begin GROUP EotProtn.HwAg.Val "MICROSAR RTE" /begin SUB_GROUP /end SUB_GROUP /begin FUNCTION_LIST /end FUNCTION_LIST /begin REF_CHARACTERISTIC /end REF_CHARACTERISTIC /begin REF_MEASUREMENT EotProtn.HwAg.Val /end REF_MEASUREMENT /end GROUP
/begin GROUP EotProtn.HwAgAuthy.Val "MICROSAR RTE" /begin SUB_GROUP /end SUB_GROUP /begin FUNCTION_LIST /end FUNCTION_LIST /begin REF_CHARACTERISTIC /end REF_CHARACTERISTIC /begin REF_MEASUREMENT EotProtn.HwAgAuthy.Val /end REF_MEASUREMENT /end GROUP
/begin GROUP EotProtn.HwAgCcwDetd.Logl "MICROSAR RTE" /begin SUB_GROUP /end SUB_GROUP /begin FUNCTION_LIST /end FUNCTION_LIST /begin REF_CHARACTERISTIC /end REF_CHARACTERISTIC /begin REF_MEASUREMENT EotProtn.HwAgCcwDetd.Logl /end REF_MEASUREMENT /end GROUP
/begin GROUP EotProtn.HwAgCwDetd.Logl "MICROSAR RTE" /begin SUB_GROUP /end SUB_GROUP /begin FUNCTION_LIST /end FUNCTION_LIST /begin REF_CHARACTERISTIC /end REF_CHARACTERISTIC /begin REF_MEASUREMENT EotProtn.HwAgCwDetd.Logl /end REF_MEASUREMENT /end GROUP
/begin GROUP EotProtn.HwAgEotCcw.Val "MICROSAR RTE" /begin SUB_GROUP /end SUB_GROUP /begin FUNCTION_LIST /end FUNCTION_LIST /begin REF_CHARACTERISTIC /end REF_CHARACTERISTIC /begin REF_MEASUREMENT EotProtn.HwAgEotCcw.Val /end REF_MEASUREMENT /end GROUP
/begin GROUP EotProtn.HwAgEotCw.Val "MICROSAR RTE" /begin SUB_GROUP /end SUB_GROUP /begin FUNCTION_LIST /end FUNCTION_LIST /begin REF_CHARACTERISTIC /end REF_CHARACTERISTIC /begin REF_MEASUREMENT EotProtn.HwAgEotCw.Val /end REF_MEASUREMENT /end GROUP
/begin GROUP EotProtn.HwTq.Val "MICROSAR RTE" /begin SUB_GROUP /end SUB_GROUP /begin FUNCTION_LIST /end FUNCTION_LIST /begin REF_CHARACTERISTIC /end REF_CHARACTERISTIC /begin REF_MEASUREMENT EotProtn.HwTq.Val /end REF_MEASUREMENT /end GROUP
/begin GROUP EotProtn.HwTqLpFil "MICROSAR RTE" /begin SUB_GROUP /end SUB_GROUP /begin FUNCTION_LIST /end FUNCTION_LIST /begin REF_CHARACTERISTIC /end REF_CHARACTERISTIC /begin REF_MEASUREMENT EotProtn.HwTqLpFil.FilGain EotProtn.HwTqLpFil.FilSt /end REF_MEASUREMENT /end GROUP
/begin GROUP EotProtn.MotVelCrf.Val "MICROSAR RTE" /begin SUB_GROUP /end SUB_GROUP /begin FUNCTION_LIST /end FUNCTION_LIST /begin REF_CHARACTERISTIC /end REF_CHARACTERISTIC /begin REF_MEASUREMENT EotProtn.MotVelCrf.Val /end REF_MEASUREMENT /end GROUP
/begin GROUP EotProtn.NewSoftEndStopSt "MICROSAR RTE" /begin SUB_GROUP /end SUB_GROUP /begin FUNCTION_LIST /end FUNCTION_LIST /begin REF_CHARACTERISTIC /end REF_CHARACTERISTIC /begin REF_MEASUREMENT EotProtn.NewSoftEndStopSt /end REF_MEASUREMENT /end GROUP
/begin GROUP EotProtn.PerInstanceMemories "MICROSAR RTE"
 /begin SUB_GROUP EotProtn.EotAssiScaLpFil EotProtn.HwTqLpFil EotProtn.NewSoftEndStopSt EotProtn.PrevEotAssiSca EotProtn.PrevEotDampg EotProtn.PrevImpctPosn EotProtn.PrevRackTrvlLimrEna EotProtn.PrevRackTrvlLimrInin EotProtn.PrevSoftEndStopSt EotProtn.dEotProtnDampg EotProtn.dEotProtnDetd EotProtn.dEotProtnEntrGain EotProtn.dEotProtnEotAssiSca EotProtn.dEotProtnEotGain EotProtn.dEotProtnExitGain EotProtn.dEotProtnLimPosn EotProtn.dEotProtnRackTrvlLimrDi /end SUB_GROUP
 /begin FUNCTION_LIST /end FUNCTION_LIST
 /begin REF_CHARACTERISTIC /end REF_CHARACTERISTIC
 /begin REF_MEASUREMENT /end REF_MEASUREMENT
/end GROUP
/begin GROUP EotProtn.PrevEotAssiSca "MICROSAR RTE" /begin SUB_GROUP /end SUB_GROUP /begin FUNCTION_LIST /end FUNCTION_LIST /begin REF_CHARACTERISTIC /end REF_CHARACTERISTIC /begin REF_MEASUREMENT EotProtn.PrevEotAssiSca /end REF_MEASUREMENT /end GROUP
/begin GROUP EotProtn.PrevEotDampg "MICROSAR RTE" /begin SUB_GROUP /end SUB_GROUP /begin FUNCTION_LIST /end FUNCTION_LIST /begin REF_CHARACTERISTIC /end REF_CHARACTERISTIC /begin REF_MEASUREMENT EotProtn.PrevEotDampg /end REF_MEASUREMENT /end GROUP
/begin GROUP EotProtn.PrevImpctPosn "MICROSAR RTE" /begin SUB_GROUP /end SUB_GROUP /begin FUNCTION_LIST /end FUNCTION_LIST /begin REF_CHARACTERISTIC /end REF_CHARACTERISTIC /begin REF_MEASUREMENT EotProtn.PrevImpctPosn /end REF_MEASUREMENT /end GROUP
/begin GROUP EotProtn.PrevRackTrvlLimrEna "MICROSAR RTE" /begin SUB_GROUP /end SUB_GROUP /begin FUNCTION_LIST /end FUNCTION_LIST /begin REF_CHARACTERISTIC /end REF_CHARACTERISTIC /begin REF_MEASUREMENT EotProtn.PrevRackTrvlLimrEna /end REF_MEASUREMENT /end GROUP
/begin GROUP EotProtn.PrevRackTrvlLimrInin "MICROSAR RTE" /begin SUB_GROUP /end SUB_GROUP /begin FUNCTION_LIST /end FUNCTION_LIST /begin REF_CHARACTERISTIC /end REF_CHARACTERISTIC /begin REF_MEASUREMENT EotProtn.PrevRackTrvlLimrInin /end REF_MEASUREMENT /end GROUP
/begin GROUP EotProtn.PrevSoftEndStopSt "MICROSAR RTE" /begin SUB_GROUP /end SUB_GROUP /begin FUNCTION_LIST /end FUNCTION_LIST /begin REF_CHARACTERISTIC /end REF_CHARACTERISTIC /begin REF_MEASUREMENT EotProtn.PrevSoftEndStopSt /end REF_MEASUREMENT /end GROUP
/begin GROUP EotProtn.ReceiverPorts "MICROSAR RTE"
 /begin SUB_GROUP EotProtn.EotProtnDi.Logl EotProtn.HwAg.Val EotProtn.HwAgAuthy.Val EotProtn.HwAgCcwDetd.Logl EotProtn.HwAgCwDetd.Logl EotProtn.HwAgEotCcw.Val EotProtn.HwAgEotCw.Val EotProtn.HwTq.Val EotProtn.MotVelCrf.Val EotProtn.SysMotTqCmdSca.Val EotProtn.VehSpd.Val /end SUB_GROUP
 /begin FUNCTION_LIST /end FUNCTION_LIST
 /begin REF_CHARACTERISTIC /end REF_CHARACTERISTIC
 /begin REF_MEASUREMENT /end REF_MEASUREMENT
/end GROUP
/begin GROUP EotProtn.SenderPorts "MICROSAR RTE"
 /begin SUB_GROUP EotProtn.EotActvCmd.Val EotProtn.EotAssiSca.Val EotProtn.EotDampgCmd.Val EotProtn.EotMotTqLim.Val /end SUB_GROUP
 /begin FUNCTION_LIST /end FUNCTION_LIST
 /begin REF_CHARACTERISTIC /end REF_CHARACTERISTIC
 /begin REF_MEASUREMENT /end REF_MEASUREMENT
/end GROUP
/begin GROUP EotProtn.SysMotTqCmdSca.Val "MICROSAR RTE" /begin SUB_GROUP /end SUB_GROUP /begin FUNCTION_LIST /end FUNCTION_LIST /begin REF_CHARACTERISTIC /end REF_CHARACTERISTIC /begin REF_MEASUREMENT EotProtn.SysMotTqCmdSca.Val /end REF_MEASUREMENT /end GROUP
/begin GROUP EotProtn.VehSpd.Val "MICROSAR RTE" /begin SUB_GROUP /end SUB_GROUP /begin FUNCTION_LIST /end FUNCTION_LIST /begin REF_CHARACTERISTIC /end REF_CHARACTERISTIC /begin REF_MEASUREMENT EotProtn.VehSpd.Val /end REF_MEASUREMENT /end GROUP
/begin GROUP EotProtn.dEotProtnDampg "MICROSAR RTE" /begin SUB_GROUP /end SUB_GROUP /begin FUNCTION_LIST /end FUNCTION_LIST /begin REF_CHARACTERISTIC /end REF_CHARACTERISTIC /begin REF_MEASUREMENT EotProtn.dEotProtnDampg /end REF_MEASUREMENT /end GROUP
/begin GROUP EotProtn.dEotProtnDetd "MICROSAR RTE" /begin SUB_GROUP /end SUB_GROUP /begin FUNCTION_LIST /end FUNCTION_LIST /begin REF_CHARACTERISTIC /end REF_CHARACTERISTIC /begin REF_MEASUREMENT EotProtn.dEotProtnDetd /end REF_MEASUREMENT /end GROUP
/begin GROUP EotProtn.dEotProtnEntrGain "MICROSAR RTE" /begin SUB_GROUP /end SUB_GROUP /begin FUNCTION_LIST /end FUNCTION_LIST /begin REF_CHARACTERISTIC /end REF_CHARACTERISTIC /begin REF_MEASUREMENT EotProtn.dEotProtnEntrGain /end REF_MEASUREMENT /end GROUP
/begin GROUP EotProtn.dEotProtnEotAssiSca "MICROSAR RTE" /begin SUB_GROUP /end SUB_GROUP /begin FUNCTION_LIST /end FUNCTION_LIST /begin REF_CHARACTERISTIC /end REF_CHARACTERISTIC /begin REF_MEASUREMENT EotProtn.dEotProtnEotAssiSca /end REF_MEASUREMENT /end GROUP
/begin GROUP EotProtn.dEotProtnEotGain "MICROSAR RTE" /begin SUB_GROUP /end SUB_GROUP /begin FUNCTION_LIST /end FUNCTION_LIST /begin REF_CHARACTERISTIC /end REF_CHARACTERISTIC /begin REF_MEASUREMENT EotProtn.dEotProtnEotGain /end REF_MEASUREMENT /end GROUP
/begin GROUP EotProtn.dEotProtnExitGain "MICROSAR RTE" /begin SUB_GROUP /end SUB_GROUP /begin FUNCTION_LIST /end FUNCTION_LIST /begin REF_CHARACTERISTIC /end REF_CHARACTERISTIC /begin REF_MEASUREMENT EotProtn.dEotProtnExitGain /end REF_MEASUREMENT /end GROUP
/begin GROUP EotProtn.dEotProtnLimPosn "MICROSAR RTE" /begin SUB_GROUP /end SUB_GROUP /begin FUNCTION_LIST /end FUNCTION_LIST /begin REF_CHARACTERISTIC /end REF_CHARACTERISTIC /begin REF_MEASUREMENT EotProtn.dEotProtnLimPosn /end REF_MEASUREMENT /end GROUP
/begin GROUP EotProtn.dEotProtnRackTrvlLimrDi "MICROSAR RTE" /begin SUB_GROUP /end SUB_GROUP /begin FUNCTION_LIST /end FUNCTION_LIST /begin REF_CHARACTERISTIC /end REF_CHARACTERISTIC /begin REF_MEASUREMENT EotProtn.dEotProtnRackTrvlLimrDi /end REF_MEASUREMENT /end GROUP
/begin GROUP EotProtnFwl "MICROSAR RTE"
 /begin SUB_GROUP EotProtnFwl.CalibrationPorts EotProtnFwl.PerInstanceMemories EotProtnFwl.ReceiverPorts EotProtnFwl.SenderPorts /end SUB_GROUP
 /begin FUNCTION_LIST /end FUNCTION_LIST
 /begin REF_CHARACTERISTIC /end REF_CHARACTERISTIC
 /begin REF_MEASUREMENT /end REF_MEASUREMENT
/end GROUP
/begin GROUP EotProtnFwl.CalibrationPorts "MICROSAR RTE"
 /begin SUB_GROUP EotProtnFwl.EotProtnFwlActvCmdLowrBnd.Ary1D EotProtnFwl.EotProtnFwlActvCmdUpprBnd.Ary1D EotProtnFwl.EotProtnFwlEotDampgActvBndX.Ary1D EotProtnFwl.EotProtnFwlEotDampgActvBndY.Ary2D EotProtnFwl.EotProtnFwlInactvLim.Val EotProtnFwl.EotProtnFwlVehSpd.Ary1D EotProtnFwl.EotProtnHwAgMin.Val EotProtnFwl.EotProtnHwDegDampgX.Ary2D EotProtnFwl.EotProtnRackTrvlLimrRng.Val EotProtnFwl.EotProtnSoftEndStopAuthyThd.Val /end SUB_GROUP
 /begin FUNCTION_LIST /end FUNCTION_LIST
 /begin REF_CHARACTERISTIC /end REF_CHARACTERISTIC
 /begin REF_MEASUREMENT /end REF_MEASUREMENT
/end GROUP
/begin GROUP EotProtnFwl.EotActvCmd.Val "MICROSAR RTE" /begin SUB_GROUP /end SUB_GROUP /begin FUNCTION_LIST /end FUNCTION_LIST /begin REF_CHARACTERISTIC /end REF_CHARACTERISTIC /begin REF_MEASUREMENT EotProtnFwl.EotActvCmd.Val /end REF_MEASUREMENT /end GROUP
/begin GROUP EotProtnFwl.EotActvCmdLimd.Val "MICROSAR RTE" /begin SUB_GROUP /end SUB_GROUP /begin FUNCTION_LIST /end FUNCTION_LIST /begin REF_CHARACTERISTIC /end REF_CHARACTERISTIC /begin REF_MEASUREMENT EotProtnFwl.EotActvCmdLimd.Val /end REF_MEASUREMENT /end GROUP
/begin GROUP EotProtnFwl.EotDampgCmd.Val "MICROSAR RTE" /begin SUB_GROUP /end SUB_GROUP /begin FUNCTION_LIST /end FUNCTION_LIST /begin REF_CHARACTERISTIC /end REF_CHARACTERISTIC /begin REF_MEASUREMENT EotProtnFwl.EotDampgCmd.Val /end REF_MEASUREMENT /end GROUP
/begin GROUP EotProtnFwl.EotDampgCmdLimd.Val "MICROSAR RTE" /begin SUB_GROUP /end SUB_GROUP /begin FUNCTION_LIST /end FUNCTION_LIST /begin REF_CHARACTERISTIC /end REF_CHARACTERISTIC /begin REF_MEASUREMENT EotProtnFwl.EotDampgCmdLimd.Val /end REF_MEASUREMENT /end GROUP
/begin GROUP EotProtnFwl.EotProtnDi.Logl "MICROSAR RTE" /begin SUB_GROUP /end SUB_GROUP /begin FUNCTION_LIST /end FUNCTION_LIST /begin REF_CHARACTERISTIC /end REF_CHARACTERISTIC /begin REF_MEASUREMENT EotProtnFwl.EotProtnDi.Logl /end REF_MEASUREMENT /end GROUP
/begin GROUP EotProtnFwl.EotProtnFwlActvCmdLowrBnd.Ary1D "MICROSAR RTE" /begin SUB_GROUP /end SUB_GROUP /begin FUNCTION_LIST /end FUNCTION_LIST /begin REF_CHARACTERISTIC EotProtnFwl.EotProtnFwlActvCmdLowrBnd.Ary1D /end REF_CHARACTERISTIC /begin REF_MEASUREMENT /end REF_MEASUREMENT /end GROUP
/begin GROUP EotProtnFwl.EotProtnFwlActvCmdUpprBnd.Ary1D "MICROSAR RTE" /begin SUB_GROUP /end SUB_GROUP /begin FUNCTION_LIST /end FUNCTION_LIST /begin REF_CHARACTERISTIC EotProtnFwl.EotProtnFwlActvCmdUpprBnd.Ary1D /end REF_CHARACTERISTIC /begin REF_MEASUREMENT /end REF_MEASUREMENT /end GROUP
/begin GROUP EotProtnFwl.EotProtnFwlEotDampgActvBndX.Ary1D "MICROSAR RTE" /begin SUB_GROUP /end SUB_GROUP /begin FUNCTION_LIST /end FUNCTION_LIST /begin REF_CHARACTERISTIC EotProtnFwl.EotProtnFwlEotDampgActvBndX.Ary1D /end REF_CHARACTERISTIC /begin REF_MEASUREMENT /end REF_MEASUREMENT /end GROUP
/begin GROUP EotProtnFwl.EotProtnFwlEotDampgActvBndY.Ary2D "MICROSAR RTE" /begin SUB_GROUP /end SUB_GROUP /begin FUNCTION_LIST /end FUNCTION_LIST /begin REF_CHARACTERISTIC EotProtnFwl.EotProtnFwlEotDampgActvBndY.Ary2D /end REF_CHARACTERISTIC /begin REF_MEASUREMENT /end REF_MEASUREMENT /end GROUP
/begin GROUP EotProtnFwl.EotProtnFwlInactvLim.Val "MICROSAR RTE" /begin SUB_GROUP /end SUB_GROUP /begin FUNCTION_LIST /end FUNCTION_LIST /begin REF_CHARACTERISTIC EotProtnFwl.EotProtnFwlInactvLim.Val /end REF_CHARACTERISTIC /begin REF_MEASUREMENT /end REF_MEASUREMENT /end GROUP
/begin GROUP EotProtnFwl.EotProtnFwlVehSpd.Ary1D "MICROSAR RTE" /begin SUB_GROUP /end SUB_GROUP /begin FUNCTION_LIST /end FUNCTION_LIST /begin REF_CHARACTERISTIC EotProtnFwl.EotProtnFwlVehSpd.Ary1D /end REF_CHARACTERISTIC /begin REF_MEASUREMENT /end REF_MEASUREMENT /end GROUP
/begin GROUP EotProtnFwl.EotProtnHwAgMin.Val "MICROSAR RTE" /begin SUB_GROUP /end SUB_GROUP /begin FUNCTION_LIST /end FUNCTION_LIST /begin REF_CHARACTERISTIC EotProtnFwl.EotProtnHwAgMin.Val /end REF_CHARACTERISTIC /begin REF_MEASUREMENT /end REF_MEASUREMENT /end GROUP
/begin GROUP EotProtnFwl.EotProtnHwDegDampgX.Ary2D "MICROSAR RTE" /begin SUB_GROUP /end SUB_GROUP /begin FUNCTION_LIST /end FUNCTION_LIST /begin REF_CHARACTERISTIC EotProtnFwl.EotProtnHwDegDampgX.Ary2D /end REF_CHARACTERISTIC /begin REF_MEASUREMENT /end REF_MEASUREMENT /end GROUP
/begin GROUP EotProtnFwl.EotProtnRackTrvlLimrRng.Val "MICROSAR RTE" /begin SUB_GROUP /end SUB_GROUP /begin FUNCTION_LIST /end FUNCTION_LIST /begin REF_CHARACTERISTIC EotProtnFwl.EotProtnRackTrvlLimrRng.Val /end REF_CHARACTERISTIC /begin REF_MEASUREMENT /end REF_MEASUREMENT /end GROUP
/begin GROUP EotProtnFwl.EotProtnSoftEndStopAuthyThd.Val "MICROSAR RTE" /begin SUB_GROUP /end SUB_GROUP /begin FUNCTION_LIST /end FUNCTION_LIST /begin REF_CHARACTERISTIC EotProtnFwl.EotProtnSoftEndStopAuthyThd.Val /end REF_CHARACTERISTIC /begin REF_MEASUREMENT /end REF_MEASUREMENT /end GROUP
/begin GROUP EotProtnFwl.HwAg.Val "MICROSAR RTE" /begin SUB_GROUP /end SUB_GROUP /begin FUNCTION_LIST /end FUNCTION_LIST /begin REF_CHARACTERISTIC /end REF_CHARACTERISTIC /begin REF_MEASUREMENT EotProtnFwl.HwAg.Val /end REF_MEASUREMENT /end GROUP
/begin GROUP EotProtnFwl.MotVelCrf.Val "MICROSAR RTE" /begin SUB_GROUP /end SUB_GROUP /begin FUNCTION_LIST /end FUNCTION_LIST /begin REF_CHARACTERISTIC /end REF_CHARACTERISTIC /begin REF_MEASUREMENT EotProtnFwl.MotVelCrf.Val /end REF_MEASUREMENT /end GROUP
/begin GROUP EotProtnFwl.PerInstanceMemories "MICROSAR RTE"
 /begin SUB_GROUP EotProtnFwl.dEotProtnFwlEotActvCmdActvLowrBnd EotProtnFwl.dEotProtnFwlEotActvCmdActvUpprBnd EotProtnFwl.dEotProtnFwlEotActvCmdMod EotProtnFwl.dEotProtnFwlEotActvCmdOverActvLim EotProtnFwl.dEotProtnFwlEotActvCmdOverInactvLim EotProtnFwl.dEotProtnFwlEotDampgActvLowrBnd EotProtnFwl.dEotProtnFwlEotDampgActvUpprBnd EotProtnFwl.dEotProtnFwlEotDampgFwX0 EotProtnFwl.dEotProtnFwlEotDampgMod EotProtnFwl.dEotProtnFwlEotDampgOverActvLim EotProtnFwl.dEotProtnFwlEotDampgOverInactvLim EotProtnFwl.dEotProtnFwlPinionAgConfSts /end SUB_GROUP
 /begin FUNCTION_LIST /end FUNCTION_LIST
 /begin REF_CHARACTERISTIC /end REF_CHARACTERISTIC
 /begin REF_MEASUREMENT /end REF_MEASUREMENT
/end GROUP
/begin GROUP EotProtnFwl.PinionAgConf.Val "MICROSAR RTE" /begin SUB_GROUP /end SUB_GROUP /begin FUNCTION_LIST /end FUNCTION_LIST /begin REF_CHARACTERISTIC /end REF_CHARACTERISTIC /begin REF_MEASUREMENT EotProtnFwl.PinionAgConf.Val /end REF_MEASUREMENT /end GROUP
/begin GROUP EotProtnFwl.ReceiverPorts "MICROSAR RTE"
 /begin SUB_GROUP EotProtnFwl.EotActvCmd.Val EotProtnFwl.EotDampgCmd.Val EotProtnFwl.EotProtnDi.Logl EotProtnFwl.HwAg.Val EotProtnFwl.MotVelCrf.Val EotProtnFwl.PinionAgConf.Val EotProtnFwl.VehSpd.Val /end SUB_GROUP
 /begin FUNCTION_LIST /end FUNCTION_LIST
 /begin REF_CHARACTERISTIC /end REF_CHARACTERISTIC
 /begin REF_MEASUREMENT /end REF_MEASUREMENT
/end GROUP
/begin GROUP EotProtnFwl.SenderPorts "MICROSAR RTE"
 /begin SUB_GROUP EotProtnFwl.EotActvCmdLimd.Val EotProtnFwl.EotDampgCmdLimd.Val /end SUB_GROUP
 /begin FUNCTION_LIST /end FUNCTION_LIST
 /begin REF_CHARACTERISTIC /end REF_CHARACTERISTIC
 /begin REF_MEASUREMENT /end REF_MEASUREMENT
/end GROUP
/begin GROUP EotProtnFwl.VehSpd.Val "MICROSAR RTE" /begin SUB_GROUP /end SUB_GROUP /begin FUNCTION_LIST /end FUNCTION_LIST /begin REF_CHARACTERISTIC /end REF_CHARACTERISTIC /begin REF_MEASUREMENT EotProtnFwl.VehSpd.Val /end REF_MEASUREMENT /end GROUP
/begin GROUP EotProtnFwl.dEotProtnFwlEotActvCmdActvLowrBnd "MICROSAR RTE" /begin SUB_GROUP /end SUB_GROUP /begin FUNCTION_LIST /end FUNCTION_LIST /begin REF_CHARACTERISTIC /end REF_CHARACTERISTIC /begin REF_MEASUREMENT EotProtnFwl.dEotProtnFwlEotActvCmdActvLowrBnd /end REF_MEASUREMENT /end GROUP
/begin GROUP EotProtnFwl.dEotProtnFwlEotActvCmdActvUpprBnd "MICROSAR RTE" /begin SUB_GROUP /end SUB_GROUP /begin FUNCTION_LIST /end FUNCTION_LIST /begin REF_CHARACTERISTIC /end REF_CHARACTERISTIC /begin REF_MEASUREMENT EotProtnFwl.dEotProtnFwlEotActvCmdActvUpprBnd /end REF_MEASUREMENT /end GROUP
/begin GROUP EotProtnFwl.dEotProtnFwlEotActvCmdMod "MICROSAR RTE" /begin SUB_GROUP /end SUB_GROUP /begin FUNCTION_LIST /end FUNCTION_LIST /begin REF_CHARACTERISTIC /end REF_CHARACTERISTIC /begin REF_MEASUREMENT EotProtnFwl.dEotProtnFwlEotActvCmdMod /end REF_MEASUREMENT /end GROUP
/begin GROUP EotProtnFwl.dEotProtnFwlEotActvCmdOverActvLim "MICROSAR RTE" /begin SUB_GROUP /end SUB_GROUP /begin FUNCTION_LIST /end FUNCTION_LIST /begin REF_CHARACTERISTIC /end REF_CHARACTERISTIC /begin REF_MEASUREMENT EotProtnFwl.dEotProtnFwlEotActvCmdOverActvLim /end REF_MEASUREMENT /end GROUP
/begin GROUP EotProtnFwl.dEotProtnFwlEotActvCmdOverInactvLim "MICROSAR RTE" /begin SUB_GROUP /end SUB_GROUP /begin FUNCTION_LIST /end FUNCTION_LIST /begin REF_CHARACTERISTIC /end REF_CHARACTERISTIC /begin REF_MEASUREMENT EotProtnFwl.dEotProtnFwlEotActvCmdOverInactvLim /end REF_MEASUREMENT /end GROUP
/begin GROUP EotProtnFwl.dEotProtnFwlEotDampgActvLowrBnd "MICROSAR RTE" /begin SUB_GROUP /end SUB_GROUP /begin FUNCTION_LIST /end FUNCTION_LIST /begin REF_CHARACTERISTIC /end REF_CHARACTERISTIC /begin REF_MEASUREMENT EotProtnFwl.dEotProtnFwlEotDampgActvLowrBnd /end REF_MEASUREMENT /end GROUP
/begin GROUP EotProtnFwl.dEotProtnFwlEotDampgActvUpprBnd "MICROSAR RTE" /begin SUB_GROUP /end SUB_GROUP /begin FUNCTION_LIST /end FUNCTION_LIST /begin REF_CHARACTERISTIC /end REF_CHARACTERISTIC /begin REF_MEASUREMENT EotProtnFwl.dEotProtnFwlEotDampgActvUpprBnd /end REF_MEASUREMENT /end GROUP
/begin GROUP EotProtnFwl.dEotProtnFwlEotDampgFwX0 "MICROSAR RTE" /begin SUB_GROUP /end SUB_GROUP /begin FUNCTION_LIST /end FUNCTION_LIST /begin REF_CHARACTERISTIC /end REF_CHARACTERISTIC /begin REF_MEASUREMENT EotProtnFwl.dEotProtnFwlEotDampgFwX0 /end REF_MEASUREMENT /end GROUP
/begin GROUP EotProtnFwl.dEotProtnFwlEotDampgMod "MICROSAR RTE" /begin SUB_GROUP /end SUB_GROUP /begin FUNCTION_LIST /end FUNCTION_LIST /begin REF_CHARACTERISTIC /end REF_CHARACTERISTIC /begin REF_MEASUREMENT EotProtnFwl.dEotProtnFwlEotDampgMod /end REF_MEASUREMENT /end GROUP
/begin GROUP EotProtnFwl.dEotProtnFwlEotDampgOverActvLim "MICROSAR RTE" /begin SUB_GROUP /end SUB_GROUP /begin FUNCTION_LIST /end FUNCTION_LIST /begin REF_CHARACTERISTIC /end REF_CHARACTERISTIC /begin REF_MEASUREMENT EotProtnFwl.dEotProtnFwlEotDampgOverActvLim /end REF_MEASUREMENT /end GROUP
/begin GROUP EotProtnFwl.dEotProtnFwlEotDampgOverInactvLim "MICROSAR RTE" /begin SUB_GROUP /end SUB_GROUP /begin FUNCTION_LIST /end FUNCTION_LIST /begin REF_CHARACTERISTIC /end REF_CHARACTERISTIC /begin REF_MEASUREMENT EotProtnFwl.dEotProtnFwlEotDampgOverInactvLim /end REF_MEASUREMENT /end GROUP
/begin GROUP EotProtnFwl.dEotProtnFwlPinionAgConfSts "MICROSAR RTE" /begin SUB_GROUP /end SUB_GROUP /begin FUNCTION_LIST /end FUNCTION_LIST /begin REF_CHARACTERISTIC /end REF_CHARACTERISTIC /begin REF_MEASUREMENT EotProtnFwl.dEotProtnFwlPinionAgConfSts /end REF_MEASUREMENT /end GROUP
/begin GROUP FltInj "MICROSAR RTE" /begin SUB_GROUP FltInj.ReceiverPorts /end SUB_GROUP /begin FUNCTION_LIST /end FUNCTION_LIST /begin REF_CHARACTERISTIC /end REF_CHARACTERISTIC /begin REF_MEASUREMENT /end REF_MEASUREMENT /end GROUP
/begin GROUP FltInj.HwVel.Val "MICROSAR RTE" /begin SUB_GROUP /end SUB_GROUP /begin FUNCTION_LIST /end FUNCTION_LIST /begin REF_CHARACTERISTIC /end REF_CHARACTERISTIC /begin REF_MEASUREMENT FltInj.HwVel.Val /end REF_MEASUREMENT /end GROUP
/begin GROUP FltInj.ReceiverPorts "MICROSAR RTE" /begin SUB_GROUP FltInj.HwVel.Val /end SUB_GROUP /begin FUNCTION_LIST /end FUNCTION_LIST /begin REF_CHARACTERISTIC /end REF_CHARACTERISTIC /begin REF_MEASUREMENT /end REF_MEASUREMENT /end GROUP
/begin GROUP GateDrv0Ctrl "MICROSAR RTE"
 /begin SUB_GROUP GateDrv0Ctrl.CalibrationPorts GateDrv0Ctrl.PerInstanceMemories GateDrv0Ctrl.ReceiverPorts GateDrv0Ctrl.SenderPorts /end SUB_GROUP
 /begin FUNCTION_LIST /end FUNCTION_LIST
 /begin REF_CHARACTERISTIC /end REF_CHARACTERISTIC
 /begin REF_MEASUREMENT /end REF_MEASUREMENT
/end GROUP
/begin GROUP GateDrv0Ctrl.CalibrationPorts "MICROSAR RTE"
 /begin SUB_GROUP GateDrv0Ctrl.GateDrv0CtrlNtcNr0x050FailStep.Val GateDrv0Ctrl.GateDrv0CtrlNtcNr0x050PassStep.Val GateDrv0Ctrl.GateDrv0CtrlNtcNr0x051FailStep.Val GateDrv0Ctrl.GateDrv0CtrlNtcNr0x051PassStep.Val GateDrv0Ctrl.GateDrv0CtrlNtcNr0x055FailStep.Val GateDrv0Ctrl.GateDrv0CtrlNtcNr0x055PassStep.Val GateDrv0Ctrl.GateDrv0CtrlUnit0Cfg2WrVal.Val GateDrv0Ctrl.GateDrv0CtrlUnit0Cfg3WrVal.Val GateDrv0Ctrl.GateDrv0CtrlUnit0Cfg4WrVal.Val GateDrv0Ctrl.GateDrv0CtrlUnit0Cfg7WrVal.Val /end SUB_GROUP
 /begin FUNCTION_LIST /end FUNCTION_LIST
 /begin REF_CHARACTERISTIC /end REF_CHARACTERISTIC
 /begin REF_MEASUREMENT /end REF_MEASUREMENT
/end GROUP
/begin GROUP GateDrv0Ctrl.DiagcStsIvtr1Inactv.Logl "MICROSAR RTE" /begin SUB_GROUP /end SUB_GROUP /begin FUNCTION_LIST /end FUNCTION_LIST /begin REF_CHARACTERISTIC /end REF_CHARACTERISTIC /begin REF_MEASUREMENT GateDrv0Ctrl.DiagcStsIvtr1Inactv.Logl /end REF_MEASUREMENT /end GROUP
/begin GROUP GateDrv0Ctrl.GateDrv0CfgCnt "MICROSAR RTE" /begin SUB_GROUP /end SUB_GROUP /begin FUNCTION_LIST /end FUNCTION_LIST /begin REF_CHARACTERISTIC /end REF_CHARACTERISTIC /begin REF_MEASUREMENT GateDrv0Ctrl.GateDrv0CfgCnt /end REF_MEASUREMENT /end GROUP
/begin GROUP GateDrv0Ctrl.GateDrv0CfgSecAtmpt "MICROSAR RTE" /begin SUB_GROUP /end SUB_GROUP /begin FUNCTION_LIST /end FUNCTION_LIST /begin REF_CHARACTERISTIC /end REF_CHARACTERISTIC /begin REF_MEASUREMENT GateDrv0Ctrl.GateDrv0CfgSecAtmpt /end REF_MEASUREMENT /end GROUP
/begin GROUP GateDrv0Ctrl.GateDrv0CtrlNtcNr0x050FailStep.Val "MICROSAR RTE" /begin SUB_GROUP /end SUB_GROUP /begin FUNCTION_LIST /end FUNCTION_LIST /begin REF_CHARACTERISTIC GateDrv0Ctrl.GateDrv0CtrlNtcNr0x050FailStep.Val /end REF_CHARACTERISTIC /begin REF_MEASUREMENT /end REF_MEASUREMENT /end GROUP
/begin GROUP GateDrv0Ctrl.GateDrv0CtrlNtcNr0x050PassStep.Val "MICROSAR RTE" /begin SUB_GROUP /end SUB_GROUP /begin FUNCTION_LIST /end FUNCTION_LIST /begin REF_CHARACTERISTIC GateDrv0Ctrl.GateDrv0CtrlNtcNr0x050PassStep.Val /end REF_CHARACTERISTIC /begin REF_MEASUREMENT /end REF_MEASUREMENT /end GROUP
/begin GROUP GateDrv0Ctrl.GateDrv0CtrlNtcNr0x051FailStep.Val "MICROSAR RTE" /begin SUB_GROUP /end SUB_GROUP /begin FUNCTION_LIST /end FUNCTION_LIST /begin REF_CHARACTERISTIC GateDrv0Ctrl.GateDrv0CtrlNtcNr0x051FailStep.Val /end REF_CHARACTERISTIC /begin REF_MEASUREMENT /end REF_MEASUREMENT /end GROUP
/begin GROUP GateDrv0Ctrl.GateDrv0CtrlNtcNr0x051PassStep.Val "MICROSAR RTE" /begin SUB_GROUP /end SUB_GROUP /begin FUNCTION_LIST /end FUNCTION_LIST /begin REF_CHARACTERISTIC GateDrv0Ctrl.GateDrv0CtrlNtcNr0x051PassStep.Val /end REF_CHARACTERISTIC /begin REF_MEASUREMENT /end REF_MEASUREMENT /end GROUP
/begin GROUP GateDrv0Ctrl.GateDrv0CtrlNtcNr0x055FailStep.Val "MICROSAR RTE" /begin SUB_GROUP /end SUB_GROUP /begin FUNCTION_LIST /end FUNCTION_LIST /begin REF_CHARACTERISTIC GateDrv0Ctrl.GateDrv0CtrlNtcNr0x055FailStep.Val /end REF_CHARACTERISTIC /begin REF_MEASUREMENT /end REF_MEASUREMENT /end GROUP
/begin GROUP GateDrv0Ctrl.GateDrv0CtrlNtcNr0x055PassStep.Val "MICROSAR RTE" /begin SUB_GROUP /end SUB_GROUP /begin FUNCTION_LIST /end FUNCTION_LIST /begin REF_CHARACTERISTIC GateDrv0Ctrl.GateDrv0CtrlNtcNr0x055PassStep.Val /end REF_CHARACTERISTIC /begin REF_MEASUREMENT /end REF_MEASUREMENT /end GROUP
/begin GROUP GateDrv0Ctrl.GateDrv0CtrlUnit0Cfg2WrVal.Val "MICROSAR RTE" /begin SUB_GROUP /end SUB_GROUP /begin FUNCTION_LIST /end FUNCTION_LIST /begin REF_CHARACTERISTIC GateDrv0Ctrl.GateDrv0CtrlUnit0Cfg2WrVal.Val /end REF_CHARACTERISTIC /begin REF_MEASUREMENT /end REF_MEASUREMENT /end GROUP
/begin GROUP GateDrv0Ctrl.GateDrv0CtrlUnit0Cfg3WrVal.Val "MICROSAR RTE" /begin SUB_GROUP /end SUB_GROUP /begin FUNCTION_LIST /end FUNCTION_LIST /begin REF_CHARACTERISTIC GateDrv0Ctrl.GateDrv0CtrlUnit0Cfg3WrVal.Val /end REF_CHARACTERISTIC /begin REF_MEASUREMENT /end REF_MEASUREMENT /end GROUP
/begin GROUP GateDrv0Ctrl.GateDrv0CtrlUnit0Cfg4WrVal.Val "MICROSAR RTE" /begin SUB_GROUP /end SUB_GROUP /begin FUNCTION_LIST /end FUNCTION_LIST /begin REF_CHARACTERISTIC GateDrv0Ctrl.GateDrv0CtrlUnit0Cfg4WrVal.Val /end REF_CHARACTERISTIC /begin REF_MEASUREMENT /end REF_MEASUREMENT /end GROUP
/begin GROUP GateDrv0Ctrl.GateDrv0CtrlUnit0Cfg7WrVal.Val "MICROSAR RTE" /begin SUB_GROUP /end SUB_GROUP /begin FUNCTION_LIST /end FUNCTION_LIST /begin REF_CHARACTERISTIC GateDrv0Ctrl.GateDrv0CtrlUnit0Cfg7WrVal.Val /end REF_CHARACTERISTIC /begin REF_MEASUREMENT /end REF_MEASUREMENT /end GROUP
/begin GROUP GateDrv0Ctrl.GateDrv0Diag0Val "MICROSAR RTE" /begin SUB_GROUP /end SUB_GROUP /begin FUNCTION_LIST /end FUNCTION_LIST /begin REF_CHARACTERISTIC /end REF_CHARACTERISTIC /begin REF_MEASUREMENT GateDrv0Ctrl.GateDrv0Diag0Val /end REF_MEASUREMENT /end GROUP
/begin GROUP GateDrv0Ctrl.GateDrv0Diag1Val "MICROSAR RTE" /begin SUB_GROUP /end SUB_GROUP /begin FUNCTION_LIST /end FUNCTION_LIST /begin REF_CHARACTERISTIC /end REF_CHARACTERISTIC /begin REF_MEASUREMENT GateDrv0Ctrl.GateDrv0Diag1Val /end REF_MEASUREMENT /end GROUP
/begin GROUP GateDrv0Ctrl.GateDrv0Diag2Val "MICROSAR RTE" /begin SUB_GROUP /end SUB_GROUP /begin FUNCTION_LIST /end FUNCTION_LIST /begin REF_CHARACTERISTIC /end REF_CHARACTERISTIC /begin REF_MEASUREMENT GateDrv0Ctrl.GateDrv0Diag2Val /end REF_MEASUREMENT /end GROUP
/begin GROUP GateDrv0Ctrl.GateDrv0OffStChkIdx "MICROSAR RTE" /begin SUB_GROUP /end SUB_GROUP /begin FUNCTION_LIST /end FUNCTION_LIST /begin REF_CHARACTERISTIC /end REF_CHARACTERISTIC /begin REF_MEASUREMENT GateDrv0Ctrl.GateDrv0OffStChkIdx /end REF_MEASUREMENT /end GROUP
/begin GROUP GateDrv0Ctrl.GateDrv0OffStChkSecAtmpt "MICROSAR RTE" /begin SUB_GROUP /end SUB_GROUP /begin FUNCTION_LIST /end FUNCTION_LIST /begin REF_CHARACTERISTIC /end REF_CHARACTERISTIC /begin REF_MEASUREMENT GateDrv0Ctrl.GateDrv0OffStChkSecAtmpt /end REF_MEASUREMENT /end GROUP
/begin GROUP GateDrv0Ctrl.GateDrv0OffStCnt "MICROSAR RTE" /begin SUB_GROUP /end SUB_GROUP /begin FUNCTION_LIST /end FUNCTION_LIST /begin REF_CHARACTERISTIC /end REF_CHARACTERISTIC /begin REF_MEASUREMENT GateDrv0Ctrl.GateDrv0OffStCnt /end REF_MEASUREMENT /end GROUP
/begin GROUP GateDrv0Ctrl.GateDrv0St "MICROSAR RTE" /begin SUB_GROUP /end SUB_GROUP /begin FUNCTION_LIST /end FUNCTION_LIST /begin REF_CHARACTERISTIC /end REF_CHARACTERISTIC /begin REF_MEASUREMENT GateDrv0Ctrl.GateDrv0St /end REF_MEASUREMENT /end GROUP
/begin GROUP GateDrv0Ctrl.GateDrv0StsVal "MICROSAR RTE" /begin SUB_GROUP /end SUB_GROUP /begin FUNCTION_LIST /end FUNCTION_LIST /begin REF_CHARACTERISTIC /end REF_CHARACTERISTIC /begin REF_MEASUREMENT GateDrv0Ctrl.GateDrv0StsVal /end REF_MEASUREMENT /end GROUP
/begin GROUP GateDrv0Ctrl.GateDrv0VrfyRes0Val "MICROSAR RTE" /begin SUB_GROUP /end SUB_GROUP /begin FUNCTION_LIST /end FUNCTION_LIST /begin REF_CHARACTERISTIC /end REF_CHARACTERISTIC /begin REF_MEASUREMENT GateDrv0Ctrl.GateDrv0VrfyRes0Val /end REF_MEASUREMENT /end GROUP
/begin GROUP GateDrv0Ctrl.GateDrv0VrfyRes1Val "MICROSAR RTE" /begin SUB_GROUP /end SUB_GROUP /begin FUNCTION_LIST /end FUNCTION_LIST /begin REF_CHARACTERISTIC /end REF_CHARACTERISTIC /begin REF_MEASUREMENT GateDrv0Ctrl.GateDrv0VrfyRes1Val /end REF_MEASUREMENT /end GROUP
/begin GROUP GateDrv0Ctrl.Ivtr0BootstrpSplyFltPrmVal "MICROSAR RTE" /begin SUB_GROUP /end SUB_GROUP /begin FUNCTION_LIST /end FUNCTION_LIST /begin REF_CHARACTERISTIC /end REF_CHARACTERISTIC /begin REF_MEASUREMENT GateDrv0Ctrl.Ivtr0BootstrpSplyFltPrmVal /end REF_MEASUREMENT /end GROUP
/begin GROUP GateDrv0Ctrl.Ivtr0GenericFltPrmVal "MICROSAR RTE" /begin SUB_GROUP /end SUB_GROUP /begin FUNCTION_LIST /end FUNCTION_LIST /begin REF_CHARACTERISTIC /end REF_CHARACTERISTIC /begin REF_MEASUREMENT GateDrv0Ctrl.Ivtr0GenericFltPrmVal /end REF_MEASUREMENT /end GROUP
/begin GROUP GateDrv0Ctrl.Ivtr0OffStChkCmpl "MICROSAR RTE" /begin SUB_GROUP /end SUB_GROUP /begin FUNCTION_LIST /end FUNCTION_LIST /begin REF_CHARACTERISTIC /end REF_CHARACTERISTIC /begin REF_MEASUREMENT GateDrv0Ctrl.Ivtr0OffStChkCmpl /end REF_MEASUREMENT /end GROUP
/begin GROUP GateDrv0Ctrl.MotDrvr0IninTestCmpl.Logl "MICROSAR RTE" /begin SUB_GROUP /end SUB_GROUP /begin FUNCTION_LIST /end FUNCTION_LIST /begin REF_CHARACTERISTIC /end REF_CHARACTERISTIC /begin REF_MEASUREMENT GateDrv0Ctrl.MotDrvr0IninTestCmpl.Logl /end REF_MEASUREMENT /end GROUP
/begin GROUP GateDrv0Ctrl.PerInstanceMemories "MICROSAR RTE"
 /begin SUB_GROUP GateDrv0Ctrl.GateDrv0CfgCnt GateDrv0Ctrl.GateDrv0CfgSecAtmpt GateDrv0Ctrl.GateDrv0Diag0Val GateDrv0Ctrl.GateDrv0Diag1Val GateDrv0Ctrl.GateDrv0Diag2Val GateDrv0Ctrl.GateDrv0OffStChkIdx GateDrv0Ctrl.GateDrv0OffStChkSecAtmpt GateDrv0Ctrl.GateDrv0OffStCnt GateDrv0Ctrl.GateDrv0St GateDrv0Ctrl.GateDrv0StsVal GateDrv0Ctrl.GateDrv0VrfyRes0Val GateDrv0Ctrl.GateDrv0VrfyRes1Val GateDrv0Ctrl.Ivtr0BootstrpSplyFltPrmVal GateDrv0Ctrl.Ivtr0GenericFltPrmVal GateDrv0Ctrl.Ivtr0OffStChkCmpl GateDrv0Ctrl.dGateDrv0CtrlGateDrv0Diag0Val GateDrv0Ctrl.dGateDrv0CtrlGateDrv0Diag1Val GateDrv0Ctrl.dGateDrv0CtrlGateDrv0Diag2Val GateDrv0Ctrl.dGateDrv0CtrlGateDrv0OffsStVrfyPrmBitIdx GateDrv0Ctrl.dGateDrv0CtrlGateDrv0StsVal GateDrv0Ctrl.dGateDrv0CtrlGateDrv0VrfyRes0Val GateDrv0Ctrl.dGateDrv0CtrlGateDrv0VrfyRes1Val /end SUB_GROUP
 /begin FUNCTION_LIST /end FUNCTION_LIST
 /begin REF_CHARACTERISTIC /end REF_CHARACTERISTIC
 /begin REF_MEASUREMENT /end REF_MEASUREMENT
/end GROUP
/begin GROUP GateDrv0Ctrl.ReceiverPorts "MICROSAR RTE"
 /begin SUB_GROUP GateDrv0Ctrl.DiagcStsIvtr1Inactv.Logl GateDrv0Ctrl.StrtUpSt.Val GateDrv0Ctrl.SysSt.Val /end SUB_GROUP
 /begin FUNCTION_LIST /end FUNCTION_LIST
 /begin REF_CHARACTERISTIC /end REF_CHARACTERISTIC
 /begin REF_MEASUREMENT /end REF_MEASUREMENT
/end GROUP
/begin GROUP GateDrv0Ctrl.SenderPorts "MICROSAR RTE" /begin SUB_GROUP GateDrv0Ctrl.MotDrvr0IninTestCmpl.Logl /end SUB_GROUP /begin FUNCTION_LIST /end FUNCTION_LIST /begin REF_CHARACTERISTIC /end REF_CHARACTERISTIC /begin REF_MEASUREMENT /end REF_MEASUREMENT /end GROUP
/begin GROUP GateDrv0Ctrl.StrtUpSt.Val "MICROSAR RTE" /begin SUB_GROUP /end SUB_GROUP /begin FUNCTION_LIST /end FUNCTION_LIST /begin REF_CHARACTERISTIC /end REF_CHARACTERISTIC /begin REF_MEASUREMENT GateDrv0Ctrl.StrtUpSt.Val /end REF_MEASUREMENT /end GROUP
/begin GROUP GateDrv0Ctrl.SysSt.Val "MICROSAR RTE" /begin SUB_GROUP /end SUB_GROUP /begin FUNCTION_LIST /end FUNCTION_LIST /begin REF_CHARACTERISTIC /end REF_CHARACTERISTIC /begin REF_MEASUREMENT GateDrv0Ctrl.SysSt.Val /end REF_MEASUREMENT /end GROUP
/begin GROUP GateDrv0Ctrl.dGateDrv0CtrlGateDrv0Diag0Val "MICROSAR RTE" /begin SUB_GROUP /end SUB_GROUP /begin FUNCTION_LIST /end FUNCTION_LIST /begin REF_CHARACTERISTIC /end REF_CHARACTERISTIC /begin REF_MEASUREMENT GateDrv0Ctrl.dGateDrv0CtrlGateDrv0Diag0Val /end REF_MEASUREMENT /end GROUP
/begin GROUP GateDrv0Ctrl.dGateDrv0CtrlGateDrv0Diag1Val "MICROSAR RTE" /begin SUB_GROUP /end SUB_GROUP /begin FUNCTION_LIST /end FUNCTION_LIST /begin REF_CHARACTERISTIC /end REF_CHARACTERISTIC /begin REF_MEASUREMENT GateDrv0Ctrl.dGateDrv0CtrlGateDrv0Diag1Val /end REF_MEASUREMENT /end GROUP
/begin GROUP GateDrv0Ctrl.dGateDrv0CtrlGateDrv0Diag2Val "MICROSAR RTE" /begin SUB_GROUP /end SUB_GROUP /begin FUNCTION_LIST /end FUNCTION_LIST /begin REF_CHARACTERISTIC /end REF_CHARACTERISTIC /begin REF_MEASUREMENT GateDrv0Ctrl.dGateDrv0CtrlGateDrv0Diag2Val /end REF_MEASUREMENT /end GROUP
/begin GROUP GateDrv0Ctrl.dGateDrv0CtrlGateDrv0OffsStVrfyPrmBitIdx "MICROSAR RTE" /begin SUB_GROUP /end SUB_GROUP /begin FUNCTION_LIST /end FUNCTION_LIST /begin REF_CHARACTERISTIC /end REF_CHARACTERISTIC /begin REF_MEASUREMENT GateDrv0Ctrl.dGateDrv0CtrlGateDrv0OffsStVrfyPrmBitIdx /end REF_MEASUREMENT /end GROUP
/begin GROUP GateDrv0Ctrl.dGateDrv0CtrlGateDrv0StsVal "MICROSAR RTE" /begin SUB_GROUP /end SUB_GROUP /begin FUNCTION_LIST /end FUNCTION_LIST /begin REF_CHARACTERISTIC /end REF_CHARACTERISTIC /begin REF_MEASUREMENT GateDrv0Ctrl.dGateDrv0CtrlGateDrv0StsVal /end REF_MEASUREMENT /end GROUP
/begin GROUP GateDrv0Ctrl.dGateDrv0CtrlGateDrv0VrfyRes0Val "MICROSAR RTE" /begin SUB_GROUP /end SUB_GROUP /begin FUNCTION_LIST /end FUNCTION_LIST /begin REF_CHARACTERISTIC /end REF_CHARACTERISTIC /begin REF_MEASUREMENT GateDrv0Ctrl.dGateDrv0CtrlGateDrv0VrfyRes0Val /end REF_MEASUREMENT /end GROUP
/begin GROUP GateDrv0Ctrl.dGateDrv0CtrlGateDrv0VrfyRes1Val "MICROSAR RTE" /begin SUB_GROUP /end SUB_GROUP /begin FUNCTION_LIST /end FUNCTION_LIST /begin REF_CHARACTERISTIC /end REF_CHARACTERISTIC /begin REF_MEASUREMENT GateDrv0Ctrl.dGateDrv0CtrlGateDrv0VrfyRes1Val /end REF_MEASUREMENT /end GROUP
/begin GROUP GmFctDiArbn "MICROSAR RTE"
 /begin SUB_GROUP GmFctDiArbn.CalibrationPorts GmFctDiArbn.PerInstanceMemories GmFctDiArbn.ReceiverPorts GmFctDiArbn.SenderPorts /end SUB_GROUP
 /begin FUNCTION_LIST /end FUNCTION_LIST
 /begin REF_CHARACTERISTIC /end REF_CHARACTERISTIC
 /begin REF_MEASUREMENT /end REF_MEASUREMENT
/end GROUP
/begin GROUP GmFctDiArbn.ApaEna.Logl "MICROSAR RTE" /begin SUB_GROUP /end SUB_GROUP /begin FUNCTION_LIST /end FUNCTION_LIST /begin REF_CHARACTERISTIC /end REF_CHARACTERISTIC /begin REF_MEASUREMENT GmFctDiArbn.ApaEna.Logl /end REF_MEASUREMENT /end GROUP
/begin GROUP GmFctDiArbn.ApaEnaArbn.Logl "MICROSAR RTE" /begin SUB_GROUP /end SUB_GROUP /begin FUNCTION_LIST /end FUNCTION_LIST /begin REF_CHARACTERISTIC /end REF_CHARACTERISTIC /begin REF_MEASUREMENT GmFctDiArbn.ApaEnaArbn.Logl /end REF_MEASUREMENT /end GROUP
/begin GROUP GmFctDiArbn.CalibrationPorts "MICROSAR RTE"
 /begin SUB_GROUP GmFctDiArbn.GmFctDiArbnEotHwAgThd.Val GmFctDiArbn.GmFctDiArbnEotTi.Val GmFctDiArbn.GmFctDiArbnOnCentrHwAgThd.Val GmFctDiArbn.GmFctDiArbnOnCentrHwTqThd.Val GmFctDiArbn.GmFctDiArbnOnCentrTi.Val GmFctDiArbn.GmFctDiArbnSrvTi.Val /end SUB_GROUP
 /begin FUNCTION_LIST /end FUNCTION_LIST
 /begin REF_CHARACTERISTIC /end REF_CHARACTERISTIC
 /begin REF_MEASUREMENT /end REF_MEASUREMENT
/end GROUP
/begin GROUP GmFctDiArbn.CcwEotEnad "MICROSAR RTE" /begin SUB_GROUP /end SUB_GROUP /begin FUNCTION_LIST /end FUNCTION_LIST /begin REF_CHARACTERISTIC /end REF_CHARACTERISTIC /begin REF_MEASUREMENT GmFctDiArbn.CcwEotEnad /end REF_MEASUREMENT /end GROUP
/begin GROUP GmFctDiArbn.CwEotEnad "MICROSAR RTE" /begin SUB_GROUP /end SUB_GROUP /begin FUNCTION_LIST /end FUNCTION_LIST /begin REF_CHARACTERISTIC /end REF_CHARACTERISTIC /begin REF_MEASUREMENT GmFctDiArbn.CwEotEnad /end REF_MEASUREMENT /end GROUP
/begin GROUP GmFctDiArbn.EscEna.Logl "MICROSAR RTE" /begin SUB_GROUP /end SUB_GROUP /begin FUNCTION_LIST /end FUNCTION_LIST /begin REF_CHARACTERISTIC /end REF_CHARACTERISTIC /begin REF_MEASUREMENT GmFctDiArbn.EscEna.Logl /end REF_MEASUREMENT /end GROUP
/begin GROUP GmFctDiArbn.EscEnaArbn.Logl "MICROSAR RTE" /begin SUB_GROUP /end SUB_GROUP /begin FUNCTION_LIST /end FUNCTION_LIST /begin REF_CHARACTERISTIC /end REF_CHARACTERISTIC /begin REF_MEASUREMENT GmFctDiArbn.EscEnaArbn.Logl /end REF_MEASUREMENT /end GROUP
/begin GROUP GmFctDiArbn.FctDiLtch "MICROSAR RTE" /begin SUB_GROUP /end SUB_GROUP /begin FUNCTION_LIST /end FUNCTION_LIST /begin REF_CHARACTERISTIC /end REF_CHARACTERISTIC /begin REF_MEASUREMENT GmFctDiArbn.FctDiLtch /end REF_MEASUREMENT /end GROUP
/begin GROUP GmFctDiArbn.GmFctDiArbnEotHwAgThd.Val "MICROSAR RTE" /begin SUB_GROUP /end SUB_GROUP /begin FUNCTION_LIST /end FUNCTION_LIST /begin REF_CHARACTERISTIC GmFctDiArbn.GmFctDiArbnEotHwAgThd.Val /end REF_CHARACTERISTIC /begin REF_MEASUREMENT /end REF_MEASUREMENT /end GROUP
/begin GROUP GmFctDiArbn.GmFctDiArbnEotTi.Val "MICROSAR RTE" /begin SUB_GROUP /end SUB_GROUP /begin FUNCTION_LIST /end FUNCTION_LIST /begin REF_CHARACTERISTIC GmFctDiArbn.GmFctDiArbnEotTi.Val /end REF_CHARACTERISTIC /begin REF_MEASUREMENT /end REF_MEASUREMENT /end GROUP
/begin GROUP GmFctDiArbn.GmFctDiArbnOnCentrHwAgThd.Val "MICROSAR RTE" /begin SUB_GROUP /end SUB_GROUP /begin FUNCTION_LIST /end FUNCTION_LIST /begin REF_CHARACTERISTIC GmFctDiArbn.GmFctDiArbnOnCentrHwAgThd.Val /end REF_CHARACTERISTIC /begin REF_MEASUREMENT /end REF_MEASUREMENT /end GROUP
/begin GROUP GmFctDiArbn.GmFctDiArbnOnCentrHwTqThd.Val "MICROSAR RTE" /begin SUB_GROUP /end SUB_GROUP /begin FUNCTION_LIST /end FUNCTION_LIST /begin REF_CHARACTERISTIC GmFctDiArbn.GmFctDiArbnOnCentrHwTqThd.Val /end REF_CHARACTERISTIC /begin REF_MEASUREMENT /end REF_MEASUREMENT /end GROUP
/begin GROUP GmFctDiArbn.GmFctDiArbnOnCentrTi.Val "MICROSAR RTE" /begin SUB_GROUP /end SUB_GROUP /begin FUNCTION_LIST /end FUNCTION_LIST /begin REF_CHARACTERISTIC GmFctDiArbn.GmFctDiArbnOnCentrTi.Val /end REF_CHARACTERISTIC /begin REF_MEASUREMENT /end REF_MEASUREMENT /end GROUP
/begin GROUP GmFctDiArbn.GmFctDiArbnSrvTi.Val "MICROSAR RTE" /begin SUB_GROUP /end SUB_GROUP /begin FUNCTION_LIST /end FUNCTION_LIST /begin REF_CHARACTERISTIC GmFctDiArbn.GmFctDiArbnSrvTi.Val /end REF_CHARACTERISTIC /begin REF_MEASUREMENT /end REF_MEASUREMENT /end GROUP
/begin GROUP GmFctDiArbn.GmFctDiSts.Val "MICROSAR RTE" /begin SUB_GROUP /end SUB_GROUP /begin FUNCTION_LIST /end FUNCTION_LIST /begin REF_CHARACTERISTIC /end REF_CHARACTERISTIC /begin REF_MEASUREMENT GmFctDiArbn.GmFctDiSts.Val /end REF_MEASUREMENT /end GROUP
/begin GROUP GmFctDiArbn.HwAg.Val "MICROSAR RTE" /begin SUB_GROUP /end SUB_GROUP /begin FUNCTION_LIST /end FUNCTION_LIST /begin REF_CHARACTERISTIC /end REF_CHARACTERISTIC /begin REF_MEASUREMENT GmFctDiArbn.HwAg.Val /end REF_MEASUREMENT /end GROUP
/**********************************************************************************************************************
* RECORD_LAYOUT
*********************************************************************************************************************/
/begin RECORD_LAYOUT RTE_RL_UBYTE FNC_VALUES 1 UBYTE ROW_DIR DIRECT /end RECORD_LAYOUT
/begin RECORD_LAYOUT RTE_RL_UWORD FNC_VALUES 1 UWORD ROW_DIR DIRECT /end RECORD_LAYOUT
/begin RECORD_LAYOUT RTE_RL_SWORD FNC_VALUES 1 SWORD ROW_DIR DIRECT /end RECORD_LAYOUT
/begin RECORD_LAYOUT RTE_RL_FLOAT32_IEEE FNC_VALUES 1 FLOAT32_IEEE ROW_DIR DIRECT /end RECORD_LAYOUT
/begin RECORD_LAYOUT RTE_RL_FLOAT64_IEEE FNC_VALUES 1 FLOAT64_IEEE ROW_DIR DIRECT /end RECORD_LAYOUT
/begin RECORD_LAYOUT RTE_RL_BOOLEAN FNC_VALUES 1 UBYTE ROW_DIR DIRECT /end RECORD_LAYOUT
/**********************************************************************************************************************
* COMPU_METHOD / COMPU_VTAB_RANGE
*********************************************************************************************************************/
/begin COMPU_METHOD RTE_CM_BOOLEAN "" TAB_VERB "%3.1" "" COMPU_TAB_REF RTE_CM_BOOLEAN /end COMPU_METHOD
/begin COMPU_VTAB_RANGE RTE_CM_BOOLEAN "" 2 0 0 "false" 1 255 "true" /end COMPU_VTAB_RANGE
/begin COMPU_METHOD RTE_CM_ENUM_SysSt1 "" TAB_VERB "%.1" "" COMPU_TAB_REF RTE_CM_ENUM_SysSt1 /end COMPU_METHOD
/begin COMPU_VTAB_RANGE RTE_CM_ENUM_SysSt1 "" 4 0 0 "SYSST_DI" 1 1 "SYSST_OFF" 2 2 "SYSST_ENA" 3 3 "SYSST_WRMININ" /end COMPU_VTAB_RANGE
/begin COMPU_METHOD RTE_CM_ENUM_GmFctDiArbnSts1 "" TAB_VERB "%.1" "" COMPU_TAB_REF RTE_CM_ENUM_GmFctDiArbnSts1 /end COMPU_METHOD
/begin COMPU_VTAB_RANGE RTE_CM_ENUM_GmFctDiArbnSts1 "" 5 0 0 "GMFCTDIARBNSTS_WAIT" 1 1 "GMFCTDIARBNSTS_INPROC" 2 2 "GMFCTDIARBNSTS_PASSD" 3 3 "GMFCTDIARBNSTS_SWBASDMTGTNFAIL" 4 4 "GMFCTDIARBNSTS_TIMEOUTFAIL" /end COMPU_VTAB_RANGE
