/begin CHARACTERISTIC CalRegn01Cmn.BattVltgCorrlnNtc0x0B1FailStep.Val "MICROSAR RTE" VALUE 0x0 RTE_RL_UWORD 0 NO_COMPU_METHOD 0 65535 SYMBOL_LINK "Rte_CalprmRom_CalRegn01Cmn_DEFAULT_RTE_CALPRM_GROUP.BattVltgCorrlnNtc0x0B1FailStep_Val" 0 DISPLAY_IDENTIFIER CalRegn01Cmn.CalibrationPorts.BattVltgCorrlnNtc0x0B1FailStep.Val /end CHARACTERISTIC
/begin CHARACTERISTIC CalRegn01Cmn.BattVltgCorrlnNtc0x0B1PassStep.Val "MICROSAR RTE" VALUE 0x0 RTE_RL_UWORD 0 NO_COMPU_METHOD 0 65535 SYMBOL_LINK "Rte_CalprmRom_CalRegn01Cmn_DEFAULT_RTE_CALPRM_GROUP.BattVltgCorrlnNtc0x0B1PassStep_Val" 0 DISPLAY_IDENTIFIER CalRegn01Cmn.CalibrationPorts.BattVltgCorrlnNtc0x0B1PassStep.Val /end CHARACTERISTIC
/begin CHARACTERISTIC CalRegn01Cmn.BattVltgCorrlnNtc0x0B5FailStep.Val "MICROSAR RTE" VALUE 0x0 RTE_RL_UWORD 0 NO_COMPU_METHOD 0 65535 SYMBOL_LINK "Rte_CalprmRom_CalRegn01Cmn_DEFAULT_RTE_CALPRM_GROUP.BattVltgCorrlnNtc0x0B5FailStep_Val" 0 DISPLAY_IDENTIFIER CalRegn01Cmn.CalibrationPorts.BattVltgCorrlnNtc0x0B5FailStep.Val /end CHARACTERISTIC
/begin CHARACTERISTIC CalRegn01Cmn.BattVltgCorrlnNtc0x0B5PassStep.Val "MICROSAR RTE" VALUE 0x0 RTE_RL_UWORD 0 NO_COMPU_METHOD 0 65535 SYMBOL_LINK "Rte_CalprmRom_CalRegn01Cmn_DEFAULT_RTE_CALPRM_GROUP.BattVltgCorrlnNtc0x0B5PassStep_Val" 0 DISPLAY_IDENTIFIER CalRegn01Cmn.CalibrationPorts.BattVltgCorrlnNtc0x0B5PassStep.Val /end CHARACTERISTIC
/begin CHARACTERISTIC CalRegn01Cmn.BattVltgCorrlnRcvrlBattLoVltg.Val "MICROSAR RTE" VALUE 0x0 RTE_RL_FLOAT32_IEEE 0 NO_COMPU_METHOD -3.402823466e+38 3.402823466e+38 SYMBOL_LINK "Rte_CalprmRom_CalRegn01Cmn_DEFAULT_RTE_CALPRM_GROUP.BattVltgCorrlnRcvrlBattLoVltg_Val" 0 DISPLAY_IDENTIFIER CalRegn01Cmn.CalibrationPorts.BattVltgCorrlnRcvrlBattLoVltg.Val /end CHARACTERISTIC
/begin CHARACTERISTIC CalRegn01Cmn.BattVltgCorrlnRcvrlBattOverVltg.Val "MICROSAR RTE" VALUE 0x0 RTE_RL_FLOAT32_IEEE 0 NO_COMPU_METHOD -3.402823466e+38 3.402823466e+38 SYMBOL_LINK "Rte_CalprmRom_CalRegn01Cmn_DEFAULT_RTE_CALPRM_GROUP.BattVltgCorrlnRcvrlBattOverVltg_Val" 0 DISPLAY_IDENTIFIER CalRegn01Cmn.CalibrationPorts.BattVltgCorrlnRcvrlBattOverVltg.Val /end CHARACTERISTIC
/begin CHARACTERISTIC CalRegn01Cmn.BattVltgCorrlnRcvrlBattUnderVltg.Val "MICROSAR RTE" VALUE 0x0 RTE_RL_FLOAT32_IEEE 0 NO_COMPU_METHOD -3.402823466e+38 3.402823466e+38 SYMBOL_LINK "Rte_CalprmRom_CalRegn01Cmn_DEFAULT_RTE_CALPRM_GROUP.BattVltgCorrlnRcvrlBattUnderVltg_Val" 0 DISPLAY_IDENTIFIER CalRegn01Cmn.CalibrationPorts.BattVltgCorrlnRcvrlBattUnderVltg.Val /end CHARACTERISTIC
/begin CHARACTERISTIC CalRegn01Cmn.BattVltgCorrlnSysMinVltg.Val "MICROSAR RTE" VALUE 0x0 RTE_RL_FLOAT32_IEEE 0 NO_COMPU_METHOD -3.402823466e+38 3.402823466e+38 SYMBOL_LINK "Rte_CalprmRom_CalRegn01Cmn_DEFAULT_RTE_CALPRM_GROUP.BattVltgCorrlnSysMinVltg_Val" 0 DISPLAY_IDENTIFIER CalRegn01Cmn.CalibrationPorts.BattVltgCorrlnSysMinVltg.Val /end CHARACTERISTIC
/begin CHARACTERISTIC CalRegn01Cmn.BattVltgSwdMax.Val "MICROSAR RTE" VALUE 0x0 RTE_RL_FLOAT32_IEEE 0 NO_COMPU_METHOD 6.0 26.5 SYMBOL_LINK "Rte_CalprmRom_CalRegn01Cmn_DEFAULT_RTE_CALPRM_GROUP.BattVltgSwdMax_Val" 0 DISPLAY_IDENTIFIER CalRegn01Cmn.CalibrationPorts.BattVltgSwdMax.Val /end CHARACTERISTIC
/begin CHARACTERISTIC CalRegn01Cmn.BrdgVltgMax.Val "MICROSAR RTE" VALUE 0x0 RTE_RL_FLOAT32_IEEE 0 NO_COMPU_METHOD -3.402823466e+38 3.402823466e+38 SYMBOL_LINK "Rte_CalprmRom_CalRegn01Cmn_DEFAULT_RTE_CALPRM_GROUP.BrdgVltgMax_Val" 0 DISPLAY_IDENTIFIER CalRegn01Cmn.CalibrationPorts.BrdgVltgMax.Val /end CHARACTERISTIC
/begin CHARACTERISTIC CalRegn01Cmn.CmnMfgSrvSecuAcsAtmptTiOut.Val "MICROSAR RTE" VALUE 0x0 RTE_RL_UWORD 0 NO_COMPU_METHOD 0 65535 SYMBOL_LINK "Rte_CalprmRom_CalRegn01Cmn_DEFAULT_RTE_CALPRM_GROUP.CmnMfgSrvSecuAcsAtmptTiOut_Val" 0 DISPLAY_IDENTIFIER CalRegn01Cmn.CalibrationPorts.CmnMfgSrvSecuAcsAtmptTiOut.Val /end CHARACTERISTIC
/begin CHARACTERISTIC CalRegn01Cmn.CmnMfgSrvSecuAcsMaxNrAtmpt.Val "MICROSAR RTE" VALUE 0x0 RTE_RL_UBYTE 0 NO_COMPU_METHOD 0 255 SYMBOL_LINK "Rte_CalprmRom_CalRegn01Cmn_DEFAULT_RTE_CALPRM_GROUP.CmnMfgSrvSecuAcsMaxNrAtmpt_Val" 0 DISPLAY_IDENTIFIER CalRegn01Cmn.CalibrationPorts.CmnMfgSrvSecuAcsMaxNrAtmpt.Val /end CHARACTERISTIC
/begin CHARACTERISTIC CalRegn01Cmn.CmplncErrHwAgNonLinCmplncDepTblY.Ary1D "MICROSAR RTE" VAL_BLK 0x0 RTE_RL_UWORD 0 NO_COMPU_METHOD 0 65535 MATRIX_DIM 6 1 1 SYMBOL_LINK "Rte_CalprmRom_CalRegn01Cmn_DEFAULT_RTE_CALPRM_GROUP.CmplncErrHwAgNonLinCmplncDepTblY_Ary1D" 0 DISPLAY_IDENTIFIER CalRegn01Cmn.CalibrationPorts.CmplncErrHwAgNonLinCmplncDepTblY.Ary1D /end CHARACTERISTIC
/begin CHARACTERISTIC CalRegn01Cmn.CmplncErrHwAgNonLinCmplncIndTblX.Ary1D "MICROSAR RTE" VAL_BLK 0x0 RTE_RL_UWORD 0 NO_COMPU_METHOD 0 65535 MATRIX_DIM 6 1 1 SYMBOL_LINK "Rte_CalprmRom_CalRegn01Cmn_DEFAULT_RTE_CALPRM_GROUP.CmplncErrHwAgNonLinCmplncIndTblX_Ary1D" 0 DISPLAY_IDENTIFIER CalRegn01Cmn.CalibrationPorts.CmplncErrHwAgNonLinCmplncIndTblX.Ary1D /end CHARACTERISTIC
/begin CHARACTERISTIC CalRegn01Cmn.CmplncErrMotAgNonLinCmplncDepTblY.Ary1D "MICROSAR RTE" VAL_BLK 0x0 RTE_RL_UWORD 0 NO_COMPU_METHOD 0 65535 MATRIX_DIM 6 1 1 SYMBOL_LINK "Rte_CalprmRom_CalRegn01Cmn_DEFAULT_RTE_CALPRM_GROUP.CmplncErrMotAgNonLinCmplncDepTblY_Ary1D" 0 DISPLAY_IDENTIFIER CalRegn01Cmn.CalibrationPorts.CmplncErrMotAgNonLinCmplncDepTblY.Ary1D /end CHARACTERISTIC
/begin CHARACTERISTIC CalRegn01Cmn.CmplncErrMotAgNonLinCmplncIndTblX.Ary1D "MICROSAR RTE" VAL_BLK 0x0 RTE_RL_UWORD 0 NO_COMPU_METHOD 0 65535 MATRIX_DIM 6 1 1 SYMBOL_LINK "Rte_CalprmRom_CalRegn01Cmn_DEFAULT_RTE_CALPRM_GROUP.CmplncErrMotAgNonLinCmplncIndTblX_Ary1D" 0 DISPLAY_IDENTIFIER CalRegn01Cmn.CalibrationPorts.CmplncErrMotAgNonLinCmplncIndTblX.Ary1D /end CHARACTERISTIC
/begin CHARACTERISTIC CalRegn01Cmn.CurrMeasArbnMaxStallCntr.Val "MICROSAR RTE" VALUE 0x0 RTE_RL_UBYTE 0 NO_COMPU_METHOD 0 255 SYMBOL_LINK "Rte_CalprmRom_CalRegn01Cmn_DEFAULT_RTE_CALPRM_GROUP.CurrMeasArbnMaxStallCntr_Val" 0 DISPLAY_IDENTIFIER CalRegn01Cmn.CalibrationPorts.CurrMeasArbnMaxStallCntr.Val /end CHARACTERISTIC
/begin CHARACTERISTIC CalRegn01Cmn.CurrMeasCorrlnMaxErrCurr.Val "MICROSAR RTE" VALUE 0x0 RTE_RL_FLOAT32_IEEE 0 NO_COMPU_METHOD -3.402823466e+38 3.402823466e+38 SYMBOL_LINK "Rte_CalprmRom_CalRegn01Cmn_DEFAULT_RTE_CALPRM_GROUP.CurrMeasCorrlnMaxErrCurr_Val" 0 DISPLAY_IDENTIFIER CalRegn01Cmn.CalibrationPorts.CurrMeasCorrlnMaxErrCurr.Val /end CHARACTERISTIC
/begin CHARACTERISTIC CalRegn01Cmn.CurrMeasCorrlnMaxStallCntr.Val "MICROSAR RTE" VALUE 0x0 RTE_RL_UBYTE 0 NO_COMPU_METHOD 0 255 SYMBOL_LINK "Rte_CalprmRom_CalRegn01Cmn_DEFAULT_RTE_CALPRM_GROUP.CurrMeasCorrlnMaxStallCntr_Val" 0 DISPLAY_IDENTIFIER CalRegn01Cmn.CalibrationPorts.CurrMeasCorrlnMaxStallCntr.Val /end CHARACTERISTIC
/begin CHARACTERISTIC CalRegn01Cmn.CurrMeasCorrlnNtc0x04DFailStep.Val "MICROSAR RTE" VALUE 0x0 RTE_RL_UWORD 0 NO_COMPU_METHOD 0 65535 SYMBOL_LINK "Rte_CalprmRom_CalRegn01Cmn_DEFAULT_RTE_CALPRM_GROUP.CurrMeasCorrlnNtc0x04DFailStep_Val" 0 DISPLAY_IDENTIFIER CalRegn01Cmn.CalibrationPorts.CurrMeasCorrlnNtc0x04DFailStep.Val /end CHARACTERISTIC
/begin CHARACTERISTIC CalRegn01Cmn.CurrMeasCorrlnNtc0x04DPassStep.Val "MICROSAR RTE" VALUE 0x0 RTE_RL_UWORD 0 NO_COMPU_METHOD 0 65535 SYMBOL_LINK "Rte_CalprmRom_CalRegn01Cmn_DEFAULT_RTE_CALPRM_GROUP.CurrMeasCorrlnNtc0x04DPassStep_Val" 0 DISPLAY_IDENTIFIER CalRegn01Cmn.CalibrationPorts.CurrMeasCorrlnNtc0x04DPassStep.Val /end CHARACTERISTIC
/begin CHARACTERISTIC CalRegn01Cmn.CurrMeasCorrlnNtc0x04EFailStep.Val "MICROSAR RTE" VALUE 0x0 RTE_RL_UWORD 0 NO_COMPU_METHOD 0 65535 SYMBOL_LINK "Rte_CalprmRom_CalRegn01Cmn_DEFAULT_RTE_CALPRM_GROUP.CurrMeasCorrlnNtc0x04EFailStep_Val" 0 DISPLAY_IDENTIFIER CalRegn01Cmn.CalibrationPorts.CurrMeasCorrlnNtc0x04EFailStep.Val /end CHARACTERISTIC
/begin CHARACTERISTIC CalRegn01Cmn.CurrMeasCorrlnNtc0x04EPassStep.Val "MICROSAR RTE" VALUE 0x0 RTE_RL_UWORD 0 NO_COMPU_METHOD 0 65535 SYMBOL_LINK "Rte_CalprmRom_CalRegn01Cmn_DEFAULT_RTE_CALPRM_GROUP.CurrMeasCorrlnNtc0x04EPassStep_Val" 0 DISPLAY_IDENTIFIER CalRegn01Cmn.CalibrationPorts.CurrMeasCorrlnNtc0x04EPassStep.Val /end CHARACTERISTIC
/begin CHARACTERISTIC CalRegn01Cmn.CurrMeasEolFixdPwmPerd.Val "MICROSAR RTE" VALUE 0x0 RTE_RL_ULONG 0 NO_COMPU_METHOD 0 4294967295 SYMBOL_LINK "Rte_CalprmRom_CalRegn01Cmn_DEFAULT_RTE_CALPRM_GROUP.CurrMeasEolFixdPwmPerd_Val" 0 DISPLAY_IDENTIFIER CalRegn01Cmn.CalibrationPorts.CurrMeasEolFixdPwmPerd.Val /end CHARACTERISTIC
/begin CHARACTERISTIC CalRegn01Cmn.CurrMeasEolGainMax.Val "MICROSAR RTE" VALUE 0x0 RTE_RL_FLOAT32_IEEE 0 NO_COMPU_METHOD -3.402823466e+38 3.402823466e+38 SYMBOL_LINK "Rte_CalprmRom_CalRegn01Cmn_DEFAULT_RTE_CALPRM_GROUP.CurrMeasEolGainMax_Val" 0 DISPLAY_IDENTIFIER CalRegn01Cmn.CalibrationPorts.CurrMeasEolGainMax.Val /end CHARACTERISTIC
/begin CHARACTERISTIC CalRegn01Cmn.CurrMeasEolGainMin.Val "MICROSAR RTE" VALUE 0x0 RTE_RL_FLOAT32_IEEE 0 NO_COMPU_METHOD -3.402823466e+38 3.402823466e+38 SYMBOL_LINK "Rte_CalprmRom_CalRegn01Cmn_DEFAULT_RTE_CALPRM_GROUP.CurrMeasEolGainMin_Val" 0 DISPLAY_IDENTIFIER CalRegn01Cmn.CalibrationPorts.CurrMeasEolGainMin.Val /end CHARACTERISTIC
/begin CHARACTERISTIC CalRegn01Cmn.CurrMeasEolGainNrOfSample.Val "MICROSAR RTE" VALUE 0x0 RTE_RL_UWORD 0 NO_COMPU_METHOD 0 65535 SYMBOL_LINK "Rte_CalprmRom_CalRegn01Cmn_DEFAULT_RTE_CALPRM_GROUP.CurrMeasEolGainNrOfSample_Val" 0 DISPLAY_IDENTIFIER CalRegn01Cmn.CalibrationPorts.CurrMeasEolGainNrOfSample.Val /end CHARACTERISTIC
/begin CHARACTERISTIC CalRegn01Cmn.CurrMeasEolGainNumer.Val "MICROSAR RTE" VALUE 0x0 RTE_RL_FLOAT32_IEEE 0 NO_COMPU_METHOD -3.402823466e+38 3.402823466e+38 SYMBOL_LINK "Rte_CalprmRom_CalRegn01Cmn_DEFAULT_RTE_CALPRM_GROUP.CurrMeasEolGainNumer_Val" 0 DISPLAY_IDENTIFIER CalRegn01Cmn.CalibrationPorts.CurrMeasEolGainNumer.Val /end CHARACTERISTIC
/begin CHARACTERISTIC CalRegn01Cmn.CurrMeasEolMaxMotVel.Val "MICROSAR RTE" VALUE 0x0 RTE_RL_FLOAT32_IEEE 0 NO_COMPU_METHOD -3.402823466e+38 3.402823466e+38 SYMBOL_LINK "Rte_CalprmRom_CalRegn01Cmn_DEFAULT_RTE_CALPRM_GROUP.CurrMeasEolMaxMotVel_Val" 0 DISPLAY_IDENTIFIER CalRegn01Cmn.CalibrationPorts.CurrMeasEolMaxMotVel.Val /end CHARACTERISTIC
/begin CHARACTERISTIC CalRegn01Cmn.CurrMeasEolOffsHiBrdgVltgMin.Val "MICROSAR RTE" VALUE 0x0 RTE_RL_FLOAT32_IEEE 0 NO_COMPU_METHOD -3.402823466e+38 3.402823466e+38 SYMBOL_LINK "Rte_CalprmRom_CalRegn01Cmn_DEFAULT_RTE_CALPRM_GROUP.CurrMeasEolOffsHiBrdgVltgMin_Val" 0 DISPLAY_IDENTIFIER CalRegn01Cmn.CalibrationPorts.CurrMeasEolOffsHiBrdgVltgMin.Val /end CHARACTERISTIC
/begin CHARACTERISTIC CalRegn01Cmn.CurrMeasEolOffsHiCmuOffs.Val "MICROSAR RTE" VALUE 0x0 RTE_RL_ULONG 0 NO_COMPU_METHOD 0 4294967295 SYMBOL_LINK "Rte_CalprmRom_CalRegn01Cmn_DEFAULT_RTE_CALPRM_GROUP.CurrMeasEolOffsHiCmuOffs_Val" 0 DISPLAY_IDENTIFIER CalRegn01Cmn.CalibrationPorts.CurrMeasEolOffsHiCmuOffs.Val /end CHARACTERISTIC
/begin CHARACTERISTIC CalRegn01Cmn.CurrMeasEolOffsLoCmuOffs.Val "MICROSAR RTE" VALUE 0x0 RTE_RL_ULONG 0 NO_COMPU_METHOD 0 4294967295 SYMBOL_LINK "Rte_CalprmRom_CalRegn01Cmn_DEFAULT_RTE_CALPRM_GROUP.CurrMeasEolOffsLoCmuOffs_Val" 0 DISPLAY_IDENTIFIER CalRegn01Cmn.CalibrationPorts.CurrMeasEolOffsLoCmuOffs.Val /end CHARACTERISTIC
/begin CHARACTERISTIC CalRegn01Cmn.CurrMeasEolOffsMax.Val "MICROSAR RTE" VALUE 0x0 RTE_RL_FLOAT32_IEEE 0 NO_COMPU_METHOD -3.402823466e+38 3.402823466e+38 SYMBOL_LINK "Rte_CalprmRom_CalRegn01Cmn_DEFAULT_RTE_CALPRM_GROUP.CurrMeasEolOffsMax_Val" 0 DISPLAY_IDENTIFIER CalRegn01Cmn.CalibrationPorts.CurrMeasEolOffsMax.Val /end CHARACTERISTIC
/begin CHARACTERISTIC CalRegn01Cmn.CurrMeasEolOffsMin.Val "MICROSAR RTE" VALUE 0x0 RTE_RL_FLOAT32_IEEE 0 NO_COMPU_METHOD -3.402823466e+38 3.402823466e+38 SYMBOL_LINK "Rte_CalprmRom_CalRegn01Cmn_DEFAULT_RTE_CALPRM_GROUP.CurrMeasEolOffsMin_Val" 0 DISPLAY_IDENTIFIER CalRegn01Cmn.CalibrationPorts.CurrMeasEolOffsMin.Val /end CHARACTERISTIC
/begin CHARACTERISTIC CalRegn01Cmn.CurrMeasEolOffsNrOfSample.Val "MICROSAR RTE" VALUE 0x0 RTE_RL_UWORD 0 NO_COMPU_METHOD 0 65535 SYMBOL_LINK "Rte_CalprmRom_CalRegn01Cmn_DEFAULT_RTE_CALPRM_GROUP.CurrMeasEolOffsNrOfSample_Val" 0 DISPLAY_IDENTIFIER CalRegn01Cmn.CalibrationPorts.CurrMeasEolOffsNrOfSample.Val /end CHARACTERISTIC
/begin CHARACTERISTIC CalRegn01Cmn.CurrMeasEolTranCntrThd.Val "MICROSAR RTE" VALUE 0x0 RTE_RL_UBYTE 0 NO_COMPU_METHOD 0 255 SYMBOL_LINK "Rte_CalprmRom_CalRegn01Cmn_DEFAULT_RTE_CALPRM_GROUP.CurrMeasEolTranCntrThd_Val" 0 DISPLAY_IDENTIFIER CalRegn01Cmn.CalibrationPorts.CurrMeasEolTranCntrThd.Val /end CHARACTERISTIC
/begin CHARACTERISTIC CalRegn01Cmn.CurrMeasMinRqrdPhaOnTi.Val "MICROSAR RTE" VALUE 0x0 RTE_RL_ULONG 0 NO_COMPU_METHOD 0 4294967295 SYMBOL_LINK "Rte_CalprmRom_CalRegn01Cmn_DEFAULT_RTE_CALPRM_GROUP.CurrMeasMinRqrdPhaOnTi_Val" 0 DISPLAY_IDENTIFIER CalRegn01Cmn.CalibrationPorts.CurrMeasMinRqrdPhaOnTi.Val /end CHARACTERISTIC
/begin CHARACTERISTIC CalRegn01Cmn.CurrMeasMotAgCompuDly.Val "MICROSAR RTE" VALUE 0x0 RTE_RL_ULONG 0 NO_COMPU_METHOD 0 4294967295 SYMBOL_LINK "Rte_CalprmRom_CalRegn01Cmn_DEFAULT_RTE_CALPRM_GROUP.CurrMeasMotAgCompuDly_Val" 0 DISPLAY_IDENTIFIER CalRegn01Cmn.CalibrationPorts.CurrMeasMotAgCompuDly.Val /end CHARACTERISTIC
/begin CHARACTERISTIC CalRegn01Cmn.CurrMeasMotCurrAdcVlyWrmIninMax.Val "MICROSAR RTE" VALUE 0x0 RTE_RL_FLOAT32_IEEE 0 NO_COMPU_METHOD -3.402823466e+38 3.402823466e+38 SYMBOL_LINK "Rte_CalprmRom_CalRegn01Cmn_DEFAULT_RTE_CALPRM_GROUP.CurrMeasMotCurrAdcVlyWrmIninMax_Val" 0 DISPLAY_IDENTIFIER CalRegn01Cmn.CalibrationPorts.CurrMeasMotCurrAdcVlyWrmIninMax.Val /end CHARACTERISTIC
/begin CHARACTERISTIC CalRegn01Cmn.CurrMeasMotCurrAdcVlyWrmIninMin.Val "MICROSAR RTE" VALUE 0x0 RTE_RL_FLOAT32_IEEE 0 NO_COMPU_METHOD -3.402823466e+38 3.402823466e+38 SYMBOL_LINK "Rte_CalprmRom_CalRegn01Cmn_DEFAULT_RTE_CALPRM_GROUP.CurrMeasMotCurrAdcVlyWrmIninMin_Val" 0 DISPLAY_IDENTIFIER CalRegn01Cmn.CalibrationPorts.CurrMeasMotCurrAdcVlyWrmIninMin.Val /end CHARACTERISTIC
/begin CHARACTERISTIC CalRegn01Cmn.CurrMeasNtc0x05DFailStep.Val "MICROSAR RTE" VALUE 0x0 RTE_RL_UWORD 0 NO_COMPU_METHOD 0 65535 SYMBOL_LINK "Rte_CalprmRom_CalRegn01Cmn_DEFAULT_RTE_CALPRM_GROUP.CurrMeasNtc0x05DFailStep_Val" 0 DISPLAY_IDENTIFIER CalRegn01Cmn.CalibrationPorts.CurrMeasNtc0x05DFailStep.Val /end CHARACTERISTIC
/begin CHARACTERISTIC CalRegn01Cmn.CurrMeasNtc0x05DPassStep.Val "MICROSAR RTE" VALUE 0x0 RTE_RL_UWORD 0 NO_COMPU_METHOD 0 65535 SYMBOL_LINK "Rte_CalprmRom_CalRegn01Cmn_DEFAULT_RTE_CALPRM_GROUP.CurrMeasNtc0x05DPassStep_Val" 0 DISPLAY_IDENTIFIER CalRegn01Cmn.CalibrationPorts.CurrMeasNtc0x05DPassStep.Val /end CHARACTERISTIC
/begin CHARACTERISTIC CalRegn01Cmn.CurrMeasNtc0x06DFailStep.Val "MICROSAR RTE" VALUE 0x0 RTE_RL_UWORD 0 NO_COMPU_METHOD 0 65535 SYMBOL_LINK "Rte_CalprmRom_CalRegn01Cmn_DEFAULT_RTE_CALPRM_GROUP.CurrMeasNtc0x06DFailStep_Val" 0 DISPLAY_IDENTIFIER CalRegn01Cmn.CalibrationPorts.CurrMeasNtc0x06DFailStep.Val /end CHARACTERISTIC
/begin CHARACTERISTIC CalRegn01Cmn.CurrMeasNtc0x06DPassStep.Val "MICROSAR RTE" VALUE 0x0 RTE_RL_UWORD 0 NO_COMPU_METHOD 0 65535 SYMBOL_LINK "Rte_CalprmRom_CalRegn01Cmn_DEFAULT_RTE_CALPRM_GROUP.CurrMeasNtc0x06DPassStep_Val" 0 DISPLAY_IDENTIFIER CalRegn01Cmn.CalibrationPorts.CurrMeasNtc0x06DPassStep.Val /end CHARACTERISTIC
/begin CHARACTERISTIC CalRegn01Cmn.CurrReasbnDiagcCurrDiagcMotEnvlpTblMax.Val "MICROSAR RTE" VALUE 0x0 RTE_RL_FLOAT32_IEEE 0 NO_COMPU_METHOD -3.402823466e+38 3.402823466e+38 SYMBOL_LINK "Rte_CalRegn01Cmn_CurrReasbnDiagcCurrDiagcMotEnvlpTblMax_Val" 0 DISPLAY_IDENTIFIER CalRegn01Cmn.CalibrationPorts.CurrReasbnDiagcCurrDiagcMotEnvlpTblMax.Val /end CHARACTERISTIC
/begin CHARACTERISTIC CalRegn01Cmn.CurrReasbnDiagcCurrDiagcPrimErrThd.Val "MICROSAR RTE" VALUE 0x0 RTE_RL_FLOAT32_IEEE 0 NO_COMPU_METHOD -3.402823466e+38 3.402823466e+38 SYMBOL_LINK "Rte_CalRegn01Cmn_CurrReasbnDiagcCurrDiagcPrimErrThd_Val" 0 DISPLAY_IDENTIFIER CalRegn01Cmn.CalibrationPorts.CurrReasbnDiagcCurrDiagcPrimErrThd.Val /end CHARACTERISTIC
/begin CHARACTERISTIC CalRegn01Cmn.CurrReasbnDiagcCurrDiagcSecdryErrThd.Val "MICROSAR RTE" VALUE 0x0 RTE_RL_FLOAT32_IEEE 0 NO_COMPU_METHOD -3.402823466e+38 3.402823466e+38 SYMBOL_LINK "Rte_CalRegn01Cmn_CurrReasbnDiagcCurrDiagcSecdryErrThd_Val" 0 DISPLAY_IDENTIFIER CalRegn01Cmn.CalibrationPorts.CurrReasbnDiagcCurrDiagcSecdryErrThd.Val /end CHARACTERISTIC
/begin CHARACTERISTIC CalRegn01Cmn.CurrReasbnDiagcCurrDiagcSecdryTqLimThd.Val "MICROSAR RTE" VALUE 0x0 RTE_RL_FLOAT32_IEEE 0 NO_COMPU_METHOD -3.402823466e+38 3.402823466e+38 SYMBOL_LINK "Rte_CalRegn01Cmn_CurrReasbnDiagcCurrDiagcSecdryTqLimThd_Val" 0 DISPLAY_IDENTIFIER CalRegn01Cmn.CalibrationPorts.CurrReasbnDiagcCurrDiagcSecdryTqLimThd.Val /end CHARACTERISTIC
/begin CHARACTERISTIC CalRegn01Cmn.CurrReasbnDiagcDiagFildLim.Val "MICROSAR RTE" VALUE 0x0 RTE_RL_FLOAT32_IEEE 0 NO_COMPU_METHOD -3.402823466e+38 3.402823466e+38 SYMBOL_LINK "Rte_CalRegn01Cmn_CurrReasbnDiagcDiagFildLim_Val" 0 DISPLAY_IDENTIFIER CalRegn01Cmn.CalibrationPorts.CurrReasbnDiagcDiagFildLim.Val /end CHARACTERISTIC
/begin CHARACTERISTIC CalRegn01Cmn.CurrReasbnDiagcDiagVltgLpFilEna.Logl "MICROSAR RTE" VALUE 0x0 RTE_RL_BOOLEAN 0 RTE_CM_BOOLEAN 0 255 SYMBOL_LINK "Rte_CalRegn01Cmn_CurrReasbnDiagcDiagVltgLpFilEna_Logl" 0 DISPLAY_IDENTIFIER CalRegn01Cmn.CalibrationPorts.CurrReasbnDiagcDiagVltgLpFilEna.Logl /end CHARACTERISTIC
/begin CHARACTERISTIC CalRegn01Cmn.CurrReasbnDiagcDiagVltgLpFilFrq.Val "MICROSAR RTE" VALUE 0x0 RTE_RL_FLOAT32_IEEE 0 NO_COMPU_METHOD -3.402823466e+38 3.402823466e+38 SYMBOL_LINK "Rte_CalRegn01Cmn_CurrReasbnDiagcDiagVltgLpFilFrq_Val" 0 DISPLAY_IDENTIFIER CalRegn01Cmn.CalibrationPorts.CurrReasbnDiagcDiagVltgLpFilFrq.Val /end CHARACTERISTIC
/begin CHARACTERISTIC CalRegn01Cmn.CurrReasbnDiagcLpFilSca.Val "MICROSAR RTE" VALUE 0x0 RTE_RL_FLOAT32_IEEE 0 NO_COMPU_METHOD -3.402823466e+38 3.402823466e+38 SYMBOL_LINK "Rte_CalRegn01Cmn_CurrReasbnDiagcLpFilSca_Val" 0 DISPLAY_IDENTIFIER CalRegn01Cmn.CalibrationPorts.CurrReasbnDiagcLpFilSca.Val /end CHARACTERISTIC
/begin CHARACTERISTIC CalRegn01Cmn.CurrReasbnDiagcMotVelHiLim.Val "MICROSAR RTE" VALUE 0x0 RTE_RL_FLOAT32_IEEE 0 NO_COMPU_METHOD -3.402823466e+38 3.402823466e+38 SYMBOL_LINK "Rte_CalRegn01Cmn_CurrReasbnDiagcMotVelHiLim_Val" 0 DISPLAY_IDENTIFIER CalRegn01Cmn.CalibrationPorts.CurrReasbnDiagcMotVelHiLim.Val /end CHARACTERISTIC
/begin CHARACTERISTIC CalRegn01Cmn.CurrReasbnDiagcMotVelLoLim.Val "MICROSAR RTE" VALUE 0x0 RTE_RL_FLOAT32_IEEE 0 NO_COMPU_METHOD -3.402823466e+38 3.402823466e+38 SYMBOL_LINK "Rte_CalRegn01Cmn_CurrReasbnDiagcMotVelLoLim_Val" 0 DISPLAY_IDENTIFIER CalRegn01Cmn.CalibrationPorts.CurrReasbnDiagcMotVelLoLim.Val /end CHARACTERISTIC
/begin CHARACTERISTIC CalRegn01Cmn.CurrReasbnDiagcMotVltgDaxLpFilFrq.Val "MICROSAR RTE" VALUE 0x0 RTE_RL_FLOAT32_IEEE 0 NO_COMPU_METHOD -3.402823466e+38 3.402823466e+38 SYMBOL_LINK "Rte_CalRegn01Cmn_CurrReasbnDiagcMotVltgDaxLpFilFrq_Val" 0 DISPLAY_IDENTIFIER CalRegn01Cmn.CalibrationPorts.CurrReasbnDiagcMotVltgDaxLpFilFrq.Val /end CHARACTERISTIC
/begin CHARACTERISTIC CalRegn01Cmn.CurrReasbnDiagcMotVltgQaxDaxFilEna.Logl "MICROSAR RTE" VALUE 0x0 RTE_RL_BOOLEAN 0 RTE_CM_BOOLEAN 0 255 SYMBOL_LINK "Rte_CalRegn01Cmn_CurrReasbnDiagcMotVltgQaxDaxFilEna_Logl" 0 DISPLAY_IDENTIFIER CalRegn01Cmn.CalibrationPorts.CurrReasbnDiagcMotVltgQaxDaxFilEna.Logl /end CHARACTERISTIC
/begin CHARACTERISTIC CalRegn01Cmn.CurrReasbnDiagcMotVltgQaxLpFilFrq.Val "MICROSAR RTE" VALUE 0x0 RTE_RL_FLOAT32_IEEE 0 NO_COMPU_METHOD -3.402823466e+38 3.402823466e+38 SYMBOL_LINK "Rte_CalRegn01Cmn_CurrReasbnDiagcMotVltgQaxLpFilFrq_Val" 0 DISPLAY_IDENTIFIER CalRegn01Cmn.CalibrationPorts.CurrReasbnDiagcMotVltgQaxLpFilFrq.Val /end CHARACTERISTIC
/begin CHARACTERISTIC CalRegn01Cmn.CurrReasbnDiagcVelLpFilEna.Logl "MICROSAR RTE" VALUE 0x0 RTE_RL_BOOLEAN 0 RTE_CM_BOOLEAN 0 255 SYMBOL_LINK "Rte_CalRegn01Cmn_CurrReasbnDiagcVelLpFilEna_Logl" 0 DISPLAY_IDENTIFIER CalRegn01Cmn.CalibrationPorts.CurrReasbnDiagcVelLpFilEna.Logl /end CHARACTERISTIC
/begin CHARACTERISTIC CalRegn01Cmn.CurrReasbnDiagcVelLpFilFrq.Val "MICROSAR RTE" VALUE 0x0 RTE_RL_FLOAT32_IEEE 0 NO_COMPU_METHOD -3.402823466e+38 3.402823466e+38 SYMBOL_LINK "Rte_CalRegn01Cmn_CurrReasbnDiagcVelLpFilFrq_Val" 0 DISPLAY_IDENTIFIER CalRegn01Cmn.CalibrationPorts.CurrReasbnDiagcVelLpFilFrq.Val /end CHARACTERISTIC
/begin CHARACTERISTIC CalRegn01Cmn.DampgPahFwlAssiAddlDampgX.Ary1D "MICROSAR RTE" VAL_BLK 0x0 RTE_RL_UWORD 0 NO_COMPU_METHOD 0 65535 MATRIX_DIM 8 1 1 SYMBOL_LINK "Rte_CalprmRom_CalRegn01Cmn_DEFAULT_RTE_CALPRM_GROUP.DampgPahFwlAssiAddlDampgX_Ary1D" 0 DISPLAY_IDENTIFIER CalRegn01Cmn.CalibrationPorts.DampgPahFwlAssiAddlDampgX.Ary1D /end CHARACTERISTIC
/begin CHARACTERISTIC CalRegn01Cmn.DampgPahFwlAssiAddlDampgY.Ary1D "MICROSAR RTE" VAL_BLK 0x0 RTE_RL_UWORD 0 NO_COMPU_METHOD 0 65535 MATRIX_DIM 8 1 1 SYMBOL_LINK "Rte_CalprmRom_CalRegn01Cmn_DEFAULT_RTE_CALPRM_GROUP.DampgPahFwlAssiAddlDampgY_Ary1D" 0 DISPLAY_IDENTIFIER CalRegn01Cmn.CalibrationPorts.DampgPahFwlAssiAddlDampgY.Ary1D /end CHARACTERISTIC
/begin CHARACTERISTIC CalRegn01Cmn.DampgPahFwlDampgCmdAddlDampgX.Ary1D "MICROSAR RTE" VAL_BLK 0x0 RTE_RL_UWORD 0 NO_COMPU_METHOD 0 65535 MATRIX_DIM 8 1 1 SYMBOL_LINK "Rte_CalprmRom_CalRegn01Cmn_DEFAULT_RTE_CALPRM_GROUP.DampgPahFwlDampgCmdAddlDampgX_Ary1D" 0 DISPLAY_IDENTIFIER CalRegn01Cmn.CalibrationPorts.DampgPahFwlDampgCmdAddlDampgX.Ary1D /end CHARACTERISTIC
/begin CHARACTERISTIC CalRegn01Cmn.DampgPahFwlDampgCmdAddlDampgY.Ary1D "MICROSAR RTE" VAL_BLK 0x0 RTE_RL_UWORD 0 NO_COMPU_METHOD 0 65535 MATRIX_DIM 8 1 1 SYMBOL_LINK "Rte_CalprmRom_CalRegn01Cmn_DEFAULT_RTE_CALPRM_GROUP.DampgPahFwlDampgCmdAddlDampgY_Ary1D" 0 DISPLAY_IDENTIFIER CalRegn01Cmn.CalibrationPorts.DampgPahFwlDampgCmdAddlDampgY.Ary1D /end CHARACTERISTIC
/begin CHARACTERISTIC CalRegn01Cmn.DampgPahFwlDampgCmdFwlOverLimDiagcFailStep.Val "MICROSAR RTE" VALUE 0x0 RTE_RL_UWORD 0 NO_COMPU_METHOD 0 65535 SYMBOL_LINK "Rte_CalprmRom_CalRegn01Cmn_DEFAULT_RTE_CALPRM_GROUP.DampgPahFwlDampgCmdFwlOverLimDiagcFailStep_Val" 0 DISPLAY_IDENTIFIER CalRegn01Cmn.CalibrationPorts.DampgPahFwlDampgCmdFwlOverLimDiagcFailStep.Val /end CHARACTERISTIC
/begin CHARACTERISTIC CalRegn01Cmn.DampgPahFwlDampgCmdFwlOverLimDiagcPassStep.Val "MICROSAR RTE" VALUE 0x0 RTE_RL_UWORD 0 NO_COMPU_METHOD 0 65535 SYMBOL_LINK "Rte_CalprmRom_CalRegn01Cmn_DEFAULT_RTE_CALPRM_GROUP.DampgPahFwlDampgCmdFwlOverLimDiagcPassStep_Val" 0 DISPLAY_IDENTIFIER CalRegn01Cmn.CalibrationPorts.DampgPahFwlDampgCmdFwlOverLimDiagcPassStep.Val /end CHARACTERISTIC
/begin CHARACTERISTIC CalRegn01Cmn.DampgPahFwlDftDampgX.Ary1D "MICROSAR RTE" VAL_BLK 0x0 RTE_RL_UWORD 0 NO_COMPU_METHOD 0 65535 MATRIX_DIM 11 1 1 SYMBOL_LINK "Rte_CalprmRom_CalRegn01Cmn_DEFAULT_RTE_CALPRM_GROUP.DampgPahFwlDftDampgX_Ary1D" 0 DISPLAY_IDENTIFIER CalRegn01Cmn.CalibrationPorts.DampgPahFwlDftDampgX.Ary1D /end CHARACTERISTIC
/begin CHARACTERISTIC CalRegn01Cmn.DampgPahFwlInertiaCmpCmdFwlOverLimDiagcFailStep.Val "MICROSAR RTE" VALUE 0x0 RTE_RL_UWORD 0 NO_COMPU_METHOD 0 65535 SYMBOL_LINK "Rte_CalprmRom_CalRegn01Cmn_DEFAULT_RTE_CALPRM_GROUP.DampgPahFwlInertiaCmpCmdFwlOverLimDiagcFailStep_Val" 0 DISPLAY_IDENTIFIER CalRegn01Cmn.CalibrationPorts.DampgPahFwlInertiaCmpCmdFwlOverLimDiagcFailStep.Val /end CHARACTERISTIC
/begin CHARACTERISTIC CalRegn01Cmn.DampgPahFwlInertiaCmpCmdFwlOverLimDiagcPassStep.Val "MICROSAR RTE" VALUE 0x0 RTE_RL_UWORD 0 NO_COMPU_METHOD 0 65535 SYMBOL_LINK "Rte_CalprmRom_CalRegn01Cmn_DEFAULT_RTE_CALPRM_GROUP.DampgPahFwlInertiaCmpCmdFwlOverLimDiagcPassStep_Val" 0 DISPLAY_IDENTIFIER CalRegn01Cmn.CalibrationPorts.DampgPahFwlInertiaCmpCmdFwlOverLimDiagcPassStep.Val /end CHARACTERISTIC
/begin CHARACTERISTIC CalRegn01Cmn.DampgPahFwlVehSpd.Ary1D "MICROSAR RTE" VAL_BLK 0x0 RTE_RL_UWORD 0 NO_COMPU_METHOD 0 65535 MATRIX_DIM 12 1 1 SYMBOL_LINK "Rte_CalprmRom_CalRegn01Cmn_DEFAULT_RTE_CALPRM_GROUP.DampgPahFwlVehSpd_Ary1D" 0 DISPLAY_IDENTIFIER CalRegn01Cmn.CalibrationPorts.DampgPahFwlVehSpd.Ary1D /end CHARACTERISTIC
/begin CHARACTERISTIC CalRegn01Cmn.DutyCycThermProtnAbsltCtrlTTblX.Ary1D "MICROSAR RTE" VAL_BLK 0x0 RTE_RL_SWORD 0 NO_COMPU_METHOD -32768 32767 MATRIX_DIM 4 1 1 SYMBOL_LINK "Rte_CalprmRom_CalRegn01Cmn_DEFAULT_RTE_CALPRM_GROUP.DutyCycThermProtnAbsltCtrlTTblX_Ary1D" 0 DISPLAY_IDENTIFIER CalRegn01Cmn.CalibrationPorts.DutyCycThermProtnAbsltCtrlTTblX.Ary1D /end CHARACTERISTIC
/begin CHARACTERISTIC CalRegn01Cmn.DutyCycThermProtnAbsltCtrlTTqTblY.Ary1D "MICROSAR RTE" VAL_BLK 0x0 RTE_RL_UWORD 0 NO_COMPU_METHOD 0 65535 MATRIX_DIM 4 1 1 SYMBOL_LINK "Rte_CalprmRom_CalRegn01Cmn_DEFAULT_RTE_CALPRM_GROUP.DutyCycThermProtnAbsltCtrlTTqTblY_Ary1D" 0 DISPLAY_IDENTIFIER CalRegn01Cmn.CalibrationPorts.DutyCycThermProtnAbsltCtrlTTqTblY.Ary1D /end CHARACTERISTIC
/begin CHARACTERISTIC CalRegn01Cmn.DutyCycThermProtnAbsltCuTTblX.Ary1D "MICROSAR RTE" VAL_BLK 0x0 RTE_RL_SWORD 0 NO_COMPU_METHOD -32768 32767 MATRIX_DIM 4 1 1 SYMBOL_LINK "Rte_CalprmRom_CalRegn01Cmn_DEFAULT_RTE_CALPRM_GROUP.DutyCycThermProtnAbsltCuTTblX_Ary1D" 0 DISPLAY_IDENTIFIER CalRegn01Cmn.CalibrationPorts.DutyCycThermProtnAbsltCuTTblX.Ary1D /end CHARACTERISTIC
/begin CHARACTERISTIC CalRegn01Cmn.DutyCycThermProtnAbsltCuTTqTblY.Ary1D "MICROSAR RTE" VAL_BLK 0x0 RTE_RL_UWORD 0 NO_COMPU_METHOD 0 65535 MATRIX_DIM 4 1 1 SYMBOL_LINK "Rte_CalprmRom_CalRegn01Cmn_DEFAULT_RTE_CALPRM_GROUP.DutyCycThermProtnAbsltCuTTqTblY_Ary1D" 0 DISPLAY_IDENTIFIER CalRegn01Cmn.CalibrationPorts.DutyCycThermProtnAbsltCuTTqTblY.Ary1D /end CHARACTERISTIC
/begin CHARACTERISTIC CalRegn01Cmn.DutyCycThermProtnAbsltMotVelBreakPt.Val "MICROSAR RTE" VALUE 0x0 RTE_RL_FLOAT32_IEEE 0 NO_COMPU_METHOD -3.402823466e+38 3.402823466e+38 SYMBOL_LINK "Rte_CalprmRom_CalRegn01Cmn_DEFAULT_RTE_CALPRM_GROUP.DutyCycThermProtnAbsltMotVelBreakPt_Val" 0 DISPLAY_IDENTIFIER CalRegn01Cmn.CalibrationPorts.DutyCycThermProtnAbsltMotVelBreakPt.Val /end CHARACTERISTIC
/begin CHARACTERISTIC CalRegn01Cmn.DutyCycThermProtnAbsltTTqSlewHiLim.Val "MICROSAR RTE" VALUE 0x0 RTE_RL_FLOAT32_IEEE 0 NO_COMPU_METHOD -3.402823466e+38 3.402823466e+38 SYMBOL_LINK "Rte_CalprmRom_CalRegn01Cmn_DEFAULT_RTE_CALPRM_GROUP.DutyCycThermProtnAbsltTTqSlewHiLim_Val" 0 DISPLAY_IDENTIFIER CalRegn01Cmn.CalibrationPorts.DutyCycThermProtnAbsltTTqSlewHiLim.Val /end CHARACTERISTIC
/begin CHARACTERISTIC CalRegn01Cmn.DutyCycThermProtnAbsltTTqSlewLoLim.Val "MICROSAR RTE" VALUE 0x0 RTE_RL_FLOAT32_IEEE 0 NO_COMPU_METHOD -3.402823466e+38 3.402823466e+38 SYMBOL_LINK "Rte_CalprmRom_CalRegn01Cmn_DEFAULT_RTE_CALPRM_GROUP.DutyCycThermProtnAbsltTTqSlewLoLim_Val" 0 DISPLAY_IDENTIFIER CalRegn01Cmn.CalibrationPorts.DutyCycThermProtnAbsltTTqSlewLoLim.Val /end CHARACTERISTIC
/begin CHARACTERISTIC CalRegn01Cmn.DutyCycThermProtnCtrlT.Val "MICROSAR RTE" VALUE 0x0 RTE_RL_FLOAT32_IEEE 0 NO_COMPU_METHOD -3.402823466e+38 3.402823466e+38 SYMBOL_LINK "Rte_CalprmRom_CalRegn01Cmn_DEFAULT_RTE_CALPRM_GROUP.DutyCycThermProtnCtrlT_Val" 0 DISPLAY_IDENTIFIER CalRegn01Cmn.CalibrationPorts.DutyCycThermProtnCtrlT.Val /end CHARACTERISTIC
/begin CHARACTERISTIC CalRegn01Cmn.DutyCycThermProtnCtrlTSeln.Logl "MICROSAR RTE" VALUE 0x0 RTE_RL_BOOLEAN 0 RTE_CM_BOOLEAN 0 255 SYMBOL_LINK "Rte_CalprmRom_CalRegn01Cmn_DEFAULT_RTE_CALPRM_GROUP.DutyCycThermProtnCtrlTSeln_Logl" 0 DISPLAY_IDENTIFIER CalRegn01Cmn.CalibrationPorts.DutyCycThermProtnCtrlTSeln.Logl /end CHARACTERISTIC
/begin CHARACTERISTIC CalRegn01Cmn.DutyCycThermProtnDutyCycFildThd.Val "MICROSAR RTE" VALUE 0x0 RTE_RL_UWORD 0 NO_COMPU_METHOD 0 65535 SYMBOL_LINK "Rte_CalprmRom_CalRegn01Cmn_DEFAULT_RTE_CALPRM_GROUP.DutyCycThermProtnDutyCycFildThd_Val" 0 DISPLAY_IDENTIFIER CalRegn01Cmn.CalibrationPorts.DutyCycThermProtnDutyCycFildThd.Val /end CHARACTERISTIC
/begin CHARACTERISTIC CalRegn01Cmn.DutyCycThermProtnIgnOffCtrlEna.Logl "MICROSAR RTE" VALUE 0x0 RTE_RL_BOOLEAN 0 RTE_CM_BOOLEAN 0 255 SYMBOL_LINK "Rte_CalprmRom_CalRegn01Cmn_DEFAULT_RTE_CALPRM_GROUP.DutyCycThermProtnIgnOffCtrlEna_Logl" 0 DISPLAY_IDENTIFIER CalRegn01Cmn.CalibrationPorts.DutyCycThermProtnIgnOffCtrlEna.Logl /end CHARACTERISTIC
/begin CHARACTERISTIC CalRegn01Cmn.DutyCycThermProtnIgnOffMsgWaitTi.Val "MICROSAR RTE" VALUE 0x0 RTE_RL_FLOAT32_IEEE 0 NO_COMPU_METHOD -3.402823466e+38 3.402823466e+38 SYMBOL_LINK "Rte_CalprmRom_CalRegn01Cmn_DEFAULT_RTE_CALPRM_GROUP.DutyCycThermProtnIgnOffMsgWaitTi_Val" 0 DISPLAY_IDENTIFIER CalRegn01Cmn.CalibrationPorts.DutyCycThermProtnIgnOffMsgWaitTi.Val /end CHARACTERISTIC
/begin CHARACTERISTIC CalRegn01Cmn.DutyCycThermProtnLstTblValNonStall.Ary1D "MICROSAR RTE" VAL_BLK 0x0 RTE_RL_UWORD 0 NO_COMPU_METHOD 0 65535 MATRIX_DIM 5 1 1 SYMBOL_LINK "Rte_CalprmRom_CalRegn01Cmn_DEFAULT_RTE_CALPRM_GROUP.DutyCycThermProtnLstTblValNonStall_Ary1D" 0 DISPLAY_IDENTIFIER CalRegn01Cmn.CalibrationPorts.DutyCycThermProtnLstTblValNonStall.Ary1D /end CHARACTERISTIC
/begin CHARACTERISTIC CalRegn01Cmn.DutyCycThermProtnLstTblValStall.Ary1D "MICROSAR RTE" VAL_BLK 0x0 RTE_RL_UWORD 0 NO_COMPU_METHOD 0 65535 MATRIX_DIM 5 1 1 SYMBOL_LINK "Rte_CalprmRom_CalRegn01Cmn_DEFAULT_RTE_CALPRM_GROUP.DutyCycThermProtnLstTblValStall_Ary1D" 0 DISPLAY_IDENTIFIER CalRegn01Cmn.CalibrationPorts.DutyCycThermProtnLstTblValStall.Ary1D /end CHARACTERISTIC
/begin CHARACTERISTIC CalRegn01Cmn.DutyCycThermProtnMotPrTSeln.Logl "MICROSAR RTE" VALUE 0x0 RTE_RL_BOOLEAN 0 RTE_CM_BOOLEAN 0 255 SYMBOL_LINK "Rte_CalprmRom_CalRegn01Cmn_DEFAULT_RTE_CALPRM_GROUP.DutyCycThermProtnMotPrTSeln_Logl" 0 DISPLAY_IDENTIFIER CalRegn01Cmn.CalibrationPorts.DutyCycThermProtnMotPrTSeln.Logl /end CHARACTERISTIC
/begin CHARACTERISTIC CalRegn01Cmn.DutyCycThermProtnMplr1NonStallTblY.Ary1D "MICROSAR RTE" VAL_BLK 0x0 RTE_RL_UWORD 0 NO_COMPU_METHOD 0 65535 MATRIX_DIM 5 1 1 SYMBOL_LINK "Rte_CalprmRom_CalRegn01Cmn_DEFAULT_RTE_CALPRM_GROUP.DutyCycThermProtnMplr1NonStallTblY_Ary1D" 0 DISPLAY_IDENTIFIER CalRegn01Cmn.CalibrationPorts.DutyCycThermProtnMplr1NonStallTblY.Ary1D /end CHARACTERISTIC
/begin CHARACTERISTIC CalRegn01Cmn.DutyCycThermProtnMplr1StallTblY.Ary1D "MICROSAR RTE" VAL_BLK 0x0 RTE_RL_UWORD 0 NO_COMPU_METHOD 0 65535 MATRIX_DIM 5 1 1 SYMBOL_LINK "Rte_CalprmRom_CalRegn01Cmn_DEFAULT_RTE_CALPRM_GROUP.DutyCycThermProtnMplr1StallTblY_Ary1D" 0 DISPLAY_IDENTIFIER CalRegn01Cmn.CalibrationPorts.DutyCycThermProtnMplr1StallTblY.Ary1D /end CHARACTERISTIC
/begin CHARACTERISTIC CalRegn01Cmn.DutyCycThermProtnMplr2NonStallTblY.Ary1D "MICROSAR RTE" VAL_BLK 0x0 RTE_RL_UWORD 0 NO_COMPU_METHOD 0 65535 MATRIX_DIM 5 1 1 SYMBOL_LINK "Rte_CalprmRom_CalRegn01Cmn_DEFAULT_RTE_CALPRM_GROUP.DutyCycThermProtnMplr2NonStallTblY_Ary1D" 0 DISPLAY_IDENTIFIER CalRegn01Cmn.CalibrationPorts.DutyCycThermProtnMplr2NonStallTblY.Ary1D /end CHARACTERISTIC
/begin CHARACTERISTIC CalRegn01Cmn.DutyCycThermProtnMplr2StallTblY.Ary1D "MICROSAR RTE" VAL_BLK 0x0 RTE_RL_UWORD 0 NO_COMPU_METHOD 0 65535 MATRIX_DIM 5 1 1 SYMBOL_LINK "Rte_CalprmRom_CalRegn01Cmn_DEFAULT_RTE_CALPRM_GROUP.DutyCycThermProtnMplr2StallTblY_Ary1D" 0 DISPLAY_IDENTIFIER CalRegn01Cmn.CalibrationPorts.DutyCycThermProtnMplr2StallTblY.Ary1D /end CHARACTERISTIC
/begin CHARACTERISTIC CalRegn01Cmn.DutyCycThermProtnMplr3NonStallTblY.Ary1D "MICROSAR RTE" VAL_BLK 0x0 RTE_RL_UWORD 0 NO_COMPU_METHOD 0 65535 MATRIX_DIM 5 1 1 SYMBOL_LINK "Rte_CalprmRom_CalRegn01Cmn_DEFAULT_RTE_CALPRM_GROUP.DutyCycThermProtnMplr3NonStallTblY_Ary1D" 0 DISPLAY_IDENTIFIER CalRegn01Cmn.CalibrationPorts.DutyCycThermProtnMplr3NonStallTblY.Ary1D /end CHARACTERISTIC
/begin CHARACTERISTIC CalRegn01Cmn.DutyCycThermProtnMplr3StallTblY.Ary1D "MICROSAR RTE" VAL_BLK 0x0 RTE_RL_UWORD 0 NO_COMPU_METHOD 0 65535 MATRIX_DIM 5 1 1 SYMBOL_LINK "Rte_CalprmRom_CalRegn01Cmn_DEFAULT_RTE_CALPRM_GROUP.DutyCycThermProtnMplr3StallTblY_Ary1D" 0 DISPLAY_IDENTIFIER CalRegn01Cmn.CalibrationPorts.DutyCycThermProtnMplr3StallTblY.Ary1D /end CHARACTERISTIC
/begin CHARACTERISTIC CalRegn01Cmn.DutyCycThermProtnMplr4NonStallTblY.Ary1D "MICROSAR RTE" VAL_BLK 0x0 RTE_RL_UWORD 0 NO_COMPU_METHOD 0 65535 MATRIX_DIM 5 1 1 SYMBOL_LINK "Rte_CalprmRom_CalRegn01Cmn_DEFAULT_RTE_CALPRM_GROUP.DutyCycThermProtnMplr4NonStallTblY_Ary1D" 0 DISPLAY_IDENTIFIER CalRegn01Cmn.CalibrationPorts.DutyCycThermProtnMplr4NonStallTblY.Ary1D /end CHARACTERISTIC
/begin CHARACTERISTIC CalRegn01Cmn.DutyCycThermProtnMplr4StallTblY.Ary1D "MICROSAR RTE" VAL_BLK 0x0 RTE_RL_UWORD 0 NO_COMPU_METHOD 0 65535 MATRIX_DIM 5 1 1 SYMBOL_LINK "Rte_CalprmRom_CalRegn01Cmn_DEFAULT_RTE_CALPRM_GROUP.DutyCycThermProtnMplr4StallTblY_Ary1D" 0 DISPLAY_IDENTIFIER CalRegn01Cmn.CalibrationPorts.DutyCycThermProtnMplr4StallTblY.Ary1D /end CHARACTERISTIC
/begin CHARACTERISTIC CalRegn01Cmn.DutyCycThermProtnMplr5NonStallTblY.Ary1D "MICROSAR RTE" VAL_BLK 0x0 RTE_RL_UWORD 0 NO_COMPU_METHOD 0 65535 MATRIX_DIM 5 1 1 SYMBOL_LINK "Rte_CalprmRom_CalRegn01Cmn_DEFAULT_RTE_CALPRM_GROUP.DutyCycThermProtnMplr5NonStallTblY_Ary1D" 0 DISPLAY_IDENTIFIER CalRegn01Cmn.CalibrationPorts.DutyCycThermProtnMplr5NonStallTblY.Ary1D /end CHARACTERISTIC
/begin CHARACTERISTIC CalRegn01Cmn.DutyCycThermProtnMplr5StallTblY.Ary1D "MICROSAR RTE" VAL_BLK 0x0 RTE_RL_UWORD 0 NO_COMPU_METHOD 0 65535 MATRIX_DIM 5 1 1 SYMBOL_LINK "Rte_CalprmRom_CalRegn01Cmn_DEFAULT_RTE_CALPRM_GROUP.DutyCycThermProtnMplr5StallTblY_Ary1D" 0 DISPLAY_IDENTIFIER CalRegn01Cmn.CalibrationPorts.DutyCycThermProtnMplr5StallTblY.Ary1D /end CHARACTERISTIC
/begin CHARACTERISTIC CalRegn01Cmn.DutyCycThermProtnMplr6NonStallTblY.Ary1D "MICROSAR RTE" VAL_BLK 0x0 RTE_RL_UWORD 0 NO_COMPU_METHOD 0 65535 MATRIX_DIM 5 1 1 SYMBOL_LINK "Rte_CalprmRom_CalRegn01Cmn_DEFAULT_RTE_CALPRM_GROUP.DutyCycThermProtnMplr6NonStallTblY_Ary1D" 0 DISPLAY_IDENTIFIER CalRegn01Cmn.CalibrationPorts.DutyCycThermProtnMplr6NonStallTblY.Ary1D /end CHARACTERISTIC
/begin CHARACTERISTIC CalRegn01Cmn.DutyCycThermProtnMplr6StallTblY.Ary1D "MICROSAR RTE" VAL_BLK 0x0 RTE_RL_UWORD 0 NO_COMPU_METHOD 0 65535 MATRIX_DIM 5 1 1 SYMBOL_LINK "Rte_CalprmRom_CalRegn01Cmn_DEFAULT_RTE_CALPRM_GROUP.DutyCycThermProtnMplr6StallTblY_Ary1D" 0 DISPLAY_IDENTIFIER CalRegn01Cmn.CalibrationPorts.DutyCycThermProtnMplr6StallTblY.Ary1D /end CHARACTERISTIC
/begin CHARACTERISTIC CalRegn01Cmn.DutyCycThermProtnMplrTSeln.Logl "MICROSAR RTE" VALUE 0x0 RTE_RL_BOOLEAN 0 RTE_CM_BOOLEAN 0 255 SYMBOL_LINK "Rte_CalprmRom_CalRegn01Cmn_DEFAULT_RTE_CALPRM_GROUP.DutyCycThermProtnMplrTSeln_Logl" 0 DISPLAY_IDENTIFIER CalRegn01Cmn.CalibrationPorts.DutyCycThermProtnMplrTSeln.Logl /end CHARACTERISTIC
/begin CHARACTERISTIC CalRegn01Cmn.DutyCycThermProtnMplrTblX.Ary1D "MICROSAR RTE" VAL_BLK 0x0 RTE_RL_SWORD 0 NO_COMPU_METHOD -32768 32767 MATRIX_DIM 5 1 1 SYMBOL_LINK "Rte_CalprmRom_CalRegn01Cmn_DEFAULT_RTE_CALPRM_GROUP.DutyCycThermProtnMplrTblX_Ary1D" 0 DISPLAY_IDENTIFIER CalRegn01Cmn.CalibrationPorts.DutyCycThermProtnMplrTblX.Ary1D /end CHARACTERISTIC
/begin CHARACTERISTIC CalRegn01Cmn.DutyCycThermProtnSlowFilTSeln.Logl "MICROSAR RTE" VALUE 0x0 RTE_RL_BOOLEAN 0 RTE_CM_BOOLEAN 0 255 SYMBOL_LINK "Rte_CalprmRom_CalRegn01Cmn_DEFAULT_RTE_CALPRM_GROUP.DutyCycThermProtnSlowFilTSeln_Logl" 0 DISPLAY_IDENTIFIER CalRegn01Cmn.CalibrationPorts.DutyCycThermProtnSlowFilTSeln.Logl /end CHARACTERISTIC
/begin CHARACTERISTIC CalRegn01Cmn.DutyCycThermProtnThermLimScaFac.Val "MICROSAR RTE" VALUE 0x0 RTE_RL_FLOAT32_IEEE 0 NO_COMPU_METHOD -3.402823466e+38 3.402823466e+38 SYMBOL_LINK "Rte_CalprmRom_CalRegn01Cmn_DEFAULT_RTE_CALPRM_GROUP.DutyCycThermProtnThermLimScaFac_Val" 0 DISPLAY_IDENTIFIER CalRegn01Cmn.CalibrationPorts.DutyCycThermProtnThermLimScaFac.Val /end CHARACTERISTIC
/begin CHARACTERISTIC CalRegn01Cmn.DutyCycThermProtnThermLoadLimTblX.Ary1D "MICROSAR RTE" VAL_BLK 0x0 RTE_RL_UWORD 0 NO_COMPU_METHOD 0 65535 MATRIX_DIM 8 1 1 SYMBOL_LINK "Rte_CalprmRom_CalRegn01Cmn_DEFAULT_RTE_CALPRM_GROUP.DutyCycThermProtnThermLoadLimTblX_Ary1D" 0 DISPLAY_IDENTIFIER CalRegn01Cmn.CalibrationPorts.DutyCycThermProtnThermLoadLimTblX.Ary1D /end CHARACTERISTIC
/begin CHARACTERISTIC CalRegn01Cmn.DutyCycThermProtnThermLoadLimTblY.Ary1D "MICROSAR RTE" VAL_BLK 0x0 RTE_RL_UWORD 0 NO_COMPU_METHOD 0 65535 MATRIX_DIM 8 1 1 SYMBOL_LINK "Rte_CalprmRom_CalRegn01Cmn_DEFAULT_RTE_CALPRM_GROUP.DutyCycThermProtnThermLoadLimTblY_Ary1D" 0 DISPLAY_IDENTIFIER CalRegn01Cmn.CalibrationPorts.DutyCycThermProtnThermLoadLimTblY.Ary1D /end CHARACTERISTIC
/begin CHARACTERISTIC CalRegn01Cmn.DutyCycThermProtnTqCmdSlewDwn.Val "MICROSAR RTE" VALUE 0x0 RTE_RL_FLOAT32_IEEE 0 NO_COMPU_METHOD -3.402823466e+38 3.402823466e+38 SYMBOL_LINK "Rte_CalprmRom_CalRegn01Cmn_DEFAULT_RTE_CALPRM_GROUP.DutyCycThermProtnTqCmdSlewDwn_Val" 0 DISPLAY_IDENTIFIER CalRegn01Cmn.CalibrationPorts.DutyCycThermProtnTqCmdSlewDwn.Val /end CHARACTERISTIC
/begin CHARACTERISTIC CalRegn01Cmn.DutyCycThermProtnTqCmdSlewUp.Val "MICROSAR RTE" VALUE 0x0 RTE_RL_FLOAT32_IEEE 0 NO_COMPU_METHOD -3.402823466e+38 3.402823466e+38 SYMBOL_LINK "Rte_CalprmRom_CalRegn01Cmn_DEFAULT_RTE_CALPRM_GROUP.DutyCycThermProtnTqCmdSlewUp_Val" 0 DISPLAY_IDENTIFIER CalRegn01Cmn.CalibrationPorts.DutyCycThermProtnTqCmdSlewUp.Val /end CHARACTERISTIC
/begin CHARACTERISTIC CalRegn01Cmn.EcuTMeasDftT.Val "MICROSAR RTE" VALUE 0x0 RTE_RL_FLOAT32_IEEE 0 NO_COMPU_METHOD -50.0 150.0 SYMBOL_LINK "Rte_CalprmRom_CalRegn01Cmn_DEFAULT_RTE_CALPRM_GROUP.EcuTMeasDftT_Val" 0 DISPLAY_IDENTIFIER CalRegn01Cmn.CalibrationPorts.EcuTMeasDftT.Val /end CHARACTERISTIC
/begin CHARACTERISTIC CalRegn01Cmn.EcuTMeasFilTau.Val "MICROSAR RTE" VALUE 0x0 RTE_RL_FLOAT32_IEEE 0 NO_COMPU_METHOD 0.1 10.0 SYMBOL_LINK "Rte_CalprmRom_CalRegn01Cmn_DEFAULT_RTE_CALPRM_GROUP.EcuTMeasFilTau_Val" 0 DISPLAY_IDENTIFIER CalRegn01Cmn.CalibrationPorts.EcuTMeasFilTau.Val /end CHARACTERISTIC
/begin CHARACTERISTIC CalRegn01Cmn.EcuTMeasNtc0x045FailStep.Val "MICROSAR RTE" VALUE 0x0 RTE_RL_UWORD 0 NO_COMPU_METHOD 0 65535 SYMBOL_LINK "Rte_CalprmRom_CalRegn01Cmn_DEFAULT_RTE_CALPRM_GROUP.EcuTMeasNtc0x045FailStep_Val" 0 DISPLAY_IDENTIFIER CalRegn01Cmn.CalibrationPorts.EcuTMeasNtc0x045FailStep.Val /end CHARACTERISTIC
/begin CHARACTERISTIC CalRegn01Cmn.EcuTMeasNtc0x045PassStep.Val "MICROSAR RTE" VALUE 0x0 RTE_RL_UWORD 0 NO_COMPU_METHOD 0 65535 SYMBOL_LINK "Rte_CalprmRom_CalRegn01Cmn_DEFAULT_RTE_CALPRM_GROUP.EcuTMeasNtc0x045PassStep_Val" 0 DISPLAY_IDENTIFIER CalRegn01Cmn.CalibrationPorts.EcuTMeasNtc0x045PassStep.Val /end CHARACTERISTIC
/begin CHARACTERISTIC CalRegn01Cmn.EcuTMeasRngDiagcMax.Val "MICROSAR RTE" VALUE 0x0 RTE_RL_FLOAT32_IEEE 0 NO_COMPU_METHOD -50.0 200.0 SYMBOL_LINK "Rte_CalprmRom_CalRegn01Cmn_DEFAULT_RTE_CALPRM_GROUP.EcuTMeasRngDiagcMax_Val" 0 DISPLAY_IDENTIFIER CalRegn01Cmn.CalibrationPorts.EcuTMeasRngDiagcMax.Val /end CHARACTERISTIC
/begin CHARACTERISTIC CalRegn01Cmn.EcuTMeasRngDiagcMin.Val "MICROSAR RTE" VALUE 0x0 RTE_RL_FLOAT32_IEEE 0 NO_COMPU_METHOD -50.0 200.0 SYMBOL_LINK "Rte_CalprmRom_CalRegn01Cmn_DEFAULT_RTE_CALPRM_GROUP.EcuTMeasRngDiagcMin_Val" 0 DISPLAY_IDENTIFIER CalRegn01Cmn.CalibrationPorts.EcuTMeasRngDiagcMin.Val /end CHARACTERISTIC
/begin CHARACTERISTIC CalRegn01Cmn.EcuTMeasScag.Val "MICROSAR RTE" VALUE 0x0 RTE_RL_FLOAT32_IEEE 0 NO_COMPU_METHOD 0.0 200.0 SYMBOL_LINK "Rte_CalprmRom_CalRegn01Cmn_DEFAULT_RTE_CALPRM_GROUP.EcuTMeasScag_Val" 0 DISPLAY_IDENTIFIER CalRegn01Cmn.CalibrationPorts.EcuTMeasScag.Val /end CHARACTERISTIC
/begin CHARACTERISTIC CalRegn01Cmn.EcuTMeasScagOffs.Val "MICROSAR RTE" VALUE 0x0 RTE_RL_FLOAT32_IEEE 0 NO_COMPU_METHOD -100.0 150.0 SYMBOL_LINK "Rte_CalprmRom_CalRegn01Cmn_DEFAULT_RTE_CALPRM_GROUP.EcuTMeasScagOffs_Val" 0 DISPLAY_IDENTIFIER CalRegn01Cmn.CalibrationPorts.EcuTMeasScagOffs.Val /end CHARACTERISTIC
/begin CHARACTERISTIC CalRegn01Cmn.ElecPwrCnsCtrlrInpR.Val "MICROSAR RTE" VALUE 0x0 RTE_RL_FLOAT32_IEEE 0 NO_COMPU_METHOD -3.402823466e+38 3.402823466e+38 SYMBOL_LINK "Rte_CalRegn01Cmn_ElecPwrCnsCtrlrInpR_Val" 0 DISPLAY_IDENTIFIER CalRegn01Cmn.CalibrationPorts.ElecPwrCnsCtrlrInpR.Val /end CHARACTERISTIC
/begin CHARACTERISTIC CalRegn01Cmn.EotLrngHwAgOverTrvlCnt.Val "MICROSAR RTE" VALUE 0x0 RTE_RL_UBYTE 0 NO_COMPU_METHOD 0 255 SYMBOL_LINK "Rte_CalprmRom_CalRegn01Cmn_DEFAULT_RTE_CALPRM_GROUP.EotLrngHwAgOverTrvlCnt_Val" 0 DISPLAY_IDENTIFIER CalRegn01Cmn.CalibrationPorts.EotLrngHwAgOverTrvlCnt.Val /end CHARACTERISTIC
/begin CHARACTERISTIC CalRegn01Cmn.EotProtnFwlEotDampgActvBndX.Ary1D "MICROSAR RTE" VAL_BLK 0x0 RTE_RL_SWORD 0 NO_COMPU_METHOD -32768 32767 MATRIX_DIM 5 1 1 SYMBOL_LINK "Rte_CalprmRom_CalRegn01Cmn_DEFAULT_RTE_CALPRM_GROUP.EotProtnFwlEotDampgActvBndX_Ary1D" 0 DISPLAY_IDENTIFIER CalRegn01Cmn.CalibrationPorts.EotProtnFwlEotDampgActvBndX.Ary1D /end CHARACTERISTIC
/begin CHARACTERISTIC CalRegn01Cmn.EotProtnFwlInactvLim.Val "MICROSAR RTE" VALUE 0x0 RTE_RL_FLOAT32_IEEE 0 NO_COMPU_METHOD -3.402823466e+38 3.402823466e+38 SYMBOL_LINK "Rte_CalprmRom_CalRegn01Cmn_DEFAULT_RTE_CALPRM_GROUP.EotProtnFwlInactvLim_Val" 0 DISPLAY_IDENTIFIER CalRegn01Cmn.CalibrationPorts.EotProtnFwlInactvLim.Val /end CHARACTERISTIC
/begin CHARACTERISTIC CalRegn01Cmn.EotProtnFwlVehSpd.Ary1D "MICROSAR RTE" VAL_BLK 0x0 RTE_RL_UWORD 0 NO_COMPU_METHOD 0 65535 MATRIX_DIM 4 1 1 SYMBOL_LINK "Rte_CalprmRom_CalRegn01Cmn_DEFAULT_RTE_CALPRM_GROUP.EotProtnFwlVehSpd_Ary1D" 0 DISPLAY_IDENTIFIER CalRegn01Cmn.CalibrationPorts.EotProtnFwlVehSpd.Ary1D /end CHARACTERISTIC
/begin CHARACTERISTIC CalRegn01Cmn.GateDrv0CtrlNtcNr0x050FailStep.Val "MICROSAR RTE" VALUE 0x0 RTE_RL_UWORD 0 NO_COMPU_METHOD 0 65535 SYMBOL_LINK "Rte_CalprmRom_CalRegn01Cmn_DEFAULT_RTE_CALPRM_GROUP.GateDrv0CtrlNtcNr0x050FailStep_Val" 0 DISPLAY_IDENTIFIER CalRegn01Cmn.CalibrationPorts.GateDrv0CtrlNtcNr0x050FailStep.Val /end CHARACTERISTIC
/begin CHARACTERISTIC CalRegn01Cmn.GateDrv0CtrlNtcNr0x050PassStep.Val "MICROSAR RTE" VALUE 0x0 RTE_RL_UWORD 0 NO_COMPU_METHOD 0 65535 SYMBOL_LINK "Rte_CalprmRom_CalRegn01Cmn_DEFAULT_RTE_CALPRM_GROUP.GateDrv0CtrlNtcNr0x050PassStep_Val" 0 DISPLAY_IDENTIFIER CalRegn01Cmn.CalibrationPorts.GateDrv0CtrlNtcNr0x050PassStep.Val /end CHARACTERISTIC
/begin CHARACTERISTIC CalRegn01Cmn.GateDrv0CtrlNtcNr0x051FailStep.Val "MICROSAR RTE" VALUE 0x0 RTE_RL_UWORD 0 NO_COMPU_METHOD 0 65535 SYMBOL_LINK "Rte_CalprmRom_CalRegn01Cmn_DEFAULT_RTE_CALPRM_GROUP.GateDrv0CtrlNtcNr0x051FailStep_Val" 0 DISPLAY_IDENTIFIER CalRegn01Cmn.CalibrationPorts.GateDrv0CtrlNtcNr0x051FailStep.Val /end CHARACTERISTIC
/begin CHARACTERISTIC CalRegn01Cmn.GateDrv0CtrlNtcNr0x051PassStep.Val "MICROSAR RTE" VALUE 0x0 RTE_RL_UWORD 0 NO_COMPU_METHOD 0 65535 SYMBOL_LINK "Rte_CalprmRom_CalRegn01Cmn_DEFAULT_RTE_CALPRM_GROUP.GateDrv0CtrlNtcNr0x051PassStep_Val" 0 DISPLAY_IDENTIFIER CalRegn01Cmn.CalibrationPorts.GateDrv0CtrlNtcNr0x051PassStep.Val /end CHARACTERISTIC
/begin CHARACTERISTIC CalRegn01Cmn.GateDrv0CtrlNtcNr0x055FailStep.Val "MICROSAR RTE" VALUE 0x0 RTE_RL_UWORD 0 NO_COMPU_METHOD 0 65535 SYMBOL_LINK "Rte_CalprmRom_CalRegn01Cmn_DEFAULT_RTE_CALPRM_GROUP.GateDrv0CtrlNtcNr0x055FailStep_Val" 0 DISPLAY_IDENTIFIER CalRegn01Cmn.CalibrationPorts.GateDrv0CtrlNtcNr0x055FailStep.Val /end CHARACTERISTIC
/begin CHARACTERISTIC CalRegn01Cmn.GateDrv0CtrlNtcNr0x055PassStep.Val "MICROSAR RTE" VALUE 0x0 RTE_RL_UWORD 0 NO_COMPU_METHOD 0 65535 SYMBOL_LINK "Rte_CalprmRom_CalRegn01Cmn_DEFAULT_RTE_CALPRM_GROUP.GateDrv0CtrlNtcNr0x055PassStep_Val" 0 DISPLAY_IDENTIFIER CalRegn01Cmn.CalibrationPorts.GateDrv0CtrlNtcNr0x055PassStep.Val /end CHARACTERISTIC
/begin CHARACTERISTIC CalRegn01Cmn.GateDrv0CtrlUnit0Cfg2WrVal.Val "MICROSAR RTE" VALUE 0x0 RTE_RL_UWORD 0 NO_COMPU_METHOD 0 65535 SYMBOL_LINK "Rte_CalprmRom_CalRegn01Cmn_DEFAULT_RTE_CALPRM_GROUP.GateDrv0CtrlUnit0Cfg2WrVal_Val" 0 DISPLAY_IDENTIFIER CalRegn01Cmn.CalibrationPorts.GateDrv0CtrlUnit0Cfg2WrVal.Val /end CHARACTERISTIC
/begin CHARACTERISTIC CalRegn01Cmn.GateDrv0CtrlUnit0Cfg3WrVal.Val "MICROSAR RTE" VALUE 0x0 RTE_RL_UWORD 0 NO_COMPU_METHOD 0 65535 SYMBOL_LINK "Rte_CalprmRom_CalRegn01Cmn_DEFAULT_RTE_CALPRM_GROUP.GateDrv0CtrlUnit0Cfg3WrVal_Val" 0 DISPLAY_IDENTIFIER CalRegn01Cmn.CalibrationPorts.GateDrv0CtrlUnit0Cfg3WrVal.Val /end CHARACTERISTIC
/begin CHARACTERISTIC CalRegn01Cmn.GateDrv0CtrlUnit0Cfg4WrVal.Val "MICROSAR RTE" VALUE 0x0 RTE_RL_UWORD 0 NO_COMPU_METHOD 0 65535 SYMBOL_LINK "Rte_CalprmRom_CalRegn01Cmn_DEFAULT_RTE_CALPRM_GROUP.GateDrv0CtrlUnit0Cfg4WrVal_Val" 0 DISPLAY_IDENTIFIER CalRegn01Cmn.CalibrationPorts.GateDrv0CtrlUnit0Cfg4WrVal.Val /end CHARACTERISTIC
/begin CHARACTERISTIC CalRegn01Cmn.GateDrv0CtrlUnit0Cfg7WrVal.Val "MICROSAR RTE" VALUE 0x0 RTE_RL_UWORD 0 NO_COMPU_METHOD 0 65535 SYMBOL_LINK "Rte_CalprmRom_CalRegn01Cmn_DEFAULT_RTE_CALPRM_GROUP.GateDrv0CtrlUnit0Cfg7WrVal_Val" 0 DISPLAY_IDENTIFIER CalRegn01Cmn.CalibrationPorts.GateDrv0CtrlUnit0Cfg7WrVal.Val /end CHARACTERISTIC
/begin CHARACTERISTIC CalRegn01Cmn.GmFctDiArbnEotHwAgThd.Val "MICROSAR RTE" VALUE 0x0 RTE_RL_FLOAT32_IEEE 0 NO_COMPU_METHOD -3.402823466e+38 3.402823466e+38 SYMBOL_LINK "Rte_CalprmRom_CalRegn01Cmn_DEFAULT_RTE_CALPRM_GROUP.GmFctDiArbnEotHwAgThd_Val" 0 DISPLAY_IDENTIFIER CalRegn01Cmn.CalibrationPorts.GmFctDiArbnEotHwAgThd.Val /end CHARACTERISTIC
/begin CHARACTERISTIC CalRegn01Cmn.GmFctDiArbnEotTi.Val "MICROSAR RTE" VALUE 0x0 RTE_RL_FLOAT32_IEEE 0 NO_COMPU_METHOD -3.402823466e+38 3.402823466e+38 SYMBOL_LINK "Rte_CalprmRom_CalRegn01Cmn_DEFAULT_RTE_CALPRM_GROUP.GmFctDiArbnEotTi_Val" 0 DISPLAY_IDENTIFIER CalRegn01Cmn.CalibrationPorts.GmFctDiArbnEotTi.Val /end CHARACTERISTIC
/begin CHARACTERISTIC CalRegn01Cmn.GmFctDiArbnOnCentrHwAgThd.Val "MICROSAR RTE" VALUE 0x0 RTE_RL_FLOAT32_IEEE 0 NO_COMPU_METHOD -3.402823466e+38 3.402823466e+38 SYMBOL_LINK "Rte_CalprmRom_CalRegn01Cmn_DEFAULT_RTE_CALPRM_GROUP.GmFctDiArbnOnCentrHwAgThd_Val" 0 DISPLAY_IDENTIFIER CalRegn01Cmn.CalibrationPorts.GmFctDiArbnOnCentrHwAgThd.Val /end CHARACTERISTIC
/begin CHARACTERISTIC CalRegn01Cmn.GmFctDiArbnOnCentrHwTqThd.Val "MICROSAR RTE" VALUE 0x0 RTE_RL_FLOAT32_IEEE 0 NO_COMPU_METHOD -3.402823466e+38 3.402823466e+38 SYMBOL_LINK "Rte_CalprmRom_CalRegn01Cmn_DEFAULT_RTE_CALPRM_GROUP.GmFctDiArbnOnCentrHwTqThd_Val" 0 DISPLAY_IDENTIFIER CalRegn01Cmn.CalibrationPorts.GmFctDiArbnOnCentrHwTqThd.Val /end CHARACTERISTIC
/begin CHARACTERISTIC CalRegn01Cmn.GmFctDiArbnOnCentrTi.Val "MICROSAR RTE" VALUE 0x0 RTE_RL_FLOAT32_IEEE 0 NO_COMPU_METHOD -3.402823466e+38 3.402823466e+38 SYMBOL_LINK "Rte_CalprmRom_CalRegn01Cmn_DEFAULT_RTE_CALPRM_GROUP.GmFctDiArbnOnCentrTi_Val" 0 DISPLAY_IDENTIFIER CalRegn01Cmn.CalibrationPorts.GmFctDiArbnOnCentrTi.Val /end CHARACTERISTIC
/begin CHARACTERISTIC CalRegn01Cmn.GmFctDiArbnSrvTi.Val "MICROSAR RTE" VALUE 0x0 RTE_RL_FLOAT32_IEEE 0 NO_COMPU_METHOD -3.402823466e+38 3.402823466e+38 SYMBOL_LINK "Rte_CalprmRom_CalRegn01Cmn_DEFAULT_RTE_CALPRM_GROUP.GmFctDiArbnSrvTi_Val" 0 DISPLAY_IDENTIFIER CalRegn01Cmn.CalibrationPorts.GmFctDiArbnSrvTi.Val /end CHARACTERISTIC
/begin CHARACTERISTIC CalRegn01Cmn.GmMsg0C5BusHiSpdInvldTiOut.Val "MICROSAR RTE" VALUE 0x0 RTE_RL_UWORD 0 NO_COMPU_METHOD 0 65535 SYMBOL_LINK "Rte_CalprmRom_CalRegn01Cmn_DEFAULT_RTE_CALPRM_GROUP.GmMsg0C5BusHiSpdInvldTiOut_Val" 0 DISPLAY_IDENTIFIER CalRegn01Cmn.CalibrationPorts.GmMsg0C5BusHiSpdInvldTiOut.Val /end CHARACTERISTIC
/begin CHARACTERISTIC CalRegn01Cmn.GmMsg0C5BusHiSpdMissTiOut.Val "MICROSAR RTE" VALUE 0x0 RTE_RL_UWORD 0 NO_COMPU_METHOD 0 65535 SYMBOL_LINK "Rte_CalprmRom_CalRegn01Cmn_DEFAULT_RTE_CALPRM_GROUP.GmMsg0C5BusHiSpdMissTiOut_Val" 0 DISPLAY_IDENTIFIER CalRegn01Cmn.CalibrationPorts.GmMsg0C5BusHiSpdMissTiOut.Val /end CHARACTERISTIC
/begin CHARACTERISTIC CalRegn01Cmn.GmMsg0C5BusHiSpdRstTiOut.Val "MICROSAR RTE" VALUE 0x0 RTE_RL_UWORD 0 NO_COMPU_METHOD 0 65535 SYMBOL_LINK "Rte_CalprmRom_CalRegn01Cmn_DEFAULT_RTE_CALPRM_GROUP.GmMsg0C5BusHiSpdRstTiOut_Val" 0 DISPLAY_IDENTIFIER CalRegn01Cmn.CalibrationPorts.GmMsg0C5BusHiSpdRstTiOut.Val /end CHARACTERISTIC
/begin CHARACTERISTIC CalRegn01Cmn.GmMsg0C5BusHiSpdSeqNrTiOut.Val "MICROSAR RTE" VALUE 0x0 RTE_RL_UWORD 0 NO_COMPU_METHOD 0 65535 SYMBOL_LINK "Rte_CalprmRom_CalRegn01Cmn_DEFAULT_RTE_CALPRM_GROUP.GmMsg0C5BusHiSpdSeqNrTiOut_Val" 0 DISPLAY_IDENTIFIER CalRegn01Cmn.CalibrationPorts.GmMsg0C5BusHiSpdSeqNrTiOut.Val /end CHARACTERISTIC
/begin CHARACTERISTIC CalRegn01Cmn.GmMsg0C9BusHiSpdInvldTiOut.Val "MICROSAR RTE" VALUE 0x0 RTE_RL_UWORD 0 NO_COMPU_METHOD 0 65535 SYMBOL_LINK "Rte_CalprmRom_CalRegn01Cmn_DEFAULT_RTE_CALPRM_GROUP.GmMsg0C9BusHiSpdInvldTiOut_Val" 0 DISPLAY_IDENTIFIER CalRegn01Cmn.CalibrationPorts.GmMsg0C9BusHiSpdInvldTiOut.Val /end CHARACTERISTIC
/begin CHARACTERISTIC CalRegn01Cmn.GmMsg0C9BusHiSpdMissTiOut.Val "MICROSAR RTE" VALUE 0x0 RTE_RL_UWORD 0 NO_COMPU_METHOD 0 65535 SYMBOL_LINK "Rte_CalprmRom_CalRegn01Cmn_DEFAULT_RTE_CALPRM_GROUP.GmMsg0C9BusHiSpdMissTiOut_Val" 0 DISPLAY_IDENTIFIER CalRegn01Cmn.CalibrationPorts.GmMsg0C9BusHiSpdMissTiOut.Val /end CHARACTERISTIC
/begin CHARACTERISTIC CalRegn01Cmn.GmMsg0C9BusHiSpdVehSpdThd.Val "MICROSAR RTE" VALUE 0x0 RTE_RL_FLOAT32_IEEE 0 NO_COMPU_METHOD -3.402823466e+38 3.402823466e+38 SYMBOL_LINK "Rte_CalprmRom_CalRegn01Cmn_DEFAULT_RTE_CALPRM_GROUP.GmMsg0C9BusHiSpdVehSpdThd_Val" 0 DISPLAY_IDENTIFIER CalRegn01Cmn.CalibrationPorts.GmMsg0C9BusHiSpdVehSpdThd.Val /end CHARACTERISTIC
/begin CHARACTERISTIC CalRegn01Cmn.GmMsg17DBusHiSpdInvldTiOut.Val "MICROSAR RTE" VALUE 0x0 RTE_RL_UWORD 0 NO_COMPU_METHOD 0 65535 SYMBOL_LINK "Rte_CalprmRom_CalRegn01Cmn_DEFAULT_RTE_CALPRM_GROUP.GmMsg17DBusHiSpdInvldTiOut_Val" 0 DISPLAY_IDENTIFIER CalRegn01Cmn.CalibrationPorts.GmMsg17DBusHiSpdInvldTiOut.Val /end CHARACTERISTIC
/begin CHARACTERISTIC CalRegn01Cmn.GmMsg17DBusHiSpdMissTiOut.Val "MICROSAR RTE" VALUE 0x0 RTE_RL_UWORD 0 NO_COMPU_METHOD 0 65535 SYMBOL_LINK "Rte_CalprmRom_CalRegn01Cmn_DEFAULT_RTE_CALPRM_GROUP.GmMsg17DBusHiSpdMissTiOut_Val" 0 DISPLAY_IDENTIFIER CalRegn01Cmn.CalibrationPorts.GmMsg17DBusHiSpdMissTiOut.Val /end CHARACTERISTIC
/begin CHARACTERISTIC CalRegn01Cmn.GmMsg180BusChassisExpInvldProtnValTiOut.Val "MICROSAR RTE" VALUE 0x0 RTE_RL_UWORD 0 NO_COMPU_METHOD 0 65535 SYMBOL_LINK "Rte_CalprmRom_CalRegn01Cmn_DEFAULT_RTE_CALPRM_GROUP.GmMsg180BusChassisExpInvldProtnValTiOut_Val" 0 DISPLAY_IDENTIFIER CalRegn01Cmn.CalibrationPorts.GmMsg180BusChassisExpInvldProtnValTiOut.Val /end CHARACTERISTIC
/begin CHARACTERISTIC CalRegn01Cmn.GmMsg180BusChassisExpMissTiOut.Val "MICROSAR RTE" VALUE 0x0 RTE_RL_UWORD 0 NO_COMPU_METHOD 0 65535 SYMBOL_LINK "Rte_CalprmRom_CalRegn01Cmn_DEFAULT_RTE_CALPRM_GROUP.GmMsg180BusChassisExpMissTiOut_Val" 0 DISPLAY_IDENTIFIER CalRegn01Cmn.CalibrationPorts.GmMsg180BusChassisExpMissTiOut.Val /end CHARACTERISTIC
/begin CHARACTERISTIC CalRegn01Cmn.GmMsg180BusChassisExpRollgCntrInvldTiOut.Val "MICROSAR RTE" VALUE 0x0 RTE_RL_UWORD 0 NO_COMPU_METHOD 0 65535 SYMBOL_LINK "Rte_CalprmRom_CalRegn01Cmn_DEFAULT_RTE_CALPRM_GROUP.GmMsg180BusChassisExpRollgCntrInvldTiOut_Val" 0 DISPLAY_IDENTIFIER CalRegn01Cmn.CalibrationPorts.GmMsg180BusChassisExpRollgCntrInvldTiOut.Val /end CHARACTERISTIC
/begin CHARACTERISTIC CalRegn01Cmn.GmMsg180BusChassisExpTqPolarity.Val "MICROSAR RTE" VALUE 0x0 RTE_RL_SBYTE 0 NO_COMPU_METHOD -128 127 SYMBOL_LINK "Rte_CalprmRom_CalRegn01Cmn_DEFAULT_RTE_CALPRM_GROUP.GmMsg180BusChassisExpTqPolarity_Val" 0 DISPLAY_IDENTIFIER CalRegn01Cmn.CalibrationPorts.GmMsg180BusChassisExpTqPolarity.Val /end CHARACTERISTIC
/begin CHARACTERISTIC CalRegn01Cmn.GmMsg180BusHiSpdCrcInvldTiOut.Val "MICROSAR RTE" VALUE 0x0 RTE_RL_UWORD 0 NO_COMPU_METHOD 0 65535 SYMBOL_LINK "Rte_CalprmRom_CalRegn01Cmn_DEFAULT_RTE_CALPRM_GROUP.GmMsg180BusHiSpdCrcInvldTiOut_Val" 0 DISPLAY_IDENTIFIER CalRegn01Cmn.CalibrationPorts.GmMsg180BusHiSpdCrcInvldTiOut.Val /end CHARACTERISTIC
/begin CHARACTERISTIC CalRegn01Cmn.GmMsg180BusHiSpdMissTiOut.Val "MICROSAR RTE" VALUE 0x0 RTE_RL_UWORD 0 NO_COMPU_METHOD 0 65535 SYMBOL_LINK "Rte_CalprmRom_CalRegn01Cmn_DEFAULT_RTE_CALPRM_GROUP.GmMsg180BusHiSpdMissTiOut_Val" 0 DISPLAY_IDENTIFIER CalRegn01Cmn.CalibrationPorts.GmMsg180BusHiSpdMissTiOut.Val /end CHARACTERISTIC
/begin CHARACTERISTIC CalRegn01Cmn.GmMsg180BusHiSpdRollgCntrInvldTiOut.Val "MICROSAR RTE" VALUE 0x0 RTE_RL_UWORD 0 NO_COMPU_METHOD 0 65535 SYMBOL_LINK "Rte_CalprmRom_CalRegn01Cmn_DEFAULT_RTE_CALPRM_GROUP.GmMsg180BusHiSpdRollgCntrInvldTiOut_Val" 0 DISPLAY_IDENTIFIER CalRegn01Cmn.CalibrationPorts.GmMsg180BusHiSpdRollgCntrInvldTiOut.Val /end CHARACTERISTIC
/begin CHARACTERISTIC CalRegn01Cmn.GmMsg180BusHiSpdTqPolarity.Val "MICROSAR RTE" VALUE 0x0 RTE_RL_SBYTE 0 NO_COMPU_METHOD -128 127 SYMBOL_LINK "Rte_CalprmRom_CalRegn01Cmn_DEFAULT_RTE_CALPRM_GROUP.GmMsg180BusHiSpdTqPolarity_Val" 0 DISPLAY_IDENTIFIER CalRegn01Cmn.CalibrationPorts.GmMsg180BusHiSpdTqPolarity.Val /end CHARACTERISTIC
/begin CHARACTERISTIC CalRegn01Cmn.GmMsg182BusChassisExpInvldTiOut.Val "MICROSAR RTE" VALUE 0x0 RTE_RL_UWORD 0 NO_COMPU_METHOD 0 65535 SYMBOL_LINK "Rte_CalprmRom_CalRegn01Cmn_DEFAULT_RTE_CALPRM_GROUP.GmMsg182BusChassisExpInvldTiOut_Val" 0 DISPLAY_IDENTIFIER CalRegn01Cmn.CalibrationPorts.GmMsg182BusChassisExpInvldTiOut.Val /end CHARACTERISTIC
/begin CHARACTERISTIC CalRegn01Cmn.GmMsg182BusChassisExpMissTiOut.Val "MICROSAR RTE" VALUE 0x0 RTE_RL_UWORD 0 NO_COMPU_METHOD 0 65535 SYMBOL_LINK "Rte_CalprmRom_CalRegn01Cmn_DEFAULT_RTE_CALPRM_GROUP.GmMsg182BusChassisExpMissTiOut_Val" 0 DISPLAY_IDENTIFIER CalRegn01Cmn.CalibrationPorts.GmMsg182BusChassisExpMissTiOut.Val /end CHARACTERISTIC
/begin CHARACTERISTIC CalRegn01Cmn.GmMsg184BusHiSpdHandsOnThd.Val "MICROSAR RTE" VALUE 0x0 RTE_RL_FLOAT32_IEEE 0 NO_COMPU_METHOD -3.402823466e+38 3.402823466e+38 SYMBOL_LINK "Rte_CalprmRom_CalRegn01Cmn_DEFAULT_RTE_CALPRM_GROUP.GmMsg184BusHiSpdHandsOnThd_Val" 0 DISPLAY_IDENTIFIER CalRegn01Cmn.CalibrationPorts.GmMsg184BusHiSpdHandsOnThd.Val /end CHARACTERISTIC
/begin CHARACTERISTIC CalRegn01Cmn.GmMsg184BusHiSpdTqPolarity.Val "MICROSAR RTE" VALUE 0x0 RTE_RL_SBYTE 0 NO_COMPU_METHOD -128 127 SYMBOL_LINK "Rte_CalprmRom_CalRegn01Cmn_DEFAULT_RTE_CALPRM_GROUP.GmMsg184BusHiSpdTqPolarity_Val" 0 DISPLAY_IDENTIFIER CalRegn01Cmn.CalibrationPorts.GmMsg184BusHiSpdTqPolarity.Val /end CHARACTERISTIC
/begin CHARACTERISTIC CalRegn01Cmn.GmMsg1CaBusChassisExpTqPolarity.Val "MICROSAR RTE" VALUE 0x0 RTE_RL_SBYTE 0 NO_COMPU_METHOD -128 127 SYMBOL_LINK "Rte_CalprmRom_CalRegn01Cmn_DEFAULT_RTE_CALPRM_GROUP.GmMsg1CaBusChassisExpTqPolarity_Val" 0 DISPLAY_IDENTIFIER CalRegn01Cmn.CalibrationPorts.GmMsg1CaBusChassisExpTqPolarity.Val /end CHARACTERISTIC
/begin CHARACTERISTIC CalRegn01Cmn.GmMsg1E9BusHiSpdAbsFaildTiOut.Val "MICROSAR RTE" VALUE 0x0 RTE_RL_UWORD 0 NO_COMPU_METHOD 0 65535 SYMBOL_LINK "Rte_CalprmRom_CalRegn01Cmn_DEFAULT_RTE_CALPRM_GROUP.GmMsg1E9BusHiSpdAbsFaildTiOut_Val" 0 DISPLAY_IDENTIFIER CalRegn01Cmn.CalibrationPorts.GmMsg1E9BusHiSpdAbsFaildTiOut.Val /end CHARACTERISTIC
/begin CHARACTERISTIC CalRegn01Cmn.GmMsg1E9BusHiSpdLatADft.Val "MICROSAR RTE" VALUE 0x0 RTE_RL_FLOAT32_IEEE 0 NO_COMPU_METHOD -3.402823466e+38 3.402823466e+38 SYMBOL_LINK "Rte_CalprmRom_CalRegn01Cmn_DEFAULT_RTE_CALPRM_GROUP.GmMsg1E9BusHiSpdLatADft_Val" 0 DISPLAY_IDENTIFIER CalRegn01Cmn.CalibrationPorts.GmMsg1E9BusHiSpdLatADft.Val /end CHARACTERISTIC
/begin CHARACTERISTIC CalRegn01Cmn.GmMsg1E9BusHiSpdLatAInvldTiOut.Val "MICROSAR RTE" VALUE 0x0 RTE_RL_UWORD 0 NO_COMPU_METHOD 0 65535 SYMBOL_LINK "Rte_CalprmRom_CalRegn01Cmn_DEFAULT_RTE_CALPRM_GROUP.GmMsg1E9BusHiSpdLatAInvldTiOut_Val" 0 DISPLAY_IDENTIFIER CalRegn01Cmn.CalibrationPorts.GmMsg1E9BusHiSpdLatAInvldTiOut.Val /end CHARACTERISTIC
/begin CHARACTERISTIC CalRegn01Cmn.GmMsg1E9BusHiSpdMissTiOut.Val "MICROSAR RTE" VALUE 0x0 RTE_RL_UWORD 0 NO_COMPU_METHOD 0 65535 SYMBOL_LINK "Rte_CalprmRom_CalRegn01Cmn_DEFAULT_RTE_CALPRM_GROUP.GmMsg1E9BusHiSpdMissTiOut_Val" 0 DISPLAY_IDENTIFIER CalRegn01Cmn.CalibrationPorts.GmMsg1E9BusHiSpdMissTiOut.Val /end CHARACTERISTIC
/begin CHARACTERISTIC CalRegn01Cmn.GmMsg1E9BusHiSpdTcsDisadTiOut.Val "MICROSAR RTE" VALUE 0x0 RTE_RL_UWORD 0 NO_COMPU_METHOD 0 65535 SYMBOL_LINK "Rte_CalprmRom_CalRegn01Cmn_DEFAULT_RTE_CALPRM_GROUP.GmMsg1E9BusHiSpdTcsDisadTiOut_Val" 0 DISPLAY_IDENTIFIER CalRegn01Cmn.CalibrationPorts.GmMsg1E9BusHiSpdTcsDisadTiOut.Val /end CHARACTERISTIC
/begin CHARACTERISTIC CalRegn01Cmn.GmMsg1E9BusHiSpdVehDynCtrlStTiOut.Val "MICROSAR RTE" VALUE 0x0 RTE_RL_UWORD 0 NO_COMPU_METHOD 0 65535 SYMBOL_LINK "Rte_CalprmRom_CalRegn01Cmn_DEFAULT_RTE_CALPRM_GROUP.GmMsg1E9BusHiSpdVehDynCtrlStTiOut_Val" 0 DISPLAY_IDENTIFIER CalRegn01Cmn.CalibrationPorts.GmMsg1E9BusHiSpdVehDynCtrlStTiOut.Val /end CHARACTERISTIC
/begin CHARACTERISTIC CalRegn01Cmn.GmMsg1E9BusHiSpdVehStabyEnhmtActvVldTiOut.Val "MICROSAR RTE" VALUE 0x0 RTE_RL_UWORD 0 NO_COMPU_METHOD 0 65535 SYMBOL_LINK "Rte_CalprmRom_CalRegn01Cmn_DEFAULT_RTE_CALPRM_GROUP.GmMsg1E9BusHiSpdVehStabyEnhmtActvVldTiOut_Val" 0 DISPLAY_IDENTIFIER CalRegn01Cmn.CalibrationPorts.GmMsg1E9BusHiSpdVehStabyEnhmtActvVldTiOut.Val /end CHARACTERISTIC
/begin CHARACTERISTIC CalRegn01Cmn.GmMsg1E9BusHiSpdYawRateDft.Val "MICROSAR RTE" VALUE 0x0 RTE_RL_FLOAT32_IEEE 0 NO_COMPU_METHOD -3.402823466e+38 3.402823466e+38 SYMBOL_LINK "Rte_CalprmRom_CalRegn01Cmn_DEFAULT_RTE_CALPRM_GROUP.GmMsg1E9BusHiSpdYawRateDft_Val" 0 DISPLAY_IDENTIFIER CalRegn01Cmn.CalibrationPorts.GmMsg1E9BusHiSpdYawRateDft.Val /end CHARACTERISTIC
/begin CHARACTERISTIC CalRegn01Cmn.GmMsg1E9BusHiSpdYawRateInvldTiOut.Val "MICROSAR RTE" VALUE 0x0 RTE_RL_UWORD 0 NO_COMPU_METHOD 0 65535 SYMBOL_LINK "Rte_CalprmRom_CalRegn01Cmn_DEFAULT_RTE_CALPRM_GROUP.GmMsg1E9BusHiSpdYawRateInvldTiOut_Val" 0 DISPLAY_IDENTIFIER CalRegn01Cmn.CalibrationPorts.GmMsg1E9BusHiSpdYawRateInvldTiOut.Val /end CHARACTERISTIC
/begin CHARACTERISTIC CalRegn01Cmn.GmMsg1F1BusHiSpdMissTiOut.Val "MICROSAR RTE" VALUE 0x0 RTE_RL_UWORD 0 NO_COMPU_METHOD 0 65535 SYMBOL_LINK "Rte_CalprmRom_CalRegn01Cmn_DEFAULT_RTE_CALPRM_GROUP.GmMsg1F1BusHiSpdMissTiOut_Val" 0 DISPLAY_IDENTIFIER CalRegn01Cmn.CalibrationPorts.GmMsg1F1BusHiSpdMissTiOut.Val /end CHARACTERISTIC
/begin CHARACTERISTIC CalRegn01Cmn.GmMsg1F5BusHiSpdInvldTiOut.Val "MICROSAR RTE" VALUE 0x0 RTE_RL_UWORD 0 NO_COMPU_METHOD 0 65535 SYMBOL_LINK "Rte_CalprmRom_CalRegn01Cmn_DEFAULT_RTE_CALPRM_GROUP.GmMsg1F5BusHiSpdInvldTiOut_Val" 0 DISPLAY_IDENTIFIER CalRegn01Cmn.CalibrationPorts.GmMsg1F5BusHiSpdInvldTiOut.Val /end CHARACTERISTIC
/begin CHARACTERISTIC CalRegn01Cmn.GmMsg1F5BusHiSpdMissTiOut.Val "MICROSAR RTE" VALUE 0x0 RTE_RL_UWORD 0 NO_COMPU_METHOD 0 65535 SYMBOL_LINK "Rte_CalprmRom_CalRegn01Cmn_DEFAULT_RTE_CALPRM_GROUP.GmMsg1F5BusHiSpdMissTiOut_Val" 0 DISPLAY_IDENTIFIER CalRegn01Cmn.CalibrationPorts.GmMsg1F5BusHiSpdMissTiOut.Val /end CHARACTERISTIC
/begin CHARACTERISTIC CalRegn01Cmn.GmMsg214BusHiSpdAbsActvProtdInvldTiOut.Val "MICROSAR RTE" VALUE 0x0 RTE_RL_UWORD 0 NO_COMPU_METHOD 0 65535 SYMBOL_LINK "Rte_CalprmRom_CalRegn01Cmn_DEFAULT_RTE_CALPRM_GROUP.GmMsg214BusHiSpdAbsActvProtdInvldTiOut_Val" 0 DISPLAY_IDENTIFIER CalRegn01Cmn.CalibrationPorts.GmMsg214BusHiSpdAbsActvProtdInvldTiOut.Val /end CHARACTERISTIC
/begin CHARACTERISTIC CalRegn01Cmn.GmMsg214BusHiSpdAbsActvProtdProtnValInvldTiOut.Val "MICROSAR RTE" VALUE 0x0 RTE_RL_UWORD 0 NO_COMPU_METHOD 0 65535 SYMBOL_LINK "Rte_CalprmRom_CalRegn01Cmn_DEFAULT_RTE_CALPRM_GROUP.GmMsg214BusHiSpdAbsActvProtdProtnValInvldTiOut_Val" 0 DISPLAY_IDENTIFIER CalRegn01Cmn.CalibrationPorts.GmMsg214BusHiSpdAbsActvProtdProtnValInvldTiOut.Val /end CHARACTERISTIC
/begin CHARACTERISTIC CalRegn01Cmn.GmMsg214BusHiSpdAbsActvProtdRollgCntrInvldTiOut.Val "MICROSAR RTE" VALUE 0x0 RTE_RL_UWORD 0 NO_COMPU_METHOD 0 65535 SYMBOL_LINK "Rte_CalprmRom_CalRegn01Cmn_DEFAULT_RTE_CALPRM_GROUP.GmMsg214BusHiSpdAbsActvProtdRollgCntrInvldTiOut_Val" 0 DISPLAY_IDENTIFIER CalRegn01Cmn.CalibrationPorts.GmMsg214BusHiSpdAbsActvProtdRollgCntrInvldTiOut.Val /end CHARACTERISTIC
/begin CHARACTERISTIC CalRegn01Cmn.GmMsg214BusHiSpdMissTiOut.Val "MICROSAR RTE" VALUE 0x0 RTE_RL_UWORD 0 NO_COMPU_METHOD 0 65535 SYMBOL_LINK "Rte_CalprmRom_CalRegn01Cmn_DEFAULT_RTE_CALPRM_GROUP.GmMsg214BusHiSpdMissTiOut_Val" 0 DISPLAY_IDENTIFIER CalRegn01Cmn.CalibrationPorts.GmMsg214BusHiSpdMissTiOut.Val /end CHARACTERISTIC
/begin CHARACTERISTIC CalRegn01Cmn.GmMsg214BusHiSpdRdntVehStabyEnhmtActvInvldTiOut.Val "MICROSAR RTE" VALUE 0x0 RTE_RL_UWORD 0 NO_COMPU_METHOD 0 65535 SYMBOL_LINK "Rte_CalprmRom_CalRegn01Cmn_DEFAULT_RTE_CALPRM_GROUP.GmMsg214BusHiSpdRdntVehStabyEnhmtActvInvldTiOut_Val" 0 DISPLAY_IDENTIFIER CalRegn01Cmn.CalibrationPorts.GmMsg214BusHiSpdRdntVehStabyEnhmtActvInvldTiOut.Val /end CHARACTERISTIC
/begin CHARACTERISTIC CalRegn01Cmn.GmMsg214BusHiSpdRdntVehStabyEnhmtActvRollgCntrInvldTiOut.Val "MICROSAR RTE" VALUE 0x0 RTE_RL_UWORD 0 NO_COMPU_METHOD 0 65535 SYMBOL_LINK "Rte_CalprmRom_CalRegn01Cmn_DEFAULT_RTE_CALPRM_GROUP.GmMsg214BusHiSpdRdntVehStabyEnhmtActvRollgCntrInvldTiOut_Val" 0 DISPLAY_IDENTIFIER CalRegn01Cmn.CalibrationPorts.GmMsg214BusHiSpdRdntVehStabyEnhmtActvRollgCntrInvldTiOut.Val /end CHARACTERISTIC
/begin CHARACTERISTIC CalRegn01Cmn.GmMsg232BusHiSpdMissTiOut.Val "MICROSAR RTE" VALUE 0x0 RTE_RL_UWORD 0 NO_COMPU_METHOD 0 65535 SYMBOL_LINK "Rte_CalprmRom_CalRegn01Cmn_DEFAULT_RTE_CALPRM_GROUP.GmMsg232BusHiSpdMissTiOut_Val" 0 DISPLAY_IDENTIFIER CalRegn01Cmn.CalibrationPorts.GmMsg232BusHiSpdMissTiOut.Val /end CHARACTERISTIC
/begin CHARACTERISTIC CalRegn01Cmn.GmMsg337BusChassisExpInvldDiagcTiOut.Val "MICROSAR RTE" VALUE 0x0 RTE_RL_UWORD 0 NO_COMPU_METHOD 0 65535 SYMBOL_LINK "Rte_CalprmRom_CalRegn01Cmn_DEFAULT_RTE_CALPRM_GROUP.GmMsg337BusChassisExpInvldDiagcTiOut_Val" 0 DISPLAY_IDENTIFIER CalRegn01Cmn.CalibrationPorts.GmMsg337BusChassisExpInvldDiagcTiOut.Val /end CHARACTERISTIC
/begin CHARACTERISTIC CalRegn01Cmn.GmMsg337BusChassisExpInvldProtnValTiOut.Val "MICROSAR RTE" VALUE 0x0 RTE_RL_UWORD 0 NO_COMPU_METHOD 0 65535 SYMBOL_LINK "Rte_CalprmRom_CalRegn01Cmn_DEFAULT_RTE_CALPRM_GROUP.GmMsg337BusChassisExpInvldProtnValTiOut_Val" 0 DISPLAY_IDENTIFIER CalRegn01Cmn.CalibrationPorts.GmMsg337BusChassisExpInvldProtnValTiOut.Val /end CHARACTERISTIC
/begin CHARACTERISTIC CalRegn01Cmn.GmMsg337BusChassisExpInvldRollgCntrTiOut.Val "MICROSAR RTE" VALUE 0x0 RTE_RL_UWORD 0 NO_COMPU_METHOD 0 65535 SYMBOL_LINK "Rte_CalprmRom_CalRegn01Cmn_DEFAULT_RTE_CALPRM_GROUP.GmMsg337BusChassisExpInvldRollgCntrTiOut_Val" 0 DISPLAY_IDENTIFIER CalRegn01Cmn.CalibrationPorts.GmMsg337BusChassisExpInvldRollgCntrTiOut.Val /end CHARACTERISTIC
/begin CHARACTERISTIC CalRegn01Cmn.GmMsg337BusChassisExpMissTiOut.Val "MICROSAR RTE" VALUE 0x0 RTE_RL_UWORD 0 NO_COMPU_METHOD 0 65535 SYMBOL_LINK "Rte_CalprmRom_CalRegn01Cmn_DEFAULT_RTE_CALPRM_GROUP.GmMsg337BusChassisExpMissTiOut_Val" 0 DISPLAY_IDENTIFIER CalRegn01Cmn.CalibrationPorts.GmMsg337BusChassisExpMissTiOut.Val /end CHARACTERISTIC
/begin CHARACTERISTIC CalRegn01Cmn.GmMsg337BusChassisExpTarAgPolarity.Val "MICROSAR RTE" VALUE 0x0 RTE_RL_SBYTE 0 NO_COMPU_METHOD -128 127 SYMBOL_LINK "Rte_CalprmRom_CalRegn01Cmn_DEFAULT_RTE_CALPRM_GROUP.GmMsg337BusChassisExpTarAgPolarity_Val" 0 DISPLAY_IDENTIFIER CalRegn01Cmn.CalibrationPorts.GmMsg337BusChassisExpTarAgPolarity.Val /end CHARACTERISTIC
/begin CHARACTERISTIC CalRegn01Cmn.GmMsg348BusChassisExpInvldTiOut.Val "MICROSAR RTE" VALUE 0x0 RTE_RL_UWORD 0 NO_COMPU_METHOD 0 65535 SYMBOL_LINK "Rte_CalprmRom_CalRegn01Cmn_DEFAULT_RTE_CALPRM_GROUP.GmMsg348BusChassisExpInvldTiOut_Val" 0 DISPLAY_IDENTIFIER CalRegn01Cmn.CalibrationPorts.GmMsg348BusChassisExpInvldTiOut.Val /end CHARACTERISTIC
/begin CHARACTERISTIC CalRegn01Cmn.GmMsg348BusChassisExpMissTiOut.Val "MICROSAR RTE" VALUE 0x0 RTE_RL_UWORD 0 NO_COMPU_METHOD 0 65535 SYMBOL_LINK "Rte_CalprmRom_CalRegn01Cmn_DEFAULT_RTE_CALPRM_GROUP.GmMsg348BusChassisExpMissTiOut_Val" 0 DISPLAY_IDENTIFIER CalRegn01Cmn.CalibrationPorts.GmMsg348BusChassisExpMissTiOut.Val /end CHARACTERISTIC
/begin CHARACTERISTIC CalRegn01Cmn.GmMsg348BusChassisExpStuckTiOut.Val "MICROSAR RTE" VALUE 0x0 RTE_RL_UWORD 0 NO_COMPU_METHOD 0 65535 SYMBOL_LINK "Rte_CalprmRom_CalRegn01Cmn_DEFAULT_RTE_CALPRM_GROUP.GmMsg348BusChassisExpStuckTiOut_Val" 0 DISPLAY_IDENTIFIER CalRegn01Cmn.CalibrationPorts.GmMsg348BusChassisExpStuckTiOut.Val /end CHARACTERISTIC
/begin CHARACTERISTIC CalRegn01Cmn.GmMsg348BusHiSpdInvldTiOut.Val "MICROSAR RTE" VALUE 0x0 RTE_RL_UWORD 0 NO_COMPU_METHOD 0 65535 SYMBOL_LINK "Rte_CalprmRom_CalRegn01Cmn_DEFAULT_RTE_CALPRM_GROUP.GmMsg348BusHiSpdInvldTiOut_Val" 0 DISPLAY_IDENTIFIER CalRegn01Cmn.CalibrationPorts.GmMsg348BusHiSpdInvldTiOut.Val /end CHARACTERISTIC
/begin CHARACTERISTIC CalRegn01Cmn.GmMsg348BusHiSpdMissTiOut.Val "MICROSAR RTE" VALUE 0x0 RTE_RL_UWORD 0 NO_COMPU_METHOD 0 65535 SYMBOL_LINK "Rte_CalprmRom_CalRegn01Cmn_DEFAULT_RTE_CALPRM_GROUP.GmMsg348BusHiSpdMissTiOut_Val" 0 DISPLAY_IDENTIFIER CalRegn01Cmn.CalibrationPorts.GmMsg348BusHiSpdMissTiOut.Val /end CHARACTERISTIC
/begin CHARACTERISTIC CalRegn01Cmn.GmMsg348BusHiSpdStuckTiOut.Val "MICROSAR RTE" VALUE 0x0 RTE_RL_UWORD 0 NO_COMPU_METHOD 0 65535 SYMBOL_LINK "Rte_CalprmRom_CalRegn01Cmn_DEFAULT_RTE_CALPRM_GROUP.GmMsg348BusHiSpdStuckTiOut_Val" 0 DISPLAY_IDENTIFIER CalRegn01Cmn.CalibrationPorts.GmMsg348BusHiSpdStuckTiOut.Val /end CHARACTERISTIC
/begin CHARACTERISTIC CalRegn01Cmn.GmMsg34ABusChassisExpInvldTiOut.Val "MICROSAR RTE" VALUE 0x0 RTE_RL_UWORD 0 NO_COMPU_METHOD 0 65535 SYMBOL_LINK "Rte_CalprmRom_CalRegn01Cmn_DEFAULT_RTE_CALPRM_GROUP.GmMsg34ABusChassisExpInvldTiOut_Val" 0 DISPLAY_IDENTIFIER CalRegn01Cmn.CalibrationPorts.GmMsg34ABusChassisExpInvldTiOut.Val /end CHARACTERISTIC
/begin CHARACTERISTIC CalRegn01Cmn.GmMsg34ABusChassisExpMissTiOut.Val "MICROSAR RTE" VALUE 0x0 RTE_RL_UWORD 0 NO_COMPU_METHOD 0 65535 SYMBOL_LINK "Rte_CalprmRom_CalRegn01Cmn_DEFAULT_RTE_CALPRM_GROUP.GmMsg34ABusChassisExpMissTiOut_Val" 0 DISPLAY_IDENTIFIER CalRegn01Cmn.CalibrationPorts.GmMsg34ABusChassisExpMissTiOut.Val /end CHARACTERISTIC
/begin CHARACTERISTIC CalRegn01Cmn.GmMsg34ABusChassisExpStuckTiOut.Val "MICROSAR RTE" VALUE 0x0 RTE_RL_UWORD 0 NO_COMPU_METHOD 0 65535 SYMBOL_LINK "Rte_CalprmRom_CalRegn01Cmn_DEFAULT_RTE_CALPRM_GROUP.GmMsg34ABusChassisExpStuckTiOut_Val" 0 DISPLAY_IDENTIFIER CalRegn01Cmn.CalibrationPorts.GmMsg34ABusChassisExpStuckTiOut.Val /end CHARACTERISTIC
/begin CHARACTERISTIC CalRegn01Cmn.GmMsg34ABusHiSpdInvldTiOut.Val "MICROSAR RTE" VALUE 0x0 RTE_RL_UWORD 0 NO_COMPU_METHOD 0 65535 SYMBOL_LINK "Rte_CalprmRom_CalRegn01Cmn_DEFAULT_RTE_CALPRM_GROUP.GmMsg34ABusHiSpdInvldTiOut_Val" 0 DISPLAY_IDENTIFIER CalRegn01Cmn.CalibrationPorts.GmMsg34ABusHiSpdInvldTiOut.Val /end CHARACTERISTIC
/begin CHARACTERISTIC CalRegn01Cmn.GmMsg34ABusHiSpdMissTiOut.Val "MICROSAR RTE" VALUE 0x0 RTE_RL_UWORD 0 NO_COMPU_METHOD 0 65535 SYMBOL_LINK "Rte_CalprmRom_CalRegn01Cmn_DEFAULT_RTE_CALPRM_GROUP.GmMsg34ABusHiSpdMissTiOut_Val" 0 DISPLAY_IDENTIFIER CalRegn01Cmn.CalibrationPorts.GmMsg34ABusHiSpdMissTiOut.Val /end CHARACTERISTIC
/begin CHARACTERISTIC CalRegn01Cmn.GmMsg34ABusHiSpdStuckTiOut.Val "MICROSAR RTE" VALUE 0x0 RTE_RL_UWORD 0 NO_COMPU_METHOD 0 65535 SYMBOL_LINK "Rte_CalprmRom_CalRegn01Cmn_DEFAULT_RTE_CALPRM_GROUP.GmMsg34ABusHiSpdStuckTiOut_Val" 0 DISPLAY_IDENTIFIER CalRegn01Cmn.CalibrationPorts.GmMsg34ABusHiSpdStuckTiOut.Val /end CHARACTERISTIC
/begin CHARACTERISTIC CalRegn01Cmn.GmMsg3F1BusHiSpdAmbTDft.Val "MICROSAR RTE" VALUE 0x0 RTE_RL_FLOAT32_IEEE 0 NO_COMPU_METHOD -3.402823466e+38 3.402823466e+38 SYMBOL_LINK "Rte_CalprmRom_CalRegn01Cmn_DEFAULT_RTE_CALPRM_GROUP.GmMsg3F1BusHiSpdAmbTDft_Val" 0 DISPLAY_IDENTIFIER CalRegn01Cmn.CalibrationPorts.GmMsg3F1BusHiSpdAmbTDft.Val /end CHARACTERISTIC
/begin CHARACTERISTIC CalRegn01Cmn.GmMsg3F1BusHiSpdInvldTiOut.Val "MICROSAR RTE" VALUE 0x0 RTE_RL_UWORD 0 NO_COMPU_METHOD 0 65535 SYMBOL_LINK "Rte_CalprmRom_CalRegn01Cmn_DEFAULT_RTE_CALPRM_GROUP.GmMsg3F1BusHiSpdInvldTiOut_Val" 0 DISPLAY_IDENTIFIER CalRegn01Cmn.CalibrationPorts.GmMsg3F1BusHiSpdInvldTiOut.Val /end CHARACTERISTIC
/begin CHARACTERISTIC CalRegn01Cmn.GmMsg3F1BusHiSpdMissTiOut.Val "MICROSAR RTE" VALUE 0x0 RTE_RL_UWORD 0 NO_COMPU_METHOD 0 65535 SYMBOL_LINK "Rte_CalprmRom_CalRegn01Cmn_DEFAULT_RTE_CALPRM_GROUP.GmMsg3F1BusHiSpdMissTiOut_Val" 0 DISPLAY_IDENTIFIER CalRegn01Cmn.CalibrationPorts.GmMsg3F1BusHiSpdMissTiOut.Val /end CHARACTERISTIC
/begin CHARACTERISTIC CalRegn01Cmn.GmMsg4D1BusHiSpdEngOilTDft.Val "MICROSAR RTE" VALUE 0x0 RTE_RL_FLOAT32_IEEE 0 NO_COMPU_METHOD -3.402823466e+38 3.402823466e+38 SYMBOL_LINK "Rte_CalprmRom_CalRegn01Cmn_DEFAULT_RTE_CALPRM_GROUP.GmMsg4D1BusHiSpdEngOilTDft_Val" 0 DISPLAY_IDENTIFIER CalRegn01Cmn.CalibrationPorts.GmMsg4D1BusHiSpdEngOilTDft.Val /end CHARACTERISTIC
/begin CHARACTERISTIC CalRegn01Cmn.GmMsg4D1BusHiSpdInvldTiOut.Val "MICROSAR RTE" VALUE 0x0 RTE_RL_UWORD 0 NO_COMPU_METHOD 0 65535 SYMBOL_LINK "Rte_CalprmRom_CalRegn01Cmn_DEFAULT_RTE_CALPRM_GROUP.GmMsg4D1BusHiSpdInvldTiOut_Val" 0 DISPLAY_IDENTIFIER CalRegn01Cmn.CalibrationPorts.GmMsg4D1BusHiSpdInvldTiOut.Val /end CHARACTERISTIC
/begin CHARACTERISTIC CalRegn01Cmn.GmMsg4D1BusHiSpdMissTiOut.Val "MICROSAR RTE" VALUE 0x0 RTE_RL_UWORD 0 NO_COMPU_METHOD 0 65535 SYMBOL_LINK "Rte_CalprmRom_CalRegn01Cmn_DEFAULT_RTE_CALPRM_GROUP.GmMsg4D1BusHiSpdMissTiOut_Val" 0 DISPLAY_IDENTIFIER CalRegn01Cmn.CalibrationPorts.GmMsg4D1BusHiSpdMissTiOut.Val /end CHARACTERISTIC
/begin CHARACTERISTIC CalRegn01Cmn.GmMsg500BusHiSpdMissTiOut.Val "MICROSAR RTE" VALUE 0x0 RTE_RL_UWORD 0 NO_COMPU_METHOD 0 65535 SYMBOL_LINK "Rte_CalprmRom_CalRegn01Cmn_DEFAULT_RTE_CALPRM_GROUP.GmMsg500BusHiSpdMissTiOut_Val" 0 DISPLAY_IDENTIFIER CalRegn01Cmn.CalibrationPorts.GmMsg500BusHiSpdMissTiOut.Val /end CHARACTERISTIC
/begin CHARACTERISTIC CalRegn01Cmn.GmMsg500BusHiSpdWhlPlsPerRevDft.Val "MICROSAR RTE" VALUE 0x0 RTE_RL_UBYTE 0 NO_COMPU_METHOD 0 255 SYMBOL_LINK "Rte_CalprmRom_CalRegn01Cmn_DEFAULT_RTE_CALPRM_GROUP.GmMsg500BusHiSpdWhlPlsPerRevDft_Val" 0 DISPLAY_IDENTIFIER CalRegn01Cmn.CalibrationPorts.GmMsg500BusHiSpdWhlPlsPerRevDft.Val /end CHARACTERISTIC
/begin CHARACTERISTIC CalRegn01Cmn.GmMsg500BusHiSpdWhlRotlStsTiStampReslDft.Val "MICROSAR RTE" VALUE 0x0 RTE_RL_FLOAT32_IEEE 0 NO_COMPU_METHOD -3.402823466e+38 3.402823466e+38 SYMBOL_LINK "Rte_CalprmRom_CalRegn01Cmn_DEFAULT_RTE_CALPRM_GROUP.GmMsg500BusHiSpdWhlRotlStsTiStampReslDft_Val" 0 DISPLAY_IDENTIFIER CalRegn01Cmn.CalibrationPorts.GmMsg500BusHiSpdWhlRotlStsTiStampReslDft.Val /end CHARACTERISTIC
/begin CHARACTERISTIC CalRegn01Cmn.HiFrqAssiPahFwlOverLimDiagcFailStep.Val "MICROSAR RTE" VALUE 0x0 RTE_RL_UWORD 0 NO_COMPU_METHOD 0 65535 SYMBOL_LINK "Rte_CalprmRom_CalRegn01Cmn_DEFAULT_RTE_CALPRM_GROUP.HiFrqAssiPahFwlOverLimDiagcFailStep_Val" 0 DISPLAY_IDENTIFIER CalRegn01Cmn.CalibrationPorts.HiFrqAssiPahFwlOverLimDiagcFailStep.Val /end CHARACTERISTIC
/begin CHARACTERISTIC CalRegn01Cmn.HiFrqAssiPahFwlOverLimDiagcPassStep.Val "MICROSAR RTE" VALUE 0x0 RTE_RL_UWORD 0 NO_COMPU_METHOD 0 65535 SYMBOL_LINK "Rte_CalprmRom_CalRegn01Cmn_DEFAULT_RTE_CALPRM_GROUP.HiFrqAssiPahFwlOverLimDiagcPassStep_Val" 0 DISPLAY_IDENTIFIER CalRegn01Cmn.CalibrationPorts.HiFrqAssiPahFwlOverLimDiagcPassStep.Val /end CHARACTERISTIC
/begin CHARACTERISTIC CalRegn01Cmn.HwAgSnsrlsCorrdPinionAgHwConf.Val "MICROSAR RTE" VALUE 0x0 RTE_RL_FLOAT32_IEEE 0 NO_COMPU_METHOD -3.402823466e+38 3.402823466e+38 SYMBOL_LINK "Rte_CalprmRom_CalRegn01Cmn_DEFAULT_RTE_CALPRM_GROUP.HwAgSnsrlsCorrdPinionAgHwConf_Val" 0 DISPLAY_IDENTIFIER CalRegn01Cmn.CalibrationPorts.HwAgSnsrlsCorrdPinionAgHwConf.Val /end CHARACTERISTIC
/begin CHARACTERISTIC CalRegn01Cmn.HwAgSnsrlsFCentrHwConf.Val "MICROSAR RTE" VALUE 0x0 RTE_RL_FLOAT32_IEEE 0 NO_COMPU_METHOD -3.402823466e+38 3.402823466e+38 SYMBOL_LINK "Rte_CalprmRom_CalRegn01Cmn_DEFAULT_RTE_CALPRM_GROUP.HwAgSnsrlsFCentrHwConf_Val" 0 DISPLAY_IDENTIFIER CalRegn01Cmn.CalibrationPorts.HwAgSnsrlsFCentrHwConf.Val /end CHARACTERISTIC
/begin CHARACTERISTIC CalRegn01Cmn.HwAgSnsrlsPinionTqFilFrq.Val "MICROSAR RTE" VALUE 0x0 RTE_RL_FLOAT32_IEEE 0 NO_COMPU_METHOD -3.402823466e+38 3.402823466e+38 SYMBOL_LINK "Rte_CalprmRom_CalRegn01Cmn_DEFAULT_RTE_CALPRM_GROUP.HwAgSnsrlsPinionTqFilFrq_Val" 0 DISPLAY_IDENTIFIER CalRegn01Cmn.CalibrationPorts.HwAgSnsrlsPinionTqFilFrq.Val /end CHARACTERISTIC
/begin CHARACTERISTIC CalRegn01Cmn.HwAgSnsrlsRelHwAgFil1Frq.Val "MICROSAR RTE" VALUE 0x0 RTE_RL_FLOAT32_IEEE 0 NO_COMPU_METHOD -3.402823466e+38 3.402823466e+38 SYMBOL_LINK "Rte_CalprmRom_CalRegn01Cmn_DEFAULT_RTE_CALPRM_GROUP.HwAgSnsrlsRelHwAgFil1Frq_Val" 0 DISPLAY_IDENTIFIER CalRegn01Cmn.CalibrationPorts.HwAgSnsrlsRelHwAgFil1Frq.Val /end CHARACTERISTIC
/begin CHARACTERISTIC CalRegn01Cmn.HwAgSnsrlsRelHwAgFil2Frq.Val "MICROSAR RTE" VALUE 0x0 RTE_RL_FLOAT32_IEEE 0 NO_COMPU_METHOD -3.402823466e+38 3.402823466e+38 SYMBOL_LINK "Rte_CalprmRom_CalRegn01Cmn_DEFAULT_RTE_CALPRM_GROUP.HwAgSnsrlsRelHwAgFil2Frq_Val" 0 DISPLAY_IDENTIFIER CalRegn01Cmn.CalibrationPorts.HwAgSnsrlsRelHwAgFil2Frq.Val /end CHARACTERISTIC
/begin CHARACTERISTIC CalRegn01Cmn.HwAgSnsrlsSmotngCoeff.Val "MICROSAR RTE" VALUE 0x0 RTE_RL_FLOAT32_IEEE 0 NO_COMPU_METHOD -3.402823466e+38 3.402823466e+38 SYMBOL_LINK "Rte_CalprmRom_CalRegn01Cmn_DEFAULT_RTE_CALPRM_GROUP.HwAgSnsrlsSmotngCoeff_Val" 0 DISPLAY_IDENTIFIER CalRegn01Cmn.CalibrationPorts.HwAgSnsrlsSmotngCoeff.Val /end CHARACTERISTIC
/begin CHARACTERISTIC CalRegn01Cmn.HwAgSnsrlsSmotngStepThd.Val "MICROSAR RTE" VALUE 0x0 RTE_RL_FLOAT32_IEEE 0 NO_COMPU_METHOD -3.402823466e+38 3.402823466e+38 SYMBOL_LINK "Rte_CalprmRom_CalRegn01Cmn_DEFAULT_RTE_CALPRM_GROUP.HwAgSnsrlsSmotngStepThd_Val" 0 DISPLAY_IDENTIFIER CalRegn01Cmn.CalibrationPorts.HwAgSnsrlsSmotngStepThd.Val /end CHARACTERISTIC
/begin CHARACTERISTIC CalRegn01Cmn.HwAgSnsrlsStordPinionConf.Val "MICROSAR RTE" VALUE 0x0 RTE_RL_FLOAT32_IEEE 0 NO_COMPU_METHOD -3.402823466e+38 3.402823466e+38 SYMBOL_LINK "Rte_CalprmRom_CalRegn01Cmn_DEFAULT_RTE_CALPRM_GROUP.HwAgSnsrlsStordPinionConf_Val" 0 DISPLAY_IDENTIFIER CalRegn01Cmn.CalibrationPorts.HwAgSnsrlsStordPinionConf.Val /end CHARACTERISTIC
/begin CHARACTERISTIC CalRegn01Cmn.HwAgSnsrlsStordPinionConfThd.Val "MICROSAR RTE" VALUE 0x0 RTE_RL_FLOAT32_IEEE 0 NO_COMPU_METHOD -3.402823466e+38 3.402823466e+38 SYMBOL_LINK "Rte_CalprmRom_CalRegn01Cmn_DEFAULT_RTE_CALPRM_GROUP.HwAgSnsrlsStordPinionConfThd_Val" 0 DISPLAY_IDENTIFIER CalRegn01Cmn.CalibrationPorts.HwAgSnsrlsStordPinionConfThd.Val /end CHARACTERISTIC
/begin CHARACTERISTIC CalRegn01Cmn.HwAgSnsrlsVehDynDifThd.Val "MICROSAR RTE" VALUE 0x0 RTE_RL_FLOAT32_IEEE 0 NO_COMPU_METHOD -3.402823466e+38 3.402823466e+38 SYMBOL_LINK "Rte_CalprmRom_CalRegn01Cmn_DEFAULT_RTE_CALPRM_GROUP.HwAgSnsrlsVehDynDifThd_Val" 0 DISPLAY_IDENTIFIER CalRegn01Cmn.CalibrationPorts.HwAgSnsrlsVehDynDifThd.Val /end CHARACTERISTIC
/begin CHARACTERISTIC CalRegn01Cmn.HwAgSnsrlsVehDynHwConf.Val "MICROSAR RTE" VALUE 0x0 RTE_RL_FLOAT32_IEEE 0 NO_COMPU_METHOD -3.402823466e+38 3.402823466e+38 SYMBOL_LINK "Rte_CalprmRom_CalRegn01Cmn_DEFAULT_RTE_CALPRM_GROUP.HwAgSnsrlsVehDynHwConf_Val" 0 DISPLAY_IDENTIFIER CalRegn01Cmn.CalibrationPorts.HwAgSnsrlsVehDynHwConf.Val /end CHARACTERISTIC
/begin CHARACTERISTIC CalRegn01Cmn.HwAgSnsrlsVehDynMotVelThd.Val "MICROSAR RTE" VALUE 0x0 RTE_RL_FLOAT32_IEEE 0 NO_COMPU_METHOD -3.402823466e+38 3.402823466e+38 SYMBOL_LINK "Rte_CalprmRom_CalRegn01Cmn_DEFAULT_RTE_CALPRM_GROUP.HwAgSnsrlsVehDynMotVelThd_Val" 0 DISPLAY_IDENTIFIER CalRegn01Cmn.CalibrationPorts.HwAgSnsrlsVehDynMotVelThd.Val /end CHARACTERISTIC
/begin CHARACTERISTIC CalRegn01Cmn.HwAgSnsrlsVehDynPinionTqThd.Val "MICROSAR RTE" VALUE 0x0 RTE_RL_FLOAT32_IEEE 0 NO_COMPU_METHOD -3.402823466e+38 3.402823466e+38 SYMBOL_LINK "Rte_CalprmRom_CalRegn01Cmn_DEFAULT_RTE_CALPRM_GROUP.HwAgSnsrlsVehDynPinionTqThd_Val" 0 DISPLAY_IDENTIFIER CalRegn01Cmn.CalibrationPorts.HwAgSnsrlsVehDynPinionTqThd.Val /end CHARACTERISTIC
/begin CHARACTERISTIC CalRegn01Cmn.HwAgSnsrlsVehDynTmr1Thd.Val "MICROSAR RTE" VALUE 0x0 RTE_RL_ULONG 0 NO_COMPU_METHOD 0 4294967295 SYMBOL_LINK "Rte_CalprmRom_CalRegn01Cmn_DEFAULT_RTE_CALPRM_GROUP.HwAgSnsrlsVehDynTmr1Thd_Val" 0 DISPLAY_IDENTIFIER CalRegn01Cmn.CalibrationPorts.HwAgSnsrlsVehDynTmr1Thd.Val /end CHARACTERISTIC
/begin CHARACTERISTIC CalRegn01Cmn.HwAgSnsrlsVehDynTmr2Thd.Val "MICROSAR RTE" VALUE 0x0 RTE_RL_ULONG 0 NO_COMPU_METHOD 0 4294967295 SYMBOL_LINK "Rte_CalprmRom_CalRegn01Cmn_DEFAULT_RTE_CALPRM_GROUP.HwAgSnsrlsVehDynTmr2Thd_Val" 0 DISPLAY_IDENTIFIER CalRegn01Cmn.CalibrationPorts.HwAgSnsrlsVehDynTmr2Thd.Val /end CHARACTERISTIC
/begin CHARACTERISTIC CalRegn01Cmn.HwAgSnsrlsWhlFrqThd.Val "MICROSAR RTE" VALUE 0x0 RTE_RL_FLOAT32_IEEE 0 NO_COMPU_METHOD -3.402823466e+38 3.402823466e+38 SYMBOL_LINK "Rte_CalprmRom_CalRegn01Cmn_DEFAULT_RTE_CALPRM_GROUP.HwAgSnsrlsWhlFrqThd_Val" 0 DISPLAY_IDENTIFIER CalRegn01Cmn.CalibrationPorts.HwAgSnsrlsWhlFrqThd.Val /end CHARACTERISTIC
/begin CHARACTERISTIC CalRegn01Cmn.HwAgSnsrlsWhlSpdHwAgCoeff1.Val "MICROSAR RTE" VALUE 0x0 RTE_RL_FLOAT32_IEEE 0 NO_COMPU_METHOD -3.402823466e+38 3.402823466e+38 SYMBOL_LINK "Rte_CalprmRom_CalRegn01Cmn_DEFAULT_RTE_CALPRM_GROUP.HwAgSnsrlsWhlSpdHwAgCoeff1_Val" 0 DISPLAY_IDENTIFIER CalRegn01Cmn.CalibrationPorts.HwAgSnsrlsWhlSpdHwAgCoeff1.Val /end CHARACTERISTIC
/begin CHARACTERISTIC CalRegn01Cmn.HwAgSnsrlsWhlSpdHwAgCoeff2.Val "MICROSAR RTE" VALUE 0x0 RTE_RL_FLOAT32_IEEE 0 NO_COMPU_METHOD -3.402823466e+38 3.402823466e+38 SYMBOL_LINK "Rte_CalprmRom_CalRegn01Cmn_DEFAULT_RTE_CALPRM_GROUP.HwAgSnsrlsWhlSpdHwAgCoeff2_Val" 0 DISPLAY_IDENTIFIER CalRegn01Cmn.CalibrationPorts.HwAgSnsrlsWhlSpdHwAgCoeff2.Val /end CHARACTERISTIC
/begin CHARACTERISTIC CalRegn01Cmn.HwAgSnsrlsWhlSpdHwAgThd.Val "MICROSAR RTE" VALUE 0x0 RTE_RL_FLOAT32_IEEE 0 NO_COMPU_METHOD -3.402823466e+38 3.402823466e+38 SYMBOL_LINK "Rte_CalprmRom_CalRegn01Cmn_DEFAULT_RTE_CALPRM_GROUP.HwAgSnsrlsWhlSpdHwAgThd_Val" 0 DISPLAY_IDENTIFIER CalRegn01Cmn.CalibrationPorts.HwAgSnsrlsWhlSpdHwAgThd.Val /end CHARACTERISTIC
/begin CHARACTERISTIC CalRegn01Cmn.HwAgSnsrlsWhlSpdHwConf.Val "MICROSAR RTE" VALUE 0x0 RTE_RL_FLOAT32_IEEE 0 NO_COMPU_METHOD -3.402823466e+38 3.402823466e+38 SYMBOL_LINK "Rte_CalprmRom_CalRegn01Cmn_DEFAULT_RTE_CALPRM_GROUP.HwAgSnsrlsWhlSpdHwConf_Val" 0 DISPLAY_IDENTIFIER CalRegn01Cmn.CalibrationPorts.HwAgSnsrlsWhlSpdHwConf.Val /end CHARACTERISTIC
/begin CHARACTERISTIC CalRegn01Cmn.HwAgSnsrlsWhlSpdRatThd.Val "MICROSAR RTE" VALUE 0x0 RTE_RL_FLOAT32_IEEE 0 NO_COMPU_METHOD -3.402823466e+38 3.402823466e+38 SYMBOL_LINK "Rte_CalprmRom_CalRegn01Cmn_DEFAULT_RTE_CALPRM_GROUP.HwAgSnsrlsWhlSpdRatThd_Val" 0 DISPLAY_IDENTIFIER CalRegn01Cmn.CalibrationPorts.HwAgSnsrlsWhlSpdRatThd.Val /end CHARACTERISTIC
/begin CHARACTERISTIC CalRegn01Cmn.HwAgSnsrlsWhlSpdTmrThd.Val "MICROSAR RTE" VALUE 0x0 RTE_RL_ULONG 0 NO_COMPU_METHOD 0 4294967295 SYMBOL_LINK "Rte_CalprmRom_CalRegn01Cmn_DEFAULT_RTE_CALPRM_GROUP.HwAgSnsrlsWhlSpdTmrThd_Val" 0 DISPLAY_IDENTIFIER CalRegn01Cmn.CalibrationPorts.HwAgSnsrlsWhlSpdTmrThd.Val /end CHARACTERISTIC
/begin CHARACTERISTIC CalRegn01Cmn.HwAgSnsrlsWhlSpdVehSpdThd.Val "MICROSAR RTE" VALUE 0x0 RTE_RL_FLOAT32_IEEE 0 NO_COMPU_METHOD -3.402823466e+38 3.402823466e+38 SYMBOL_LINK "Rte_CalprmRom_CalRegn01Cmn_DEFAULT_RTE_CALPRM_GROUP.HwAgSnsrlsWhlSpdVehSpdThd_Val" 0 DISPLAY_IDENTIFIER CalRegn01Cmn.CalibrationPorts.HwAgSnsrlsWhlSpdVehSpdThd.Val /end CHARACTERISTIC
/begin CHARACTERISTIC CalRegn01Cmn.HwAgSysArbnHwAgConf1Snsr.Val "MICROSAR RTE" VALUE 0x0 RTE_RL_FLOAT32_IEEE 0 NO_COMPU_METHOD -3.402823466e+38 3.402823466e+38 SYMBOL_LINK "Rte_CalprmRom_CalRegn01Cmn_DEFAULT_RTE_CALPRM_GROUP.HwAgSysArbnHwAgConf1Snsr_Val" 0 DISPLAY_IDENTIFIER CalRegn01Cmn.CalibrationPorts.HwAgSysArbnHwAgConf1Snsr.Val /end CHARACTERISTIC
/begin CHARACTERISTIC CalRegn01Cmn.HwAgSysArbnHwAgConf2Snsr.Val "MICROSAR RTE" VALUE 0x0 RTE_RL_FLOAT32_IEEE 0 NO_COMPU_METHOD -3.402823466e+38 3.402823466e+38 SYMBOL_LINK "Rte_CalprmRom_CalRegn01Cmn_DEFAULT_RTE_CALPRM_GROUP.HwAgSysArbnHwAgConf2Snsr_Val" 0 DISPLAY_IDENTIFIER CalRegn01Cmn.CalibrationPorts.HwAgSysArbnHwAgConf2Snsr.Val /end CHARACTERISTIC
/begin CHARACTERISTIC CalRegn01Cmn.HwAgSysArbnHwAgConfNoSnsr.Val "MICROSAR RTE" VALUE 0x0 RTE_RL_FLOAT32_IEEE 0 NO_COMPU_METHOD -3.402823466e+38 3.402823466e+38 SYMBOL_LINK "Rte_CalprmRom_CalRegn01Cmn_DEFAULT_RTE_CALPRM_GROUP.HwAgSysArbnHwAgConfNoSnsr_Val" 0 DISPLAY_IDENTIFIER CalRegn01Cmn.CalibrationPorts.HwAgSysArbnHwAgConfNoSnsr.Val /end CHARACTERISTIC
/begin CHARACTERISTIC CalRegn01Cmn.HwAgSysArbnHwAgCorrdCorrlnThd.Val "MICROSAR RTE" VALUE 0x0 RTE_RL_FLOAT32_IEEE 0 NO_COMPU_METHOD -3.402823466e+38 3.402823466e+38 SYMBOL_LINK "Rte_CalprmRom_CalRegn01Cmn_DEFAULT_RTE_CALPRM_GROUP.HwAgSysArbnHwAgCorrdCorrlnThd_Val" 0 DISPLAY_IDENTIFIER CalRegn01Cmn.CalibrationPorts.HwAgSysArbnHwAgCorrdCorrlnThd.Val /end CHARACTERISTIC
/begin CHARACTERISTIC CalRegn01Cmn.HwAgSysArbnHwAgCorrlnFailDebStep.Val "MICROSAR RTE" VALUE 0x0 RTE_RL_UWORD 0 NO_COMPU_METHOD 0 65535 SYMBOL_LINK "Rte_CalprmRom_CalRegn01Cmn_DEFAULT_RTE_CALPRM_GROUP.HwAgSysArbnHwAgCorrlnFailDebStep_Val" 0 DISPLAY_IDENTIFIER CalRegn01Cmn.CalibrationPorts.HwAgSysArbnHwAgCorrlnFailDebStep.Val /end CHARACTERISTIC
/begin CHARACTERISTIC CalRegn01Cmn.HwAgSysArbnHwAgCorrlnPassDebStep.Val "MICROSAR RTE" VALUE 0x0 RTE_RL_UWORD 0 NO_COMPU_METHOD 0 65535 SYMBOL_LINK "Rte_CalprmRom_CalRegn01Cmn_DEFAULT_RTE_CALPRM_GROUP.HwAgSysArbnHwAgCorrlnPassDebStep_Val" 0 DISPLAY_IDENTIFIER CalRegn01Cmn.CalibrationPorts.HwAgSysArbnHwAgCorrlnPassDebStep.Val /end CHARACTERISTIC
/begin CHARACTERISTIC CalRegn01Cmn.HwAgSysArbnHwAgCorrlnRng.Val "MICROSAR RTE" VALUE 0x0 RTE_RL_FLOAT32_IEEE 0 NO_COMPU_METHOD -3.402823466e+38 3.402823466e+38 SYMBOL_LINK "Rte_CalprmRom_CalRegn01Cmn_DEFAULT_RTE_CALPRM_GROUP.HwAgSysArbnHwAgCorrlnRng_Val" 0 DISPLAY_IDENTIFIER CalRegn01Cmn.CalibrationPorts.HwAgSysArbnHwAgCorrlnRng.Val /end CHARACTERISTIC
/begin CHARACTERISTIC CalRegn01Cmn.HwAgSysArbnHwAgSlewRate.Val "MICROSAR RTE" VALUE 0x0 RTE_RL_FLOAT32_IEEE 0 NO_COMPU_METHOD -3.402823466e+38 3.402823466e+38 SYMBOL_LINK "Rte_CalprmRom_CalRegn01Cmn_DEFAULT_RTE_CALPRM_GROUP.HwAgSysArbnHwAgSlewRate_Val" 0 DISPLAY_IDENTIFIER CalRegn01Cmn.CalibrationPorts.HwAgSysArbnHwAgSlewRate.Val /end CHARACTERISTIC
/begin CHARACTERISTIC CalRegn01Cmn.HwAgSysArbnHwAgSnsrlsCorrlnThd.Val "MICROSAR RTE" VALUE 0x0 RTE_RL_FLOAT32_IEEE 0 NO_COMPU_METHOD -3.402823466e+38 3.402823466e+38 SYMBOL_LINK "Rte_CalprmRom_CalRegn01Cmn_DEFAULT_RTE_CALPRM_GROUP.HwAgSysArbnHwAgSnsrlsCorrlnThd_Val" 0 DISPLAY_IDENTIFIER CalRegn01Cmn.CalibrationPorts.HwAgSysArbnHwAgSnsrlsCorrlnThd.Val /end CHARACTERISTIC
/begin CHARACTERISTIC CalRegn01Cmn.HwAgSysArbnHwAgSnsrlsKineThd.Val "MICROSAR RTE" VALUE 0x0 RTE_RL_FLOAT32_IEEE 0 NO_COMPU_METHOD -3.402823466e+38 3.402823466e+38 SYMBOL_LINK "Rte_CalprmRom_CalRegn01Cmn_DEFAULT_RTE_CALPRM_GROUP.HwAgSysArbnHwAgSnsrlsKineThd_Val" 0 DISPLAY_IDENTIFIER CalRegn01Cmn.CalibrationPorts.HwAgSysArbnHwAgSnsrlsKineThd.Val /end CHARACTERISTIC
/begin CHARACTERISTIC CalRegn01Cmn.HwAgSysArbnHwAgToMotAgCorrlnElpdTiLim.Val "MICROSAR RTE" VALUE 0x0 RTE_RL_ULONG 0 NO_COMPU_METHOD 0 4294967295 SYMBOL_LINK "Rte_CalprmRom_CalRegn01Cmn_DEFAULT_RTE_CALPRM_GROUP.HwAgSysArbnHwAgToMotAgCorrlnElpdTiLim_Val" 0 DISPLAY_IDENTIFIER CalRegn01Cmn.CalibrationPorts.HwAgSysArbnHwAgToMotAgCorrlnElpdTiLim.Val /end CHARACTERISTIC
/begin CHARACTERISTIC CalRegn01Cmn.HwAgSysArbnSerlComHwAgCorrdConf.Val "MICROSAR RTE" VALUE 0x0 RTE_RL_FLOAT32_IEEE 0 NO_COMPU_METHOD -3.402823466e+38 3.402823466e+38 SYMBOL_LINK "Rte_CalprmRom_CalRegn01Cmn_DEFAULT_RTE_CALPRM_GROUP.HwAgSysArbnSerlComHwAgCorrdConf_Val" 0 DISPLAY_IDENTIFIER CalRegn01Cmn.CalibrationPorts.HwAgSysArbnSerlComHwAgCorrdConf.Val /end CHARACTERISTIC
/begin CHARACTERISTIC CalRegn01Cmn.HwAgSysArbnSerlComHwAgSnsrlsConf.Val "MICROSAR RTE" VALUE 0x0 RTE_RL_FLOAT32_IEEE 0 NO_COMPU_METHOD -3.402823466e+38 3.402823466e+38 SYMBOL_LINK "Rte_CalprmRom_CalRegn01Cmn_DEFAULT_RTE_CALPRM_GROUP.HwAgSysArbnSerlComHwAgSnsrlsConf_Val" 0 DISPLAY_IDENTIFIER CalRegn01Cmn.CalibrationPorts.HwAgSysArbnSerlComHwAgSnsrlsConf.Val /end CHARACTERISTIC
/begin CHARACTERISTIC CalRegn01Cmn.HwAgSysArbnSlewRateTmr.Val "MICROSAR RTE" VALUE 0x0 RTE_RL_FLOAT32_IEEE 0 NO_COMPU_METHOD -3.402823466e+38 3.402823466e+38 SYMBOL_LINK "Rte_CalprmRom_CalRegn01Cmn_DEFAULT_RTE_CALPRM_GROUP.HwAgSysArbnSlewRateTmr_Val" 0 DISPLAY_IDENTIFIER CalRegn01Cmn.CalibrationPorts.HwAgSysArbnSlewRateTmr.Val /end CHARACTERISTIC
/begin CHARACTERISTIC CalRegn01Cmn.HwAgTrajGennAMax.Val "MICROSAR RTE" VALUE 0x0 RTE_RL_FLOAT32_IEEE 0 NO_COMPU_METHOD -3.402823466e+38 3.402823466e+38 SYMBOL_LINK "Rte_CalprmRom_CalRegn01Cmn_DEFAULT_RTE_CALPRM_GROUP.HwAgTrajGennAMax_Val" 0 DISPLAY_IDENTIFIER CalRegn01Cmn.CalibrationPorts.HwAgTrajGennAMax.Val /end CHARACTERISTIC
/begin CHARACTERISTIC CalRegn01Cmn.HwAgTrajGennAgMax.Val "MICROSAR RTE" VALUE 0x0 RTE_RL_FLOAT32_IEEE 0 NO_COMPU_METHOD -3.402823466e+38 3.402823466e+38 SYMBOL_LINK "Rte_CalprmRom_CalRegn01Cmn_DEFAULT_RTE_CALPRM_GROUP.HwAgTrajGennAgMax_Val" 0 DISPLAY_IDENTIFIER CalRegn01Cmn.CalibrationPorts.HwAgTrajGennAgMax.Val /end CHARACTERISTIC
/begin CHARACTERISTIC CalRegn01Cmn.HwAgTrajGennVelMax.Val "MICROSAR RTE" VALUE 0x0 RTE_RL_FLOAT32_IEEE 0 NO_COMPU_METHOD -3.402823466e+38 3.402823466e+38 SYMBOL_LINK "Rte_CalprmRom_CalRegn01Cmn_DEFAULT_RTE_CALPRM_GROUP.HwAgTrajGennVelMax_Val" 0 DISPLAY_IDENTIFIER CalRegn01Cmn.CalibrationPorts.HwAgTrajGennVelMax.Val /end CHARACTERISTIC
/begin CHARACTERISTIC CalRegn01Cmn.HwTq2MeasHwTq2PrtclFltFailStep.Val "MICROSAR RTE" VALUE 0x0 RTE_RL_UWORD 0 NO_COMPU_METHOD 0 65535 SYMBOL_LINK "Rte_CalprmRom_CalRegn01Cmn_DEFAULT_RTE_CALPRM_GROUP.HwTq2MeasHwTq2PrtclFltFailStep_Val" 0 DISPLAY_IDENTIFIER CalRegn01Cmn.CalibrationPorts.HwTq2MeasHwTq2PrtclFltFailStep.Val /end CHARACTERISTIC
/begin CHARACTERISTIC CalRegn01Cmn.HwTq2MeasHwTq2PrtclFltPassStep.Val "MICROSAR RTE" VALUE 0x0 RTE_RL_UWORD 0 NO_COMPU_METHOD 0 65535 SYMBOL_LINK "Rte_CalprmRom_CalRegn01Cmn_DEFAULT_RTE_CALPRM_GROUP.HwTq2MeasHwTq2PrtclFltPassStep_Val" 0 DISPLAY_IDENTIFIER CalRegn01Cmn.CalibrationPorts.HwTq2MeasHwTq2PrtclFltPassStep.Val /end CHARACTERISTIC
/begin CHARACTERISTIC CalRegn01Cmn.HwTq3MeasHwTq3PrtclFltFailStep.Val "MICROSAR RTE" VALUE 0x0 RTE_RL_UWORD 0 NO_COMPU_METHOD 0 65535 SYMBOL_LINK "Rte_CalprmRom_CalRegn01Cmn_DEFAULT_RTE_CALPRM_GROUP.HwTq3MeasHwTq3PrtclFltFailStep_Val" 0 DISPLAY_IDENTIFIER CalRegn01Cmn.CalibrationPorts.HwTq3MeasHwTq3PrtclFltFailStep.Val /end CHARACTERISTIC
/begin CHARACTERISTIC CalRegn01Cmn.HwTq3MeasHwTq3PrtclFltPassStep.Val "MICROSAR RTE" VALUE 0x0 RTE_RL_UWORD 0 NO_COMPU_METHOD 0 65535 SYMBOL_LINK "Rte_CalprmRom_CalRegn01Cmn_DEFAULT_RTE_CALPRM_GROUP.HwTq3MeasHwTq3PrtclFltPassStep_Val" 0 DISPLAY_IDENTIFIER CalRegn01Cmn.CalibrationPorts.HwTq3MeasHwTq3PrtclFltPassStep.Val /end CHARACTERISTIC
/begin CHARACTERISTIC CalRegn01Cmn.HwTqArbnMaxStallTqA.Val "MICROSAR RTE" VALUE 0x0 RTE_RL_UBYTE 0 NO_COMPU_METHOD 0 255 SYMBOL_LINK "Rte_CalprmRom_CalRegn01Cmn_DEFAULT_RTE_CALPRM_GROUP.HwTqArbnMaxStallTqA_Val" 0 DISPLAY_IDENTIFIER CalRegn01Cmn.CalibrationPorts.HwTqArbnMaxStallTqA.Val /end CHARACTERISTIC
/begin CHARACTERISTIC CalRegn01Cmn.HwTqArbnMaxStallTqB.Val "MICROSAR RTE" VALUE 0x0 RTE_RL_UBYTE 0 NO_COMPU_METHOD 0 255 SYMBOL_LINK "Rte_CalprmRom_CalRegn01Cmn_DEFAULT_RTE_CALPRM_GROUP.HwTqArbnMaxStallTqB_Val" 0 DISPLAY_IDENTIFIER CalRegn01Cmn.CalibrationPorts.HwTqArbnMaxStallTqB.Val /end CHARACTERISTIC
/begin CHARACTERISTIC CalRegn01Cmn.HwTqArbnMaxStallTqC.Val "MICROSAR RTE" VALUE 0x0 RTE_RL_UBYTE 0 NO_COMPU_METHOD 0 255 SYMBOL_LINK "Rte_CalprmRom_CalRegn01Cmn_DEFAULT_RTE_CALPRM_GROUP.HwTqArbnMaxStallTqC_Val" 0 DISPLAY_IDENTIFIER CalRegn01Cmn.CalibrationPorts.HwTqArbnMaxStallTqC.Val /end CHARACTERISTIC
/begin CHARACTERISTIC CalRegn01Cmn.HwTqArbnMaxStallTqD.Val "MICROSAR RTE" VALUE 0x0 RTE_RL_UBYTE 0 NO_COMPU_METHOD 0 255 SYMBOL_LINK "Rte_CalprmRom_CalRegn01Cmn_DEFAULT_RTE_CALPRM_GROUP.HwTqArbnMaxStallTqD_Val" 0 DISPLAY_IDENTIFIER CalRegn01Cmn.CalibrationPorts.HwTqArbnMaxStallTqD.Val /end CHARACTERISTIC
/begin CHARACTERISTIC CalRegn01Cmn.HwTqCorrlnChACmnModCmpLpFilActvnThd.Val "MICROSAR RTE" VALUE 0x0 RTE_RL_FLOAT32_IEEE 0 NO_COMPU_METHOD -3.402823466e+38 3.402823466e+38 SYMBOL_LINK "Rte_CalprmRom_CalRegn01Cmn_DEFAULT_RTE_CALPRM_GROUP.HwTqCorrlnChACmnModCmpLpFilActvnThd_Val" 0 DISPLAY_IDENTIFIER CalRegn01Cmn.CalibrationPorts.HwTqCorrlnChACmnModCmpLpFilActvnThd.Val /end CHARACTERISTIC
/begin GROUP CalRegn01Cmn.BattVltgCorrlnNtc0x0B1FailStep.Val "MICROSAR RTE" /begin SUB_GROUP /end SUB_GROUP /begin FUNCTION_LIST /end FUNCTION_LIST /begin REF_CHARACTERISTIC CalRegn01Cmn.BattVltgCorrlnNtc0x0B1FailStep.Val /end REF_CHARACTERISTIC /begin REF_MEASUREMENT /end REF_MEASUREMENT /end GROUP
/begin GROUP CalRegn01Cmn.BattVltgCorrlnNtc0x0B1PassStep.Val "MICROSAR RTE" /begin SUB_GROUP /end SUB_GROUP /begin FUNCTION_LIST /end FUNCTION_LIST /begin REF_CHARACTERISTIC CalRegn01Cmn.BattVltgCorrlnNtc0x0B1PassStep.Val /end REF_CHARACTERISTIC /begin REF_MEASUREMENT /end REF_MEASUREMENT /end GROUP
/begin GROUP CalRegn01Cmn.BattVltgCorrlnNtc0x0B5FailStep.Val "MICROSAR RTE" /begin SUB_GROUP /end SUB_GROUP /begin FUNCTION_LIST /end FUNCTION_LIST /begin REF_CHARACTERISTIC CalRegn01Cmn.BattVltgCorrlnNtc0x0B5FailStep.Val /end REF_CHARACTERISTIC /begin REF_MEASUREMENT /end REF_MEASUREMENT /end GROUP
/begin GROUP CalRegn01Cmn.BattVltgCorrlnNtc0x0B5PassStep.Val "MICROSAR RTE" /begin SUB_GROUP /end SUB_GROUP /begin FUNCTION_LIST /end FUNCTION_LIST /begin REF_CHARACTERISTIC CalRegn01Cmn.BattVltgCorrlnNtc0x0B5PassStep.Val /end REF_CHARACTERISTIC /begin REF_MEASUREMENT /end REF_MEASUREMENT /end GROUP
/begin GROUP CalRegn01Cmn.BattVltgCorrlnRcvrlBattLoVltg.Val "MICROSAR RTE" /begin SUB_GROUP /end SUB_GROUP /begin FUNCTION_LIST /end FUNCTION_LIST /begin REF_CHARACTERISTIC CalRegn01Cmn.BattVltgCorrlnRcvrlBattLoVltg.Val /end REF_CHARACTERISTIC /begin REF_MEASUREMENT /end REF_MEASUREMENT /end GROUP
/begin GROUP CalRegn01Cmn.BattVltgCorrlnRcvrlBattOverVltg.Val "MICROSAR RTE" /begin SUB_GROUP /end SUB_GROUP /begin FUNCTION_LIST /end FUNCTION_LIST /begin REF_CHARACTERISTIC CalRegn01Cmn.BattVltgCorrlnRcvrlBattOverVltg.Val /end REF_CHARACTERISTIC /begin REF_MEASUREMENT /end REF_MEASUREMENT /end GROUP
/begin GROUP CalRegn01Cmn.BattVltgCorrlnRcvrlBattUnderVltg.Val "MICROSAR RTE" /begin SUB_GROUP /end SUB_GROUP /begin FUNCTION_LIST /end FUNCTION_LIST /begin REF_CHARACTERISTIC CalRegn01Cmn.BattVltgCorrlnRcvrlBattUnderVltg.Val /end REF_CHARACTERISTIC /begin REF_MEASUREMENT /end REF_MEASUREMENT /end GROUP
/begin GROUP CalRegn01Cmn.BattVltgCorrlnSysMinVltg.Val "MICROSAR RTE" /begin SUB_GROUP /end SUB_GROUP /begin FUNCTION_LIST /end FUNCTION_LIST /begin REF_CHARACTERISTIC CalRegn01Cmn.BattVltgCorrlnSysMinVltg.Val /end REF_CHARACTERISTIC /begin REF_MEASUREMENT /end REF_MEASUREMENT /end GROUP
/begin GROUP CalRegn01Cmn.BattVltgSwdMax.Val "MICROSAR RTE" /begin SUB_GROUP /end SUB_GROUP /begin FUNCTION_LIST /end FUNCTION_LIST /begin REF_CHARACTERISTIC CalRegn01Cmn.BattVltgSwdMax.Val /end REF_CHARACTERISTIC /begin REF_MEASUREMENT /end REF_MEASUREMENT /end GROUP
/begin GROUP CalRegn01Cmn.BrdgVltgMax.Val "MICROSAR RTE" /begin SUB_GROUP /end SUB_GROUP /begin FUNCTION_LIST /end FUNCTION_LIST /begin REF_CHARACTERISTIC CalRegn01Cmn.BrdgVltgMax.Val /end REF_CHARACTERISTIC /begin REF_MEASUREMENT /end REF_MEASUREMENT /end GROUP
/begin GROUP CalRegn01Cmn.CalibrationPorts "MICROSAR RTE"
 /begin SUB_GROUP CalRegn01Cmn.AdcDiagcNtc0x032FailStep.Val CalRegn01Cmn.AdcDiagcNtc0x032PassStep.Val CalRegn01Cmn.AdcDiagcNtc0x033FailStep.Val CalRegn01Cmn.AdcDiagcNtc0x033PassStep.Val CalRegn01Cmn.AssiPahFwlDiRcvr.Logl CalRegn01Cmn.AssiPahFwlVehSpd.Ary1D CalRegn01Cmn.AssiSumLimNtc0x0C4FailStep.Val CalRegn01Cmn.AssiSumLimNtc0x0C4PassStep.Val CalRegn01Cmn.AssiSumLimPullCmpLim.Val CalRegn01Cmn.BasAssiPahFwlOverLimDiagcFailStep.Val CalRegn01Cmn.BasAssiPahFwlOverLimDiagcPassStep.Val CalRegn01Cmn.BattVltgCorrlnAllwdVltgDif.Val CalRegn01Cmn.BattVltgCorrlnBattLoVltg.Val CalRegn01Cmn.BattVltgCorrlnBattOverVltg.Val CalRegn01Cmn.BattVltgCorrlnBattUnderVltg.Val CalRegn01Cmn.BattVltgCorrlnNtc0x03C0x0440x04CFailStep.Val CalRegn01Cmn.BattVltgCorrlnNtc0x03C0x0440x04CPassStep.Val CalRegn01Cmn.BattVltgCorrlnNtc0x03DFailStep.Val CalRegn01Cmn.BattVltgCorrlnNtc0x03DPassStep.Val CalRegn01Cmn.BattVltgCorrlnNtc0x0B0FailStep.Val CalRegn01Cmn.BattVltgCorrlnNtc0x0B0PassStep.Val CalRegn01Cmn.BattVltgCorrlnNtc0x0B1FailStep.Val CalRegn01Cmn.BattVltgCorrlnNtc0x0B1PassStep.Val CalRegn01Cmn.BattVltgCorrlnNtc0x0B5FailStep.Val CalRegn01Cmn.BattVltgCorrlnNtc0x0B5PassStep.Val CalRegn01Cmn.BattVltgCorrlnRcvrlBattLoVltg.Val CalRegn01Cmn.BattVltgCorrlnRcvrlBattOverVltg.Val CalRegn01Cmn.BattVltgCorrlnRcvrlBattUnderVltg.Val CalRegn01Cmn.BattVltgCorrlnSysMinVltg.Val CalRegn01Cmn.BattVltgSwdMax.Val CalRegn01Cmn.BrdgVltgMax.Val CalRegn01Cmn.CmnMfgSrvSecuAcsAtmptTiOut.Val CalRegn01Cmn.CmnMfgSrvSecuAcsMaxNrAtmpt.Val CalRegn01Cmn.CmplncErrHwAgNonLinCmplncDepTblY.Ary1D CalRegn01Cmn.CmplncErrHwAgNonLinCmplncIndTblX.Ary1D CalRegn01Cmn.CmplncErrMotAgNonLinCmplncDepTblY.Ary1D CalRegn01Cmn.CmplncErrMotAgNonLinCmplncIndTblX.Ary1D CalRegn01Cmn.CurrMeasArbnMaxStallCntr.Val CalRegn01Cmn.CurrMeasCorrlnMaxErrCurr.Val CalRegn01Cmn.CurrMeasCorrlnMaxStallCntr.Val CalRegn01Cmn.CurrMeasCorrlnNtc0x04DFailStep.Val CalRegn01Cmn.CurrMeasCorrlnNtc0x04DPassStep.Val CalRegn01Cmn.CurrMeasCorrlnNtc0x04EFailStep.Val CalRegn01Cmn.CurrMeasCorrlnNtc0x04EPassStep.Val CalRegn01Cmn.CurrMeasEolFixdPwmPerd.Val CalRegn01Cmn.CurrMeasEolGainMax.Val CalRegn01Cmn.CurrMeasEolGainMin.Val CalRegn01Cmn.CurrMeasEolGainNrOfSample.Val CalRegn01Cmn.CurrMeasEolGainNumer.Val CalRegn01Cmn.CurrMeasEolMaxMotVel.Val CalRegn01Cmn.CurrMeasEolOffsHiBrdgVltgMin.Val CalRegn01Cmn.CurrMeasEolOffsHiCmuOffs.Val CalRegn01Cmn.CurrMeasEolOffsLoCmuOffs.Val CalRegn01Cmn.CurrMeasEolOffsMax.Val CalRegn01Cmn.CurrMeasEolOffsMin.Val CalRegn01Cmn.CurrMeasEolOffsNrOfSample.Val CalRegn01Cmn.CurrMeasEolTranCntrThd.Val CalRegn01Cmn.CurrMeasMinRqrdPhaOnTi.Val CalRegn01Cmn.CurrMeasMotAgCompuDly.Val CalRegn01Cmn.CurrMeasMotCurrAdcVlyWrmIninMax.Val CalRegn01Cmn.CurrMeasMotCurrAdcVlyWrmIninMin.Val CalRegn01Cmn.CurrMeasNtc0x05DFailStep.Val CalRegn01Cmn.CurrMeasNtc0x05DPassStep.Val CalRegn01Cmn.CurrMeasNtc0x06DFailStep.Val CalRegn01Cmn.CurrMeasNtc0x06DPassStep.Val CalRegn01Cmn.CurrReasbnDiagcCurrDiagcMotEnvlpTblMax.Val CalRegn01Cmn.CurrReasbnDiagcCurrDiagcPrimErrThd.Val CalRegn01Cmn.CurrReasbnDiagcCurrDiagcSecdryErrThd.Val CalRegn01Cmn.CurrReasbnDiagcCurrDiagcSecdryTqLimThd.Val CalRegn01Cmn.CurrReasbnDiagcDiagFildLim.Val CalRegn01Cmn.CurrReasbnDiagcDiagVltgLpFilEna.Logl CalRegn01Cmn.CurrReasbnDiagcDiagVltgLpFilFrq.Val CalRegn01Cmn.CurrReasbnDiagcLpFilSca.Val CalRegn01Cmn.CurrReasbnDiagcMotVelHiLim.Val CalRegn01Cmn.CurrReasbnDiagcMotVelLoLim.Val CalRegn01Cmn.CurrReasbnDiagcMotVltgDaxLpFilFrq.Val CalRegn01Cmn.CurrReasbnDiagcMotVltgQaxDaxFilEna.Logl CalRegn01Cmn.CurrReasbnDiagcMotVltgQaxLpFilFrq.Val CalRegn01Cmn.CurrReasbnDiagcVelLpFilEna.Logl CalRegn01Cmn.CurrReasbnDiagcVelLpFilFrq.Val CalRegn01Cmn.DampgPahFwlAssiAddlDampgX.Ary1D CalRegn01Cmn.DampgPahFwlAssiAddlDampgY.Ary1D CalRegn01Cmn.DampgPahFwlDampgCmdAddlDampgX.Ary1D CalRegn01Cmn.DampgPahFwlDampgCmdAddlDampgY.Ary1D CalRegn01Cmn.DampgPahFwlDampgCmdFwlOverLimDiagcFailStep.Val CalRegn01Cmn.DampgPahFwlDampgCmdFwlOverLimDiagcPassStep.Val CalRegn01Cmn.DampgPahFwlDftDampgX.Ary1D CalRegn01Cmn.DampgPahFwlInertiaCmpCmdFwlOverLimDiagcFailStep.Val CalRegn01Cmn.DampgPahFwlInertiaCmpCmdFwlOverLimDiagcPassStep.Val CalRegn01Cmn.DampgPahFwlVehSpd.Ary1D CalRegn01Cmn.DutyCycThermProtnAbsltCtrlTTblX.Ary1D CalRegn01Cmn.DutyCycThermProtnAbsltCtrlTTqTblY.Ary1D CalRegn01Cmn.DutyCycThermProtnAbsltCuTTblX.Ary1D CalRegn01Cmn.DutyCycThermProtnAbsltCuTTqTblY.Ary1D CalRegn01Cmn.DutyCycThermProtnAbsltMotVelBreakPt.Val CalRegn01Cmn.DutyCycThermProtnAbsltTTqSlewHiLim.Val CalRegn01Cmn.DutyCycThermProtnAbsltTTqSlewLoLim.Val CalRegn01Cmn.DutyCycThermProtnCtrlT.Val CalRegn01Cmn.DutyCycThermProtnCtrlTSeln.Logl CalRegn01Cmn.DutyCycThermProtnDutyCycFildThd.Val CalRegn01Cmn.DutyCycThermProtnIgnOffCtrlEna.Logl CalRegn01Cmn.DutyCycThermProtnIgnOffMsgWaitTi.Val CalRegn01Cmn.DutyCycThermProtnLstTblValNonStall.Ary1D CalRegn01Cmn.DutyCycThermProtnLstTblValStall.Ary1D CalRegn01Cmn.DutyCycThermProtnMotPrTSeln.Logl CalRegn01Cmn.DutyCycThermProtnMplr1NonStallTblY.Ary1D CalRegn01Cmn.DutyCycThermProtnMplr1StallTblY.Ary1D CalRegn01Cmn.DutyCycThermProtnMplr2NonStallTblY.Ary1D CalRegn01Cmn.DutyCycThermProtnMplr2StallTblY.Ary1D CalRegn01Cmn.DutyCycThermProtnMplr3NonStallTblY.Ary1D CalRegn01Cmn.DutyCycThermProtnMplr3StallTblY.Ary1D CalRegn01Cmn.DutyCycThermProtnMplr4NonStallTblY.Ary1D CalRegn01Cmn.DutyCycThermProtnMplr4StallTblY.Ary1D CalRegn01Cmn.DutyCycThermProtnMplr5NonStallTblY.Ary1D CalRegn01Cmn.DutyCycThermProtnMplr5StallTblY.Ary1D CalRegn01Cmn.DutyCycThermProtnMplr6NonStallTblY.Ary1D CalRegn01Cmn.DutyCycThermProtnMplr6StallTblY.Ary1D CalRegn01Cmn.DutyCycThermProtnMplrTSeln.Logl CalRegn01Cmn.DutyCycThermProtnMplrTblX.Ary1D CalRegn01Cmn.DutyCycThermProtnSlowFilTSeln.Logl CalRegn01Cmn.DutyCycThermProtnThermLimScaFac.Val CalRegn01Cmn.DutyCycThermProtnThermLoadLimTblX.Ary1D CalRegn01Cmn.DutyCycThermProtnThermLoadLimTblY.Ary1D CalRegn01Cmn.DutyCycThermProtnTqCmdSlewDwn.Val CalRegn01Cmn.DutyCycThermProtnTqCmdSlewUp.Val CalRegn01Cmn.EcuTMeasDftT.Val CalRegn01Cmn.EcuTMeasFilTau.Val CalRegn01Cmn.EcuTMeasNtc0x045FailStep.Val CalRegn01Cmn.EcuTMeasNtc0x045PassStep.Val CalRegn01Cmn.EcuTMeasRngDiagcMax.Val CalRegn01Cmn.EcuTMeasRngDiagcMin.Val CalRegn01Cmn.EcuTMeasScag.Val CalRegn01Cmn.EcuTMeasScagOffs.Val CalRegn01Cmn.ElecPwrCnsCtrlrInpR.Val CalRegn01Cmn.EotLrngHwAgOverTrvlCnt.Val CalRegn01Cmn.EotProtnFwlEotDampgActvBndX.Ary1D CalRegn01Cmn.EotProtnFwlInactvLim.Val CalRegn01Cmn.EotProtnFwlVehSpd.Ary1D CalRegn01Cmn.GateDrv0CtrlNtcNr0x050FailStep.Val CalRegn01Cmn.GateDrv0CtrlNtcNr0x050PassStep.Val CalRegn01Cmn.GateDrv0CtrlNtcNr0x051FailStep.Val CalRegn01Cmn.GateDrv0CtrlNtcNr0x051PassStep.Val CalRegn01Cmn.GateDrv0CtrlNtcNr0x055FailStep.Val CalRegn01Cmn.GateDrv0CtrlNtcNr0x055PassStep.Val CalRegn01Cmn.GateDrv0CtrlUnit0Cfg2WrVal.Val CalRegn01Cmn.GateDrv0CtrlUnit0Cfg3WrVal.Val CalRegn01Cmn.GateDrv0CtrlUnit0Cfg4WrVal.Val CalRegn01Cmn.GateDrv0CtrlUnit0Cfg7WrVal.Val CalRegn01Cmn.GmFctDiArbnEotHwAgThd.Val CalRegn01Cmn.GmFctDiArbnEotTi.Val CalRegn01Cmn.GmFctDiArbnOnCentrHwAgThd.Val CalRegn01Cmn.GmFctDiArbnOnCentrHwTqThd.Val CalRegn01Cmn.GmFctDiArbnOnCentrTi.Val CalRegn01Cmn.GmFctDiArbnSrvTi.Val CalRegn01Cmn.GmMsg0C5BusHiSpdInvldTiOut.Val CalRegn01Cmn.GmMsg0C5BusHiSpdMissTiOut.Val CalRegn01Cmn.GmMsg0C5BusHiSpdRstTiOut.Val CalRegn01Cmn.GmMsg0C5BusHiSpdSeqNrTiOut.Val CalRegn01Cmn.GmMsg0C9BusHiSpdInvldTiOut.Val CalRegn01Cmn.GmMsg0C9BusHiSpdMissTiOut.Val CalRegn01Cmn.GmMsg0C9BusHiSpdVehSpdThd.Val CalRegn01Cmn.GmMsg17DBusHiSpdInvldTiOut.Val CalRegn01Cmn.GmMsg17DBusHiSpdMissTiOut.Val CalRegn01Cmn.GmMsg180BusChassisExpInvldProtnValTiOut.Val CalRegn01Cmn.GmMsg180BusChassisExpMissTiOut.Val CalRegn01Cmn.GmMsg180BusChassisExpRollgCntrInvldTiOut.Val CalRegn01Cmn.GmMsg180BusChassisExpTqPolarity.Val CalRegn01Cmn.GmMsg180BusHiSpdCrcInvldTiOut.Val CalRegn01Cmn.GmMsg180BusHiSpdMissTiOut.Val CalRegn01Cmn.GmMsg180BusHiSpdRollgCntrInvldTiOut.Val CalRegn01Cmn.GmMsg180BusHiSpdTqPolarity.Val CalRegn01Cmn.GmMsg182BusChassisExpInvldTiOut.Val CalRegn01Cmn.GmMsg182BusChassisExpMissTiOut.Val CalRegn01Cmn.GmMsg184BusHiSpdHandsOnThd.Val CalRegn01Cmn.GmMsg184BusHiSpdTqPolarity.Val CalRegn01Cmn.GmMsg1CaBusChassisExpTqPolarity.Val CalRegn01Cmn.GmMsg1E9BusHiSpdAbsFaildTiOut.Val CalRegn01Cmn.GmMsg1E9BusHiSpdLatADft.Val CalRegn01Cmn.GmMsg1E9BusHiSpdLatAInvldTiOut.Val CalRegn01Cmn.GmMsg1E9BusHiSpdMissTiOut.Val CalRegn01Cmn.GmMsg1E9BusHiSpdTcsDisadTiOut.Val CalRegn01Cmn.GmMsg1E9BusHiSpdVehDynCtrlStTiOut.Val CalRegn01Cmn.GmMsg1E9BusHiSpdVehStabyEnhmtActvVldTiOut.Val CalRegn01Cmn.GmMsg1E9BusHiSpdYawRateDft.Val CalRegn01Cmn.GmMsg1E9BusHiSpdYawRateInvldTiOut.Val CalRegn01Cmn.GmMsg1F1BusHiSpdMissTiOut.Val CalRegn01Cmn.GmMsg1F5BusHiSpdInvldTiOut.Val CalRegn01Cmn.GmMsg1F5BusHiSpdMissTiOut.Val CalRegn01Cmn.GmMsg214BusHiSpdAbsActvProtdInvldTiOut.Val CalRegn01Cmn.GmMsg214BusHiSpdAbsActvProtdProtnValInvldTiOut.Val CalRegn01Cmn.GmMsg214BusHiSpdAbsActvProtdRollgCntrInvldTiOut.Val CalRegn01Cmn.GmMsg214BusHiSpdMissTiOut.Val CalRegn01Cmn.GmMsg214BusHiSpdRdntVehStabyEnhmtActvInvldTiOut.Val CalRegn01Cmn.GmMsg214BusHiSpdRdntVehStabyEnhmtActvRollgCntrInvldTiOut.Val CalRegn01Cmn.GmMsg232BusHiSpdMissTiOut.Val CalRegn01Cmn.GmMsg337BusChassisExpInvldDiagcTiOut.Val CalRegn01Cmn.GmMsg337BusChassisExpInvldProtnValTiOut.Val CalRegn01Cmn.GmMsg337BusChassisExpInvldRollgCntrTiOut.Val CalRegn01Cmn.GmMsg337BusChassisExpMissTiOut.Val CalRegn01Cmn.GmMsg337BusChassisExpTarAgPolarity.Val CalRegn01Cmn.GmMsg348BusChassisExpInvldTiOut.Val CalRegn01Cmn.GmMsg348BusChassisExpMissTiOut.Val CalRegn01Cmn.GmMsg348BusChassisExpStuckTiOut.Val CalRegn01Cmn.GmMsg348BusHiSpdInvldTiOut.Val CalRegn01Cmn.GmMsg348BusHiSpdMissTiOut.Val CalRegn01Cmn.GmMsg348BusHiSpdStuckTiOut.Val CalRegn01Cmn.GmMsg34ABusChassisExpInvldTiOut.Val CalRegn01Cmn.GmMsg34ABusChassisExpMissTiOut.Val CalRegn01Cmn.GmMsg34ABusChassisExpStuckTiOut.Val CalRegn01Cmn.GmMsg34ABusHiSpdInvldTiOut.Val CalRegn01Cmn.GmMsg34ABusHiSpdMissTiOut.Val CalRegn01Cmn.GmMsg34ABusHiSpdStuckTiOut.Val CalRegn01Cmn.GmMsg3F1BusHiSpdAmbTDft.Val CalRegn01Cmn.GmMsg3F1BusHiSpdInvldTiOut.Val CalRegn01Cmn.GmMsg3F1BusHiSpdMissTiOut.Val CalRegn01Cmn.GmMsg4D1BusHiSpdEngOilTDft.Val CalRegn01Cmn.GmMsg4D1BusHiSpdInvldTiOut.Val CalRegn01Cmn.GmMsg4D1BusHiSpdMissTiOut.Val CalRegn01Cmn.GmMsg500BusHiSpdMissTiOut.Val CalRegn01Cmn.GmMsg500BusHiSpdWhlPlsPerRevDft.Val CalRegn01Cmn.GmMsg500BusHiSpdWhlRotlStsTiStampReslDft.Val CalRegn01Cmn.HiFrqAssiPahFwlOverLimDiagcFailStep.Val CalRegn01Cmn.HiFrqAssiPahFwlOverLimDiagcPassStep.Val CalRegn01Cmn.HwAgSnsrlsCorrdPinionAgHwConf.Val CalRegn01Cmn.HwAgSnsrlsFCentrHwConf.Val CalRegn01Cmn.HwAgSnsrlsPinionTqFilFrq.Val CalRegn01Cmn.HwAgSnsrlsRelHwAgFil1Frq.Val CalRegn01Cmn.HwAgSnsrlsRelHwAgFil2Frq.Val CalRegn01Cmn.HwAgSnsrlsSmotngCoeff.Val CalRegn01Cmn.HwAgSnsrlsSmotngStepThd.Val CalRegn01Cmn.HwAgSnsrlsStordPinionConf.Val CalRegn01Cmn.HwAgSnsrlsStordPinionConfThd.Val CalRegn01Cmn.HwAgSnsrlsVehDynDifThd.Val CalRegn01Cmn.HwAgSnsrlsVehDynHwConf.Val CalRegn01Cmn.HwAgSnsrlsVehDynMotVelThd.Val CalRegn01Cmn.HwAgSnsrlsVehDynPinionTqThd.Val CalRegn01Cmn.HwAgSnsrlsVehDynTmr1Thd.Val CalRegn01Cmn.HwAgSnsrlsVehDynTmr2Thd.Val CalRegn01Cmn.HwAgSnsrlsWhlFrqThd.Val CalRegn01Cmn.HwAgSnsrlsWhlSpdHwAgCoeff1.Val CalRegn01Cmn.HwAgSnsrlsWhlSpdHwAgCoeff2.Val CalRegn01Cmn.HwAgSnsrlsWhlSpdHwAgThd.Val CalRegn01Cmn.HwAgSnsrlsWhlSpdHwConf.Val CalRegn01Cmn.HwAgSnsrlsWhlSpdRatThd.Val CalRegn01Cmn.HwAgSnsrlsWhlSpdTmrThd.Val CalRegn01Cmn.HwAgSnsrlsWhlSpdVehSpdThd.Val CalRegn01Cmn.HwAgSysArbnHwAgConf1Snsr.Val CalRegn01Cmn.HwAgSysArbnHwAgConf2Snsr.Val CalRegn01Cmn.HwAgSysArbnHwAgConfNoSnsr.Val CalRegn01Cmn.HwAgSysArbnHwAgCorrdCorrlnThd.Val CalRegn01Cmn.HwAgSysArbnHwAgCorrlnFailDebStep.Val CalRegn01Cmn.HwAgSysArbnHwAgCorrlnPassDebStep.Val CalRegn01Cmn.HwAgSysArbnHwAgCorrlnRng.Val CalRegn01Cmn.HwAgSysArbnHwAgSlewRate.Val CalRegn01Cmn.HwAgSysArbnHwAgSnsrlsCorrlnThd.Val CalRegn01Cmn.HwAgSysArbnHwAgSnsrlsKineThd.Val CalRegn01Cmn.HwAgSysArbnHwAgToMotAgCorrlnElpdTiLim.Val CalRegn01Cmn.HwAgSysArbnSerlComHwAgCorrdConf.Val CalRegn01Cmn.HwAgSysArbnSerlComHwAgSnsrlsConf.Val CalRegn01Cmn.HwAgSysArbnSlewRateTmr.Val CalRegn01Cmn.HwAgTrajGennAMax.Val CalRegn01Cmn.HwAgTrajGennAgMax.Val CalRegn01Cmn.HwAgTrajGennVelMax.Val CalRegn01Cmn.HwTq2MeasHwTq2PrtclFltFailStep.Val CalRegn01Cmn.HwTq2MeasHwTq2PrtclFltPassStep.Val CalRegn01Cmn.HwTq3MeasHwTq3PrtclFltFailStep.Val CalRegn01Cmn.HwTq3MeasHwTq3PrtclFltPassStep.Val CalRegn01Cmn.HwTqArbnMaxStallTqA.Val CalRegn01Cmn.HwTqArbnMaxStallTqB.Val CalRegn01Cmn.HwTqArbnMaxStallTqC.Val CalRegn01Cmn.HwTqArbnMaxStallTqD.Val CalRegn01Cmn.HwTqCorrlnChACmnModCmpLpFilActvnThd.Val CalRegn01Cmn.HwTqCorrlnChACmnModCmpLpFilFrq.Val CalRegn01Cmn.HwTqCorrlnChACmnModCmpLpFilOutpLim.Val CalRegn01Cmn.HwTqCorrlnChAImdtCorrlnChkFailThd.Val CalRegn01Cmn.HwTqCorrlnChAImdtCorrlnChkPassThd.Val CalRegn01Cmn.HwTqCorrlnChAStabStClrFltThd.Val CalRegn01Cmn.HwTqCorrlnChAStabStLpFilFrq.Val CalRegn01Cmn.HwTqCorrlnChAStabStSetFltThd.Val CalRegn01Cmn.HwTqCorrlnChATqSumMaxLim.Val CalRegn01Cmn.HwTqCorrlnChATraLpFilX.Ary1D CalRegn01Cmn.HwTqCorrlnChATraLpFilY.Ary1D CalRegn01Cmn.HwTqCorrlnChATraSumClrFltThd.Val CalRegn01Cmn.HwTqCorrlnChATraSumSetFltThd.Val CalRegn01Cmn.HwTqCorrlnChBCmnModCmpLpFilActvnThd.Val CalRegn01Cmn.HwTqCorrlnChBCmnModCmpLpFilFrq.Val CalRegn01Cmn.HwTqCorrlnChBCmnModCmpLpFilOutpLim.Val CalRegn01Cmn.HwTqCorrlnChBImdtCorrlnChkFailThd.Val CalRegn01Cmn.HwTqCorrlnChBImdtCorrlnChkPassThd.Val CalRegn01Cmn.HwTqCorrlnChBStabStClrFltThd.Val CalRegn01Cmn.HwTqCorrlnChBStabStLpFilFrq.Val CalRegn01Cmn.HwTqCorrlnChBStabStSetFltThd.Val CalRegn01Cmn.HwTqCorrlnChBTqSumMaxLim.Val CalRegn01Cmn.HwTqCorrlnChBTraLpFilX.Ary1D CalRegn01Cmn.HwTqCorrlnChBTraLpFilY.Ary1D CalRegn01Cmn.HwTqCorrlnChBTraSumClrFltThd.Val CalRegn01Cmn.HwTqCorrlnChBTraSumSetFltThd.Val CalRegn01Cmn.HwTqCorrlnMaxStallTqA.Val CalRegn01Cmn.HwTqCorrlnMaxStallTqB.Val CalRegn01Cmn.HwTqCorrlnMaxStallTqC.Val CalRegn01Cmn.HwTqCorrlnMaxStallTqD.Val CalRegn01Cmn.ImcArbnEcuIninTiOutThd.Val CalRegn01Cmn.ImcArbnFrmFltThd.Val CalRegn01Cmn.LoaMgrCurrIvtrMtgtnRate.Val CalRegn01Cmn.LoaMgrCurrIvtrMtgtnSca.Val CalRegn01Cmn.LoaMgrCurrIvtrMtgtnScaZeroEna.Logl CalRegn01Cmn.LoaMgrCurrMeasIdptSig0Resp.Val CalRegn01Cmn.LoaMgrCurrMeasIdptSig1Resp.Val CalRegn01Cmn.LoaMgrCurrMeasIdptSig2Resp.Val CalRegn01Cmn.LoaMgrCurrMeasIdptSigFltThd.Val CalRegn01Cmn.LoaMgrCurrMeasMtgtnRate.Val CalRegn01Cmn.LoaMgrCurrMeasMtgtnSca.Val CalRegn01Cmn.LoaMgrCurrMeasMtgtnScaZeroEna.Logl CalRegn01Cmn.LoaMgrFadeOutStRate.Val CalRegn01Cmn.LoaMgrHwTqIdptSig0NoTqLoaResp.Val CalRegn01Cmn.LoaMgrHwTqIdptSig1NoTqLoaResp.Val CalRegn01Cmn.LoaMgrHwTqIdptSig2Resp.Val CalRegn01Cmn.LoaMgrHwTqIdptSig4Resp.Val CalRegn01Cmn.LoaMgrHwTqIdptSigFltThd.Val CalRegn01Cmn.LoaMgrHwTqLoaAvlResp.Val CalRegn01Cmn.LoaMgrIvtrIdptSig0Resp.Val CalRegn01Cmn.LoaMgrIvtrIdptSig1Resp.Val CalRegn01Cmn.LoaMgrIvtrIdptSig2Resp.Val CalRegn01Cmn.LoaMgrIvtrIdptSigFltThd.Val CalRegn01Cmn.LoaMgrIvtrMtgtnRate.Val CalRegn01Cmn.LoaMgrIvtrMtgtnSca.Val CalRegn01Cmn.LoaMgrIvtrMtgtnScaZeroEna.Logl CalRegn01Cmn.LoaMgrLimdStRate.Val CalRegn01Cmn.LoaMgrLimdStSca.Val CalRegn01Cmn.LoaMgrMotAgAvlSnsrlsResp.Val CalRegn01Cmn.LoaMgrMotAgIdptSig0NoSnsrlsResp.Val CalRegn01Cmn.LoaMgrMotAgIdptSig1NoSnsrlsResp.Val CalRegn01Cmn.LoaMgrMotAgIdptSig2Resp.Val CalRegn01Cmn.LoaMgrMotAgIdptSig3Resp.Val CalRegn01Cmn.LoaMgrMotAgIdptSigFltThd.Val CalRegn01Cmn.LoaMgrMotAgMtgtnRate.Val CalRegn01Cmn.LoaMgrMotAgMtgtnSca.Val CalRegn01Cmn.LoaMgrMotAgMtgtnScaZeroEna.Logl CalRegn01Cmn.MotCtrlPrmEstimnFetRNom.Val CalRegn01Cmn.MotCtrlPrmEstimnFetThermCoeff.Val CalRegn01Cmn.MotCtrlPrmEstimnMagThermCoeff.Val CalRegn01Cmn.MotCtrlPrmEstimnMotBackEmfConHiLim.Val CalRegn01Cmn.MotCtrlPrmEstimnMotBackEmfConLoLim.Val CalRegn01Cmn.MotCtrlPrmEstimnMotBackEmfConNom.Val CalRegn01Cmn.MotCtrlPrmEstimnMotBackEmfConSatnScaIvtrLoaMtgtn.Val CalRegn01Cmn.MotCtrlPrmEstimnMotBackEmfConSatnX.Ary1D CalRegn01Cmn.MotCtrlPrmEstimnMotBackEmfConSatnY.Ary1D CalRegn01Cmn.MotCtrlPrmEstimnMotCurrDaxInduSatnBilnrSeln.Ary1D CalRegn01Cmn.MotCtrlPrmEstimnMotCurrQaxInduSatnX.Ary1D CalRegn01Cmn.MotCtrlPrmEstimnMotInduDaxHiLim.Val CalRegn01Cmn.MotCtrlPrmEstimnMotInduDaxIvtrLoaMtgtn.Val CalRegn01Cmn.MotCtrlPrmEstimnMotInduDaxLoLim.Val CalRegn01Cmn.MotCtrlPrmEstimnMotInduDaxNom.Val CalRegn01Cmn.MotCtrlPrmEstimnMotInduDaxSatnScaY.Ary2D CalRegn01Cmn.MotCtrlPrmEstimnMotInduQaxHiLim.Val CalRegn01Cmn.MotCtrlPrmEstimnMotInduQaxIvtrLoaMtgtn.Val CalRegn01Cmn.MotCtrlPrmEstimnMotInduQaxLoLim.Val CalRegn01Cmn.MotCtrlPrmEstimnMotInduQaxNom.Val CalRegn01Cmn.MotCtrlPrmEstimnMotInduQaxSatnScaY.Ary2D CalRegn01Cmn.MotCtrlPrmEstimnMotRHiLim.Val CalRegn01Cmn.MotCtrlPrmEstimnMotRLoLim.Val CalRegn01Cmn.MotCtrlPrmEstimnMotRNom.Val CalRegn01Cmn.MotCtrlPrmEstimnMotWidgThermCoeff.Val CalRegn01Cmn.MotCtrlPrmEstimnTNom.Val CalRegn01Cmn.MotCurrPeakEstimnCurrFilFrq.Val CalRegn01Cmn.MotCurrPeakEstimnCurrPeakEstimdFilFrq.Val CalRegn01Cmn.MotCurrRegCfgCtrlrDynGainVehSpdCutOff.Val CalRegn01Cmn.MotCurrRegCfgCurrLoopSecOrderTrfFctEna.Logl CalRegn01Cmn.MotCurrRegCfgIntglGainSampleTi.Val CalRegn01Cmn.MotCurrRegCfgMotAgCompuDly.Val CalRegn01Cmn.MotCurrRegCfgMotClsdLoopBwDaxY.Ary1D CalRegn01Cmn.MotCurrRegCfgMotClsdLoopBwQaxY.Ary1D CalRegn01Cmn.MotCurrRegCfgMotCtrlPrmSelnX.Ary1D CalRegn01Cmn.MotCurrRegCfgMotDampgRatDax.Val CalRegn01Cmn.MotCurrRegCfgMotDampgRatQax.Val CalRegn01Cmn.MotCurrRegCfgMotNatFrqDaxY.Ary1D CalRegn01Cmn.MotCurrRegCfgMotNatFrqQaxY.Ary1D CalRegn01Cmn.MotCurrRegCfgMotRVirtDax.Val CalRegn01Cmn.MotCurrRegCfgMotRVirtQax.Val CalRegn01Cmn.MotCurrRegCfgMotVelFilFrq.Val CalRegn01Cmn.MotCurrRegVltgLimrCurrLoaScarSlewRate.Val CalRegn01Cmn.MotCurrRegVltgLimrDaxAntiWdupCoeff.Val CalRegn01Cmn.MotCurrRegVltgLimrDualEcuLoaScarSlewRate.Val CalRegn01Cmn.MotCurrRegVltgLimrIvtrLoaScarSlewRate.Val CalRegn01Cmn.MotCurrRegVltgLimrMotCurrPredEna.Logl CalRegn01Cmn.MotCurrRegVltgLimrMotCurrPredTi.Val CalRegn01Cmn.MotCurrRegVltgLimrMotCurrQaxRefMdfnRplEna.Logl CalRegn01Cmn.MotCurrRegVltgLimrMotVltgBrdgFilEna.Logl CalRegn01Cmn.MotCurrRegVltgLimrMotVltgBrdgLpFilFrq.Val CalRegn01Cmn.MotCurrRegVltgLimrMotVltgDaxIntglHiLim.Val CalRegn01Cmn.MotCurrRegVltgLimrMotVltgDaxIntglLoLim.Val CalRegn01Cmn.MotCurrRegVltgLimrMotVltgQaxFfFilEna.Logl CalRegn01Cmn.MotCurrRegVltgLimrMotVltgQaxFfLpFilFrq.Val CalRegn01Cmn.MotCurrRegVltgLimrMotVltgQaxIntglHiLim.Val CalRegn01Cmn.MotCurrRegVltgLimrMotVltgQaxIntglLoLim.Val CalRegn01Cmn.MotCurrRegVltgLimrQaxAntiWdupCoeff.Val CalRegn01Cmn.MotCurrRegVltgLimrQaxAntiWdupScagDi.Logl CalRegn01Cmn.MotDrvDiagcErrFilFrq.Val CalRegn01Cmn.MotDrvDiagcErrOffs.Val CalRegn01Cmn.MotDrvDiagcErrThd.Val CalRegn01Cmn.MotQuadDetnMotDirHysInsts.Val CalRegn01Cmn.MotRefMdlCurrDaxBoostGain.Val CalRegn01Cmn.MotRefMdlCurrDaxBoostTqScaX.Ary1D CalRegn01Cmn.MotRefMdlCurrDaxBoostTqScaY.Ary1D CalRegn01Cmn.MotRefMdlCurrDaxQaxRefDelta.Ary1D CalRegn01Cmn.MotRefMdlCurrItrnTolr.Val CalRegn01Cmn.MotRefMdlFbCtrlDi.Logl CalRegn01Cmn.MotRefMdlIvtrDeadTiBrdgVltgSca.Val CalRegn01Cmn.MotRefMdlMinCurrItrnLim.Val CalRegn01Cmn.MotRefMdlMotCurrDaxMaxSca.Val CalRegn01Cmn.MotRefMdlMotVelLpFilFrq.Val CalRegn01Cmn.MotRefMdlMotVltgDerivtvTiCon.Val CalRegn01Cmn.MotRefMdlQuad13VltgSdlX.Ary1D CalRegn01Cmn.MotRefMdlQuad13VltgSdlY.Ary1D CalRegn01Cmn.MotRefMdlQuad24VltgSdlX.Ary1D CalRegn01Cmn.MotRefMdlQuad24VltgSdlY.Ary1D CalRegn01Cmn.MotRefMdlRefLocnItrnLim.Val CalRegn01Cmn.MotRefMdlTqItrnLim.Val CalRegn01Cmn.MotRefMdlTqItrnTolr.Val CalRegn01Cmn.MotRefMdlVltgModDynCmpEna.Logl CalRegn01Cmn.MotRefMdlVltgOverRThdSca.Val CalRegn01Cmn.MotRplCoggCfgMotAgTiDly.Val CalRegn01Cmn.MotRplCoggCfgMotCurrDaxRplBilnrSeln.Ary1D CalRegn01Cmn.MotRplCoggCfgMotCurrQaxRpl.Ary1D CalRegn01Cmn.MotRplCoggCfgMotTqCmdCurrRgltrBwCmpMgnY.Ary2D CalRegn01Cmn.MotRplCoggCfgMotTqCmdCurrRgltrBwCmpPhaY.Ary2D CalRegn01Cmn.MotRplCoggCfgMotTqCmdCurrRgltrBwCmpX.Ary1D CalRegn01Cmn.MotRplCoggCfgMotTqRplOrder1X.Ary2D CalRegn01Cmn.MotRplCoggCfgMotTqRplOrder1Y.Ary2D CalRegn01Cmn.MotRplCoggCfgMotTqRplOrder2X.Ary2D CalRegn01Cmn.MotRplCoggCfgMotTqRplOrder2Y.Ary2D CalRegn01Cmn.MotRplCoggCfgMotTqRplOrder3X.Ary2D CalRegn01Cmn.MotRplCoggCfgMotTqRplOrder3Y.Ary2D CalRegn01Cmn.MotRplCoggCfgMotVelBilnrSeln.Ary1D CalRegn01Cmn.MotRplCoggCmdHrmncOrder1Elec.Val CalRegn01Cmn.MotRplCoggCmdHrmncOrder2Elec.Val CalRegn01Cmn.MotRplCoggCmdHrmncOrder3Elec.Val CalRegn01Cmn.MotTqCmdScaMax.Val CalRegn01Cmn.MotTqCmdScaMin.Val CalRegn01Cmn.MotTqTranlDampgVehSpdBlndY.Ary1D CalRegn01Cmn.NxtrCalIdsCal0DevlpAuthor.Ary1D CalRegn01Cmn.NxtrCalIdsCal0DevlpDesc.Ary1D CalRegn01Cmn.NxtrCalIdsCal0DevlpRelNr.Val CalRegn01Cmn.NxtrCalIdsCal0DevlpRelSt.Val CalRegn01Cmn.NxtrCalIdsCal0DevlpTiStamp.Val CalRegn01Cmn.NxtrCalIdsCal0DevlpVers.Val CalRegn01Cmn.PwrDiscnctOpenThd.Val CalRegn01Cmn.PwrLimrAssiRednLpFilFrq.Val CalRegn01Cmn.PwrLimrBackEmfConStdT.Val CalRegn01Cmn.PwrLimrBrdgVltgAdjSlew.Val CalRegn01Cmn.PwrLimrBrdgVltgAltFltAdj.Val CalRegn01Cmn.PwrLimrFilAssiRednThd.Val CalRegn01Cmn.PwrLimrLoVoltAssiRcvrThd.Val CalRegn01Cmn.PwrLimrLoVoltAssiRcvrTi.Val CalRegn01Cmn.PwrLimrMotEnvlpX.Ary1D CalRegn01Cmn.PwrLimrMotEnvlpY.Ary1D CalRegn01Cmn.PwrLimrMotVelLpFilFrq.Val CalRegn01Cmn.PwrLimrSpdAdjSlewDec.Val CalRegn01Cmn.PwrLimrSpdAdjSlewEna.Logl CalRegn01Cmn.PwrLimrSpdAdjSlewInc.Val CalRegn01Cmn.PwrLimrStdOperMotEnvlpX.Ary1D CalRegn01Cmn.PwrLimrStdOperMotEnvlpY.Ary1D CalRegn01Cmn.PwrLimrVltgDptMotVelOffsX.Ary1D CalRegn01Cmn.PwrLimrVltgDptMotVelOffsY.Ary1D CalRegn01Cmn.PwrSplyNtc0x07BFailStep.Val CalRegn01Cmn.PwrSplyNtc0x07BPassStep.Val CalRegn01Cmn.PwrSplyNtc0x07CFailStep.Val CalRegn01Cmn.PwrSplyNtc0x07CPassStep.Val CalRegn01Cmn.PwrSplyNtc0x07DFailStep.Val CalRegn01Cmn.PwrSplyNtc0x07DPassStep.Val CalRegn01Cmn.SinVltgGennDthrLpFilCoeff.Val CalRegn01Cmn.SnsrOffsLrngSampleCntForHwTqLrngRst.Val CalRegn01Cmn.StHlthSigNormnAbsltMotPosDifStHlthDiagThd.Val CalRegn01Cmn.StHlthSigNormnCurrMotSumStHlthDiagThd.Val CalRegn01Cmn.StHlthSigNormnDigTqStHlthDiagThd.Val CalRegn01Cmn.StHlthSigNormnDutyCycFltLimThd.Val CalRegn01Cmn.StHlthSigNormnIdptSigStHlthSca.Val CalRegn01Cmn.StHlthSigNormnMaxFricThd.Val CalRegn01Cmn.StHlthSigNormnMinRackTrvlLim.Val CalRegn01Cmn.StHlthSigNormnMotPosStHlthDiagThd.Val CalRegn01Cmn.StHlthSigNormnMotVelCal.Val CalRegn01Cmn.StHlthSigNormnPhaInfoStHlthDiagThd.Val CalRegn01Cmn.StHlthSigNormnStHlthCorrlnErr.Val CalRegn01Cmn.StHlthSigNormnStHlthCurrMotSum.Val CalRegn01Cmn.StHlthSigNormnStHlthPhaInfo.Val CalRegn01Cmn.StHlthSigNormnValMaxStHlthErr.Val CalRegn01Cmn.StHlthSigNormnValMinStHlthErr.Val CalRegn01Cmn.StHlthSigNormnWhlImbRejctnThd.Val CalRegn01Cmn.SysGlbPrmVehSpdBilnrSeln.Ary1D CalRegn01Cmn.TSG31CfgAndUseAdcStrtOfCnvn2Offs.Val CalRegn01Cmn.TSG31CfgAndUseAdcStrtOfCnvnMotCtrlPeakOffs.Val CalRegn01Cmn.TSG31CfgAndUseAdcStrtOfCnvnMotCtrlVlyOffs.Val CalRegn01Cmn.TSG31CfgAndUseMtrAg0SPIStart.Val CalRegn01Cmn.TSG31CfgAndUsePwmDbnd.Val CalRegn01Cmn.TqOscnAmpLimY.Ary1D CalRegn01Cmn.TqOscnFallRampRateCal.Val CalRegn01Cmn.TqOscnFrqIn.Ary1D CalRegn01Cmn.TqOscnRisngRampRateCal.Val CalRegn01Cmn.TqOscnUseRampRateCal.Logl CalRegn01Cmn.TunSelnAuthyTunSelnRtDiCmd.Logl CalRegn01Cmn.VehSigCdngDftLatA.Val CalRegn01Cmn.VehSigCdngDftLgtA.Val CalRegn01Cmn.VehSigCdngDftVehSpd.Val CalRegn01Cmn.VehSigCdngDftYawRate.Val CalRegn01Cmn.VehSigCdngLatADifThd.Val CalRegn01Cmn.VehSigCdngLatAFilFrq.Val CalRegn01Cmn.VehSigCdngLtgADifThd.Val CalRegn01Cmn.VehSigCdngVehSpdDifThd.Val CalRegn01Cmn.VehSigCdngVehYawSlewRate.Val CalRegn01Cmn.VehSigCdngYawRateDifThd.Val CalRegn01Cmn.VehSpdLimrMaxAssiX.Ary1D CalRegn01Cmn.VehSpdLimrMaxAssiY.Ary1D CalRegn01Cmn.VehSpdLimrPosMaxOffs1.Val CalRegn01Cmn.VehSpdLimrPosMaxOffs2.Val CalRegn01Cmn.WhlImbRejctnFrqDiagcLpFil.Val /end SUB_GROUP
 /begin FUNCTION_LIST /end FUNCTION_LIST
 /begin REF_CHARACTERISTIC /end REF_CHARACTERISTIC
 /begin REF_MEASUREMENT /end REF_MEASUREMENT
/end GROUP
/begin GROUP CalRegn01Cmn.CmnMfgSrvSecuAcsAtmptTiOut.Val "MICROSAR RTE" /begin SUB_GROUP /end SUB_GROUP /begin FUNCTION_LIST /end FUNCTION_LIST /begin REF_CHARACTERISTIC CalRegn01Cmn.CmnMfgSrvSecuAcsAtmptTiOut.Val /end REF_CHARACTERISTIC /begin REF_MEASUREMENT /end REF_MEASUREMENT /end GROUP
/begin GROUP CalRegn01Cmn.CmnMfgSrvSecuAcsMaxNrAtmpt.Val "MICROSAR RTE" /begin SUB_GROUP /end SUB_GROUP /begin FUNCTION_LIST /end FUNCTION_LIST /begin REF_CHARACTERISTIC CalRegn01Cmn.CmnMfgSrvSecuAcsMaxNrAtmpt.Val /end REF_CHARACTERISTIC /begin REF_MEASUREMENT /end REF_MEASUREMENT /end GROUP
/begin GROUP CalRegn01Cmn.CmplncErrHwAgNonLinCmplncDepTblY.Ary1D "MICROSAR RTE" /begin SUB_GROUP /end SUB_GROUP /begin FUNCTION_LIST /end FUNCTION_LIST /begin REF_CHARACTERISTIC CalRegn01Cmn.CmplncErrHwAgNonLinCmplncDepTblY.Ary1D /end REF_CHARACTERISTIC /begin REF_MEASUREMENT /end REF_MEASUREMENT /end GROUP
/begin GROUP CalRegn01Cmn.CmplncErrHwAgNonLinCmplncIndTblX.Ary1D "MICROSAR RTE" /begin SUB_GROUP /end SUB_GROUP /begin FUNCTION_LIST /end FUNCTION_LIST /begin REF_CHARACTERISTIC CalRegn01Cmn.CmplncErrHwAgNonLinCmplncIndTblX.Ary1D /end REF_CHARACTERISTIC /begin REF_MEASUREMENT /end REF_MEASUREMENT /end GROUP
/begin GROUP CalRegn01Cmn.CmplncErrMotAgNonLinCmplncDepTblY.Ary1D "MICROSAR RTE" /begin SUB_GROUP /end SUB_GROUP /begin FUNCTION_LIST /end FUNCTION_LIST /begin REF_CHARACTERISTIC CalRegn01Cmn.CmplncErrMotAgNonLinCmplncDepTblY.Ary1D /end REF_CHARACTERISTIC /begin REF_MEASUREMENT /end REF_MEASUREMENT /end GROUP
/begin GROUP CalRegn01Cmn.CmplncErrMotAgNonLinCmplncIndTblX.Ary1D "MICROSAR RTE" /begin SUB_GROUP /end SUB_GROUP /begin FUNCTION_LIST /end FUNCTION_LIST /begin REF_CHARACTERISTIC CalRegn01Cmn.CmplncErrMotAgNonLinCmplncIndTblX.Ary1D /end REF_CHARACTERISTIC /begin REF_MEASUREMENT /end REF_MEASUREMENT /end GROUP
/begin GROUP CalRegn01Cmn.CurrMeasArbnMaxStallCntr.Val "MICROSAR RTE" /begin SUB_GROUP /end SUB_GROUP /begin FUNCTION_LIST /end FUNCTION_LIST /begin REF_CHARACTERISTIC CalRegn01Cmn.CurrMeasArbnMaxStallCntr.Val /end REF_CHARACTERISTIC /begin REF_MEASUREMENT /end REF_MEASUREMENT /end GROUP
/begin GROUP CalRegn01Cmn.CurrMeasCorrlnMaxErrCurr.Val "MICROSAR RTE" /begin SUB_GROUP /end SUB_GROUP /begin FUNCTION_LIST /end FUNCTION_LIST /begin REF_CHARACTERISTIC CalRegn01Cmn.CurrMeasCorrlnMaxErrCurr.Val /end REF_CHARACTERISTIC /begin REF_MEASUREMENT /end REF_MEASUREMENT /end GROUP
/begin GROUP CalRegn01Cmn.CurrMeasCorrlnMaxStallCntr.Val "MICROSAR RTE" /begin SUB_GROUP /end SUB_GROUP /begin FUNCTION_LIST /end FUNCTION_LIST /begin REF_CHARACTERISTIC CalRegn01Cmn.CurrMeasCorrlnMaxStallCntr.Val /end REF_CHARACTERISTIC /begin REF_MEASUREMENT /end REF_MEASUREMENT /end GROUP
/begin GROUP CalRegn01Cmn.CurrMeasCorrlnNtc0x04DFailStep.Val "MICROSAR RTE" /begin SUB_GROUP /end SUB_GROUP /begin FUNCTION_LIST /end FUNCTION_LIST /begin REF_CHARACTERISTIC CalRegn01Cmn.CurrMeasCorrlnNtc0x04DFailStep.Val /end REF_CHARACTERISTIC /begin REF_MEASUREMENT /end REF_MEASUREMENT /end GROUP
/begin GROUP CalRegn01Cmn.CurrMeasCorrlnNtc0x04DPassStep.Val "MICROSAR RTE" /begin SUB_GROUP /end SUB_GROUP /begin FUNCTION_LIST /end FUNCTION_LIST /begin REF_CHARACTERISTIC CalRegn01Cmn.CurrMeasCorrlnNtc0x04DPassStep.Val /end REF_CHARACTERISTIC /begin REF_MEASUREMENT /end REF_MEASUREMENT /end GROUP
/begin GROUP CalRegn01Cmn.CurrMeasCorrlnNtc0x04EFailStep.Val "MICROSAR RTE" /begin SUB_GROUP /end SUB_GROUP /begin FUNCTION_LIST /end FUNCTION_LIST /begin REF_CHARACTERISTIC CalRegn01Cmn.CurrMeasCorrlnNtc0x04EFailStep.Val /end REF_CHARACTERISTIC /begin REF_MEASUREMENT /end REF_MEASUREMENT /end GROUP
/begin GROUP CalRegn01Cmn.CurrMeasCorrlnNtc0x04EPassStep.Val "MICROSAR RTE" /begin SUB_GROUP /end SUB_GROUP /begin FUNCTION_LIST /end FUNCTION_LIST /begin REF_CHARACTERISTIC CalRegn01Cmn.CurrMeasCorrlnNtc0x04EPassStep.Val /end REF_CHARACTERISTIC /begin REF_MEASUREMENT /end REF_MEASUREMENT /end GROUP
/begin GROUP CalRegn01Cmn.CurrMeasEolFixdPwmPerd.Val "MICROSAR RTE" /begin SUB_GROUP /end SUB_GROUP /begin FUNCTION_LIST /end FUNCTION_LIST /begin REF_CHARACTERISTIC CalRegn01Cmn.CurrMeasEolFixdPwmPerd.Val /end REF_CHARACTERISTIC /begin REF_MEASUREMENT /end REF_MEASUREMENT /end GROUP
/begin GROUP CalRegn01Cmn.CurrMeasEolGainMax.Val "MICROSAR RTE" /begin SUB_GROUP /end SUB_GROUP /begin FUNCTION_LIST /end FUNCTION_LIST /begin REF_CHARACTERISTIC CalRegn01Cmn.CurrMeasEolGainMax.Val /end REF_CHARACTERISTIC /begin REF_MEASUREMENT /end REF_MEASUREMENT /end GROUP
/begin GROUP CalRegn01Cmn.CurrMeasEolGainMin.Val "MICROSAR RTE" /begin SUB_GROUP /end SUB_GROUP /begin FUNCTION_LIST /end FUNCTION_LIST /begin REF_CHARACTERISTIC CalRegn01Cmn.CurrMeasEolGainMin.Val /end REF_CHARACTERISTIC /begin REF_MEASUREMENT /end REF_MEASUREMENT /end GROUP
/begin GROUP CalRegn01Cmn.CurrMeasEolGainNrOfSample.Val "MICROSAR RTE" /begin SUB_GROUP /end SUB_GROUP /begin FUNCTION_LIST /end FUNCTION_LIST /begin REF_CHARACTERISTIC CalRegn01Cmn.CurrMeasEolGainNrOfSample.Val /end REF_CHARACTERISTIC /begin REF_MEASUREMENT /end REF_MEASUREMENT /end GROUP
/begin GROUP CalRegn01Cmn.CurrMeasEolGainNumer.Val "MICROSAR RTE" /begin SUB_GROUP /end SUB_GROUP /begin FUNCTION_LIST /end FUNCTION_LIST /begin REF_CHARACTERISTIC CalRegn01Cmn.CurrMeasEolGainNumer.Val /end REF_CHARACTERISTIC /begin REF_MEASUREMENT /end REF_MEASUREMENT /end GROUP
/begin GROUP CalRegn01Cmn.CurrMeasEolMaxMotVel.Val "MICROSAR RTE" /begin SUB_GROUP /end SUB_GROUP /begin FUNCTION_LIST /end FUNCTION_LIST /begin REF_CHARACTERISTIC CalRegn01Cmn.CurrMeasEolMaxMotVel.Val /end REF_CHARACTERISTIC /begin REF_MEASUREMENT /end REF_MEASUREMENT /end GROUP
/begin GROUP CalRegn01Cmn.CurrMeasEolOffsHiBrdgVltgMin.Val "MICROSAR RTE" /begin SUB_GROUP /end SUB_GROUP /begin FUNCTION_LIST /end FUNCTION_LIST /begin REF_CHARACTERISTIC CalRegn01Cmn.CurrMeasEolOffsHiBrdgVltgMin.Val /end REF_CHARACTERISTIC /begin REF_MEASUREMENT /end REF_MEASUREMENT /end GROUP
/begin GROUP CalRegn01Cmn.CurrMeasEolOffsHiCmuOffs.Val "MICROSAR RTE" /begin SUB_GROUP /end SUB_GROUP /begin FUNCTION_LIST /end FUNCTION_LIST /begin REF_CHARACTERISTIC CalRegn01Cmn.CurrMeasEolOffsHiCmuOffs.Val /end REF_CHARACTERISTIC /begin REF_MEASUREMENT /end REF_MEASUREMENT /end GROUP
/begin GROUP CalRegn01Cmn.CurrMeasEolOffsLoCmuOffs.Val "MICROSAR RTE" /begin SUB_GROUP /end SUB_GROUP /begin FUNCTION_LIST /end FUNCTION_LIST /begin REF_CHARACTERISTIC CalRegn01Cmn.CurrMeasEolOffsLoCmuOffs.Val /end REF_CHARACTERISTIC /begin REF_MEASUREMENT /end REF_MEASUREMENT /end GROUP
/begin GROUP CalRegn01Cmn.CurrMeasEolOffsMax.Val "MICROSAR RTE" /begin SUB_GROUP /end SUB_GROUP /begin FUNCTION_LIST /end FUNCTION_LIST /begin REF_CHARACTERISTIC CalRegn01Cmn.CurrMeasEolOffsMax.Val /end REF_CHARACTERISTIC /begin REF_MEASUREMENT /end REF_MEASUREMENT /end GROUP
/begin GROUP CalRegn01Cmn.CurrMeasEolOffsMin.Val "MICROSAR RTE" /begin SUB_GROUP /end SUB_GROUP /begin FUNCTION_LIST /end FUNCTION_LIST /begin REF_CHARACTERISTIC CalRegn01Cmn.CurrMeasEolOffsMin.Val /end REF_CHARACTERISTIC /begin REF_MEASUREMENT /end REF_MEASUREMENT /end GROUP
/begin GROUP CalRegn01Cmn.CurrMeasEolOffsNrOfSample.Val "MICROSAR RTE" /begin SUB_GROUP /end SUB_GROUP /begin FUNCTION_LIST /end FUNCTION_LIST /begin REF_CHARACTERISTIC CalRegn01Cmn.CurrMeasEolOffsNrOfSample.Val /end REF_CHARACTERISTIC /begin REF_MEASUREMENT /end REF_MEASUREMENT /end GROUP
/begin GROUP CalRegn01Cmn.CurrMeasEolTranCntrThd.Val "MICROSAR RTE" /begin SUB_GROUP /end SUB_GROUP /begin FUNCTION_LIST /end FUNCTION_LIST /begin REF_CHARACTERISTIC CalRegn01Cmn.CurrMeasEolTranCntrThd.Val /end REF_CHARACTERISTIC /begin REF_MEASUREMENT /end REF_MEASUREMENT /end GROUP
/begin GROUP CalRegn01Cmn.CurrMeasMinRqrdPhaOnTi.Val "MICROSAR RTE" /begin SUB_GROUP /end SUB_GROUP /begin FUNCTION_LIST /end FUNCTION_LIST /begin REF_CHARACTERISTIC CalRegn01Cmn.CurrMeasMinRqrdPhaOnTi.Val /end REF_CHARACTERISTIC /begin REF_MEASUREMENT /end REF_MEASUREMENT /end GROUP
/begin GROUP CalRegn01Cmn.CurrMeasMotAgCompuDly.Val "MICROSAR RTE" /begin SUB_GROUP /end SUB_GROUP /begin FUNCTION_LIST /end FUNCTION_LIST /begin REF_CHARACTERISTIC CalRegn01Cmn.CurrMeasMotAgCompuDly.Val /end REF_CHARACTERISTIC /begin REF_MEASUREMENT /end REF_MEASUREMENT /end GROUP
/begin GROUP CalRegn01Cmn.CurrMeasMotCurrAdcVlyWrmIninMax.Val "MICROSAR RTE" /begin SUB_GROUP /end SUB_GROUP /begin FUNCTION_LIST /end FUNCTION_LIST /begin REF_CHARACTERISTIC CalRegn01Cmn.CurrMeasMotCurrAdcVlyWrmIninMax.Val /end REF_CHARACTERISTIC /begin REF_MEASUREMENT /end REF_MEASUREMENT /end GROUP
/begin GROUP CalRegn01Cmn.CurrMeasMotCurrAdcVlyWrmIninMin.Val "MICROSAR RTE" /begin SUB_GROUP /end SUB_GROUP /begin FUNCTION_LIST /end FUNCTION_LIST /begin REF_CHARACTERISTIC CalRegn01Cmn.CurrMeasMotCurrAdcVlyWrmIninMin.Val /end REF_CHARACTERISTIC /begin REF_MEASUREMENT /end REF_MEASUREMENT /end GROUP
/begin GROUP CalRegn01Cmn.CurrMeasNtc0x05DFailStep.Val "MICROSAR RTE" /begin SUB_GROUP /end SUB_GROUP /begin FUNCTION_LIST /end FUNCTION_LIST /begin REF_CHARACTERISTIC CalRegn01Cmn.CurrMeasNtc0x05DFailStep.Val /end REF_CHARACTERISTIC /begin REF_MEASUREMENT /end REF_MEASUREMENT /end GROUP
/begin GROUP CalRegn01Cmn.CurrMeasNtc0x05DPassStep.Val "MICROSAR RTE" /begin SUB_GROUP /end SUB_GROUP /begin FUNCTION_LIST /end FUNCTION_LIST /begin REF_CHARACTERISTIC CalRegn01Cmn.CurrMeasNtc0x05DPassStep.Val /end REF_CHARACTERISTIC /begin REF_MEASUREMENT /end REF_MEASUREMENT /end GROUP
/begin GROUP CalRegn01Cmn.CurrMeasNtc0x06DFailStep.Val "MICROSAR RTE" /begin SUB_GROUP /end SUB_GROUP /begin FUNCTION_LIST /end FUNCTION_LIST /begin REF_CHARACTERISTIC CalRegn01Cmn.CurrMeasNtc0x06DFailStep.Val /end REF_CHARACTERISTIC /begin REF_MEASUREMENT /end REF_MEASUREMENT /end GROUP
/begin GROUP CalRegn01Cmn.CurrMeasNtc0x06DPassStep.Val "MICROSAR RTE" /begin SUB_GROUP /end SUB_GROUP /begin FUNCTION_LIST /end FUNCTION_LIST /begin REF_CHARACTERISTIC CalRegn01Cmn.CurrMeasNtc0x06DPassStep.Val /end REF_CHARACTERISTIC /begin REF_MEASUREMENT /end REF_MEASUREMENT /end GROUP
/begin GROUP CalRegn01Cmn.CurrReasbnDiagcCurrDiagcMotEnvlpTblMax.Val "MICROSAR RTE" /begin SUB_GROUP /end SUB_GROUP /begin FUNCTION_LIST /end FUNCTION_LIST /begin REF_CHARACTERISTIC CalRegn01Cmn.CurrReasbnDiagcCurrDiagcMotEnvlpTblMax.Val /end REF_CHARACTERISTIC /begin REF_MEASUREMENT /end REF_MEASUREMENT /end GROUP
/begin GROUP CalRegn01Cmn.CurrReasbnDiagcCurrDiagcPrimErrThd.Val "MICROSAR RTE" /begin SUB_GROUP /end SUB_GROUP /begin FUNCTION_LIST /end FUNCTION_LIST /begin REF_CHARACTERISTIC CalRegn01Cmn.CurrReasbnDiagcCurrDiagcPrimErrThd.Val /end REF_CHARACTERISTIC /begin REF_MEASUREMENT /end REF_MEASUREMENT /end GROUP
/begin GROUP CalRegn01Cmn.CurrReasbnDiagcCurrDiagcSecdryErrThd.Val "MICROSAR RTE" /begin SUB_GROUP /end SUB_GROUP /begin FUNCTION_LIST /end FUNCTION_LIST /begin REF_CHARACTERISTIC CalRegn01Cmn.CurrReasbnDiagcCurrDiagcSecdryErrThd.Val /end REF_CHARACTERISTIC /begin REF_MEASUREMENT /end REF_MEASUREMENT /end GROUP
/begin GROUP CalRegn01Cmn.CurrReasbnDiagcCurrDiagcSecdryTqLimThd.Val "MICROSAR RTE" /begin SUB_GROUP /end SUB_GROUP /begin FUNCTION_LIST /end FUNCTION_LIST /begin REF_CHARACTERISTIC CalRegn01Cmn.CurrReasbnDiagcCurrDiagcSecdryTqLimThd.Val /end REF_CHARACTERISTIC /begin REF_MEASUREMENT /end REF_MEASUREMENT /end GROUP
/begin GROUP CalRegn01Cmn.CurrReasbnDiagcDiagFildLim.Val "MICROSAR RTE" /begin SUB_GROUP /end SUB_GROUP /begin FUNCTION_LIST /end FUNCTION_LIST /begin REF_CHARACTERISTIC CalRegn01Cmn.CurrReasbnDiagcDiagFildLim.Val /end REF_CHARACTERISTIC /begin REF_MEASUREMENT /end REF_MEASUREMENT /end GROUP
/begin GROUP CalRegn01Cmn.CurrReasbnDiagcDiagVltgLpFilEna.Logl "MICROSAR RTE" /begin SUB_GROUP /end SUB_GROUP /begin FUNCTION_LIST /end FUNCTION_LIST /begin REF_CHARACTERISTIC CalRegn01Cmn.CurrReasbnDiagcDiagVltgLpFilEna.Logl /end REF_CHARACTERISTIC /begin REF_MEASUREMENT /end REF_MEASUREMENT /end GROUP
/begin GROUP CalRegn01Cmn.CurrReasbnDiagcDiagVltgLpFilFrq.Val "MICROSAR RTE" /begin SUB_GROUP /end SUB_GROUP /begin FUNCTION_LIST /end FUNCTION_LIST /begin REF_CHARACTERISTIC CalRegn01Cmn.CurrReasbnDiagcDiagVltgLpFilFrq.Val /end REF_CHARACTERISTIC /begin REF_MEASUREMENT /end REF_MEASUREMENT /end GROUP
/begin GROUP CalRegn01Cmn.CurrReasbnDiagcLpFilSca.Val "MICROSAR RTE" /begin SUB_GROUP /end SUB_GROUP /begin FUNCTION_LIST /end FUNCTION_LIST /begin REF_CHARACTERISTIC CalRegn01Cmn.CurrReasbnDiagcLpFilSca.Val /end REF_CHARACTERISTIC /begin REF_MEASUREMENT /end REF_MEASUREMENT /end GROUP
/begin GROUP CalRegn01Cmn.CurrReasbnDiagcMotVelHiLim.Val "MICROSAR RTE" /begin SUB_GROUP /end SUB_GROUP /begin FUNCTION_LIST /end FUNCTION_LIST /begin REF_CHARACTERISTIC CalRegn01Cmn.CurrReasbnDiagcMotVelHiLim.Val /end REF_CHARACTERISTIC /begin REF_MEASUREMENT /end REF_MEASUREMENT /end GROUP
/begin GROUP CalRegn01Cmn.CurrReasbnDiagcMotVelLoLim.Val "MICROSAR RTE" /begin SUB_GROUP /end SUB_GROUP /begin FUNCTION_LIST /end FUNCTION_LIST /begin REF_CHARACTERISTIC CalRegn01Cmn.CurrReasbnDiagcMotVelLoLim.Val /end REF_CHARACTERISTIC /begin REF_MEASUREMENT /end REF_MEASUREMENT /end GROUP
/begin GROUP CalRegn01Cmn.CurrReasbnDiagcMotVltgDaxLpFilFrq.Val "MICROSAR RTE" /begin SUB_GROUP /end SUB_GROUP /begin FUNCTION_LIST /end FUNCTION_LIST /begin REF_CHARACTERISTIC CalRegn01Cmn.CurrReasbnDiagcMotVltgDaxLpFilFrq.Val /end REF_CHARACTERISTIC /begin REF_MEASUREMENT /end REF_MEASUREMENT /end GROUP
/begin GROUP CalRegn01Cmn.CurrReasbnDiagcMotVltgQaxDaxFilEna.Logl "MICROSAR RTE" /begin SUB_GROUP /end SUB_GROUP /begin FUNCTION_LIST /end FUNCTION_LIST /begin REF_CHARACTERISTIC CalRegn01Cmn.CurrReasbnDiagcMotVltgQaxDaxFilEna.Logl /end REF_CHARACTERISTIC /begin REF_MEASUREMENT /end REF_MEASUREMENT /end GROUP
/begin GROUP CalRegn01Cmn.CurrReasbnDiagcMotVltgQaxLpFilFrq.Val "MICROSAR RTE" /begin SUB_GROUP /end SUB_GROUP /begin FUNCTION_LIST /end FUNCTION_LIST /begin REF_CHARACTERISTIC CalRegn01Cmn.CurrReasbnDiagcMotVltgQaxLpFilFrq.Val /end REF_CHARACTERISTIC /begin REF_MEASUREMENT /end REF_MEASUREMENT /end GROUP
/begin GROUP CalRegn01Cmn.CurrReasbnDiagcVelLpFilEna.Logl "MICROSAR RTE" /begin SUB_GROUP /end SUB_GROUP /begin FUNCTION_LIST /end FUNCTION_LIST /begin REF_CHARACTERISTIC CalRegn01Cmn.CurrReasbnDiagcVelLpFilEna.Logl /end REF_CHARACTERISTIC /begin REF_MEASUREMENT /end REF_MEASUREMENT /end GROUP
/begin GROUP CalRegn01Cmn.CurrReasbnDiagcVelLpFilFrq.Val "MICROSAR RTE" /begin SUB_GROUP /end SUB_GROUP /begin FUNCTION_LIST /end FUNCTION_LIST /begin REF_CHARACTERISTIC CalRegn01Cmn.CurrReasbnDiagcVelLpFilFrq.Val /end REF_CHARACTERISTIC /begin REF_MEASUREMENT /end REF_MEASUREMENT /end GROUP
/begin GROUP CalRegn01Cmn.DampgPahFwlAssiAddlDampgX.Ary1D "MICROSAR RTE" /begin SUB_GROUP /end SUB_GROUP /begin FUNCTION_LIST /end FUNCTION_LIST /begin REF_CHARACTERISTIC CalRegn01Cmn.DampgPahFwlAssiAddlDampgX.Ary1D /end REF_CHARACTERISTIC /begin REF_MEASUREMENT /end REF_MEASUREMENT /end GROUP
/begin GROUP CalRegn01Cmn.DampgPahFwlAssiAddlDampgY.Ary1D "MICROSAR RTE" /begin SUB_GROUP /end SUB_GROUP /begin FUNCTION_LIST /end FUNCTION_LIST /begin REF_CHARACTERISTIC CalRegn01Cmn.DampgPahFwlAssiAddlDampgY.Ary1D /end REF_CHARACTERISTIC /begin REF_MEASUREMENT /end REF_MEASUREMENT /end GROUP
/begin GROUP CalRegn01Cmn.DampgPahFwlDampgCmdAddlDampgX.Ary1D "MICROSAR RTE" /begin SUB_GROUP /end SUB_GROUP /begin FUNCTION_LIST /end FUNCTION_LIST /begin REF_CHARACTERISTIC CalRegn01Cmn.DampgPahFwlDampgCmdAddlDampgX.Ary1D /end REF_CHARACTERISTIC /begin REF_MEASUREMENT /end REF_MEASUREMENT /end GROUP
/begin GROUP CalRegn01Cmn.DampgPahFwlDampgCmdAddlDampgY.Ary1D "MICROSAR RTE" /begin SUB_GROUP /end SUB_GROUP /begin FUNCTION_LIST /end FUNCTION_LIST /begin REF_CHARACTERISTIC CalRegn01Cmn.DampgPahFwlDampgCmdAddlDampgY.Ary1D /end REF_CHARACTERISTIC /begin REF_MEASUREMENT /end REF_MEASUREMENT /end GROUP
/begin GROUP CalRegn01Cmn.DampgPahFwlDampgCmdFwlOverLimDiagcFailStep.Val "MICROSAR RTE" /begin SUB_GROUP /end SUB_GROUP /begin FUNCTION_LIST /end FUNCTION_LIST
 /begin REF_CHARACTERISTIC CalRegn01Cmn.DampgPahFwlDampgCmdFwlOverLimDiagcFailStep.Val /end REF_CHARACTERISTIC
 /begin REF_MEASUREMENT /end REF_MEASUREMENT
/end GROUP
/begin GROUP CalRegn01Cmn.DampgPahFwlDampgCmdFwlOverLimDiagcPassStep.Val "MICROSAR RTE" /begin SUB_GROUP /end SUB_GROUP /begin FUNCTION_LIST /end FUNCTION_LIST
 /begin REF_CHARACTERISTIC CalRegn01Cmn.DampgPahFwlDampgCmdFwlOverLimDiagcPassStep.Val /end REF_CHARACTERISTIC
 /begin REF_MEASUREMENT /end REF_MEASUREMENT
/end GROUP
/begin GROUP CalRegn01Cmn.DampgPahFwlDftDampgX.Ary1D "MICROSAR RTE" /begin SUB_GROUP /end SUB_GROUP /begin FUNCTION_LIST /end FUNCTION_LIST /begin REF_CHARACTERISTIC CalRegn01Cmn.DampgPahFwlDftDampgX.Ary1D /end REF_CHARACTERISTIC /begin REF_MEASUREMENT /end REF_MEASUREMENT /end GROUP
/begin GROUP CalRegn01Cmn.DampgPahFwlInertiaCmpCmdFwlOverLimDiagcFailStep.Val "MICROSAR RTE" /begin SUB_GROUP /end SUB_GROUP /begin FUNCTION_LIST /end FUNCTION_LIST
 /begin REF_CHARACTERISTIC CalRegn01Cmn.DampgPahFwlInertiaCmpCmdFwlOverLimDiagcFailStep.Val /end REF_CHARACTERISTIC
 /begin REF_MEASUREMENT /end REF_MEASUREMENT
/end GROUP
/begin GROUP CalRegn01Cmn.DampgPahFwlInertiaCmpCmdFwlOverLimDiagcPassStep.Val "MICROSAR RTE" /begin SUB_GROUP /end SUB_GROUP /begin FUNCTION_LIST /end FUNCTION_LIST
 /begin REF_CHARACTERISTIC CalRegn01Cmn.DampgPahFwlInertiaCmpCmdFwlOverLimDiagcPassStep.Val /end REF_CHARACTERISTIC
 /begin REF_MEASUREMENT /end REF_MEASUREMENT
/end GROUP
/begin GROUP CalRegn01Cmn.DampgPahFwlVehSpd.Ary1D "MICROSAR RTE" /begin SUB_GROUP /end SUB_GROUP /begin FUNCTION_LIST /end FUNCTION_LIST /begin REF_CHARACTERISTIC CalRegn01Cmn.DampgPahFwlVehSpd.Ary1D /end REF_CHARACTERISTIC /begin REF_MEASUREMENT /end REF_MEASUREMENT /end GROUP
/begin GROUP CalRegn01Cmn.DutyCycThermProtnAbsltCtrlTTblX.Ary1D "MICROSAR RTE" /begin SUB_GROUP /end SUB_GROUP /begin FUNCTION_LIST /end FUNCTION_LIST /begin REF_CHARACTERISTIC CalRegn01Cmn.DutyCycThermProtnAbsltCtrlTTblX.Ary1D /end REF_CHARACTERISTIC /begin REF_MEASUREMENT /end REF_MEASUREMENT /end GROUP
/begin GROUP CalRegn01Cmn.DutyCycThermProtnAbsltCtrlTTqTblY.Ary1D "MICROSAR RTE" /begin SUB_GROUP /end SUB_GROUP /begin FUNCTION_LIST /end FUNCTION_LIST /begin REF_CHARACTERISTIC CalRegn01Cmn.DutyCycThermProtnAbsltCtrlTTqTblY.Ary1D /end REF_CHARACTERISTIC /begin REF_MEASUREMENT /end REF_MEASUREMENT /end GROUP
/begin GROUP CalRegn01Cmn.DutyCycThermProtnAbsltCuTTblX.Ary1D "MICROSAR RTE" /begin SUB_GROUP /end SUB_GROUP /begin FUNCTION_LIST /end FUNCTION_LIST /begin REF_CHARACTERISTIC CalRegn01Cmn.DutyCycThermProtnAbsltCuTTblX.Ary1D /end REF_CHARACTERISTIC /begin REF_MEASUREMENT /end REF_MEASUREMENT /end GROUP
/begin GROUP CalRegn01Cmn.DutyCycThermProtnAbsltCuTTqTblY.Ary1D "MICROSAR RTE" /begin SUB_GROUP /end SUB_GROUP /begin FUNCTION_LIST /end FUNCTION_LIST /begin REF_CHARACTERISTIC CalRegn01Cmn.DutyCycThermProtnAbsltCuTTqTblY.Ary1D /end REF_CHARACTERISTIC /begin REF_MEASUREMENT /end REF_MEASUREMENT /end GROUP
/begin GROUP CalRegn01Cmn.DutyCycThermProtnAbsltMotVelBreakPt.Val "MICROSAR RTE" /begin SUB_GROUP /end SUB_GROUP /begin FUNCTION_LIST /end FUNCTION_LIST /begin REF_CHARACTERISTIC CalRegn01Cmn.DutyCycThermProtnAbsltMotVelBreakPt.Val /end REF_CHARACTERISTIC /begin REF_MEASUREMENT /end REF_MEASUREMENT /end GROUP
/begin GROUP CalRegn01Cmn.DutyCycThermProtnAbsltTTqSlewHiLim.Val "MICROSAR RTE" /begin SUB_GROUP /end SUB_GROUP /begin FUNCTION_LIST /end FUNCTION_LIST /begin REF_CHARACTERISTIC CalRegn01Cmn.DutyCycThermProtnAbsltTTqSlewHiLim.Val /end REF_CHARACTERISTIC /begin REF_MEASUREMENT /end REF_MEASUREMENT /end GROUP
/begin GROUP CalRegn01Cmn.DutyCycThermProtnAbsltTTqSlewLoLim.Val "MICROSAR RTE" /begin SUB_GROUP /end SUB_GROUP /begin FUNCTION_LIST /end FUNCTION_LIST /begin REF_CHARACTERISTIC CalRegn01Cmn.DutyCycThermProtnAbsltTTqSlewLoLim.Val /end REF_CHARACTERISTIC /begin REF_MEASUREMENT /end REF_MEASUREMENT /end GROUP
/begin GROUP CalRegn01Cmn.DutyCycThermProtnCtrlT.Val "MICROSAR RTE" /begin SUB_GROUP /end SUB_GROUP /begin FUNCTION_LIST /end FUNCTION_LIST /begin REF_CHARACTERISTIC CalRegn01Cmn.DutyCycThermProtnCtrlT.Val /end REF_CHARACTERISTIC /begin REF_MEASUREMENT /end REF_MEASUREMENT /end GROUP
/begin GROUP CalRegn01Cmn.DutyCycThermProtnCtrlTSeln.Logl "MICROSAR RTE" /begin SUB_GROUP /end SUB_GROUP /begin FUNCTION_LIST /end FUNCTION_LIST /begin REF_CHARACTERISTIC CalRegn01Cmn.DutyCycThermProtnCtrlTSeln.Logl /end REF_CHARACTERISTIC /begin REF_MEASUREMENT /end REF_MEASUREMENT /end GROUP
/begin GROUP CalRegn01Cmn.DutyCycThermProtnDutyCycFildThd.Val "MICROSAR RTE" /begin SUB_GROUP /end SUB_GROUP /begin FUNCTION_LIST /end FUNCTION_LIST /begin REF_CHARACTERISTIC CalRegn01Cmn.DutyCycThermProtnDutyCycFildThd.Val /end REF_CHARACTERISTIC /begin REF_MEASUREMENT /end REF_MEASUREMENT /end GROUP
/begin GROUP CalRegn01Cmn.DutyCycThermProtnIgnOffCtrlEna.Logl "MICROSAR RTE" /begin SUB_GROUP /end SUB_GROUP /begin FUNCTION_LIST /end FUNCTION_LIST /begin REF_CHARACTERISTIC CalRegn01Cmn.DutyCycThermProtnIgnOffCtrlEna.Logl /end REF_CHARACTERISTIC /begin REF_MEASUREMENT /end REF_MEASUREMENT /end GROUP
/begin GROUP CalRegn01Cmn.DutyCycThermProtnIgnOffMsgWaitTi.Val "MICROSAR RTE" /begin SUB_GROUP /end SUB_GROUP /begin FUNCTION_LIST /end FUNCTION_LIST /begin REF_CHARACTERISTIC CalRegn01Cmn.DutyCycThermProtnIgnOffMsgWaitTi.Val /end REF_CHARACTERISTIC /begin REF_MEASUREMENT /end REF_MEASUREMENT /end GROUP
/begin GROUP CalRegn01Cmn.DutyCycThermProtnLstTblValNonStall.Ary1D "MICROSAR RTE" /begin SUB_GROUP /end SUB_GROUP /begin FUNCTION_LIST /end FUNCTION_LIST /begin REF_CHARACTERISTIC CalRegn01Cmn.DutyCycThermProtnLstTblValNonStall.Ary1D /end REF_CHARACTERISTIC /begin REF_MEASUREMENT /end REF_MEASUREMENT /end GROUP
/begin GROUP CalRegn01Cmn.DutyCycThermProtnLstTblValStall.Ary1D "MICROSAR RTE" /begin SUB_GROUP /end SUB_GROUP /begin FUNCTION_LIST /end FUNCTION_LIST /begin REF_CHARACTERISTIC CalRegn01Cmn.DutyCycThermProtnLstTblValStall.Ary1D /end REF_CHARACTERISTIC /begin REF_MEASUREMENT /end REF_MEASUREMENT /end GROUP
/begin GROUP CalRegn01Cmn.DutyCycThermProtnMotPrTSeln.Logl "MICROSAR RTE" /begin SUB_GROUP /end SUB_GROUP /begin FUNCTION_LIST /end FUNCTION_LIST /begin REF_CHARACTERISTIC CalRegn01Cmn.DutyCycThermProtnMotPrTSeln.Logl /end REF_CHARACTERISTIC /begin REF_MEASUREMENT /end REF_MEASUREMENT /end GROUP
/begin GROUP CalRegn01Cmn.DutyCycThermProtnMplr1NonStallTblY.Ary1D "MICROSAR RTE" /begin SUB_GROUP /end SUB_GROUP /begin FUNCTION_LIST /end FUNCTION_LIST /begin REF_CHARACTERISTIC CalRegn01Cmn.DutyCycThermProtnMplr1NonStallTblY.Ary1D /end REF_CHARACTERISTIC /begin REF_MEASUREMENT /end REF_MEASUREMENT /end GROUP
/begin GROUP CalRegn01Cmn.DutyCycThermProtnMplr1StallTblY.Ary1D "MICROSAR RTE" /begin SUB_GROUP /end SUB_GROUP /begin FUNCTION_LIST /end FUNCTION_LIST /begin REF_CHARACTERISTIC CalRegn01Cmn.DutyCycThermProtnMplr1StallTblY.Ary1D /end REF_CHARACTERISTIC /begin REF_MEASUREMENT /end REF_MEASUREMENT /end GROUP
/begin GROUP CalRegn01Cmn.DutyCycThermProtnMplr2NonStallTblY.Ary1D "MICROSAR RTE" /begin SUB_GROUP /end SUB_GROUP /begin FUNCTION_LIST /end FUNCTION_LIST /begin REF_CHARACTERISTIC CalRegn01Cmn.DutyCycThermProtnMplr2NonStallTblY.Ary1D /end REF_CHARACTERISTIC /begin REF_MEASUREMENT /end REF_MEASUREMENT /end GROUP
/begin GROUP CalRegn01Cmn.DutyCycThermProtnMplr2StallTblY.Ary1D "MICROSAR RTE" /begin SUB_GROUP /end SUB_GROUP /begin FUNCTION_LIST /end FUNCTION_LIST /begin REF_CHARACTERISTIC CalRegn01Cmn.DutyCycThermProtnMplr2StallTblY.Ary1D /end REF_CHARACTERISTIC /begin REF_MEASUREMENT /end REF_MEASUREMENT /end GROUP
/begin GROUP CalRegn01Cmn.DutyCycThermProtnMplr3NonStallTblY.Ary1D "MICROSAR RTE" /begin SUB_GROUP /end SUB_GROUP /begin FUNCTION_LIST /end FUNCTION_LIST /begin REF_CHARACTERISTIC CalRegn01Cmn.DutyCycThermProtnMplr3NonStallTblY.Ary1D /end REF_CHARACTERISTIC /begin REF_MEASUREMENT /end REF_MEASUREMENT /end GROUP
/begin GROUP CalRegn01Cmn.DutyCycThermProtnMplr3StallTblY.Ary1D "MICROSAR RTE" /begin SUB_GROUP /end SUB_GROUP /begin FUNCTION_LIST /end FUNCTION_LIST /begin REF_CHARACTERISTIC CalRegn01Cmn.DutyCycThermProtnMplr3StallTblY.Ary1D /end REF_CHARACTERISTIC /begin REF_MEASUREMENT /end REF_MEASUREMENT /end GROUP
/begin GROUP CalRegn01Cmn.DutyCycThermProtnMplr4NonStallTblY.Ary1D "MICROSAR RTE" /begin SUB_GROUP /end SUB_GROUP /begin FUNCTION_LIST /end FUNCTION_LIST /begin REF_CHARACTERISTIC CalRegn01Cmn.DutyCycThermProtnMplr4NonStallTblY.Ary1D /end REF_CHARACTERISTIC /begin REF_MEASUREMENT /end REF_MEASUREMENT /end GROUP
/begin GROUP CalRegn01Cmn.DutyCycThermProtnMplr4StallTblY.Ary1D "MICROSAR RTE" /begin SUB_GROUP /end SUB_GROUP /begin FUNCTION_LIST /end FUNCTION_LIST /begin REF_CHARACTERISTIC CalRegn01Cmn.DutyCycThermProtnMplr4StallTblY.Ary1D /end REF_CHARACTERISTIC /begin REF_MEASUREMENT /end REF_MEASUREMENT /end GROUP
/begin GROUP CalRegn01Cmn.DutyCycThermProtnMplr5NonStallTblY.Ary1D "MICROSAR RTE" /begin SUB_GROUP /end SUB_GROUP /begin FUNCTION_LIST /end FUNCTION_LIST /begin REF_CHARACTERISTIC CalRegn01Cmn.DutyCycThermProtnMplr5NonStallTblY.Ary1D /end REF_CHARACTERISTIC /begin REF_MEASUREMENT /end REF_MEASUREMENT /end GROUP
/begin GROUP CalRegn01Cmn.DutyCycThermProtnMplr5StallTblY.Ary1D "MICROSAR RTE" /begin SUB_GROUP /end SUB_GROUP /begin FUNCTION_LIST /end FUNCTION_LIST /begin REF_CHARACTERISTIC CalRegn01Cmn.DutyCycThermProtnMplr5StallTblY.Ary1D /end REF_CHARACTERISTIC /begin REF_MEASUREMENT /end REF_MEASUREMENT /end GROUP
/begin GROUP CalRegn01Cmn.DutyCycThermProtnMplr6NonStallTblY.Ary1D "MICROSAR RTE" /begin SUB_GROUP /end SUB_GROUP /begin FUNCTION_LIST /end FUNCTION_LIST /begin REF_CHARACTERISTIC CalRegn01Cmn.DutyCycThermProtnMplr6NonStallTblY.Ary1D /end REF_CHARACTERISTIC /begin REF_MEASUREMENT /end REF_MEASUREMENT /end GROUP
/begin GROUP CalRegn01Cmn.DutyCycThermProtnMplr6StallTblY.Ary1D "MICROSAR RTE" /begin SUB_GROUP /end SUB_GROUP /begin FUNCTION_LIST /end FUNCTION_LIST /begin REF_CHARACTERISTIC CalRegn01Cmn.DutyCycThermProtnMplr6StallTblY.Ary1D /end REF_CHARACTERISTIC /begin REF_MEASUREMENT /end REF_MEASUREMENT /end GROUP
/begin GROUP CalRegn01Cmn.DutyCycThermProtnMplrTSeln.Logl "MICROSAR RTE" /begin SUB_GROUP /end SUB_GROUP /begin FUNCTION_LIST /end FUNCTION_LIST /begin REF_CHARACTERISTIC CalRegn01Cmn.DutyCycThermProtnMplrTSeln.Logl /end REF_CHARACTERISTIC /begin REF_MEASUREMENT /end REF_MEASUREMENT /end GROUP
/begin GROUP CalRegn01Cmn.DutyCycThermProtnMplrTblX.Ary1D "MICROSAR RTE" /begin SUB_GROUP /end SUB_GROUP /begin FUNCTION_LIST /end FUNCTION_LIST /begin REF_CHARACTERISTIC CalRegn01Cmn.DutyCycThermProtnMplrTblX.Ary1D /end REF_CHARACTERISTIC /begin REF_MEASUREMENT /end REF_MEASUREMENT /end GROUP
/begin GROUP CalRegn01Cmn.DutyCycThermProtnSlowFilTSeln.Logl "MICROSAR RTE" /begin SUB_GROUP /end SUB_GROUP /begin FUNCTION_LIST /end FUNCTION_LIST /begin REF_CHARACTERISTIC CalRegn01Cmn.DutyCycThermProtnSlowFilTSeln.Logl /end REF_CHARACTERISTIC /begin REF_MEASUREMENT /end REF_MEASUREMENT /end GROUP
/begin GROUP CalRegn01Cmn.DutyCycThermProtnThermLimScaFac.Val "MICROSAR RTE" /begin SUB_GROUP /end SUB_GROUP /begin FUNCTION_LIST /end FUNCTION_LIST /begin REF_CHARACTERISTIC CalRegn01Cmn.DutyCycThermProtnThermLimScaFac.Val /end REF_CHARACTERISTIC /begin REF_MEASUREMENT /end REF_MEASUREMENT /end GROUP
/begin GROUP CalRegn01Cmn.DutyCycThermProtnThermLoadLimTblX.Ary1D "MICROSAR RTE" /begin SUB_GROUP /end SUB_GROUP /begin FUNCTION_LIST /end FUNCTION_LIST /begin REF_CHARACTERISTIC CalRegn01Cmn.DutyCycThermProtnThermLoadLimTblX.Ary1D /end REF_CHARACTERISTIC /begin REF_MEASUREMENT /end REF_MEASUREMENT /end GROUP
/begin GROUP CalRegn01Cmn.DutyCycThermProtnThermLoadLimTblY.Ary1D "MICROSAR RTE" /begin SUB_GROUP /end SUB_GROUP /begin FUNCTION_LIST /end FUNCTION_LIST /begin REF_CHARACTERISTIC CalRegn01Cmn.DutyCycThermProtnThermLoadLimTblY.Ary1D /end REF_CHARACTERISTIC /begin REF_MEASUREMENT /end REF_MEASUREMENT /end GROUP
/begin GROUP CalRegn01Cmn.DutyCycThermProtnTqCmdSlewDwn.Val "MICROSAR RTE" /begin SUB_GROUP /end SUB_GROUP /begin FUNCTION_LIST /end FUNCTION_LIST /begin REF_CHARACTERISTIC CalRegn01Cmn.DutyCycThermProtnTqCmdSlewDwn.Val /end REF_CHARACTERISTIC /begin REF_MEASUREMENT /end REF_MEASUREMENT /end GROUP
/begin GROUP CalRegn01Cmn.DutyCycThermProtnTqCmdSlewUp.Val "MICROSAR RTE" /begin SUB_GROUP /end SUB_GROUP /begin FUNCTION_LIST /end FUNCTION_LIST /begin REF_CHARACTERISTIC CalRegn01Cmn.DutyCycThermProtnTqCmdSlewUp.Val /end REF_CHARACTERISTIC /begin REF_MEASUREMENT /end REF_MEASUREMENT /end GROUP
/begin GROUP CalRegn01Cmn.EcuTMeasDftT.Val "MICROSAR RTE" /begin SUB_GROUP /end SUB_GROUP /begin FUNCTION_LIST /end FUNCTION_LIST /begin REF_CHARACTERISTIC CalRegn01Cmn.EcuTMeasDftT.Val /end REF_CHARACTERISTIC /begin REF_MEASUREMENT /end REF_MEASUREMENT /end GROUP
/begin GROUP CalRegn01Cmn.EcuTMeasFilTau.Val "MICROSAR RTE" /begin SUB_GROUP /end SUB_GROUP /begin FUNCTION_LIST /end FUNCTION_LIST /begin REF_CHARACTERISTIC CalRegn01Cmn.EcuTMeasFilTau.Val /end REF_CHARACTERISTIC /begin REF_MEASUREMENT /end REF_MEASUREMENT /end GROUP
/begin GROUP CalRegn01Cmn.EcuTMeasNtc0x045FailStep.Val "MICROSAR RTE" /begin SUB_GROUP /end SUB_GROUP /begin FUNCTION_LIST /end FUNCTION_LIST /begin REF_CHARACTERISTIC CalRegn01Cmn.EcuTMeasNtc0x045FailStep.Val /end REF_CHARACTERISTIC /begin REF_MEASUREMENT /end REF_MEASUREMENT /end GROUP
/begin GROUP CalRegn01Cmn.EcuTMeasNtc0x045PassStep.Val "MICROSAR RTE" /begin SUB_GROUP /end SUB_GROUP /begin FUNCTION_LIST /end FUNCTION_LIST /begin REF_CHARACTERISTIC CalRegn01Cmn.EcuTMeasNtc0x045PassStep.Val /end REF_CHARACTERISTIC /begin REF_MEASUREMENT /end REF_MEASUREMENT /end GROUP
/begin GROUP CalRegn01Cmn.EcuTMeasRngDiagcMax.Val "MICROSAR RTE" /begin SUB_GROUP /end SUB_GROUP /begin FUNCTION_LIST /end FUNCTION_LIST /begin REF_CHARACTERISTIC CalRegn01Cmn.EcuTMeasRngDiagcMax.Val /end REF_CHARACTERISTIC /begin REF_MEASUREMENT /end REF_MEASUREMENT /end GROUP
/begin GROUP CalRegn01Cmn.EcuTMeasRngDiagcMin.Val "MICROSAR RTE" /begin SUB_GROUP /end SUB_GROUP /begin FUNCTION_LIST /end FUNCTION_LIST /begin REF_CHARACTERISTIC CalRegn01Cmn.EcuTMeasRngDiagcMin.Val /end REF_CHARACTERISTIC /begin REF_MEASUREMENT /end REF_MEASUREMENT /end GROUP
/begin GROUP CalRegn01Cmn.EcuTMeasScag.Val "MICROSAR RTE" /begin SUB_GROUP /end SUB_GROUP /begin FUNCTION_LIST /end FUNCTION_LIST /begin REF_CHARACTERISTIC CalRegn01Cmn.EcuTMeasScag.Val /end REF_CHARACTERISTIC /begin REF_MEASUREMENT /end REF_MEASUREMENT /end GROUP
/begin GROUP CalRegn01Cmn.EcuTMeasScagOffs.Val "MICROSAR RTE" /begin SUB_GROUP /end SUB_GROUP /begin FUNCTION_LIST /end FUNCTION_LIST /begin REF_CHARACTERISTIC CalRegn01Cmn.EcuTMeasScagOffs.Val /end REF_CHARACTERISTIC /begin REF_MEASUREMENT /end REF_MEASUREMENT /end GROUP
/begin GROUP CalRegn01Cmn.ElecPwrCnsCtrlrInpR.Val "MICROSAR RTE" /begin SUB_GROUP /end SUB_GROUP /begin FUNCTION_LIST /end FUNCTION_LIST /begin REF_CHARACTERISTIC CalRegn01Cmn.ElecPwrCnsCtrlrInpR.Val /end REF_CHARACTERISTIC /begin REF_MEASUREMENT /end REF_MEASUREMENT /end GROUP
/begin GROUP CalRegn01Cmn.EotLrngHwAgOverTrvlCnt.Val "MICROSAR RTE" /begin SUB_GROUP /end SUB_GROUP /begin FUNCTION_LIST /end FUNCTION_LIST /begin REF_CHARACTERISTIC CalRegn01Cmn.EotLrngHwAgOverTrvlCnt.Val /end REF_CHARACTERISTIC /begin REF_MEASUREMENT /end REF_MEASUREMENT /end GROUP
/begin GROUP CalRegn01Cmn.EotProtnFwlEotDampgActvBndX.Ary1D "MICROSAR RTE" /begin SUB_GROUP /end SUB_GROUP /begin FUNCTION_LIST /end FUNCTION_LIST /begin REF_CHARACTERISTIC CalRegn01Cmn.EotProtnFwlEotDampgActvBndX.Ary1D /end REF_CHARACTERISTIC /begin REF_MEASUREMENT /end REF_MEASUREMENT /end GROUP
/begin GROUP CalRegn01Cmn.EotProtnFwlInactvLim.Val "MICROSAR RTE" /begin SUB_GROUP /end SUB_GROUP /begin FUNCTION_LIST /end FUNCTION_LIST /begin REF_CHARACTERISTIC CalRegn01Cmn.EotProtnFwlInactvLim.Val /end REF_CHARACTERISTIC /begin REF_MEASUREMENT /end REF_MEASUREMENT /end GROUP
/begin GROUP CalRegn01Cmn.EotProtnFwlVehSpd.Ary1D "MICROSAR RTE" /begin SUB_GROUP /end SUB_GROUP /begin FUNCTION_LIST /end FUNCTION_LIST /begin REF_CHARACTERISTIC CalRegn01Cmn.EotProtnFwlVehSpd.Ary1D /end REF_CHARACTERISTIC /begin REF_MEASUREMENT /end REF_MEASUREMENT /end GROUP
/begin GROUP CalRegn01Cmn.GateDrv0CtrlNtcNr0x050FailStep.Val "MICROSAR RTE" /begin SUB_GROUP /end SUB_GROUP /begin FUNCTION_LIST /end FUNCTION_LIST /begin REF_CHARACTERISTIC CalRegn01Cmn.GateDrv0CtrlNtcNr0x050FailStep.Val /end REF_CHARACTERISTIC /begin REF_MEASUREMENT /end REF_MEASUREMENT /end GROUP
/begin GROUP CalRegn01Cmn.GateDrv0CtrlNtcNr0x050PassStep.Val "MICROSAR RTE" /begin SUB_GROUP /end SUB_GROUP /begin FUNCTION_LIST /end FUNCTION_LIST /begin REF_CHARACTERISTIC CalRegn01Cmn.GateDrv0CtrlNtcNr0x050PassStep.Val /end REF_CHARACTERISTIC /begin REF_MEASUREMENT /end REF_MEASUREMENT /end GROUP
/begin GROUP CalRegn01Cmn.GateDrv0CtrlNtcNr0x051FailStep.Val "MICROSAR RTE" /begin SUB_GROUP /end SUB_GROUP /begin FUNCTION_LIST /end FUNCTION_LIST /begin REF_CHARACTERISTIC CalRegn01Cmn.GateDrv0CtrlNtcNr0x051FailStep.Val /end REF_CHARACTERISTIC /begin REF_MEASUREMENT /end REF_MEASUREMENT /end GROUP
/begin GROUP CalRegn01Cmn.GateDrv0CtrlNtcNr0x051PassStep.Val "MICROSAR RTE" /begin SUB_GROUP /end SUB_GROUP /begin FUNCTION_LIST /end FUNCTION_LIST /begin REF_CHARACTERISTIC CalRegn01Cmn.GateDrv0CtrlNtcNr0x051PassStep.Val /end REF_CHARACTERISTIC /begin REF_MEASUREMENT /end REF_MEASUREMENT /end GROUP
/begin GROUP CalRegn01Cmn.GateDrv0CtrlNtcNr0x055FailStep.Val "MICROSAR RTE" /begin SUB_GROUP /end SUB_GROUP /begin FUNCTION_LIST /end FUNCTION_LIST /begin REF_CHARACTERISTIC CalRegn01Cmn.GateDrv0CtrlNtcNr0x055FailStep.Val /end REF_CHARACTERISTIC /begin REF_MEASUREMENT /end REF_MEASUREMENT /end GROUP
/begin GROUP CalRegn01Cmn.GateDrv0CtrlNtcNr0x055PassStep.Val "MICROSAR RTE" /begin SUB_GROUP /end SUB_GROUP /begin FUNCTION_LIST /end FUNCTION_LIST /begin REF_CHARACTERISTIC CalRegn01Cmn.GateDrv0CtrlNtcNr0x055PassStep.Val /end REF_CHARACTERISTIC /begin REF_MEASUREMENT /end REF_MEASUREMENT /end GROUP
/begin GROUP CalRegn01Cmn.GateDrv0CtrlUnit0Cfg2WrVal.Val "MICROSAR RTE" /begin SUB_GROUP /end SUB_GROUP /begin FUNCTION_LIST /end FUNCTION_LIST /begin REF_CHARACTERISTIC CalRegn01Cmn.GateDrv0CtrlUnit0Cfg2WrVal.Val /end REF_CHARACTERISTIC /begin REF_MEASUREMENT /end REF_MEASUREMENT /end GROUP
/begin GROUP CalRegn01Cmn.GateDrv0CtrlUnit0Cfg3WrVal.Val "MICROSAR RTE" /begin SUB_GROUP /end SUB_GROUP /begin FUNCTION_LIST /end FUNCTION_LIST /begin REF_CHARACTERISTIC CalRegn01Cmn.GateDrv0CtrlUnit0Cfg3WrVal.Val /end REF_CHARACTERISTIC /begin REF_MEASUREMENT /end REF_MEASUREMENT /end GROUP
/begin GROUP CalRegn01Cmn.GateDrv0CtrlUnit0Cfg4WrVal.Val "MICROSAR RTE" /begin SUB_GROUP /end SUB_GROUP /begin FUNCTION_LIST /end FUNCTION_LIST /begin REF_CHARACTERISTIC CalRegn01Cmn.GateDrv0CtrlUnit0Cfg4WrVal.Val /end REF_CHARACTERISTIC /begin REF_MEASUREMENT /end REF_MEASUREMENT /end GROUP
/begin GROUP CalRegn01Cmn.GateDrv0CtrlUnit0Cfg7WrVal.Val "MICROSAR RTE" /begin SUB_GROUP /end SUB_GROUP /begin FUNCTION_LIST /end FUNCTION_LIST /begin REF_CHARACTERISTIC CalRegn01Cmn.GateDrv0CtrlUnit0Cfg7WrVal.Val /end REF_CHARACTERISTIC /begin REF_MEASUREMENT /end REF_MEASUREMENT /end GROUP
/begin GROUP CalRegn01Cmn.GmFctDiArbnEotHwAgThd.Val "MICROSAR RTE" /begin SUB_GROUP /end SUB_GROUP /begin FUNCTION_LIST /end FUNCTION_LIST /begin REF_CHARACTERISTIC CalRegn01Cmn.GmFctDiArbnEotHwAgThd.Val /end REF_CHARACTERISTIC /begin REF_MEASUREMENT /end REF_MEASUREMENT /end GROUP
/begin GROUP CalRegn01Cmn.GmFctDiArbnEotTi.Val "MICROSAR RTE" /begin SUB_GROUP /end SUB_GROUP /begin FUNCTION_LIST /end FUNCTION_LIST /begin REF_CHARACTERISTIC CalRegn01Cmn.GmFctDiArbnEotTi.Val /end REF_CHARACTERISTIC /begin REF_MEASUREMENT /end REF_MEASUREMENT /end GROUP
/begin GROUP CalRegn01Cmn.GmFctDiArbnOnCentrHwAgThd.Val "MICROSAR RTE" /begin SUB_GROUP /end SUB_GROUP /begin FUNCTION_LIST /end FUNCTION_LIST /begin REF_CHARACTERISTIC CalRegn01Cmn.GmFctDiArbnOnCentrHwAgThd.Val /end REF_CHARACTERISTIC /begin REF_MEASUREMENT /end REF_MEASUREMENT /end GROUP
/begin GROUP CalRegn01Cmn.GmFctDiArbnOnCentrHwTqThd.Val "MICROSAR RTE" /begin SUB_GROUP /end SUB_GROUP /begin FUNCTION_LIST /end FUNCTION_LIST /begin REF_CHARACTERISTIC CalRegn01Cmn.GmFctDiArbnOnCentrHwTqThd.Val /end REF_CHARACTERISTIC /begin REF_MEASUREMENT /end REF_MEASUREMENT /end GROUP
/begin GROUP CalRegn01Cmn.GmFctDiArbnOnCentrTi.Val "MICROSAR RTE" /begin SUB_GROUP /end SUB_GROUP /begin FUNCTION_LIST /end FUNCTION_LIST /begin REF_CHARACTERISTIC CalRegn01Cmn.GmFctDiArbnOnCentrTi.Val /end REF_CHARACTERISTIC /begin REF_MEASUREMENT /end REF_MEASUREMENT /end GROUP
/begin GROUP CalRegn01Cmn.GmFctDiArbnSrvTi.Val "MICROSAR RTE" /begin SUB_GROUP /end SUB_GROUP /begin FUNCTION_LIST /end FUNCTION_LIST /begin REF_CHARACTERISTIC CalRegn01Cmn.GmFctDiArbnSrvTi.Val /end REF_CHARACTERISTIC /begin REF_MEASUREMENT /end REF_MEASUREMENT /end GROUP
/begin GROUP CalRegn01Cmn.GmMsg0C5BusHiSpdInvldTiOut.Val "MICROSAR RTE" /begin SUB_GROUP /end SUB_GROUP /begin FUNCTION_LIST /end FUNCTION_LIST /begin REF_CHARACTERISTIC CalRegn01Cmn.GmMsg0C5BusHiSpdInvldTiOut.Val /end REF_CHARACTERISTIC /begin REF_MEASUREMENT /end REF_MEASUREMENT /end GROUP
/begin GROUP CalRegn01Cmn.GmMsg0C5BusHiSpdMissTiOut.Val "MICROSAR RTE" /begin SUB_GROUP /end SUB_GROUP /begin FUNCTION_LIST /end FUNCTION_LIST /begin REF_CHARACTERISTIC CalRegn01Cmn.GmMsg0C5BusHiSpdMissTiOut.Val /end REF_CHARACTERISTIC /begin REF_MEASUREMENT /end REF_MEASUREMENT /end GROUP
/begin GROUP CalRegn01Cmn.GmMsg0C5BusHiSpdRstTiOut.Val "MICROSAR RTE" /begin SUB_GROUP /end SUB_GROUP /begin FUNCTION_LIST /end FUNCTION_LIST /begin REF_CHARACTERISTIC CalRegn01Cmn.GmMsg0C5BusHiSpdRstTiOut.Val /end REF_CHARACTERISTIC /begin REF_MEASUREMENT /end REF_MEASUREMENT /end GROUP
/begin GROUP CalRegn01Cmn.GmMsg0C5BusHiSpdSeqNrTiOut.Val "MICROSAR RTE" /begin SUB_GROUP /end SUB_GROUP /begin FUNCTION_LIST /end FUNCTION_LIST /begin REF_CHARACTERISTIC CalRegn01Cmn.GmMsg0C5BusHiSpdSeqNrTiOut.Val /end REF_CHARACTERISTIC /begin REF_MEASUREMENT /end REF_MEASUREMENT /end GROUP
/begin GROUP CalRegn01Cmn.GmMsg0C9BusHiSpdInvldTiOut.Val "MICROSAR RTE" /begin SUB_GROUP /end SUB_GROUP /begin FUNCTION_LIST /end FUNCTION_LIST /begin REF_CHARACTERISTIC CalRegn01Cmn.GmMsg0C9BusHiSpdInvldTiOut.Val /end REF_CHARACTERISTIC /begin REF_MEASUREMENT /end REF_MEASUREMENT /end GROUP
/begin GROUP CalRegn01Cmn.GmMsg0C9BusHiSpdMissTiOut.Val "MICROSAR RTE" /begin SUB_GROUP /end SUB_GROUP /begin FUNCTION_LIST /end FUNCTION_LIST /begin REF_CHARACTERISTIC CalRegn01Cmn.GmMsg0C9BusHiSpdMissTiOut.Val /end REF_CHARACTERISTIC /begin REF_MEASUREMENT /end REF_MEASUREMENT /end GROUP
/begin GROUP CalRegn01Cmn.GmMsg0C9BusHiSpdVehSpdThd.Val "MICROSAR RTE" /begin SUB_GROUP /end SUB_GROUP /begin FUNCTION_LIST /end FUNCTION_LIST /begin REF_CHARACTERISTIC CalRegn01Cmn.GmMsg0C9BusHiSpdVehSpdThd.Val /end REF_CHARACTERISTIC /begin REF_MEASUREMENT /end REF_MEASUREMENT /end GROUP
/begin GROUP CalRegn01Cmn.GmMsg17DBusHiSpdInvldTiOut.Val "MICROSAR RTE" /begin SUB_GROUP /end SUB_GROUP /begin FUNCTION_LIST /end FUNCTION_LIST /begin REF_CHARACTERISTIC CalRegn01Cmn.GmMsg17DBusHiSpdInvldTiOut.Val /end REF_CHARACTERISTIC /begin REF_MEASUREMENT /end REF_MEASUREMENT /end GROUP
/begin GROUP CalRegn01Cmn.GmMsg17DBusHiSpdMissTiOut.Val "MICROSAR RTE" /begin SUB_GROUP /end SUB_GROUP /begin FUNCTION_LIST /end FUNCTION_LIST /begin REF_CHARACTERISTIC CalRegn01Cmn.GmMsg17DBusHiSpdMissTiOut.Val /end REF_CHARACTERISTIC /begin REF_MEASUREMENT /end REF_MEASUREMENT /end GROUP
/begin GROUP CalRegn01Cmn.GmMsg180BusChassisExpInvldProtnValTiOut.Val "MICROSAR RTE" /begin SUB_GROUP /end SUB_GROUP /begin FUNCTION_LIST /end FUNCTION_LIST /begin REF_CHARACTERISTIC CalRegn01Cmn.GmMsg180BusChassisExpInvldProtnValTiOut.Val /end REF_CHARACTERISTIC /begin REF_MEASUREMENT /end REF_MEASUREMENT /end GROUP
/begin GROUP CalRegn01Cmn.GmMsg180BusChassisExpMissTiOut.Val "MICROSAR RTE" /begin SUB_GROUP /end SUB_GROUP /begin FUNCTION_LIST /end FUNCTION_LIST /begin REF_CHARACTERISTIC CalRegn01Cmn.GmMsg180BusChassisExpMissTiOut.Val /end REF_CHARACTERISTIC /begin REF_MEASUREMENT /end REF_MEASUREMENT /end GROUP
/begin GROUP CalRegn01Cmn.GmMsg180BusChassisExpRollgCntrInvldTiOut.Val "MICROSAR RTE" /begin SUB_GROUP /end SUB_GROUP /begin FUNCTION_LIST /end FUNCTION_LIST /begin REF_CHARACTERISTIC CalRegn01Cmn.GmMsg180BusChassisExpRollgCntrInvldTiOut.Val /end REF_CHARACTERISTIC /begin REF_MEASUREMENT /end REF_MEASUREMENT /end GROUP
/begin GROUP CalRegn01Cmn.GmMsg180BusChassisExpTqPolarity.Val "MICROSAR RTE" /begin SUB_GROUP /end SUB_GROUP /begin FUNCTION_LIST /end FUNCTION_LIST /begin REF_CHARACTERISTIC CalRegn01Cmn.GmMsg180BusChassisExpTqPolarity.Val /end REF_CHARACTERISTIC /begin REF_MEASUREMENT /end REF_MEASUREMENT /end GROUP
/begin GROUP CalRegn01Cmn.GmMsg180BusHiSpdCrcInvldTiOut.Val "MICROSAR RTE" /begin SUB_GROUP /end SUB_GROUP /begin FUNCTION_LIST /end FUNCTION_LIST /begin REF_CHARACTERISTIC CalRegn01Cmn.GmMsg180BusHiSpdCrcInvldTiOut.Val /end REF_CHARACTERISTIC /begin REF_MEASUREMENT /end REF_MEASUREMENT /end GROUP
/begin GROUP CalRegn01Cmn.GmMsg180BusHiSpdMissTiOut.Val "MICROSAR RTE" /begin SUB_GROUP /end SUB_GROUP /begin FUNCTION_LIST /end FUNCTION_LIST /begin REF_CHARACTERISTIC CalRegn01Cmn.GmMsg180BusHiSpdMissTiOut.Val /end REF_CHARACTERISTIC /begin REF_MEASUREMENT /end REF_MEASUREMENT /end GROUP
/begin GROUP CalRegn01Cmn.GmMsg180BusHiSpdRollgCntrInvldTiOut.Val "MICROSAR RTE" /begin SUB_GROUP /end SUB_GROUP /begin FUNCTION_LIST /end FUNCTION_LIST /begin REF_CHARACTERISTIC CalRegn01Cmn.GmMsg180BusHiSpdRollgCntrInvldTiOut.Val /end REF_CHARACTERISTIC /begin REF_MEASUREMENT /end REF_MEASUREMENT /end GROUP
/begin GROUP CalRegn01Cmn.GmMsg180BusHiSpdTqPolarity.Val "MICROSAR RTE" /begin SUB_GROUP /end SUB_GROUP /begin FUNCTION_LIST /end FUNCTION_LIST /begin REF_CHARACTERISTIC CalRegn01Cmn.GmMsg180BusHiSpdTqPolarity.Val /end REF_CHARACTERISTIC /begin REF_MEASUREMENT /end REF_MEASUREMENT /end GROUP
/begin GROUP CalRegn01Cmn.GmMsg182BusChassisExpInvldTiOut.Val "MICROSAR RTE" /begin SUB_GROUP /end SUB_GROUP /begin FUNCTION_LIST /end FUNCTION_LIST /begin REF_CHARACTERISTIC CalRegn01Cmn.GmMsg182BusChassisExpInvldTiOut.Val /end REF_CHARACTERISTIC /begin REF_MEASUREMENT /end REF_MEASUREMENT /end GROUP
/begin GROUP CalRegn01Cmn.GmMsg182BusChassisExpMissTiOut.Val "MICROSAR RTE" /begin SUB_GROUP /end SUB_GROUP /begin FUNCTION_LIST /end FUNCTION_LIST /begin REF_CHARACTERISTIC CalRegn01Cmn.GmMsg182BusChassisExpMissTiOut.Val /end REF_CHARACTERISTIC /begin REF_MEASUREMENT /end REF_MEASUREMENT /end GROUP
/begin GROUP CalRegn01Cmn.GmMsg184BusHiSpdHandsOnThd.Val "MICROSAR RTE" /begin SUB_GROUP /end SUB_GROUP /begin FUNCTION_LIST /end FUNCTION_LIST /begin REF_CHARACTERISTIC CalRegn01Cmn.GmMsg184BusHiSpdHandsOnThd.Val /end REF_CHARACTERISTIC /begin REF_MEASUREMENT /end REF_MEASUREMENT /end GROUP
/begin GROUP CalRegn01Cmn.GmMsg184BusHiSpdTqPolarity.Val "MICROSAR RTE" /begin SUB_GROUP /end SUB_GROUP /begin FUNCTION_LIST /end FUNCTION_LIST /begin REF_CHARACTERISTIC CalRegn01Cmn.GmMsg184BusHiSpdTqPolarity.Val /end REF_CHARACTERISTIC /begin REF_MEASUREMENT /end REF_MEASUREMENT /end GROUP
/begin GROUP CalRegn01Cmn.GmMsg1CaBusChassisExpTqPolarity.Val "MICROSAR RTE" /begin SUB_GROUP /end SUB_GROUP /begin FUNCTION_LIST /end FUNCTION_LIST /begin REF_CHARACTERISTIC CalRegn01Cmn.GmMsg1CaBusChassisExpTqPolarity.Val /end REF_CHARACTERISTIC /begin REF_MEASUREMENT /end REF_MEASUREMENT /end GROUP
/begin GROUP CalRegn01Cmn.GmMsg1E9BusHiSpdAbsFaildTiOut.Val "MICROSAR RTE" /begin SUB_GROUP /end SUB_GROUP /begin FUNCTION_LIST /end FUNCTION_LIST /begin REF_CHARACTERISTIC CalRegn01Cmn.GmMsg1E9BusHiSpdAbsFaildTiOut.Val /end REF_CHARACTERISTIC /begin REF_MEASUREMENT /end REF_MEASUREMENT /end GROUP
/begin GROUP CalRegn01Cmn.GmMsg1E9BusHiSpdLatADft.Val "MICROSAR RTE" /begin SUB_GROUP /end SUB_GROUP /begin FUNCTION_LIST /end FUNCTION_LIST /begin REF_CHARACTERISTIC CalRegn01Cmn.GmMsg1E9BusHiSpdLatADft.Val /end REF_CHARACTERISTIC /begin REF_MEASUREMENT /end REF_MEASUREMENT /end GROUP
/begin GROUP CalRegn01Cmn.GmMsg1E9BusHiSpdLatAInvldTiOut.Val "MICROSAR RTE" /begin SUB_GROUP /end SUB_GROUP /begin FUNCTION_LIST /end FUNCTION_LIST /begin REF_CHARACTERISTIC CalRegn01Cmn.GmMsg1E9BusHiSpdLatAInvldTiOut.Val /end REF_CHARACTERISTIC /begin REF_MEASUREMENT /end REF_MEASUREMENT /end GROUP
/begin GROUP CalRegn01Cmn.GmMsg1E9BusHiSpdMissTiOut.Val "MICROSAR RTE" /begin SUB_GROUP /end SUB_GROUP /begin FUNCTION_LIST /end FUNCTION_LIST /begin REF_CHARACTERISTIC CalRegn01Cmn.GmMsg1E9BusHiSpdMissTiOut.Val /end REF_CHARACTERISTIC /begin REF_MEASUREMENT /end REF_MEASUREMENT /end GROUP
/begin GROUP CalRegn01Cmn.GmMsg1E9BusHiSpdTcsDisadTiOut.Val "MICROSAR RTE" /begin SUB_GROUP /end SUB_GROUP /begin FUNCTION_LIST /end FUNCTION_LIST /begin REF_CHARACTERISTIC CalRegn01Cmn.GmMsg1E9BusHiSpdTcsDisadTiOut.Val /end REF_CHARACTERISTIC /begin REF_MEASUREMENT /end REF_MEASUREMENT /end GROUP
/begin GROUP CalRegn01Cmn.GmMsg1E9BusHiSpdVehDynCtrlStTiOut.Val "MICROSAR RTE" /begin SUB_GROUP /end SUB_GROUP /begin FUNCTION_LIST /end FUNCTION_LIST /begin REF_CHARACTERISTIC CalRegn01Cmn.GmMsg1E9BusHiSpdVehDynCtrlStTiOut.Val /end REF_CHARACTERISTIC /begin REF_MEASUREMENT /end REF_MEASUREMENT /end GROUP
/begin GROUP CalRegn01Cmn.GmMsg1E9BusHiSpdVehStabyEnhmtActvVldTiOut.Val "MICROSAR RTE" /begin SUB_GROUP /end SUB_GROUP /begin FUNCTION_LIST /end FUNCTION_LIST /begin REF_CHARACTERISTIC CalRegn01Cmn.GmMsg1E9BusHiSpdVehStabyEnhmtActvVldTiOut.Val /end REF_CHARACTERISTIC /begin REF_MEASUREMENT /end REF_MEASUREMENT /end GROUP
/begin GROUP CalRegn01Cmn.GmMsg1E9BusHiSpdYawRateDft.Val "MICROSAR RTE" /begin SUB_GROUP /end SUB_GROUP /begin FUNCTION_LIST /end FUNCTION_LIST /begin REF_CHARACTERISTIC CalRegn01Cmn.GmMsg1E9BusHiSpdYawRateDft.Val /end REF_CHARACTERISTIC /begin REF_MEASUREMENT /end REF_MEASUREMENT /end GROUP
/begin GROUP CalRegn01Cmn.GmMsg1E9BusHiSpdYawRateInvldTiOut.Val "MICROSAR RTE" /begin SUB_GROUP /end SUB_GROUP /begin FUNCTION_LIST /end FUNCTION_LIST /begin REF_CHARACTERISTIC CalRegn01Cmn.GmMsg1E9BusHiSpdYawRateInvldTiOut.Val /end REF_CHARACTERISTIC /begin REF_MEASUREMENT /end REF_MEASUREMENT /end GROUP
/begin GROUP CalRegn01Cmn.GmMsg1F1BusHiSpdMissTiOut.Val "MICROSAR RTE" /begin SUB_GROUP /end SUB_GROUP /begin FUNCTION_LIST /end FUNCTION_LIST /begin REF_CHARACTERISTIC CalRegn01Cmn.GmMsg1F1BusHiSpdMissTiOut.Val /end REF_CHARACTERISTIC /begin REF_MEASUREMENT /end REF_MEASUREMENT /end GROUP
/begin GROUP CalRegn01Cmn.GmMsg1F5BusHiSpdInvldTiOut.Val "MICROSAR RTE" /begin SUB_GROUP /end SUB_GROUP /begin FUNCTION_LIST /end FUNCTION_LIST /begin REF_CHARACTERISTIC CalRegn01Cmn.GmMsg1F5BusHiSpdInvldTiOut.Val /end REF_CHARACTERISTIC /begin REF_MEASUREMENT /end REF_MEASUREMENT /end GROUP
/begin GROUP CalRegn01Cmn.GmMsg1F5BusHiSpdMissTiOut.Val "MICROSAR RTE" /begin SUB_GROUP /end SUB_GROUP /begin FUNCTION_LIST /end FUNCTION_LIST /begin REF_CHARACTERISTIC CalRegn01Cmn.GmMsg1F5BusHiSpdMissTiOut.Val /end REF_CHARACTERISTIC /begin REF_MEASUREMENT /end REF_MEASUREMENT /end GROUP
/begin GROUP CalRegn01Cmn.GmMsg214BusHiSpdAbsActvProtdInvldTiOut.Val "MICROSAR RTE" /begin SUB_GROUP /end SUB_GROUP /begin FUNCTION_LIST /end FUNCTION_LIST /begin REF_CHARACTERISTIC CalRegn01Cmn.GmMsg214BusHiSpdAbsActvProtdInvldTiOut.Val /end REF_CHARACTERISTIC /begin REF_MEASUREMENT /end REF_MEASUREMENT /end GROUP
/begin GROUP CalRegn01Cmn.GmMsg214BusHiSpdAbsActvProtdProtnValInvldTiOut.Val "MICROSAR RTE" /begin SUB_GROUP /end SUB_GROUP /begin FUNCTION_LIST /end FUNCTION_LIST
 /begin REF_CHARACTERISTIC CalRegn01Cmn.GmMsg214BusHiSpdAbsActvProtdProtnValInvldTiOut.Val /end REF_CHARACTERISTIC
 /begin REF_MEASUREMENT /end REF_MEASUREMENT
/end GROUP
/begin GROUP CalRegn01Cmn.GmMsg214BusHiSpdAbsActvProtdRollgCntrInvldTiOut.Val "MICROSAR RTE" /begin SUB_GROUP /end SUB_GROUP /begin FUNCTION_LIST /end FUNCTION_LIST
 /begin REF_CHARACTERISTIC CalRegn01Cmn.GmMsg214BusHiSpdAbsActvProtdRollgCntrInvldTiOut.Val /end REF_CHARACTERISTIC
 /begin REF_MEASUREMENT /end REF_MEASUREMENT
/end GROUP
/begin GROUP CalRegn01Cmn.GmMsg214BusHiSpdMissTiOut.Val "MICROSAR RTE" /begin SUB_GROUP /end SUB_GROUP /begin FUNCTION_LIST /end FUNCTION_LIST /begin REF_CHARACTERISTIC CalRegn01Cmn.GmMsg214BusHiSpdMissTiOut.Val /end REF_CHARACTERISTIC /begin REF_MEASUREMENT /end REF_MEASUREMENT /end GROUP
/begin GROUP CalRegn01Cmn.GmMsg214BusHiSpdRdntVehStabyEnhmtActvInvldTiOut.Val "MICROSAR RTE" /begin SUB_GROUP /end SUB_GROUP /begin FUNCTION_LIST /end FUNCTION_LIST
 /begin REF_CHARACTERISTIC CalRegn01Cmn.GmMsg214BusHiSpdRdntVehStabyEnhmtActvInvldTiOut.Val /end REF_CHARACTERISTIC
 /begin REF_MEASUREMENT /end REF_MEASUREMENT
/end GROUP
/begin GROUP CalRegn01Cmn.GmMsg214BusHiSpdRdntVehStabyEnhmtActvRollgCntrInvldTiOut.Val "MICROSAR RTE" /begin SUB_GROUP /end SUB_GROUP /begin FUNCTION_LIST /end FUNCTION_LIST
 /begin REF_CHARACTERISTIC CalRegn01Cmn.GmMsg214BusHiSpdRdntVehStabyEnhmtActvRollgCntrInvldTiOut.Val /end REF_CHARACTERISTIC
 /begin REF_MEASUREMENT /end REF_MEASUREMENT
/end GROUP
/begin GROUP CalRegn01Cmn.GmMsg232BusHiSpdMissTiOut.Val "MICROSAR RTE" /begin SUB_GROUP /end SUB_GROUP /begin FUNCTION_LIST /end FUNCTION_LIST /begin REF_CHARACTERISTIC CalRegn01Cmn.GmMsg232BusHiSpdMissTiOut.Val /end REF_CHARACTERISTIC /begin REF_MEASUREMENT /end REF_MEASUREMENT /end GROUP
/begin GROUP CalRegn01Cmn.GmMsg337BusChassisExpInvldDiagcTiOut.Val "MICROSAR RTE" /begin SUB_GROUP /end SUB_GROUP /begin FUNCTION_LIST /end FUNCTION_LIST /begin REF_CHARACTERISTIC CalRegn01Cmn.GmMsg337BusChassisExpInvldDiagcTiOut.Val /end REF_CHARACTERISTIC /begin REF_MEASUREMENT /end REF_MEASUREMENT /end GROUP
/begin GROUP CalRegn01Cmn.GmMsg337BusChassisExpInvldProtnValTiOut.Val "MICROSAR RTE" /begin SUB_GROUP /end SUB_GROUP /begin FUNCTION_LIST /end FUNCTION_LIST /begin REF_CHARACTERISTIC CalRegn01Cmn.GmMsg337BusChassisExpInvldProtnValTiOut.Val /end REF_CHARACTERISTIC /begin REF_MEASUREMENT /end REF_MEASUREMENT /end GROUP
/begin GROUP CalRegn01Cmn.GmMsg337BusChassisExpInvldRollgCntrTiOut.Val "MICROSAR RTE" /begin SUB_GROUP /end SUB_GROUP /begin FUNCTION_LIST /end FUNCTION_LIST /begin REF_CHARACTERISTIC CalRegn01Cmn.GmMsg337BusChassisExpInvldRollgCntrTiOut.Val /end REF_CHARACTERISTIC /begin REF_MEASUREMENT /end REF_MEASUREMENT /end GROUP
/begin GROUP CalRegn01Cmn.GmMsg337BusChassisExpMissTiOut.Val "MICROSAR RTE" /begin SUB_GROUP /end SUB_GROUP /begin FUNCTION_LIST /end FUNCTION_LIST /begin REF_CHARACTERISTIC CalRegn01Cmn.GmMsg337BusChassisExpMissTiOut.Val /end REF_CHARACTERISTIC /begin REF_MEASUREMENT /end REF_MEASUREMENT /end GROUP
/begin GROUP CalRegn01Cmn.GmMsg337BusChassisExpTarAgPolarity.Val "MICROSAR RTE" /begin SUB_GROUP /end SUB_GROUP /begin FUNCTION_LIST /end FUNCTION_LIST /begin REF_CHARACTERISTIC CalRegn01Cmn.GmMsg337BusChassisExpTarAgPolarity.Val /end REF_CHARACTERISTIC /begin REF_MEASUREMENT /end REF_MEASUREMENT /end GROUP
/begin GROUP CalRegn01Cmn.GmMsg348BusChassisExpInvldTiOut.Val "MICROSAR RTE" /begin SUB_GROUP /end SUB_GROUP /begin FUNCTION_LIST /end FUNCTION_LIST /begin REF_CHARACTERISTIC CalRegn01Cmn.GmMsg348BusChassisExpInvldTiOut.Val /end REF_CHARACTERISTIC /begin REF_MEASUREMENT /end REF_MEASUREMENT /end GROUP
/begin GROUP CalRegn01Cmn.GmMsg348BusChassisExpMissTiOut.Val "MICROSAR RTE" /begin SUB_GROUP /end SUB_GROUP /begin FUNCTION_LIST /end FUNCTION_LIST /begin REF_CHARACTERISTIC CalRegn01Cmn.GmMsg348BusChassisExpMissTiOut.Val /end REF_CHARACTERISTIC /begin REF_MEASUREMENT /end REF_MEASUREMENT /end GROUP
/begin GROUP CalRegn01Cmn.GmMsg348BusChassisExpStuckTiOut.Val "MICROSAR RTE" /begin SUB_GROUP /end SUB_GROUP /begin FUNCTION_LIST /end FUNCTION_LIST /begin REF_CHARACTERISTIC CalRegn01Cmn.GmMsg348BusChassisExpStuckTiOut.Val /end REF_CHARACTERISTIC /begin REF_MEASUREMENT /end REF_MEASUREMENT /end GROUP
/begin GROUP CalRegn01Cmn.GmMsg348BusHiSpdInvldTiOut.Val "MICROSAR RTE" /begin SUB_GROUP /end SUB_GROUP /begin FUNCTION_LIST /end FUNCTION_LIST /begin REF_CHARACTERISTIC CalRegn01Cmn.GmMsg348BusHiSpdInvldTiOut.Val /end REF_CHARACTERISTIC /begin REF_MEASUREMENT /end REF_MEASUREMENT /end GROUP
/begin GROUP CalRegn01Cmn.GmMsg348BusHiSpdMissTiOut.Val "MICROSAR RTE" /begin SUB_GROUP /end SUB_GROUP /begin FUNCTION_LIST /end FUNCTION_LIST /begin REF_CHARACTERISTIC CalRegn01Cmn.GmMsg348BusHiSpdMissTiOut.Val /end REF_CHARACTERISTIC /begin REF_MEASUREMENT /end REF_MEASUREMENT /end GROUP
/begin GROUP CalRegn01Cmn.GmMsg348BusHiSpdStuckTiOut.Val "MICROSAR RTE" /begin SUB_GROUP /end SUB_GROUP /begin FUNCTION_LIST /end FUNCTION_LIST /begin REF_CHARACTERISTIC CalRegn01Cmn.GmMsg348BusHiSpdStuckTiOut.Val /end REF_CHARACTERISTIC /begin REF_MEASUREMENT /end REF_MEASUREMENT /end GROUP
/begin GROUP CalRegn01Cmn.GmMsg34ABusChassisExpInvldTiOut.Val "MICROSAR RTE" /begin SUB_GROUP /end SUB_GROUP /begin FUNCTION_LIST /end FUNCTION_LIST /begin REF_CHARACTERISTIC CalRegn01Cmn.GmMsg34ABusChassisExpInvldTiOut.Val /end REF_CHARACTERISTIC /begin REF_MEASUREMENT /end REF_MEASUREMENT /end GROUP
/begin GROUP CalRegn01Cmn.GmMsg34ABusChassisExpMissTiOut.Val "MICROSAR RTE" /begin SUB_GROUP /end SUB_GROUP /begin FUNCTION_LIST /end FUNCTION_LIST /begin REF_CHARACTERISTIC CalRegn01Cmn.GmMsg34ABusChassisExpMissTiOut.Val /end REF_CHARACTERISTIC /begin REF_MEASUREMENT /end REF_MEASUREMENT /end GROUP
/begin GROUP CalRegn01Cmn.GmMsg34ABusChassisExpStuckTiOut.Val "MICROSAR RTE" /begin SUB_GROUP /end SUB_GROUP /begin FUNCTION_LIST /end FUNCTION_LIST /begin REF_CHARACTERISTIC CalRegn01Cmn.GmMsg34ABusChassisExpStuckTiOut.Val /end REF_CHARACTERISTIC /begin REF_MEASUREMENT /end REF_MEASUREMENT /end GROUP
/begin GROUP CalRegn01Cmn.GmMsg34ABusHiSpdInvldTiOut.Val "MICROSAR RTE" /begin SUB_GROUP /end SUB_GROUP /begin FUNCTION_LIST /end FUNCTION_LIST /begin REF_CHARACTERISTIC CalRegn01Cmn.GmMsg34ABusHiSpdInvldTiOut.Val /end REF_CHARACTERISTIC /begin REF_MEASUREMENT /end REF_MEASUREMENT /end GROUP
/begin GROUP CalRegn01Cmn.GmMsg34ABusHiSpdMissTiOut.Val "MICROSAR RTE" /begin SUB_GROUP /end SUB_GROUP /begin FUNCTION_LIST /end FUNCTION_LIST /begin REF_CHARACTERISTIC CalRegn01Cmn.GmMsg34ABusHiSpdMissTiOut.Val /end REF_CHARACTERISTIC /begin REF_MEASUREMENT /end REF_MEASUREMENT /end GROUP
/begin GROUP CalRegn01Cmn.GmMsg34ABusHiSpdStuckTiOut.Val "MICROSAR RTE" /begin SUB_GROUP /end SUB_GROUP /begin FUNCTION_LIST /end FUNCTION_LIST /begin REF_CHARACTERISTIC CalRegn01Cmn.GmMsg34ABusHiSpdStuckTiOut.Val /end REF_CHARACTERISTIC /begin REF_MEASUREMENT /end REF_MEASUREMENT /end GROUP
/begin GROUP CalRegn01Cmn.GmMsg3F1BusHiSpdAmbTDft.Val "MICROSAR RTE" /begin SUB_GROUP /end SUB_GROUP /begin FUNCTION_LIST /end FUNCTION_LIST /begin REF_CHARACTERISTIC CalRegn01Cmn.GmMsg3F1BusHiSpdAmbTDft.Val /end REF_CHARACTERISTIC /begin REF_MEASUREMENT /end REF_MEASUREMENT /end GROUP
/begin GROUP CalRegn01Cmn.GmMsg3F1BusHiSpdInvldTiOut.Val "MICROSAR RTE" /begin SUB_GROUP /end SUB_GROUP /begin FUNCTION_LIST /end FUNCTION_LIST /begin REF_CHARACTERISTIC CalRegn01Cmn.GmMsg3F1BusHiSpdInvldTiOut.Val /end REF_CHARACTERISTIC /begin REF_MEASUREMENT /end REF_MEASUREMENT /end GROUP
/begin GROUP CalRegn01Cmn.GmMsg3F1BusHiSpdMissTiOut.Val "MICROSAR RTE" /begin SUB_GROUP /end SUB_GROUP /begin FUNCTION_LIST /end FUNCTION_LIST /begin REF_CHARACTERISTIC CalRegn01Cmn.GmMsg3F1BusHiSpdMissTiOut.Val /end REF_CHARACTERISTIC /begin REF_MEASUREMENT /end REF_MEASUREMENT /end GROUP
/begin GROUP CalRegn01Cmn.GmMsg4D1BusHiSpdEngOilTDft.Val "MICROSAR RTE" /begin SUB_GROUP /end SUB_GROUP /begin FUNCTION_LIST /end FUNCTION_LIST /begin REF_CHARACTERISTIC CalRegn01Cmn.GmMsg4D1BusHiSpdEngOilTDft.Val /end REF_CHARACTERISTIC /begin REF_MEASUREMENT /end REF_MEASUREMENT /end GROUP
/begin GROUP CalRegn01Cmn.GmMsg4D1BusHiSpdInvldTiOut.Val "MICROSAR RTE" /begin SUB_GROUP /end SUB_GROUP /begin FUNCTION_LIST /end FUNCTION_LIST /begin REF_CHARACTERISTIC CalRegn01Cmn.GmMsg4D1BusHiSpdInvldTiOut.Val /end REF_CHARACTERISTIC /begin REF_MEASUREMENT /end REF_MEASUREMENT /end GROUP
/begin GROUP CalRegn01Cmn.GmMsg4D1BusHiSpdMissTiOut.Val "MICROSAR RTE" /begin SUB_GROUP /end SUB_GROUP /begin FUNCTION_LIST /end FUNCTION_LIST /begin REF_CHARACTERISTIC CalRegn01Cmn.GmMsg4D1BusHiSpdMissTiOut.Val /end REF_CHARACTERISTIC /begin REF_MEASUREMENT /end REF_MEASUREMENT /end GROUP
/begin GROUP CalRegn01Cmn.GmMsg500BusHiSpdMissTiOut.Val "MICROSAR RTE" /begin SUB_GROUP /end SUB_GROUP /begin FUNCTION_LIST /end FUNCTION_LIST /begin REF_CHARACTERISTIC CalRegn01Cmn.GmMsg500BusHiSpdMissTiOut.Val /end REF_CHARACTERISTIC /begin REF_MEASUREMENT /end REF_MEASUREMENT /end GROUP
/begin GROUP CalRegn01Cmn.GmMsg500BusHiSpdWhlPlsPerRevDft.Val "MICROSAR RTE" /begin SUB_GROUP /end SUB_GROUP /begin FUNCTION_LIST /end FUNCTION_LIST /begin REF_CHARACTERISTIC CalRegn01Cmn.GmMsg500BusHiSpdWhlPlsPerRevDft.Val /end REF_CHARACTERISTIC /begin REF_MEASUREMENT /end REF_MEASUREMENT /end GROUP
/begin GROUP CalRegn01Cmn.GmMsg500BusHiSpdWhlRotlStsTiStampReslDft.Val "MICROSAR RTE" /begin SUB_GROUP /end SUB_GROUP /begin FUNCTION_LIST /end FUNCTION_LIST /begin REF_CHARACTERISTIC CalRegn01Cmn.GmMsg500BusHiSpdWhlRotlStsTiStampReslDft.Val /end REF_CHARACTERISTIC /begin REF_MEASUREMENT /end REF_MEASUREMENT /end GROUP
/begin GROUP CalRegn01Cmn.HiFrqAssiPahFwlOverLimDiagcFailStep.Val "MICROSAR RTE" /begin SUB_GROUP /end SUB_GROUP /begin FUNCTION_LIST /end FUNCTION_LIST /begin REF_CHARACTERISTIC CalRegn01Cmn.HiFrqAssiPahFwlOverLimDiagcFailStep.Val /end REF_CHARACTERISTIC /begin REF_MEASUREMENT /end REF_MEASUREMENT /end GROUP
/begin GROUP CalRegn01Cmn.HiFrqAssiPahFwlOverLimDiagcPassStep.Val "MICROSAR RTE" /begin SUB_GROUP /end SUB_GROUP /begin FUNCTION_LIST /end FUNCTION_LIST /begin REF_CHARACTERISTIC CalRegn01Cmn.HiFrqAssiPahFwlOverLimDiagcPassStep.Val /end REF_CHARACTERISTIC /begin REF_MEASUREMENT /end REF_MEASUREMENT /end GROUP
/begin GROUP CalRegn01Cmn.HwAgSnsrlsCorrdPinionAgHwConf.Val "MICROSAR RTE" /begin SUB_GROUP /end SUB_GROUP /begin FUNCTION_LIST /end FUNCTION_LIST /begin REF_CHARACTERISTIC CalRegn01Cmn.HwAgSnsrlsCorrdPinionAgHwConf.Val /end REF_CHARACTERISTIC /begin REF_MEASUREMENT /end REF_MEASUREMENT /end GROUP
/begin GROUP CalRegn01Cmn.HwAgSnsrlsFCentrHwConf.Val "MICROSAR RTE" /begin SUB_GROUP /end SUB_GROUP /begin FUNCTION_LIST /end FUNCTION_LIST /begin REF_CHARACTERISTIC CalRegn01Cmn.HwAgSnsrlsFCentrHwConf.Val /end REF_CHARACTERISTIC /begin REF_MEASUREMENT /end REF_MEASUREMENT /end GROUP
/begin GROUP CalRegn01Cmn.HwAgSnsrlsPinionTqFilFrq.Val "MICROSAR RTE" /begin SUB_GROUP /end SUB_GROUP /begin FUNCTION_LIST /end FUNCTION_LIST /begin REF_CHARACTERISTIC CalRegn01Cmn.HwAgSnsrlsPinionTqFilFrq.Val /end REF_CHARACTERISTIC /begin REF_MEASUREMENT /end REF_MEASUREMENT /end GROUP
/begin GROUP CalRegn01Cmn.HwAgSnsrlsRelHwAgFil1Frq.Val "MICROSAR RTE" /begin SUB_GROUP /end SUB_GROUP /begin FUNCTION_LIST /end FUNCTION_LIST /begin REF_CHARACTERISTIC CalRegn01Cmn.HwAgSnsrlsRelHwAgFil1Frq.Val /end REF_CHARACTERISTIC /begin REF_MEASUREMENT /end REF_MEASUREMENT /end GROUP
/begin GROUP CalRegn01Cmn.HwAgSnsrlsRelHwAgFil2Frq.Val "MICROSAR RTE" /begin SUB_GROUP /end SUB_GROUP /begin FUNCTION_LIST /end FUNCTION_LIST /begin REF_CHARACTERISTIC CalRegn01Cmn.HwAgSnsrlsRelHwAgFil2Frq.Val /end REF_CHARACTERISTIC /begin REF_MEASUREMENT /end REF_MEASUREMENT /end GROUP
/begin GROUP CalRegn01Cmn.HwAgSnsrlsSmotngCoeff.Val "MICROSAR RTE" /begin SUB_GROUP /end SUB_GROUP /begin FUNCTION_LIST /end FUNCTION_LIST /begin REF_CHARACTERISTIC CalRegn01Cmn.HwAgSnsrlsSmotngCoeff.Val /end REF_CHARACTERISTIC /begin REF_MEASUREMENT /end REF_MEASUREMENT /end GROUP
/begin GROUP CalRegn01Cmn.HwAgSnsrlsSmotngStepThd.Val "MICROSAR RTE" /begin SUB_GROUP /end SUB_GROUP /begin FUNCTION_LIST /end FUNCTION_LIST /begin REF_CHARACTERISTIC CalRegn01Cmn.HwAgSnsrlsSmotngStepThd.Val /end REF_CHARACTERISTIC /begin REF_MEASUREMENT /end REF_MEASUREMENT /end GROUP
/begin GROUP CalRegn01Cmn.HwAgSnsrlsStordPinionConf.Val "MICROSAR RTE" /begin SUB_GROUP /end SUB_GROUP /begin FUNCTION_LIST /end FUNCTION_LIST /begin REF_CHARACTERISTIC CalRegn01Cmn.HwAgSnsrlsStordPinionConf.Val /end REF_CHARACTERISTIC /begin REF_MEASUREMENT /end REF_MEASUREMENT /end GROUP
/begin GROUP CalRegn01Cmn.HwAgSnsrlsStordPinionConfThd.Val "MICROSAR RTE" /begin SUB_GROUP /end SUB_GROUP /begin FUNCTION_LIST /end FUNCTION_LIST /begin REF_CHARACTERISTIC CalRegn01Cmn.HwAgSnsrlsStordPinionConfThd.Val /end REF_CHARACTERISTIC /begin REF_MEASUREMENT /end REF_MEASUREMENT /end GROUP
/begin GROUP CalRegn01Cmn.HwAgSnsrlsVehDynDifThd.Val "MICROSAR RTE" /begin SUB_GROUP /end SUB_GROUP /begin FUNCTION_LIST /end FUNCTION_LIST /begin REF_CHARACTERISTIC CalRegn01Cmn.HwAgSnsrlsVehDynDifThd.Val /end REF_CHARACTERISTIC /begin REF_MEASUREMENT /end REF_MEASUREMENT /end GROUP
/begin GROUP CalRegn01Cmn.HwAgSnsrlsVehDynHwConf.Val "MICROSAR RTE" /begin SUB_GROUP /end SUB_GROUP /begin FUNCTION_LIST /end FUNCTION_LIST /begin REF_CHARACTERISTIC CalRegn01Cmn.HwAgSnsrlsVehDynHwConf.Val /end REF_CHARACTERISTIC /begin REF_MEASUREMENT /end REF_MEASUREMENT /end GROUP
/begin GROUP CalRegn01Cmn.HwAgSnsrlsVehDynMotVelThd.Val "MICROSAR RTE" /begin SUB_GROUP /end SUB_GROUP /begin FUNCTION_LIST /end FUNCTION_LIST /begin REF_CHARACTERISTIC CalRegn01Cmn.HwAgSnsrlsVehDynMotVelThd.Val /end REF_CHARACTERISTIC /begin REF_MEASUREMENT /end REF_MEASUREMENT /end GROUP
/begin GROUP CalRegn01Cmn.HwAgSnsrlsVehDynPinionTqThd.Val "MICROSAR RTE" /begin SUB_GROUP /end SUB_GROUP /begin FUNCTION_LIST /end FUNCTION_LIST /begin REF_CHARACTERISTIC CalRegn01Cmn.HwAgSnsrlsVehDynPinionTqThd.Val /end REF_CHARACTERISTIC /begin REF_MEASUREMENT /end REF_MEASUREMENT /end GROUP
/begin GROUP CalRegn01Cmn.HwAgSnsrlsVehDynTmr1Thd.Val "MICROSAR RTE" /begin SUB_GROUP /end SUB_GROUP /begin FUNCTION_LIST /end FUNCTION_LIST /begin REF_CHARACTERISTIC CalRegn01Cmn.HwAgSnsrlsVehDynTmr1Thd.Val /end REF_CHARACTERISTIC /begin REF_MEASUREMENT /end REF_MEASUREMENT /end GROUP
/begin GROUP CalRegn01Cmn.HwAgSnsrlsVehDynTmr2Thd.Val "MICROSAR RTE" /begin SUB_GROUP /end SUB_GROUP /begin FUNCTION_LIST /end FUNCTION_LIST /begin REF_CHARACTERISTIC CalRegn01Cmn.HwAgSnsrlsVehDynTmr2Thd.Val /end REF_CHARACTERISTIC /begin REF_MEASUREMENT /end REF_MEASUREMENT /end GROUP
/begin GROUP CalRegn01Cmn.HwAgSnsrlsWhlFrqThd.Val "MICROSAR RTE" /begin SUB_GROUP /end SUB_GROUP /begin FUNCTION_LIST /end FUNCTION_LIST /begin REF_CHARACTERISTIC CalRegn01Cmn.HwAgSnsrlsWhlFrqThd.Val /end REF_CHARACTERISTIC /begin REF_MEASUREMENT /end REF_MEASUREMENT /end GROUP
/begin GROUP CalRegn01Cmn.HwAgSnsrlsWhlSpdHwAgCoeff1.Val "MICROSAR RTE" /begin SUB_GROUP /end SUB_GROUP /begin FUNCTION_LIST /end FUNCTION_LIST /begin REF_CHARACTERISTIC CalRegn01Cmn.HwAgSnsrlsWhlSpdHwAgCoeff1.Val /end REF_CHARACTERISTIC /begin REF_MEASUREMENT /end REF_MEASUREMENT /end GROUP
/begin GROUP CalRegn01Cmn.HwAgSnsrlsWhlSpdHwAgCoeff2.Val "MICROSAR RTE" /begin SUB_GROUP /end SUB_GROUP /begin FUNCTION_LIST /end FUNCTION_LIST /begin REF_CHARACTERISTIC CalRegn01Cmn.HwAgSnsrlsWhlSpdHwAgCoeff2.Val /end REF_CHARACTERISTIC /begin REF_MEASUREMENT /end REF_MEASUREMENT /end GROUP
/begin GROUP CalRegn01Cmn.HwAgSnsrlsWhlSpdHwAgThd.Val "MICROSAR RTE" /begin SUB_GROUP /end SUB_GROUP /begin FUNCTION_LIST /end FUNCTION_LIST /begin REF_CHARACTERISTIC CalRegn01Cmn.HwAgSnsrlsWhlSpdHwAgThd.Val /end REF_CHARACTERISTIC /begin REF_MEASUREMENT /end REF_MEASUREMENT /end GROUP
/begin GROUP CalRegn01Cmn.HwAgSnsrlsWhlSpdHwConf.Val "MICROSAR RTE" /begin SUB_GROUP /end SUB_GROUP /begin FUNCTION_LIST /end FUNCTION_LIST /begin REF_CHARACTERISTIC CalRegn01Cmn.HwAgSnsrlsWhlSpdHwConf.Val /end REF_CHARACTERISTIC /begin REF_MEASUREMENT /end REF_MEASUREMENT /end GROUP
/begin GROUP CalRegn01Cmn.HwAgSnsrlsWhlSpdRatThd.Val "MICROSAR RTE" /begin SUB_GROUP /end SUB_GROUP /begin FUNCTION_LIST /end FUNCTION_LIST /begin REF_CHARACTERISTIC CalRegn01Cmn.HwAgSnsrlsWhlSpdRatThd.Val /end REF_CHARACTERISTIC /begin REF_MEASUREMENT /end REF_MEASUREMENT /end GROUP
/begin GROUP CalRegn01Cmn.HwAgSnsrlsWhlSpdTmrThd.Val "MICROSAR RTE" /begin SUB_GROUP /end SUB_GROUP /begin FUNCTION_LIST /end FUNCTION_LIST /begin REF_CHARACTERISTIC CalRegn01Cmn.HwAgSnsrlsWhlSpdTmrThd.Val /end REF_CHARACTERISTIC /begin REF_MEASUREMENT /end REF_MEASUREMENT /end GROUP
/begin GROUP CalRegn01Cmn.HwAgSnsrlsWhlSpdVehSpdThd.Val "MICROSAR RTE" /begin SUB_GROUP /end SUB_GROUP /begin FUNCTION_LIST /end FUNCTION_LIST /begin REF_CHARACTERISTIC CalRegn01Cmn.HwAgSnsrlsWhlSpdVehSpdThd.Val /end REF_CHARACTERISTIC /begin REF_MEASUREMENT /end REF_MEASUREMENT /end GROUP
/begin GROUP CalRegn01Cmn.HwAgSysArbnHwAgConf1Snsr.Val "MICROSAR RTE" /begin SUB_GROUP /end SUB_GROUP /begin FUNCTION_LIST /end FUNCTION_LIST /begin REF_CHARACTERISTIC CalRegn01Cmn.HwAgSysArbnHwAgConf1Snsr.Val /end REF_CHARACTERISTIC /begin REF_MEASUREMENT /end REF_MEASUREMENT /end GROUP
/begin GROUP CalRegn01Cmn.HwAgSysArbnHwAgConf2Snsr.Val "MICROSAR RTE" /begin SUB_GROUP /end SUB_GROUP /begin FUNCTION_LIST /end FUNCTION_LIST /begin REF_CHARACTERISTIC CalRegn01Cmn.HwAgSysArbnHwAgConf2Snsr.Val /end REF_CHARACTERISTIC /begin REF_MEASUREMENT /end REF_MEASUREMENT /end GROUP
/begin GROUP CalRegn01Cmn.HwAgSysArbnHwAgConfNoSnsr.Val "MICROSAR RTE" /begin SUB_GROUP /end SUB_GROUP /begin FUNCTION_LIST /end FUNCTION_LIST /begin REF_CHARACTERISTIC CalRegn01Cmn.HwAgSysArbnHwAgConfNoSnsr.Val /end REF_CHARACTERISTIC /begin REF_MEASUREMENT /end REF_MEASUREMENT /end GROUP
/begin GROUP CalRegn01Cmn.HwAgSysArbnHwAgCorrdCorrlnThd.Val "MICROSAR RTE" /begin SUB_GROUP /end SUB_GROUP /begin FUNCTION_LIST /end FUNCTION_LIST /begin REF_CHARACTERISTIC CalRegn01Cmn.HwAgSysArbnHwAgCorrdCorrlnThd.Val /end REF_CHARACTERISTIC /begin REF_MEASUREMENT /end REF_MEASUREMENT /end GROUP
/begin GROUP CalRegn01Cmn.HwAgSysArbnHwAgCorrlnFailDebStep.Val "MICROSAR RTE" /begin SUB_GROUP /end SUB_GROUP /begin FUNCTION_LIST /end FUNCTION_LIST /begin REF_CHARACTERISTIC CalRegn01Cmn.HwAgSysArbnHwAgCorrlnFailDebStep.Val /end REF_CHARACTERISTIC /begin REF_MEASUREMENT /end REF_MEASUREMENT /end GROUP
/begin GROUP CalRegn01Cmn.HwAgSysArbnHwAgCorrlnPassDebStep.Val "MICROSAR RTE" /begin SUB_GROUP /end SUB_GROUP /begin FUNCTION_LIST /end FUNCTION_LIST /begin REF_CHARACTERISTIC CalRegn01Cmn.HwAgSysArbnHwAgCorrlnPassDebStep.Val /end REF_CHARACTERISTIC /begin REF_MEASUREMENT /end REF_MEASUREMENT /end GROUP
/begin GROUP CalRegn01Cmn.HwAgSysArbnHwAgCorrlnRng.Val "MICROSAR RTE" /begin SUB_GROUP /end SUB_GROUP /begin FUNCTION_LIST /end FUNCTION_LIST /begin REF_CHARACTERISTIC CalRegn01Cmn.HwAgSysArbnHwAgCorrlnRng.Val /end REF_CHARACTERISTIC /begin REF_MEASUREMENT /end REF_MEASUREMENT /end GROUP
/begin GROUP CalRegn01Cmn.HwAgSysArbnHwAgSlewRate.Val "MICROSAR RTE" /begin SUB_GROUP /end SUB_GROUP /begin FUNCTION_LIST /end FUNCTION_LIST /begin REF_CHARACTERISTIC CalRegn01Cmn.HwAgSysArbnHwAgSlewRate.Val /end REF_CHARACTERISTIC /begin REF_MEASUREMENT /end REF_MEASUREMENT /end GROUP
/begin GROUP CalRegn01Cmn.HwAgSysArbnHwAgSnsrlsCorrlnThd.Val "MICROSAR RTE" /begin SUB_GROUP /end SUB_GROUP /begin FUNCTION_LIST /end FUNCTION_LIST /begin REF_CHARACTERISTIC CalRegn01Cmn.HwAgSysArbnHwAgSnsrlsCorrlnThd.Val /end REF_CHARACTERISTIC /begin REF_MEASUREMENT /end REF_MEASUREMENT /end GROUP
/begin GROUP CalRegn01Cmn.HwAgSysArbnHwAgSnsrlsKineThd.Val "MICROSAR RTE" /begin SUB_GROUP /end SUB_GROUP /begin FUNCTION_LIST /end FUNCTION_LIST /begin REF_CHARACTERISTIC CalRegn01Cmn.HwAgSysArbnHwAgSnsrlsKineThd.Val /end REF_CHARACTERISTIC /begin REF_MEASUREMENT /end REF_MEASUREMENT /end GROUP
/begin GROUP CalRegn01Cmn.HwAgSysArbnHwAgToMotAgCorrlnElpdTiLim.Val "MICROSAR RTE" /begin SUB_GROUP /end SUB_GROUP /begin FUNCTION_LIST /end FUNCTION_LIST /begin REF_CHARACTERISTIC CalRegn01Cmn.HwAgSysArbnHwAgToMotAgCorrlnElpdTiLim.Val /end REF_CHARACTERISTIC /begin REF_MEASUREMENT /end REF_MEASUREMENT /end GROUP
/begin GROUP CalRegn01Cmn.HwAgSysArbnSerlComHwAgCorrdConf.Val "MICROSAR RTE" /begin SUB_GROUP /end SUB_GROUP /begin FUNCTION_LIST /end FUNCTION_LIST /begin REF_CHARACTERISTIC CalRegn01Cmn.HwAgSysArbnSerlComHwAgCorrdConf.Val /end REF_CHARACTERISTIC /begin REF_MEASUREMENT /end REF_MEASUREMENT /end GROUP
/begin GROUP CalRegn01Cmn.HwAgSysArbnSerlComHwAgSnsrlsConf.Val "MICROSAR RTE" /begin SUB_GROUP /end SUB_GROUP /begin FUNCTION_LIST /end FUNCTION_LIST /begin REF_CHARACTERISTIC CalRegn01Cmn.HwAgSysArbnSerlComHwAgSnsrlsConf.Val /end REF_CHARACTERISTIC /begin REF_MEASUREMENT /end REF_MEASUREMENT /end GROUP
/begin GROUP CalRegn01Cmn.HwAgSysArbnSlewRateTmr.Val "MICROSAR RTE" /begin SUB_GROUP /end SUB_GROUP /begin FUNCTION_LIST /end FUNCTION_LIST /begin REF_CHARACTERISTIC CalRegn01Cmn.HwAgSysArbnSlewRateTmr.Val /end REF_CHARACTERISTIC /begin REF_MEASUREMENT /end REF_MEASUREMENT /end GROUP
/begin GROUP CalRegn01Cmn.HwAgTrajGennAMax.Val "MICROSAR RTE" /begin SUB_GROUP /end SUB_GROUP /begin FUNCTION_LIST /end FUNCTION_LIST /begin REF_CHARACTERISTIC CalRegn01Cmn.HwAgTrajGennAMax.Val /end REF_CHARACTERISTIC /begin REF_MEASUREMENT /end REF_MEASUREMENT /end GROUP
/begin GROUP CalRegn01Cmn.HwAgTrajGennAgMax.Val "MICROSAR RTE" /begin SUB_GROUP /end SUB_GROUP /begin FUNCTION_LIST /end FUNCTION_LIST /begin REF_CHARACTERISTIC CalRegn01Cmn.HwAgTrajGennAgMax.Val /end REF_CHARACTERISTIC /begin REF_MEASUREMENT /end REF_MEASUREMENT /end GROUP
/begin GROUP CalRegn01Cmn.HwAgTrajGennVelMax.Val "MICROSAR RTE" /begin SUB_GROUP /end SUB_GROUP /begin FUNCTION_LIST /end FUNCTION_LIST /begin REF_CHARACTERISTIC CalRegn01Cmn.HwAgTrajGennVelMax.Val /end REF_CHARACTERISTIC /begin REF_MEASUREMENT /end REF_MEASUREMENT /end GROUP
/begin GROUP CalRegn01Cmn.HwTq2MeasHwTq2PrtclFltFailStep.Val "MICROSAR RTE" /begin SUB_GROUP /end SUB_GROUP /begin FUNCTION_LIST /end FUNCTION_LIST /begin REF_CHARACTERISTIC CalRegn01Cmn.HwTq2MeasHwTq2PrtclFltFailStep.Val /end REF_CHARACTERISTIC /begin REF_MEASUREMENT /end REF_MEASUREMENT /end GROUP
/begin GROUP CalRegn01Cmn.HwTq2MeasHwTq2PrtclFltPassStep.Val "MICROSAR RTE" /begin SUB_GROUP /end SUB_GROUP /begin FUNCTION_LIST /end FUNCTION_LIST /begin REF_CHARACTERISTIC CalRegn01Cmn.HwTq2MeasHwTq2PrtclFltPassStep.Val /end REF_CHARACTERISTIC /begin REF_MEASUREMENT /end REF_MEASUREMENT /end GROUP
/begin GROUP CalRegn01Cmn.HwTq3MeasHwTq3PrtclFltFailStep.Val "MICROSAR RTE" /begin SUB_GROUP /end SUB_GROUP /begin FUNCTION_LIST /end FUNCTION_LIST /begin REF_CHARACTERISTIC CalRegn01Cmn.HwTq3MeasHwTq3PrtclFltFailStep.Val /end REF_CHARACTERISTIC /begin REF_MEASUREMENT /end REF_MEASUREMENT /end GROUP
/begin GROUP CalRegn01Cmn.HwTq3MeasHwTq3PrtclFltPassStep.Val "MICROSAR RTE" /begin SUB_GROUP /end SUB_GROUP /begin FUNCTION_LIST /end FUNCTION_LIST /begin REF_CHARACTERISTIC CalRegn01Cmn.HwTq3MeasHwTq3PrtclFltPassStep.Val /end REF_CHARACTERISTIC /begin REF_MEASUREMENT /end REF_MEASUREMENT /end GROUP
/begin GROUP CalRegn01Cmn.HwTqArbnMaxStallTqA.Val "MICROSAR RTE" /begin SUB_GROUP /end SUB_GROUP /begin FUNCTION_LIST /end FUNCTION_LIST /begin REF_CHARACTERISTIC CalRegn01Cmn.HwTqArbnMaxStallTqA.Val /end REF_CHARACTERISTIC /begin REF_MEASUREMENT /end REF_MEASUREMENT /end GROUP
/begin GROUP CalRegn01Cmn.HwTqArbnMaxStallTqB.Val "MICROSAR RTE" /begin SUB_GROUP /end SUB_GROUP /begin FUNCTION_LIST /end FUNCTION_LIST /begin REF_CHARACTERISTIC CalRegn01Cmn.HwTqArbnMaxStallTqB.Val /end REF_CHARACTERISTIC /begin REF_MEASUREMENT /end REF_MEASUREMENT /end GROUP
/begin GROUP CalRegn01Cmn.HwTqArbnMaxStallTqC.Val "MICROSAR RTE" /begin SUB_GROUP /end SUB_GROUP /begin FUNCTION_LIST /end FUNCTION_LIST /begin REF_CHARACTERISTIC CalRegn01Cmn.HwTqArbnMaxStallTqC.Val /end REF_CHARACTERISTIC /begin REF_MEASUREMENT /end REF_MEASUREMENT /end GROUP
/begin GROUP CalRegn01Cmn.HwTqArbnMaxStallTqD.Val "MICROSAR RTE" /begin SUB_GROUP /end SUB_GROUP /begin FUNCTION_LIST /end FUNCTION_LIST /begin REF_CHARACTERISTIC CalRegn01Cmn.HwTqArbnMaxStallTqD.Val /end REF_CHARACTERISTIC /begin REF_MEASUREMENT /end REF_MEASUREMENT /end GROUP
/begin GROUP CalRegn01Cmn.HwTqCorrlnChACmnModCmpLpFilActvnThd.Val "MICROSAR RTE" /begin SUB_GROUP /end SUB_GROUP /begin FUNCTION_LIST /end FUNCTION_LIST /begin REF_CHARACTERISTIC CalRegn01Cmn.HwTqCorrlnChACmnModCmpLpFilActvnThd.Val /end REF_CHARACTERISTIC /begin REF_MEASUREMENT /end REF_MEASUREMENT /end GROUP
/**********************************************************************************************************************
* RECORD_LAYOUT
*********************************************************************************************************************/
/begin RECORD_LAYOUT RTE_RL_UBYTE FNC_VALUES 1 UBYTE ROW_DIR DIRECT /end RECORD_LAYOUT
/begin RECORD_LAYOUT RTE_RL_UWORD FNC_VALUES 1 UWORD ROW_DIR DIRECT /end RECORD_LAYOUT
/begin RECORD_LAYOUT RTE_RL_ULONG FNC_VALUES 1 ULONG ROW_DIR DIRECT /end RECORD_LAYOUT
/begin RECORD_LAYOUT RTE_RL_SBYTE FNC_VALUES 1 SBYTE ROW_DIR DIRECT /end RECORD_LAYOUT
/begin RECORD_LAYOUT RTE_RL_SWORD FNC_VALUES 1 SWORD ROW_DIR DIRECT /end RECORD_LAYOUT
/begin RECORD_LAYOUT RTE_RL_FLOAT32_IEEE FNC_VALUES 1 FLOAT32_IEEE ROW_DIR DIRECT /end RECORD_LAYOUT
/begin RECORD_LAYOUT RTE_RL_BOOLEAN FNC_VALUES 1 UBYTE ROW_DIR DIRECT /end RECORD_LAYOUT
/**********************************************************************************************************************
* COMPU_METHOD / COMPU_VTAB_RANGE
*********************************************************************************************************************/
/begin COMPU_METHOD RTE_CM_BOOLEAN "" TAB_VERB "%3.1" "" COMPU_TAB_REF RTE_CM_BOOLEAN /end COMPU_METHOD
/begin COMPU_VTAB_RANGE RTE_CM_BOOLEAN "" 2 0 0 "false" 1 255 "true" /end COMPU_VTAB_RANGE
