[part 1 of 4: package /COM/VECTOR/CFG/WORKFLOW/SYSDESC/SYNC]
AUTOSAR XML (schema 4-0-3)
package /COM/VECTOR/CFG/WORKFLOW/SYSDESC/SYNC
  flat map FLATMAP
    3171 x flat instance descriptor:
      ComponentPrototype: upstream-reference=ECU_Composition.VehSpdLimr, ecu-extract-reference=COMPOSITIONTYPE.VehSpdLimr
      ComponentPrototype_001: upstream-reference=ECU_Composition.VehSigCdng, ecu-extract-reference=COMPOSITIONTYPE.VehSigCdng
      ComponentPrototype_002: upstream-reference=ECU_Composition.TunSelnMngt, ecu-extract-reference=COMPOSITIONTYPE.TunSelnMngt
      ComponentPrototype_003: upstream-reference=ECU_Composition.TunSelnAuthy, ecu-extract-reference=COMPOSITIONTYPE.TunSelnAuthy
      ComponentPrototype_004: upstream-reference=ECU_Composition.TqLoa, ecu-extract-reference=COMPOSITIONTYPE.TqLoa
      ComponentPrototype_005: upstream-reference=ECU_Composition.TmplMonr, ecu-extract-reference=COMPOSITIONTYPE.TmplMonr
      ComponentPrototype_006: upstream-reference=ECU_Composition.TEstimn, ecu-extract-reference=COMPOSITIONTYPE.TEstimn
      ComponentPrototype_007: upstream-reference=ECU_Composition.SysStMod, ecu-extract-reference=COMPOSITIONTYPE.SysStMod
      ComponentPrototype_008: upstream-reference=ECU_Composition.StOutpCtrl, ecu-extract-reference=COMPOSITIONTYPE.StOutpCtrl
      ComponentPrototype_009: upstream-reference=ECU_Composition.StabyCmp, ecu-extract-reference=COMPOSITIONTYPE.StabyCmp
      ComponentPrototype_010: upstream-reference=ECU_Composition.SerlComOutpProxy, ecu-extract-reference=COMPOSITIONTYPE.SerlComOutpProxy
      ComponentPrototype_011: upstream-reference=ECU_Composition.SerlComInpProxy, ecu-extract-reference=COMPOSITIONTYPE.SerlComInpProxy
      ComponentPrototype_012: upstream-reference=ECU_Composition.Rtn, ecu-extract-reference=COMPOSITIONTYPE.Rtn
      ComponentPrototype_013: upstream-reference=ECU_Composition.PwrUpSeq, ecu-extract-reference=COMPOSITIONTYPE.PwrUpSeq
      ComponentPrototype_014: upstream-reference=ECU_Composition.PwrSply, ecu-extract-reference=COMPOSITIONTYPE.PwrSply
      ComponentPrototype_015: upstream-reference=ECU_Composition.PwrLimr, ecu-extract-reference=COMPOSITIONTYPE.PwrLimr
      ComponentPrototype_016: upstream-reference=ECU_Composition.PwrDiscnct, ecu-extract-reference=COMPOSITIONTYPE.PwrDiscnct
      ComponentPrototype_017: upstream-reference=ECU_Composition.PullCmpActv, ecu-extract-reference=COMPOSITIONTYPE.PullCmpActv
      ComponentPrototype_018: upstream-reference=ECU_Composition.PolarityCfg, ecu-extract-reference=COMPOSITIONTYPE.PolarityCfg
      ComponentPrototype_019: upstream-reference=ECU_Composition.PartNr, ecu-extract-reference=COMPOSITIONTYPE.PartNr
      ComponentPrototype_021: upstream-reference=ECU_Composition.MotTqTranlDampg, ecu-extract-reference=COMPOSITIONTYPE.MotTqTranlDampg
      ComponentPrototype_022: upstream-reference=ECU_Composition.MotRefMdl, ecu-extract-reference=COMPOSITIONTYPE.MotRefMdl
      ComponentPrototype_023: upstream-reference=ECU_Composition.MotQuadDetn, ecu-extract-reference=COMPOSITIONTYPE.MotQuadDetn
      ComponentPrototype_024: upstream-reference=ECU_Composition.MotDrvDiagc, ecu-extract-reference=COMPOSITIONTYPE.MotDrvDiagc
      ComponentPrototype_025: upstream-reference=ECU_Composition.MotCurrRegCfg, ecu-extract-reference=COMPOSITIONTYPE.MotCurrRegCfg
      ComponentPrototype_026: upstream-reference=ECU_Composition.MotCurrPeakEstimn, ecu-extract-reference=COMPOSITIONTYPE.MotCurrPeakEstimn
      ComponentPrototype_027: upstream-reference=ECU_Composition.MotCtrlPrmEstimn, ecu-extract-reference=COMPOSITIONTYPE.MotCtrlPrmEstimn
      ComponentPrototype_028: upstream-reference=ECU_Composition.MotAgCorrln, ecu-extract-reference=COMPOSITIONTYPE.MotAgCorrln
      ComponentPrototype_030: upstream-reference=ECU_Composition.LoaMgr, ecu-extract-reference=COMPOSITIONTYPE.LoaMgr
      ComponentPrototype_031: upstream-reference=ECU_Composition.LimrCdng, ecu-extract-reference=COMPOSITIONTYPE.LimrCdng
      ComponentPrototype_032: upstream-reference=ECU_Composition.IoHwAb, ecu-extract-reference=COMPOSITIONTYPE.IoHwAb
      ComponentPrototype_033: upstream-reference=ECU_Composition.InertiaCmpVel, ecu-extract-reference=COMPOSITIONTYPE.InertiaCmpVel
      ComponentPrototype_034: upstream-reference=ECU_Composition.HysCmp, ecu-extract-reference=COMPOSITIONTYPE.HysCmp
      ComponentPrototype_035: upstream-reference=ECU_Composition.HwTqCorrln, ecu-extract-reference=COMPOSITIONTYPE.HwTqCorrln
      ComponentPrototype_036: upstream-reference=ECU_Composition.HwTqArbn, ecu-extract-reference=COMPOSITIONTYPE.HwTqArbn
      ComponentPrototype_037: upstream-reference=ECU_Composition.HwAgSysArbn, ecu-extract-reference=COMPOSITIONTYPE.HwAgSysArbn
      ComponentPrototype_038: upstream-reference=ECU_Composition.HwAgCorrln, ecu-extract-reference=COMPOSITIONTYPE.HwAgCorrln
      ComponentPrototype_039: upstream-reference=ECU_Composition.HwAgArbn, ecu-extract-reference=COMPOSITIONTYPE.HwAgArbn
      ComponentPrototype_040: upstream-reference=ECU_Composition.HwAg1Meas, ecu-extract-reference=COMPOSITIONTYPE.HwAg1Meas
      ComponentPrototype_041: upstream-reference=ECU_Composition.HwAg0Meas, ecu-extract-reference=COMPOSITIONTYPE.HwAg0Meas
      ComponentPrototype_042: upstream-reference=ECU_Composition.HiLoadStallLimr, ecu-extract-reference=COMPOSITIONTYPE.HiLoadStallLimr
      ComponentPrototype_043: upstream-reference=ECU_Composition.GmVehSpdArbn, ecu-extract-reference=COMPOSITIONTYPE.GmVehSpdArbn
      ComponentPrototype_044: upstream-reference=ECU_Composition.GmVehPwrMod, ecu-extract-reference=COMPOSITIONTYPE.GmVehPwrMod
      ComponentPrototype_045: upstream-reference=ECU_Composition.GmTqArbn, ecu-extract-reference=COMPOSITIONTYPE.GmTqArbn
      ComponentPrototype_046: upstream-reference=ECU_Composition.GmStrtStop, ecu-extract-reference=COMPOSITIONTYPE.GmStrtStop
      ComponentPrototype_047: upstream-reference=ECU_Composition.GmOvrlStMgr, ecu-extract-reference=COMPOSITIONTYPE.GmOvrlStMgr
      ComponentPrototype_049: upstream-reference=ECU_Composition.GmMsg3F1BusHiSpd, ecu-extract-reference=COMPOSITIONTYPE.GmMsg3F1BusHiSpd
      ComponentPrototype_051: upstream-reference=ECU_Composition.GmMsg34ABusHiSpd, ecu-extract-reference=COMPOSITIONTYPE.GmMsg34ABusHiSpd
      ComponentPrototype_052: upstream-reference=ECU_Composition.GmMsg34ABusChassisExp, ecu-extract-reference=COMPOSITIONTYPE.GmMsg34ABusChassisExp
      ComponentPrototype_053: upstream-reference=ECU_Composition.GmMsg348BusHiSpd, ecu-extract-reference=COMPOSITIONTYPE.GmMsg348BusHiSpd
      ComponentPrototype_054: upstream-reference=ECU_Composition.GmMsg348BusChassisExp, ecu-extract-reference=COMPOSITIONTYPE.GmMsg348BusChassisExp
      ComponentPrototype_055: upstream-reference=ECU_Composition.GmMsg337BusChassisExp, ecu-extract-reference=COMPOSITIONTYPE.GmMsg337BusChassisExp
      ComponentPrototype_056: upstream-reference=ECU_Composition.GmMsg335BusChassisExp, ecu-extract-reference=COMPOSITIONTYPE.GmMsg335BusChassisExp
      ComponentPrototype_057: upstream-reference=ECU_Composition.GmMsg232BusHiSpd, ecu-extract-reference=COMPOSITIONTYPE.GmMsg232BusHiSpd
      ComponentPrototype_058: upstream-reference=ECU_Composition.GmMsg214BusHiSpd, ecu-extract-reference=COMPOSITIONTYPE.GmMsg214BusHiSpd
      ComponentPrototype_059: upstream-reference=ECU_Composition.GmMsg1F5BusHiSpd, ecu-extract-reference=COMPOSITIONTYPE.GmMsg1F5BusHiSpd
      ComponentPrototype_060: upstream-reference=ECU_Composition.GmMsg1F1BusHiSpd, ecu-extract-reference=COMPOSITIONTYPE.GmMsg1F1BusHiSpd
      ComponentPrototype_061: upstream-reference=ECU_Composition.GmMsg1E9BusHiSpd, ecu-extract-reference=COMPOSITIONTYPE.GmMsg1E9BusHiSpd
      ComponentPrototype_062: upstream-reference=ECU_Composition.GmMsg1E5BusHiSpd, ecu-extract-reference=COMPOSITIONTYPE.GmMsg1E5BusHiSpd
      ComponentPrototype_063: upstream-reference=ECU_Composition.GmMsg1E5BusChassisExp, ecu-extract-reference=COMPOSITIONTYPE.GmMsg1E5BusChassisExp
      ComponentPrototype_064: upstream-reference=ECU_Composition.GmMsg1CABusChassisExp, ecu-extract-reference=COMPOSITIONTYPE.GmMsg1CABusChassisExp
      ComponentPrototype_065: upstream-reference=ECU_Composition.GmMsg184BusHiSpd, ecu-extract-reference=COMPOSITIONTYPE.GmMsg184BusHiSpd
      ComponentPrototype_066: upstream-reference=ECU_Composition.GmMsg182BusChassisExp, ecu-extract-reference=COMPOSITIONTYPE.GmMsg182BusChassisExp
      ComponentPrototype_067: upstream-reference=ECU_Composition.GmMsg180BusHiSpd, ecu-extract-reference=COMPOSITIONTYPE.GmMsg180BusHiSpd
      ComponentPrototype_068: upstream-reference=ECU_Composition.GmMsg180BusChassisExp, ecu-extract-reference=COMPOSITIONTYPE.GmMsg180BusChassisExp
      ComponentPrototype_069: upstream-reference=ECU_Composition.GmMsg17DBusHiSpd, ecu-extract-reference=COMPOSITIONTYPE.GmMsg17DBusHiSpd
      ComponentPrototype_071: upstream-reference=ECU_Composition.GmMsg0C9BusHiSpd, ecu-extract-reference=COMPOSITIONTYPE.GmMsg0C9BusHiSpd
      ComponentPrototype_073: upstream-reference=ECU_Composition.FltInj, ecu-extract-reference=COMPOSITIONTYPE.FltInj
      ComponentPrototype_074: upstream-reference=ECU_Composition.EotProtn, ecu-extract-reference=COMPOSITIONTYPE.EotProtn
      ComponentPrototype_075: upstream-reference=ECU_Composition.EotLrng, ecu-extract-reference=COMPOSITIONTYPE.EotLrng
      ComponentPrototype_076: upstream-reference=ECU_Composition.EcuTMeas, ecu-extract-reference=COMPOSITIONTYPE.EcuTMeas
      ComponentPrototype_077: upstream-reference=ECU_Composition.DutyCycThermProtn, ecu-extract-reference=COMPOSITIONTYPE.DutyCycThermProtn
      ComponentPrototype_078: upstream-reference=ECU_Composition.DiagcMgrProxyAppl6, ecu-extract-reference=COMPOSITIONTYPE.DiagcMgrProxyAppl6
      ComponentPrototype_079: upstream-reference=ECU_Composition.DiagcMgrProxyAppl10, ecu-extract-reference=COMPOSITIONTYPE.DiagcMgrProxyAppl10
      ComponentPrototype_080: upstream-reference=ECU_Composition.DiagcMgr, ecu-extract-reference=COMPOSITIONTYPE.DiagcMgr
      ComponentPrototype_082: upstream-reference=ECU_Composition.Dampg, ecu-extract-reference=COMPOSITIONTYPE.Dampg
      ComponentPrototype_083: upstream-reference=ECU_Composition.CustDiagc, ecu-extract-reference=COMPOSITIONTYPE.CustDiagc
      ComponentPrototype_084: upstream-reference=ECU_Composition.CurrMeasCorrln, ecu-extract-reference=COMPOSITIONTYPE.CurrMeasCorrln
      ComponentPrototype_085: upstream-reference=ECU_Composition.CmnMfgSrvIf, ecu-extract-reference=COMPOSITIONTYPE.CmnMfgSrvIf
      ComponentPrototype_086: upstream-reference=ECU_Composition.CmnMfgSrv, ecu-extract-reference=COMPOSITIONTYPE.CmnMfgSrv
      ComponentPrototype_087: upstream-reference=ECU_Composition.CDD_XcpIf, ecu-extract-reference=COMPOSITIONTYPE.CDD_XcpIf
      ComponentPrototype_088: upstream-reference=ECU_Composition.CDD_TSG31CfgAndUse, ecu-extract-reference=COMPOSITIONTYPE.CDD_TSG31CfgAndUse
      ComponentPrototype_089: upstream-reference=ECU_Composition.CDD_Tauj1CfgAndUse, ecu-extract-reference=COMPOSITIONTYPE.CDD_Tauj1CfgAndUse
      ComponentPrototype_090: upstream-reference=ECU_Composition.CDD_Tauj0CfgAndUse, ecu-extract-reference=COMPOSITIONTYPE.CDD_Tauj0CfgAndUse
      ComponentPrototype_091: upstream-reference=ECU_Composition.CDD_SyncCrc, ecu-extract-reference=COMPOSITIONTYPE.CDD_SyncCrc
      ComponentPrototype_092: upstream-reference=ECU_Composition.CDD_SnsrMeasStrt, ecu-extract-reference=COMPOSITIONTYPE.CDD_SnsrMeasStrt
      ComponentPrototype_093: upstream-reference=ECU_Composition.CDD_SinVltgGenn, ecu-extract-reference=COMPOSITIONTYPE.CDD_SinVltgGenn
      ComponentPrototype_094: upstream-reference=ECU_Composition.CDD_RamMem, ecu-extract-reference=COMPOSITIONTYPE.CDD_RamMem
      ComponentPrototype_095: upstream-reference=ECU_Composition.CDD_NxtrTi, ecu-extract-reference=COMPOSITIONTYPE.CDD_NxtrTi
      ComponentPrototype_096: upstream-reference=ECU_Composition.CDD_MotVel, ecu-extract-reference=COMPOSITIONTYPE.CDD_MotVel
      ComponentPrototype_097: upstream-reference=ECU_Composition.CDD_MotCurrRegVltgLimr, ecu-extract-reference=COMPOSITIONTYPE.CDD_MotCurrRegVltgLimr
      ComponentPrototype_098: upstream-reference=ECU_Composition.CDD_MotCtrlMgr, ecu-extract-reference=COMPOSITIONTYPE.CDD_MotCtrlMgr
      ComponentPrototype_099: upstream-reference=ECU_Composition.CDD_MotAgCmp, ecu-extract-reference=COMPOSITIONTYPE.CDD_MotAgCmp
      ComponentPrototype_100: upstream-reference=ECU_Composition.CDD_MotAgArbn, ecu-extract-reference=COMPOSITIONTYPE.CDD_MotAgArbn
      ComponentPrototype_101: upstream-reference=ECU_Composition.CDD_MotAg1Meas, ecu-extract-reference=COMPOSITIONTYPE.CDD_MotAg1Meas
      ComponentPrototype_102: upstream-reference=ECU_Composition.CDD_MotAg0Meas, ecu-extract-reference=COMPOSITIONTYPE.CDD_MotAg0Meas
      ComponentPrototype_103: upstream-reference=ECU_Composition.CDD_McuCoreCfgAndDiagc, ecu-extract-reference=COMPOSITIONTYPE.CDD_McuCoreCfgAndDiagc
      ComponentPrototype_104: upstream-reference=ECU_Composition.CDD_HwTq3Meas, ecu-extract-reference=COMPOSITIONTYPE.CDD_HwTq3Meas
      ComponentPrototype_105: upstream-reference=ECU_Composition.CDD_HwTq2Meas, ecu-extract-reference=COMPOSITIONTYPE.CDD_HwTq2Meas
      ComponentPrototype_106: upstream-reference=ECU_Composition.CDD_HwTq1Meas, ecu-extract-reference=COMPOSITIONTYPE.CDD_HwTq1Meas
      ComponentPrototype_107: upstream-reference=ECU_Composition.CDD_HwTq0Meas, ecu-extract-reference=COMPOSITIONTYPE.CDD_HwTq0Meas
      ComponentPrototype_108: upstream-reference=ECU_Composition.CDD_GuardCfgAndDiagc, ecu-extract-reference=COMPOSITIONTYPE.CDD_GuardCfgAndDiagc
      ComponentPrototype_109: upstream-reference=ECU_Composition.CDD_GmG2kcaMcuCfg, ecu-extract-reference=COMPOSITIONTYPE.CDD_GmG2kcaMcuCfg
      ComponentPrototype_110: upstream-reference=ECU_Composition.CDD_GMLANSdl, ecu-extract-reference=COMPOSITIONTYPE.CDD_GMLANSdl
      ComponentPrototype_111: upstream-reference=ECU_Composition.CDD_FlsMem, ecu-extract-reference=COMPOSITIONTYPE.CDD_FlsMem
      ComponentPrototype_112: upstream-reference=ECU_Composition.CDD_ExcpnHndlg, ecu-extract-reference=COMPOSITIONTYPE.CDD_ExcpnHndlg
      ComponentPrototype_113: upstream-reference=ECU_Composition.CDD_EcmOutpAndDiagc, ecu-extract-reference=COMPOSITIONTYPE.CDD_EcmOutpAndDiagc
      ComponentPrototype_114: upstream-reference=ECU_Composition.CDD_DmaCfgAndUse, ecu-extract-reference=COMPOSITIONTYPE.CDD_DmaCfgAndUse
      ComponentPrototype_115: upstream-reference=ECU_Composition.CDD_CurrMeasArbn, ecu-extract-reference=COMPOSITIONTYPE.CDD_CurrMeasArbn
      ComponentPrototype_116: upstream-reference=ECU_Composition.CDD_CurrMeas, ecu-extract-reference=COMPOSITIONTYPE.CDD_CurrMeas
      ComponentPrototype_117: upstream-reference=ECU_Composition.CDD_ChkPtAppl6, ecu-extract-reference=COMPOSITIONTYPE.CDD_ChkPtAppl6
      ComponentPrototype_118: upstream-reference=ECU_Composition.CDD_ChkPtAppl10, ecu-extract-reference=COMPOSITIONTYPE.CDD_ChkPtAppl10
      ComponentPrototype_119: upstream-reference=ECU_Composition.CDD_Adc1CfgAndUse, ecu-extract-reference=COMPOSITIONTYPE.CDD_Adc1CfgAndUse
      ComponentPrototype_120: upstream-reference=ECU_Composition.CDD_Adc0CfgAndUse, ecu-extract-reference=COMPOSITIONTYPE.CDD_Adc0CfgAndUse
      ComponentPrototype_121: upstream-reference=ECU_Composition.CalRegn03Rt00GroupB, ecu-extract-reference=COMPOSITIONTYPE.CalRegn03Rt00GroupB
      ComponentPrototype_122: upstream-reference=ECU_Composition.CalRegn03Rt00GroupA, ecu-extract-reference=COMPOSITIONTYPE.CalRegn03Rt00GroupA
      ComponentPrototype_124: upstream-reference=ECU_Composition.CalRegn03Inin00GroupA, ecu-extract-reference=COMPOSITIONTYPE.CalRegn03Inin00GroupA
      ComponentPrototype_125: upstream-reference=ECU_Composition.CalRegn03Inin00, ecu-extract-reference=COMPOSITIONTYPE.CalRegn03Inin00
      ComponentPrototype_126: upstream-reference=ECU_Composition.CalRegn03CmnGroupA, ecu-extract-reference=COMPOSITIONTYPE.CalRegn03CmnGroupA
      ComponentPrototype_127: upstream-reference=ECU_Composition.CalRegn03Cmn, ecu-extract-reference=COMPOSITIONTYPE.CalRegn03Cmn
      ComponentPrototype_129: upstream-reference=ECU_Composition.CalRegn02Cmn, ecu-extract-reference=COMPOSITIONTYPE.CalRegn02Cmn
      ComponentPrototype_131: upstream-reference=ECU_Composition.CalRegn01Rt00, ecu-extract-reference=COMPOSITIONTYPE.CalRegn01Rt00
      ComponentPrototype_133: upstream-reference=ECU_Composition.CalRegn01Inin00GroupB, ecu-extract-reference=COMPOSITIONTYPE.CalRegn01Inin00GroupB
      ComponentPrototype_135: upstream-reference=ECU_Composition.CalRegn01Inin00, ecu-extract-reference=COMPOSITIONTYPE.CalRegn01Inin00
      ComponentPrototype_137: upstream-reference=ECU_Composition.CalRegn01CmnGroupB, ecu-extract-reference=COMPOSITIONTYPE.CalRegn01CmnGroupB
      ComponentPrototype_138: upstream-reference=ECU_Composition.CalRegn01Cmn, ecu-extract-reference=COMPOSITIONTYPE.CalRegn01Cmn
      ComponentPrototype_139: upstream-reference=ECU_Composition.BattVltgCorrln, ecu-extract-reference=COMPOSITIONTYPE.BattVltgCorrln
      ComponentPrototype_140: upstream-reference=ECU_Composition.BattVltg, ecu-extract-reference=COMPOSITIONTYPE.BattVltg
      ComponentPrototype_141: upstream-reference=ECU_Composition.AssiSumLim, ecu-extract-reference=COMPOSITIONTYPE.AssiSumLim
      ComponentPrototype_143: upstream-reference=ECU_Composition.AssiHiFrq, ecu-extract-reference=COMPOSITIONTYPE.AssiHiFrq
      ComponentPrototype_144: upstream-reference=ECU_Composition.Assi, ecu-extract-reference=COMPOSITIONTYPE.Assi
      AssemblySwConnector_001: ecu-extract-reference=AssiDAssiCmdBasDDampgDAssiCmdBas
      AssemblySwConnector_002: ecu-extract-reference=AssiDAssiCmdBasDHysCmpDAssiCmdBas
      AssemblySwConnector_003: ecu-extract-reference=AssiDAssiCmdBasDInertiaCmpVelDAssiCmdBas
      AssemblySwConnector_006: ecu-extract-reference=AssiSumLimDSetManTqCmdDCmnMfgSrvDSetManTqCmd
      AssemblySwConnector_007: ecu-extract-reference=AssiSumLimDMotTqCmdLimdPreStallDHiLoadStallLimrDMotTqCmdLimdPreStall
      AssemblySwConnector_009: ecu-extract-reference=BattVltgDBrdgVltgDCDD_CurrMeasDBrdgVltg
      AssemblySwConnector_010: ecu-extract-reference=BattVltgDBrdgVltgDCDD_MotCtrlMgrDBrdgVltg
      AssemblySwConnector_011: ecu-extract-reference=BattVltgDBrdgVltgDMotRefMdlDBrdgVltg
      AssemblySwConnector_012: ecu-extract-reference=BattVltgDBrdgVltgDPwrLimrDBrdgVltg
      AssemblySwConnector_013: ecu-extract-reference=BattVltgCorrlnDBattSwdVltgCorrlnStsDBattVltgDBattSwdVltgCorrlnSts
      AssemblySwConnector_014: ecu-extract-reference=CalRegn01CmnDAssiSumLimNtc0x0C4FailStepDAssiSumLimDAssiSumLimNtc0x0C4FailStep
      AssemblySwConnector_015: ecu-extract-reference=CalRegn01CmnDAssiSumLimNtc0x0C4PassStepDAssiSumLimDAssiSumLimNtc0x0C4PassStep
      AssemblySwConnector_016: ecu-extract-reference=CalRegn01CmnDAssiSumLimPullCmpLimDAssiSumLimDAssiSumLimPullCmpLim
      AssemblySwConnector_017: ecu-extract-reference=CalRegn01CmnDBattVltgSwdMaxDBattVltgDBattVltgSwdMax
      AssemblySwConnector_018: ecu-extract-reference=CalRegn01CmnDBattVltgCorrlnAllwdVltgDifDBattVltgCorrlnDBattVltgCorrlnAllwdVltgDif
      AssemblySwConnector_019: ecu-extract-reference=CalRegn01CmnDBattVltgCorrlnBattLoVltgDBattVltgCorrlnDBattVltgCorrlnBattLoVltg
      AssemblySwConnector_020: ecu-extract-reference=CalRegn01CmnDBattVltgCorrlnBattOverVltgDBattVltgCorrlnDBattVltgCorrlnBattOverVltg
      AssemblySwConnector_021: ecu-extract-reference=CalRegn01CmnDBattVltgCorrlnBattUnderVltgDBattVltgCorrlnDBattVltgCorrlnBattUnderVltg
      AssemblySwConnector_022: ecu-extract-reference=CalRegn01CmnDBattVltgCorrlnNtc0x03C0x0440x04CFailStepDBattVltgCorrlnDBattVltgCorrlnNtc0x03C0x0440x04CFailStep
      AssemblySwConnector_023: ecu-extract-reference=CalRegn01CmnDBattVltgCorrlnNtc0x03C0x0440x04CPassStepDBattVltgCorrlnDBattVltgCorrlnNtc0x03C0x0440x04CPassStep
      AssemblySwConnector_024: ecu-extract-reference=CalRegn01CmnDBattVltgCorrlnNtc0x0B0FailStepDBattVltgCorrlnDBattVltgCorrlnNtc0x0B0FailStep
      AssemblySwConnector_025: ecu-extract-reference=CalRegn01CmnDBattVltgCorrlnNtc0x0B0PassStepDBattVltgCorrlnDBattVltgCorrlnNtc0x0B0PassStep
      AssemblySwConnector_026: ecu-extract-reference=CalRegn01CmnDBattVltgCorrlnNtc0x0B1FailStepDBattVltgCorrlnDBattVltgCorrlnNtc0x0B1FailStep
      AssemblySwConnector_027: ecu-extract-reference=CalRegn01CmnDBattVltgCorrlnNtc0x0B1PassStepDBattVltgCorrlnDBattVltgCorrlnNtc0x0B1PassStep
      AssemblySwConnector_028: ecu-extract-reference=CalRegn01CmnDBattVltgCorrlnNtc0x0B5FailStepDBattVltgCorrlnDBattVltgCorrlnNtc0x0B5FailStep
      AssemblySwConnector_029: ecu-extract-reference=CalRegn01CmnDBattVltgCorrlnNtc0x0B5PassStepDBattVltgCorrlnDBattVltgCorrlnNtc0x0B5PassStep
      AssemblySwConnector_030: ecu-extract-reference=CalRegn01CmnDBattVltgCorrlnRcvrlBattLoVltgDBattVltgCorrlnDBattVltgCorrlnRcvrlBattLoVltg
      AssemblySwConnector_031: ecu-extract-reference=CalRegn01CmnDBattVltgCorrlnRcvrlBattOverVltgDBattVltgCorrlnDBattVltgCorrlnRcvrlBattOverVltg
      AssemblySwConnector_032: ecu-extract-reference=CalRegn01CmnDBattVltgCorrlnRcvrlBattUnderVltgDBattVltgCorrlnDBattVltgCorrlnRcvrlBattUnderVltg
      AssemblySwConnector_033: ecu-extract-reference=CalRegn01CmnDBattVltgSwdMaxDBattVltgCorrlnDBattVltgSwdMax
      AssemblySwConnector_034: ecu-extract-reference=CalRegn01CmnDCurrMeasEolFixdPwmPerdDCDD_CurrMeasDCurrMeasEolFixdPwmPerd
      AssemblySwConnector_035: ecu-extract-reference=CalRegn01CmnDCurrMeasEolGainMaxDCDD_CurrMeasDCurrMeasEolGainMax
      AssemblySwConnector_036: ecu-extract-reference=CalRegn01CmnDCurrMeasEolGainMinDCDD_CurrMeasDCurrMeasEolGainMin
      AssemblySwConnector_037: ecu-extract-reference=CalRegn01CmnDCurrMeasEolGainNrOfSampleDCDD_CurrMeasDCurrMeasEolGainNrOfSample
      AssemblySwConnector_038: ecu-extract-reference=CalRegn01CmnDCurrMeasEolGainNumerDCDD_CurrMeasDCurrMeasEolGainNumer
      AssemblySwConnector_039: ecu-extract-reference=CalRegn01CmnDCurrMeasEolMaxMotVelDCDD_CurrMeasDCurrMeasEolMaxMotVel
      AssemblySwConnector_040: ecu-extract-reference=CalRegn01CmnDCurrMeasEolOffsHiBrdgVltgMinDCDD_CurrMeasDCurrMeasEolOffsHiBrdgVltgMin
      AssemblySwConnector_041: ecu-extract-reference=CalRegn01CmnDCurrMeasEolOffsHiCmuOffsDCDD_CurrMeasDCurrMeasEolOffsHiCmuOffs
      AssemblySwConnector_042: ecu-extract-reference=CalRegn01CmnDCurrMeasEolOffsLoCmuOffsDCDD_CurrMeasDCurrMeasEolOffsLoCmuOffs
      AssemblySwConnector_043: ecu-extract-reference=CalRegn01CmnDCurrMeasEolOffsMaxDCDD_CurrMeasDCurrMeasEolOffsMax
      AssemblySwConnector_044: ecu-extract-reference=CalRegn01CmnDCurrMeasEolOffsMinDCDD_CurrMeasDCurrMeasEolOffsMin
      AssemblySwConnector_045: ecu-extract-reference=CalRegn01CmnDCurrMeasEolOffsNrOfSampleDCDD_CurrMeasDCurrMeasEolOffsNrOfSample
      AssemblySwConnector_046: ecu-extract-reference=CalRegn01CmnDCurrMeasEolTranCntrThdDCDD_CurrMeasDCurrMeasEolTranCntrThd
      AssemblySwConnector_047: ecu-extract-reference=CalRegn01CmnDCurrMeasMinRqrdPhaOnTiDCDD_CurrMeasDCurrMeasMinRqrdPhaOnTi
      AssemblySwConnector_048: ecu-extract-reference=CalRegn01CmnDCurrMeasMotAgCompuDlyDCDD_CurrMeasDCurrMeasMotAgCompuDly
      AssemblySwConnector_051: ecu-extract-reference=CalRegn01CmnDCurrMeasMotCurrAdcVlyWrmIninMaxDCDD_CurrMeasDCurrMeasMotCurrAdcVlyWrmIninMax
      AssemblySwConnector_052: ecu-extract-reference=CalRegn01CmnDCurrMeasMotCurrAdcVlyWrmIninMinDCDD_CurrMeasDCurrMeasMotCurrAdcVlyWrmIninMin
      AssemblySwConnector_053: ecu-extract-reference=CalRegn01CmnDCurrMeasNtc0x05DFailStepDCDD_CurrMeasDCurrMeasNtc0x05DFailStep
      AssemblySwConnector_054: ecu-extract-reference=CalRegn01CmnDCurrMeasNtc0x05DPassStepDCDD_CurrMeasDCurrMeasNtc0x05DPassStep
      AssemblySwConnector_055: ecu-extract-reference=CalRegn01CmnDCurrMeasNtc0x06DFailStepDCDD_CurrMeasDCurrMeasNtc0x06DFailStep
      AssemblySwConnector_056: ecu-extract-reference=CalRegn01CmnDCurrMeasNtc0x06DPassStepDCDD_CurrMeasDCurrMeasNtc0x06DPassStep
      AssemblySwConnector_061: ecu-extract-reference=CalRegn01CmnDCurrMeasArbnMaxStallCntrDCDD_CurrMeasArbnDCurrMeasArbnMaxStallCntr
      AssemblySwConnector_063: ecu-extract-reference=CalRegn01CmnDMotCurrRegCfgMotRVirtDaxDCDD_MotCurrRegVltgLimrDMotCurrRegCfgMotRVirtDax
      AssemblySwConnector_064: ecu-extract-reference=CalRegn01CmnDMotCurrRegCfgMotRVirtQaxDCDD_MotCurrRegVltgLimrDMotCurrRegCfgMotRVirtQax
      AssemblySwConnector_065: ecu-extract-reference=CalRegn01CmnDMotCurrRegVltgLimrCurrLoaScarSlewRateDCDD_MotCurrRegVltgLimrDMotCurrRegVltgLimrCurrLoaScarSlewRate
      AssemblySwConnector_066: ecu-extract-reference=CalRegn01CmnDMotCurrRegVltgLimrDaxAntiWdupCoeffDCDD_MotCurrRegVltgLimrDMotCurrRegVltgLimrDaxAntiWdupCoeff
      AssemblySwConnector_067: ecu-extract-reference=CalRegn01CmnDMotCurrRegVltgLimrIvtrLoaScarSlewRateDCDD_MotCurrRegVltgLimrDMotCurrRegVltgLimrIvtrLoaScarSlewRate
      AssemblySwConnector_068: ecu-extract-reference=CalRegn01CmnDMotCurrRegVltgLimrQaxAntiWdupCoeffDCDD_MotCurrRegVltgLimrDMotCurrRegVltgLimrQaxAntiWdupCoeff
      AssemblySwConnector_069: ecu-extract-reference=CalRegn01CmnDMotCurrRegVltgLimrQaxAntiWdupScagDiDCDD_MotCurrRegVltgLimrDMotCurrRegVltgLimrQaxAntiWdupScagDi
      AssemblySwConnector_070: ecu-extract-reference=CalRegn01CmnDMotRefMdlFbCtrlDiDCDD_MotCurrRegVltgLimrDMotRefMdlFbCtrlDi
      AssemblySwConnector_071: ecu-extract-reference=CalRegn01CmnDMotRefMdlIvtrDeadTiBrdgVltgScaDCDD_MotCurrRegVltgLimrDMotRefMdlIvtrDeadTiBrdgVltgSca
      AssemblySwConnector_073: ecu-extract-reference=CalRegn01CmnDCurrMeasEolFixdPwmPerdDCDD_TSG31CfgAndUseDCurrMeasEolFixdPwmPerd
      AssemblySwConnector_074: ecu-extract-reference=CalRegn01CmnDCurrMeasEolOffsHiCmuOffsDCDD_TSG31CfgAndUseDCurrMeasEolOffsHiCmuOffs
      AssemblySwConnector_075: ecu-extract-reference=CalRegn01CmnDCurrMeasEolOffsLoCmuOffsDCDD_TSG31CfgAndUseDCurrMeasEolOffsLoCmuOffs
      AssemblySwConnector_076: ecu-extract-reference=CalRegn01CmnDTSG31CfgAndUseAdcStrtOfCnvn2OffsDCDD_TSG31CfgAndUseDTSG31CfgAndUseAdcStrtOfCnvn2Offs
      AssemblySwConnector_077: ecu-extract-reference=CalRegn01CmnDTSG31CfgAndUseAdcStrtOfCnvnMotCtrlPeakOffsDCDD_TSG31CfgAndUseDTSG31CfgAndUseAdcStrtOfCnvnMotCtrlPeakOffs
      AssemblySwConnector_078: ecu-extract-reference=CalRegn01CmnDTSG31CfgAndUseAdcStrtOfCnvnMotCtrlVlyOffsDCDD_TSG31CfgAndUseDTSG31CfgAndUseAdcStrtOfCnvnMotCtrlVlyOffs
      AssemblySwConnector_079: ecu-extract-reference=CalRegn01CmnDTSG31CfgAndUseMtrAg0SPIStartDCDD_TSG31CfgAndUseDTSG31CfgAndUseMtrAg0SPIStart
      AssemblySwConnector_080: ecu-extract-reference=CalRegn01CmnDTSG31CfgAndUsePwmDbndDCDD_TSG31CfgAndUseDTSG31CfgAndUsePwmDbnd
      AssemblySwConnector_082: ecu-extract-reference=CalRegn01CmnDCmnMfgSrvSecuAcsAtmptTiOutDCmnMfgSrvDCmnMfgSrvSecuAcsAtmptTiOut
      AssemblySwConnector_083: ecu-extract-reference=CalRegn01CmnDCmnMfgSrvSecuAcsMaxNrAtmptDCmnMfgSrvDCmnMfgSrvSecuAcsMaxNrAtmpt
      AssemblySwConnector_084: ecu-extract-reference=CalRegn01CmnDCurrMeasCorrlnMaxErrCurrDCurrMeasCorrlnDCurrMeasCorrlnMaxErrCurr
      AssemblySwConnector_085: ecu-extract-reference=CalRegn01CmnDCurrMeasCorrlnMaxStallCntrDCurrMeasCorrlnDCurrMeasCorrlnMaxStallCntr
      AssemblySwConnector_086: ecu-extract-reference=CalRegn01CmnDCurrMeasCorrlnNtc0x04DFailStepDCurrMeasCorrlnDCurrMeasCorrlnNtc0x04DFailStep
      AssemblySwConnector_087: ecu-extract-reference=CalRegn01CmnDCurrMeasCorrlnNtc0x04DPassStepDCurrMeasCorrlnDCurrMeasCorrlnNtc0x04DPassStep
      AssemblySwConnector_088: ecu-extract-reference=CalRegn01CmnDCurrMeasCorrlnNtc0x04EFailStepDCurrMeasCorrlnDCurrMeasCorrlnNtc0x04EFailStep
      AssemblySwConnector_089: ecu-extract-reference=CalRegn01CmnDCurrMeasCorrlnNtc0x04EPassStepDCurrMeasCorrlnDCurrMeasCorrlnNtc0x04EPassStep
      AssemblySwConnector_090: ecu-extract-reference=CalRegn01CmnDDutyCycThermProtnAbsltCtrlTTblXDDutyCycThermProtnDDutyCycThermProtnAbsltCtrlTTblX
      AssemblySwConnector_091: ecu-extract-reference=CalRegn01CmnDDutyCycThermProtnAbsltCtrlTTqTblYDDutyCycThermProtnDDutyCycThermProtnAbsltCtrlTTqTblY
      AssemblySwConnector_092: ecu-extract-reference=CalRegn01CmnDDutyCycThermProtnAbsltCuTTblXDDutyCycThermProtnDDutyCycThermProtnAbsltCuTTblX
      AssemblySwConnector_093: ecu-extract-reference=CalRegn01CmnDDutyCycThermProtnAbsltCuTTqTblYDDutyCycThermProtnDDutyCycThermProtnAbsltCuTTqTblY
      AssemblySwConnector_094: ecu-extract-reference=CalRegn01CmnDDutyCycThermProtnAbsltMotVelBreakPtDDutyCycThermProtnDDutyCycThermProtnAbsltMotVelBreakPt
      AssemblySwConnector_095: ecu-extract-reference=CalRegn01CmnDDutyCycThermProtnAbsltTTqSlewHiLimDDutyCycThermProtnDDutyCycThermProtnAbsltTTqSlewHiLim
      AssemblySwConnector_096: ecu-extract-reference=CalRegn01CmnDDutyCycThermProtnAbsltTTqSlewLoLimDDutyCycThermProtnDDutyCycThermProtnAbsltTTqSlewLoLim
      AssemblySwConnector_097: ecu-extract-reference=CalRegn01CmnDDutyCycThermProtnCtrlTDDutyCycThermProtnDDutyCycThermProtnCtrlT
      AssemblySwConnector_098: ecu-extract-reference=CalRegn01CmnDDutyCycThermProtnCtrlTSelnDDutyCycThermProtnDDutyCycThermProtnCtrlTSeln
      AssemblySwConnector_100: ecu-extract-reference=CalRegn01CmnDDutyCycThermProtnDutyCycFildThdDDutyCycThermProtnDDutyCycThermProtnDutyCycFildThd
      AssemblySwConnector_101: ecu-extract-reference=CalRegn01CmnDDutyCycThermProtnIgnOffCtrlEnaDDutyCycThermProtnDDutyCycThermProtnIgnOffCtrlEna
      AssemblySwConnector_102: ecu-extract-reference=CalRegn01CmnDDutyCycThermProtnIgnOffMsgWaitTiDDutyCycThermProtnDDutyCycThermProtnIgnOffMsgWaitTi
      AssemblySwConnector_103: ecu-extract-reference=CalRegn01CmnDDutyCycThermProtnLstTblValNonStallDDutyCycThermProtnDDutyCycThermProtnLstTblValNonStall
      AssemblySwConnector_104: ecu-extract-reference=CalRegn01CmnDDutyCycThermProtnLstTblValStallDDutyCycThermProtnDDutyCycThermProtnLstTblValStall
      AssemblySwConnector_105: ecu-extract-reference=CalRegn01CmnDDutyCycThermProtnMotPrTSelnDDutyCycThermProtnDDutyCycThermProtnMotPrTSeln
      AssemblySwConnector_106: ecu-extract-reference=CalRegn01CmnDDutyCycThermProtnMplr1NonStallTblYDDutyCycThermProtnDDutyCycThermProtnMplr1NonStallTblY
      AssemblySwConnector_107: ecu-extract-reference=CalRegn01CmnDDutyCycThermProtnMplr1StallTblYDDutyCycThermProtnDDutyCycThermProtnMplr1StallTblY
      AssemblySwConnector_108: ecu-extract-reference=CalRegn01CmnDDutyCycThermProtnMplr2NonStallTblYDDutyCycThermProtnDDutyCycThermProtnMplr2NonStallTblY
      AssemblySwConnector_109: ecu-extract-reference=CalRegn01CmnDDutyCycThermProtnMplr2StallTblYDDutyCycThermProtnDDutyCycThermProtnMplr2StallTblY
      AssemblySwConnector_110: ecu-extract-reference=CalRegn01CmnDDutyCycThermProtnMplr3NonStallTblYDDutyCycThermProtnDDutyCycThermProtnMplr3NonStallTblY
      AssemblySwConnector_111: ecu-extract-reference=CalRegn01CmnDDutyCycThermProtnMplr3StallTblYDDutyCycThermProtnDDutyCycThermProtnMplr3StallTblY
      AssemblySwConnector_112: ecu-extract-reference=CalRegn01CmnDDutyCycThermProtnMplr4NonStallTblYDDutyCycThermProtnDDutyCycThermProtnMplr4NonStallTblY
      AssemblySwConnector_113: ecu-extract-reference=CalRegn01CmnDDutyCycThermProtnMplr4StallTblYDDutyCycThermProtnDDutyCycThermProtnMplr4StallTblY
      AssemblySwConnector_114: ecu-extract-reference=CalRegn01CmnDDutyCycThermProtnMplr5NonStallTblYDDutyCycThermProtnDDutyCycThermProtnMplr5NonStallTblY
      AssemblySwConnector_115: ecu-extract-reference=CalRegn01CmnDDutyCycThermProtnMplr5StallTblYDDutyCycThermProtnDDutyCycThermProtnMplr5StallTblY
      AssemblySwConnector_116: ecu-extract-reference=CalRegn01CmnDDutyCycThermProtnMplr6NonStallTblYDDutyCycThermProtnDDutyCycThermProtnMplr6NonStallTblY
      AssemblySwConnector_117: ecu-extract-reference=CalRegn01CmnDDutyCycThermProtnMplr6StallTblYDDutyCycThermProtnDDutyCycThermProtnMplr6StallTblY
      AssemblySwConnector_118: ecu-extract-reference=CalRegn01CmnDDutyCycThermProtnMplrTblXDDutyCycThermProtnDDutyCycThermProtnMplrTblX
      AssemblySwConnector_119: ecu-extract-reference=CalRegn01CmnDDutyCycThermProtnMplrTSelnDDutyCycThermProtnDDutyCycThermProtnMplrTSeln
      AssemblySwConnector_120: ecu-extract-reference=CalRegn01CmnDDutyCycThermProtnSlowFilTSelnDDutyCycThermProtnDDutyCycThermProtnSlowFilTSeln
      AssemblySwConnector_121: ecu-extract-reference=CalRegn01CmnDDutyCycThermProtnThermLoadLimTblXDDutyCycThermProtnDDutyCycThermProtnThermLoadLimTblX
      AssemblySwConnector_122: ecu-extract-reference=CalRegn01CmnDDutyCycThermProtnThermLoadLimTblYDDutyCycThermProtnDDutyCycThermProtnThermLoadLimTblY
      AssemblySwConnector_123: ecu-extract-reference=CalRegn01CmnDDutyCycThermProtnTqCmdSlewDwnDDutyCycThermProtnDDutyCycThermProtnTqCmdSlewDwn
      AssemblySwConnector_124: ecu-extract-reference=CalRegn01CmnDDutyCycThermProtnTqCmdSlewUpDDutyCycThermProtnDDutyCycThermProtnTqCmdSlewUp
      AssemblySwConnector_125: ecu-extract-reference=CalRegn01CmnDEcuTMeasDftTDEcuTMeasDEcuTMeasDftT
      AssemblySwConnector_126: ecu-extract-reference=CalRegn01CmnDEcuTMeasFilTauDEcuTMeasDEcuTMeasFilTau
      AssemblySwConnector_127: ecu-extract-reference=CalRegn01CmnDEcuTMeasNtc0x045FailStepDEcuTMeasDEcuTMeasNtc0x045FailStep
      AssemblySwConnector_128: ecu-extract-reference=CalRegn01CmnDEcuTMeasNtc0x045PassStepDEcuTMeasDEcuTMeasNtc0x045PassStep
      AssemblySwConnector_129: ecu-extract-reference=CalRegn01CmnDEcuTMeasRngDiagcMaxDEcuTMeasDEcuTMeasRngDiagcMax
      AssemblySwConnector_130: ecu-extract-reference=CalRegn01CmnDEcuTMeasRngDiagcMinDEcuTMeasDEcuTMeasRngDiagcMin
      AssemblySwConnector_131: ecu-extract-reference=CalRegn01CmnDEcuTMeasScagDEcuTMeasDEcuTMeasScag
      AssemblySwConnector_132: ecu-extract-reference=CalRegn01CmnDEcuTMeasScagOffsDEcuTMeasDEcuTMeasScagOffs
      AssemblySwConnector_158: ecu-extract-reference=CalRegn01CmnDGmMsg0C9BusHiSpdInvldTiOutDGmMsg0C9BusHiSpdDGmMsg0C9BusHiSpdInvldTiOut
      AssemblySwConnector_159: ecu-extract-reference=CalRegn01CmnDGmMsg0C9BusHiSpdMissTiOutDGmMsg0C9BusHiSpdDGmMsg0C9BusHiSpdMissTiOut
      AssemblySwConnector_160: ecu-extract-reference=CalRegn01CmnDGmMsg0C9BusHiSpdVehSpdThdDGmMsg0C9BusHiSpdDGmMsg0C9BusHiSpdVehSpdThd
      AssemblySwConnector_161: ecu-extract-reference=CalRegn01CmnDGmMsg17DBusHiSpdInvldTiOutDGmMsg17DBusHiSpdDGmMsg17DBusHiSpdInvldTiOut
      AssemblySwConnector_162: ecu-extract-reference=CalRegn01CmnDGmMsg17DBusHiSpdMissTiOutDGmMsg17DBusHiSpdDGmMsg17DBusHiSpdMissTiOut
      AssemblySwConnector_163: ecu-extract-reference=CalRegn01CmnDGmMsg180BusChassisExpInvldProtnValTiOutDGmMsg180BusChassisExpDGmMsg180BusChassisExpInvldProtnValTiOut
      AssemblySwConnector_164: ecu-extract-reference=CalRegn01CmnDGmMsg180BusChassisExpMissTiOutDGmMsg180BusChassisExpDGmMsg180BusChassisExpMissTiOut
      AssemblySwConnector_165: ecu-extract-reference=CalRegn01CmnDGmMsg180BusChassisExpRollgCntrInvldTiOutDGmMsg180BusChassisExpDGmMsg180BusChassisExpRollgCntrInvldTiOut
      AssemblySwConnector_166: ecu-extract-reference=CalRegn01CmnDGmMsg180BusChassisExpTqPolarityDGmMsg180BusChassisExpDGmMsg180BusChassisExpTqPolarity
      AssemblySwConnector_167: ecu-extract-reference=CalRegn01CmnDGmMsg180BusHiSpdCrcInvldTiOutDGmMsg180BusHiSpdDGmMsg180BusHiSpdCrcInvldTiOut
      AssemblySwConnector_168: ecu-extract-reference=CalRegn01CmnDGmMsg180BusHiSpdMissTiOutDGmMsg180BusHiSpdDGmMsg180BusHiSpdMissTiOut
      AssemblySwConnector_169: ecu-extract-reference=CalRegn01CmnDGmMsg180BusHiSpdRollgCntrInvldTiOutDGmMsg180BusHiSpdDGmMsg180BusHiSpdRollgCntrInvldTiOut
      AssemblySwConnector_170: ecu-extract-reference=CalRegn01CmnDGmMsg180BusHiSpdTqPolarityDGmMsg180BusHiSpdDGmMsg180BusHiSpdTqPolarity
      AssemblySwConnector_171: ecu-extract-reference=CalRegn01CmnDGmMsg182BusChassisExpInvldTiOutDGmMsg182BusChassisExpDGmMsg182BusChassisExpInvldTiOut
      AssemblySwConnector_172: ecu-extract-reference=CalRegn01CmnDGmMsg182BusChassisExpMissTiOutDGmMsg182BusChassisExpDGmMsg182BusChassisExpMissTiOut
      AssemblySwConnector_173: ecu-extract-reference=CalRegn01CmnDGmMsg184BusHiSpdHandsOnThdDGmMsg184BusHiSpdDGmMsg184BusHiSpdHandsOnThd
      AssemblySwConnector_174: ecu-extract-reference=CalRegn01CmnDGmMsg184BusHiSpdTqPolarityDGmMsg184BusHiSpdDGmMsg184BusHiSpdTqPolarity
      AssemblySwConnector_175: ecu-extract-reference=CalRegn01CmnDGmMsg1CaBusChassisExpTqPolarityDGmMsg1CABusChassisExpDGmMsg1CaBusChassisExpTqPolarity
      AssemblySwConnector_176: ecu-extract-reference=CalRegn01CmnDGmMsg1E9BusHiSpdAbsFaildTiOutDGmMsg1E9BusHiSpdDGmMsg1E9BusHiSpdAbsFaildTiOut
      AssemblySwConnector_177: ecu-extract-reference=CalRegn01CmnDGmMsg1E9BusHiSpdLatADftDGmMsg1E9BusHiSpdDGmMsg1E9BusHiSpdLatADft
      AssemblySwConnector_178: ecu-extract-reference=CalRegn01CmnDGmMsg1E9BusHiSpdLatAInvldTiOutDGmMsg1E9BusHiSpdDGmMsg1E9BusHiSpdLatAInvldTiOut
      AssemblySwConnector_179: ecu-extract-reference=CalRegn01CmnDGmMsg1E9BusHiSpdMissTiOutDGmMsg1E9BusHiSpdDGmMsg1E9BusHiSpdMissTiOut
      AssemblySwConnector_180: ecu-extract-reference=CalRegn01CmnDGmMsg1E9BusHiSpdTcsDisadTiOutDGmMsg1E9BusHiSpdDGmMsg1E9BusHiSpdTcsDisadTiOut
      AssemblySwConnector_181: ecu-extract-reference=CalRegn01CmnDGmMsg1E9BusHiSpdVehDynCtrlStTiOutDGmMsg1E9BusHiSpdDGmMsg1E9BusHiSpdVehDynCtrlStTiOut
      AssemblySwConnector_182: ecu-extract-reference=CalRegn01CmnDGmMsg1E9BusHiSpdVehStabyEnhmtActvVldTiOutDGmMsg1E9BusHiSpdDGmMsg1E9BusHiSpdVehStabyEnhmtActvVldTiOut
      AssemblySwConnector_183: ecu-extract-reference=CalRegn01CmnDGmMsg1E9BusHiSpdYawRateDftDGmMsg1E9BusHiSpdDGmMsg1E9BusHiSpdYawRateDft
      AssemblySwConnector_184: ecu-extract-reference=CalRegn01CmnDGmMsg1E9BusHiSpdYawRateInvldTiOutDGmMsg1E9BusHiSpdDGmMsg1E9BusHiSpdYawRateInvldTiOut
      AssemblySwConnector_185: ecu-extract-reference=CalRegn01CmnDGmMsg1F1BusHiSpdMissTiOutDGmMsg1F1BusHiSpdDGmMsg1F1BusHiSpdMissTiOut
      AssemblySwConnector_186: ecu-extract-reference=CalRegn01CmnDGmMsg1F5BusHiSpdInvldTiOutDGmMsg1F5BusHiSpdDGmMsg1F5BusHiSpdInvldTiOut
      AssemblySwConnector_187: ecu-extract-reference=CalRegn01CmnDGmMsg1F5BusHiSpdMissTiOutDGmMsg1F5BusHiSpdDGmMsg1F5BusHiSpdMissTiOut
      AssemblySwConnector_188: ecu-extract-reference=CalRegn01CmnDGmMsg214BusHiSpdAbsActvProtdProtnValInvldTiOutDGmMsg214BusHiSpdDGmMsg214BusHiSpdAbsActvProtdProtnValInvldTiOut
      AssemblySwConnector_189: ecu-extract-reference=CalRegn01CmnDGmMsg214BusHiSpdAbsActvProtdRollgCntrInvldTiOutDGmMsg214BusHiSpdDGmMsg214BusHiSpdAbsActvProtdRollgCntrInvldTiOut
      AssemblySwConnector_190: ecu-extract-reference=CalRegn01CmnDGmMsg214BusHiSpdMissTiOutDGmMsg214BusHiSpdDGmMsg214BusHiSpdMissTiOut
      AssemblySwConnector_191: ecu-extract-reference=CalRegn01CmnDGmMsg214BusHiSpdRdntVehStabyEnhmtActvInvldTiOutDGmMsg214BusHiSpdDGmMsg214BusHiSpdRdntVehStabyEnhmtActvInvldTiOut
      AssemblySwConnector_192: ecu-extract-reference=CalRegn01CmnDGmMsg214BusHiSpdRdntVehStabyEnhmtActvRollgCntrInvldTiOutDGmMsg214BusHiSpdDGmMsg214BusHiSpdRdntVehStabyEn_9a2ddc79
      AssemblySwConnector_193: ecu-extract-reference=CalRegn01CmnDGmMsg232BusHiSpdMissTiOutDGmMsg232BusHiSpdDGmMsg232BusHiSpdMissTiOut
      AssemblySwConnector_194: ecu-extract-reference=CalRegn01CmnDGmMsg337BusChassisExpInvldDiagcTiOutDGmMsg337BusChassisExpDGmMsg337BusChassisExpInvldDiagcTiOut
      AssemblySwConnector_195: ecu-extract-reference=CalRegn01CmnDGmMsg337BusChassisExpMissTiOutDGmMsg337BusChassisExpDGmMsg337BusChassisExpMissTiOut
      AssemblySwConnector_196: ecu-extract-reference=CalRegn01CmnDGmMsg337BusChassisExpTarAgPolarityDGmMsg337BusChassisExpDGmMsg337BusChassisExpTarAgPolarity
      AssemblySwConnector_197: ecu-extract-reference=CalRegn01CmnDGmMsg348BusChassisExpInvldTiOutDGmMsg348BusChassisExpDGmMsg348BusChassisExpInvldTiOut
      AssemblySwConnector_198: ecu-extract-reference=CalRegn01CmnDGmMsg348BusChassisExpMissTiOutDGmMsg348BusChassisExpDGmMsg348BusChassisExpMissTiOut
      AssemblySwConnector_199: ecu-extract-reference=CalRegn01CmnDGmMsg348BusChassisExpStuckTiOutDGmMsg348BusChassisExpDGmMsg348BusChassisExpStuckTiOut
      AssemblySwConnector_200: ecu-extract-reference=CalRegn01CmnDGmMsg348BusHiSpdInvldTiOutDGmMsg348BusHiSpdDGmMsg348BusHiSpdInvldTiOut
      AssemblySwConnector_201: ecu-extract-reference=CalRegn01CmnDGmMsg348BusHiSpdMissTiOutDGmMsg348BusHiSpdDGmMsg348BusHiSpdMissTiOut
      AssemblySwConnector_202: ecu-extract-reference=CalRegn01CmnDGmMsg348BusHiSpdStuckTiOutDGmMsg348BusHiSpdDGmMsg348BusHiSpdStuckTiOut
      AssemblySwConnector_203: ecu-extract-reference=CalRegn01CmnDGmMsg34ABusChassisExpInvldTiOutDGmMsg34ABusChassisExpDGmMsg34ABusChassisExpInvldTiOut
      AssemblySwConnector_204: ecu-extract-reference=CalRegn01CmnDGmMsg34ABusChassisExpMissTiOutDGmMsg34ABusChassisExpDGmMsg34ABusChassisExpMissTiOut
      AssemblySwConnector_205: ecu-extract-reference=CalRegn01CmnDGmMsg34ABusChassisExpStuckTiOutDGmMsg34ABusChassisExpDGmMsg34ABusChassisExpStuckTiOut
      AssemblySwConnector_206: ecu-extract-reference=CalRegn01CmnDGmMsg34ABusHiSpdInvldTiOutDGmMsg34ABusHiSpdDGmMsg34ABusHiSpdInvldTiOut
      AssemblySwConnector_207: ecu-extract-reference=CalRegn01CmnDGmMsg34ABusHiSpdMissTiOutDGmMsg34ABusHiSpdDGmMsg34ABusHiSpdMissTiOut
      AssemblySwConnector_208: ecu-extract-reference=CalRegn01CmnDGmMsg34ABusHiSpdStuckTiOutDGmMsg34ABusHiSpdDGmMsg34ABusHiSpdStuckTiOut
      AssemblySwConnector_211: ecu-extract-reference=CalRegn01CmnDGmMsg3F1BusHiSpdAmbTDftDGmMsg3F1BusHiSpdDGmMsg3F1BusHiSpdAmbTDft
      AssemblySwConnector_212: ecu-extract-reference=CalRegn01CmnDGmMsg3F1BusHiSpdInvldTiOutDGmMsg3F1BusHiSpdDGmMsg3F1BusHiSpdInvldTiOut
      AssemblySwConnector_213: ecu-extract-reference=CalRegn01CmnDGmMsg3F1BusHiSpdMissTiOutDGmMsg3F1BusHiSpdDGmMsg3F1BusHiSpdMissTiOut
      AssemblySwConnector_234: ecu-extract-reference=CalRegn01CmnDHwAgSysArbnHwAgSlewRateDHwAgSysArbnDHwAgSysArbnHwAgSlewRate
      AssemblySwConnector_235: ecu-extract-reference=CalRegn01CmnDHwAgSysArbnSlewRateTmrDHwAgSysArbnDHwAgSysArbnSlewRateTmr
      AssemblySwConnector_236: ecu-extract-reference=CalRegn01CmnDHwTqArbnMaxStallTqADHwTqArbnDHwTqArbnMaxStallTqA
      AssemblySwConnector_237: ecu-extract-reference=CalRegn01CmnDHwTqArbnMaxStallTqBDHwTqArbnDHwTqArbnMaxStallTqB
      AssemblySwConnector_238: ecu-extract-reference=CalRegn01CmnDHwTqArbnMaxStallTqCDHwTqArbnDHwTqArbnMaxStallTqC
      AssemblySwConnector_239: ecu-extract-reference=CalRegn01CmnDHwTqArbnMaxStallTqDDHwTqArbnDHwTqArbnMaxStallTqD
      AssemblySwConnector_240: ecu-extract-reference=CalRegn01CmnDHwTqCorrlnChACmnModCmpLpFilActvnThdDHwTqCorrlnDHwTqCorrlnChACmnModCmpLpFilActvnThd
      AssemblySwConnector_241: ecu-extract-reference=CalRegn01CmnDHwTqCorrlnChACmnModCmpLpFilFrqDHwTqCorrlnDHwTqCorrlnChACmnModCmpLpFilFrq
      AssemblySwConnector_242: ecu-extract-reference=CalRegn01CmnDHwTqCorrlnChACmnModCmpLpFilOutpLimDHwTqCorrlnDHwTqCorrlnChACmnModCmpLpFilOutpLim
      AssemblySwConnector_243: ecu-extract-reference=CalRegn01CmnDHwTqCorrlnChAImdtCorrlnChkFailThdDHwTqCorrlnDHwTqCorrlnChAImdtCorrlnChkFailThd
      AssemblySwConnector_244: ecu-extract-reference=CalRegn01CmnDHwTqCorrlnChAImdtCorrlnChkPassThdDHwTqCorrlnDHwTqCorrlnChAImdtCorrlnChkPassThd
      AssemblySwConnector_245: ecu-extract-reference=CalRegn01CmnDHwTqCorrlnChAStabStClrFltThdDHwTqCorrlnDHwTqCorrlnChAStabStClrFltThd
      AssemblySwConnector_246: ecu-extract-reference=CalRegn01CmnDHwTqCorrlnChAStabStLpFilFrqDHwTqCorrlnDHwTqCorrlnChAStabStLpFilFrq
      AssemblySwConnector_247: ecu-extract-reference=CalRegn01CmnDHwTqCorrlnChAStabStSetFltThdDHwTqCorrlnDHwTqCorrlnChAStabStSetFltThd
      AssemblySwConnector_248: ecu-extract-reference=CalRegn01CmnDHwTqCorrlnChATqSumMaxLimDHwTqCorrlnDHwTqCorrlnChATqSumMaxLim
      AssemblySwConnector_249: ecu-extract-reference=CalRegn01CmnDHwTqCorrlnChATraLpFilXDHwTqCorrlnDHwTqCorrlnChATraLpFilX
      AssemblySwConnector_250: ecu-extract-reference=CalRegn01CmnDHwTqCorrlnChATraLpFilYDHwTqCorrlnDHwTqCorrlnChATraLpFilY
      AssemblySwConnector_251: ecu-extract-reference=CalRegn01CmnDHwTqCorrlnChATraSumClrFltThdDHwTqCorrlnDHwTqCorrlnChATraSumClrFltThd
      AssemblySwConnector_252: ecu-extract-reference=CalRegn01CmnDHwTqCorrlnChATraSumSetFltThdDHwTqCorrlnDHwTqCorrlnChATraSumSetFltThd
      AssemblySwConnector_253: ecu-extract-reference=CalRegn01CmnDHwTqCorrlnChBCmnModCmpLpFilActvnThdDHwTqCorrlnDHwTqCorrlnChBCmnModCmpLpFilActvnThd
      AssemblySwConnector_254: ecu-extract-reference=CalRegn01CmnDHwTqCorrlnChBCmnModCmpLpFilFrqDHwTqCorrlnDHwTqCorrlnChBCmnModCmpLpFilFrq
      AssemblySwConnector_255: ecu-extract-reference=CalRegn01CmnDHwTqCorrlnChBCmnModCmpLpFilOutpLimDHwTqCorrlnDHwTqCorrlnChBCmnModCmpLpFilOutpLim
      AssemblySwConnector_256: ecu-extract-reference=CalRegn01CmnDHwTqCorrlnChBImdtCorrlnChkFailThdDHwTqCorrlnDHwTqCorrlnChBImdtCorrlnChkFailThd
      AssemblySwConnector_257: ecu-extract-reference=CalRegn01CmnDHwTqCorrlnChBImdtCorrlnChkPassThdDHwTqCorrlnDHwTqCorrlnChBImdtCorrlnChkPassThd
      AssemblySwConnector_258: ecu-extract-reference=CalRegn01CmnDHwTqCorrlnChBStabStClrFltThdDHwTqCorrlnDHwTqCorrlnChBStabStClrFltThd
      AssemblySwConnector_259: ecu-extract-reference=CalRegn01CmnDHwTqCorrlnChBStabStLpFilFrqDHwTqCorrlnDHwTqCorrlnChBStabStLpFilFrq
      AssemblySwConnector_260: ecu-extract-reference=CalRegn01CmnDHwTqCorrlnChBStabStSetFltThdDHwTqCorrlnDHwTqCorrlnChBStabStSetFltThd
      AssemblySwConnector_261: ecu-extract-reference=CalRegn01CmnDHwTqCorrlnChBTqSumMaxLimDHwTqCorrlnDHwTqCorrlnChBTqSumMaxLim
      AssemblySwConnector_262: ecu-extract-reference=CalRegn01CmnDHwTqCorrlnChBTraLpFilXDHwTqCorrlnDHwTqCorrlnChBTraLpFilX
      AssemblySwConnector_263: ecu-extract-reference=CalRegn01CmnDHwTqCorrlnChBTraLpFilYDHwTqCorrlnDHwTqCorrlnChBTraLpFilY
      AssemblySwConnector_264: ecu-extract-reference=CalRegn01CmnDHwTqCorrlnChBTraSumClrFltThdDHwTqCorrlnDHwTqCorrlnChBTraSumClrFltThd
      AssemblySwConnector_265: ecu-extract-reference=CalRegn01CmnDHwTqCorrlnChBTraSumSetFltThdDHwTqCorrlnDHwTqCorrlnChBTraSumSetFltThd
      AssemblySwConnector_266: ecu-extract-reference=CalRegn01CmnDHwTqCorrlnMaxStallTqADHwTqCorrlnDHwTqCorrlnMaxStallTqA
      AssemblySwConnector_267: ecu-extract-reference=CalRegn01CmnDHwTqCorrlnMaxStallTqBDHwTqCorrlnDHwTqCorrlnMaxStallTqB
      AssemblySwConnector_268: ecu-extract-reference=CalRegn01CmnDHwTqCorrlnMaxStallTqCDHwTqCorrlnDHwTqCorrlnMaxStallTqC
      AssemblySwConnector_269: ecu-extract-reference=CalRegn01CmnDHwTqCorrlnMaxStallTqDDHwTqCorrlnDHwTqCorrlnMaxStallTqD
      AssemblySwConnector_272: ecu-extract-reference=CalRegn01CmnDLoaMgrCurrIvtrMtgtnRateDLoaMgrDLoaMgrCurrIvtrMtgtnRate
      AssemblySwConnector_273: ecu-extract-reference=CalRegn01CmnDLoaMgrCurrIvtrMtgtnScaDLoaMgrDLoaMgrCurrIvtrMtgtnSca
      AssemblySwConnector_274: ecu-extract-reference=CalRegn01CmnDLoaMgrCurrIvtrMtgtnScaZeroEnaDLoaMgrDLoaMgrCurrIvtrMtgtnScaZeroEna
      AssemblySwConnector_275: ecu-extract-reference=CalRegn01CmnDLoaMgrCurrMeasIdptSig0RespDLoaMgrDLoaMgrCurrMeasIdptSig0Resp
      AssemblySwConnector_276: ecu-extract-reference=CalRegn01CmnDLoaMgrCurrMeasIdptSig1RespDLoaMgrDLoaMgrCurrMeasIdptSig1Resp
      AssemblySwConnector_277: ecu-extract-reference=CalRegn01CmnDLoaMgrCurrMeasIdptSig2RespDLoaMgrDLoaMgrCurrMeasIdptSig2Resp
      AssemblySwConnector_278: ecu-extract-reference=CalRegn01CmnDLoaMgrCurrMeasIdptSigFltThdDLoaMgrDLoaMgrCurrMeasIdptSigFltThd
      AssemblySwConnector_279: ecu-extract-reference=CalRegn01CmnDLoaMgrCurrMeasMtgtnRateDLoaMgrDLoaMgrCurrMeasMtgtnRate
      AssemblySwConnector_280: ecu-extract-reference=CalRegn01CmnDLoaMgrCurrMeasMtgtnScaDLoaMgrDLoaMgrCurrMeasMtgtnSca
      AssemblySwConnector_281: ecu-extract-reference=CalRegn01CmnDLoaMgrCurrMeasMtgtnScaZeroEnaDLoaMgrDLoaMgrCurrMeasMtgtnScaZeroEna
      AssemblySwConnector_282: ecu-extract-reference=CalRegn01CmnDLoaMgrFadeOutStRateDLoaMgrDLoaMgrFadeOutStRate
      AssemblySwConnector_283: ecu-extract-reference=CalRegn01CmnDLoaMgrHwTqIdptSig0NoTqLoaRespDLoaMgrDLoaMgrHwTqIdptSig0NoTqLoaResp
      AssemblySwConnector_284: ecu-extract-reference=CalRegn01CmnDLoaMgrHwTqIdptSig1NoTqLoaRespDLoaMgrDLoaMgrHwTqIdptSig1NoTqLoaResp
      AssemblySwConnector_285: ecu-extract-reference=CalRegn01CmnDLoaMgrHwTqIdptSig2RespDLoaMgrDLoaMgrHwTqIdptSig2Resp
      AssemblySwConnector_286: ecu-extract-reference=CalRegn01CmnDLoaMgrHwTqIdptSig4RespDLoaMgrDLoaMgrHwTqIdptSig4Resp
      AssemblySwConnector_287: ecu-extract-reference=CalRegn01CmnDLoaMgrHwTqIdptSigFltThdDLoaMgrDLoaMgrHwTqIdptSigFltThd
      AssemblySwConnector_288: ecu-extract-reference=CalRegn01CmnDLoaMgrHwTqLoaAvlRespDLoaMgrDLoaMgrHwTqLoaAvlResp
      AssemblySwConnector_289: ecu-extract-reference=CalRegn01CmnDLoaMgrIvtrIdptSig0RespDLoaMgrDLoaMgrIvtrIdptSig0Resp
      AssemblySwConnector_290: ecu-extract-reference=CalRegn01CmnDLoaMgrIvtrIdptSig1RespDLoaMgrDLoaMgrIvtrIdptSig1Resp
      AssemblySwConnector_291: ecu-extract-reference=CalRegn01CmnDLoaMgrIvtrIdptSig2RespDLoaMgrDLoaMgrIvtrIdptSig2Resp
      AssemblySwConnector_292: ecu-extract-reference=CalRegn01CmnDLoaMgrIvtrIdptSigFltThdDLoaMgrDLoaMgrIvtrIdptSigFltThd
      AssemblySwConnector_293: ecu-extract-reference=CalRegn01CmnDLoaMgrIvtrMtgtnRateDLoaMgrDLoaMgrIvtrMtgtnRate
      AssemblySwConnector_294: ecu-extract-reference=CalRegn01CmnDLoaMgrIvtrMtgtnScaDLoaMgrDLoaMgrIvtrMtgtnSca
      AssemblySwConnector_295: ecu-extract-reference=CalRegn01CmnDLoaMgrIvtrMtgtnScaZeroEnaDLoaMgrDLoaMgrIvtrMtgtnScaZeroEna
      AssemblySwConnector_296: ecu-extract-reference=CalRegn01CmnDLoaMgrLimdStRateDLoaMgrDLoaMgrLimdStRate
      AssemblySwConnector_297: ecu-extract-reference=CalRegn01CmnDLoaMgrLimdStScaDLoaMgrDLoaMgrLimdStSca
      AssemblySwConnector_298: ecu-extract-reference=CalRegn01CmnDLoaMgrMotAgAvlSnsrlsRespDLoaMgrDLoaMgrMotAgAvlSnsrlsResp
      AssemblySwConnector_299: ecu-extract-reference=CalRegn01CmnDLoaMgrMotAgIdptSig0NoSnsrlsRespDLoaMgrDLoaMgrMotAgIdptSig0NoSnsrlsResp
      AssemblySwConnector_300: ecu-extract-reference=CalRegn01CmnDLoaMgrMotAgIdptSig1NoSnsrlsRespDLoaMgrDLoaMgrMotAgIdptSig1NoSnsrlsResp
      AssemblySwConnector_301: ecu-extract-reference=CalRegn01CmnDLoaMgrMotAgIdptSig2RespDLoaMgrDLoaMgrMotAgIdptSig2Resp
      AssemblySwConnector_302: ecu-extract-reference=CalRegn01CmnDLoaMgrMotAgIdptSig3RespDLoaMgrDLoaMgrMotAgIdptSig3Resp
      AssemblySwConnector_303: ecu-extract-reference=CalRegn01CmnDLoaMgrMotAgIdptSigFltThdDLoaMgrDLoaMgrMotAgIdptSigFltThd
      AssemblySwConnector_304: ecu-extract-reference=CalRegn01CmnDLoaMgrMotAgMtgtnRateDLoaMgrDLoaMgrMotAgMtgtnRate
      AssemblySwConnector_305: ecu-extract-reference=CalRegn01CmnDLoaMgrMotAgMtgtnScaDLoaMgrDLoaMgrMotAgMtgtnSca
      AssemblySwConnector_306: ecu-extract-reference=CalRegn01CmnDLoaMgrMotAgMtgtnScaZeroEnaDLoaMgrDLoaMgrMotAgMtgtnScaZeroEna
      AssemblySwConnector_308: ecu-extract-reference=CalRegn01CmnDMotCtrlPrmEstimnFetRNomDMotCtrlPrmEstimnDMotCtrlPrmEstimnFetRNom
      AssemblySwConnector_309: ecu-extract-reference=CalRegn01CmnDMotCtrlPrmEstimnFetThermCoeffDMotCtrlPrmEstimnDMotCtrlPrmEstimnFetThermCoeff
      AssemblySwConnector_310: ecu-extract-reference=CalRegn01CmnDMotCtrlPrmEstimnMagThermCoeffDMotCtrlPrmEstimnDMotCtrlPrmEstimnMagThermCoeff
      AssemblySwConnector_311: ecu-extract-reference=CalRegn01CmnDMotCtrlPrmEstimnMotBackEmfConHiLimDMotCtrlPrmEstimnDMotCtrlPrmEstimnMotBackEmfConHiLim
      AssemblySwConnector_312: ecu-extract-reference=CalRegn01CmnDMotCtrlPrmEstimnMotBackEmfConLoLimDMotCtrlPrmEstimnDMotCtrlPrmEstimnMotBackEmfConLoLim
      AssemblySwConnector_313: ecu-extract-reference=CalRegn01CmnDMotCtrlPrmEstimnMotBackEmfConNomDMotCtrlPrmEstimnDMotCtrlPrmEstimnMotBackEmfConNom
      AssemblySwConnector_314: ecu-extract-reference=CalRegn01CmnDMotCtrlPrmEstimnMotBackEmfConSatnXDMotCtrlPrmEstimnDMotCtrlPrmEstimnMotBackEmfConSatnX
      AssemblySwConnector_315: ecu-extract-reference=CalRegn01CmnDMotCtrlPrmEstimnMotBackEmfConSatnYDMotCtrlPrmEstimnDMotCtrlPrmEstimnMotBackEmfConSatnY
      AssemblySwConnector_316: ecu-extract-reference=CalRegn01CmnDMotCtrlPrmEstimnMotCurrDaxInduSatnBilnrSelnDMotCtrlPrmEstimnDMotCtrlPrmEstimnMotCurrDaxInduSatnBilnrSeln
      AssemblySwConnector_317: ecu-extract-reference=CalRegn01CmnDMotCtrlPrmEstimnMotCurrQaxInduSatnXDMotCtrlPrmEstimnDMotCtrlPrmEstimnMotCurrQaxInduSatnX
      AssemblySwConnector_318: ecu-extract-reference=CalRegn01CmnDMotCtrlPrmEstimnMotInduDaxHiLimDMotCtrlPrmEstimnDMotCtrlPrmEstimnMotInduDaxHiLim
      AssemblySwConnector_319: ecu-extract-reference=CalRegn01CmnDMotCtrlPrmEstimnMotInduDaxLoLimDMotCtrlPrmEstimnDMotCtrlPrmEstimnMotInduDaxLoLim
      AssemblySwConnector_320: ecu-extract-reference=CalRegn01CmnDMotCtrlPrmEstimnMotInduDaxNomDMotCtrlPrmEstimnDMotCtrlPrmEstimnMotInduDaxNom
      AssemblySwConnector_321: ecu-extract-reference=CalRegn01CmnDMotCtrlPrmEstimnMotInduDaxSatnScaYDMotCtrlPrmEstimnDMotCtrlPrmEstimnMotInduDaxSatnScaY
      AssemblySwConnector_322: ecu-extract-reference=CalRegn01CmnDMotCtrlPrmEstimnMotInduQaxHiLimDMotCtrlPrmEstimnDMotCtrlPrmEstimnMotInduQaxHiLim
      AssemblySwConnector_323: ecu-extract-reference=CalRegn01CmnDMotCtrlPrmEstimnMotInduQaxLoLimDMotCtrlPrmEstimnDMotCtrlPrmEstimnMotInduQaxLoLim
      AssemblySwConnector_324: ecu-extract-reference=CalRegn01CmnDMotCtrlPrmEstimnMotInduQaxNomDMotCtrlPrmEstimnDMotCtrlPrmEstimnMotInduQaxNom
      AssemblySwConnector_325: ecu-extract-reference=CalRegn01CmnDMotCtrlPrmEstimnMotInduQaxSatnScaYDMotCtrlPrmEstimnDMotCtrlPrmEstimnMotInduQaxSatnScaY
      AssemblySwConnector_326: ecu-extract-reference=CalRegn01CmnDMotCtrlPrmEstimnMotRHiLimDMotCtrlPrmEstimnDMotCtrlPrmEstimnMotRHiLim
      AssemblySwConnector_327: ecu-extract-reference=CalRegn01CmnDMotCtrlPrmEstimnMotRLoLimDMotCtrlPrmEstimnDMotCtrlPrmEstimnMotRLoLim
      AssemblySwConnector_328: ecu-extract-reference=CalRegn01CmnDMotCtrlPrmEstimnMotRNomDMotCtrlPrmEstimnDMotCtrlPrmEstimnMotRNom
      AssemblySwConnector_329: ecu-extract-reference=CalRegn01CmnDMotCtrlPrmEstimnMotWidgThermCoeffDMotCtrlPrmEstimnDMotCtrlPrmEstimnMotWidgThermCoeff
      AssemblySwConnector_330: ecu-extract-reference=CalRegn01CmnDMotCtrlPrmEstimnTNomDMotCtrlPrmEstimnDMotCtrlPrmEstimnTNom
      AssemblySwConnector_331: ecu-extract-reference=CalRegn01CmnDMotCurrPeakEstimnCurrFilFrqDMotCurrPeakEstimnDMotCurrPeakEstimnCurrFilFrq
      AssemblySwConnector_332: ecu-extract-reference=CalRegn01CmnDMotCurrPeakEstimnCurrPeakEstimdFilFrqDMotCurrPeakEstimnDMotCurrPeakEstimnCurrPeakEstimdFilFrq
      AssemblySwConnector_333: ecu-extract-reference=CalRegn01CmnDMotCurrRegCfgCtrlrDynGainVehSpdCutOffDMotCurrRegCfgDMotCurrRegCfgCtrlrDynGainVehSpdCutOff
      AssemblySwConnector_336: ecu-extract-reference=CalRegn01CmnDMotCurrRegCfgMotAgCompuDlyDMotCurrRegCfgDMotCurrRegCfgMotAgCompuDly
      AssemblySwConnector_337: ecu-extract-reference=CalRegn01CmnDMotCurrRegCfgMotClsdLoopBwDaxYDMotCurrRegCfgDMotCurrRegCfgMotClsdLoopBwDaxY
      AssemblySwConnector_338: ecu-extract-reference=CalRegn01CmnDMotCurrRegCfgMotClsdLoopBwQaxYDMotCurrRegCfgDMotCurrRegCfgMotClsdLoopBwQaxY
      AssemblySwConnector_340: ecu-extract-reference=CalRegn01CmnDMotCurrRegCfgMotDampgRatDaxDMotCurrRegCfgDMotCurrRegCfgMotDampgRatDax
      AssemblySwConnector_341: ecu-extract-reference=CalRegn01CmnDMotCurrRegCfgMotDampgRatQaxDMotCurrRegCfgDMotCurrRegCfgMotDampgRatQax
      AssemblySwConnector_342: ecu-extract-reference=CalRegn01CmnDMotCurrRegCfgMotNatFrqDaxYDMotCurrRegCfgDMotCurrRegCfgMotNatFrqDaxY
      AssemblySwConnector_343: ecu-extract-reference=CalRegn01CmnDMotCurrRegCfgMotNatFrqQaxYDMotCurrRegCfgDMotCurrRegCfgMotNatFrqQaxY
      AssemblySwConnector_344: ecu-extract-reference=CalRegn01CmnDMotCurrRegCfgMotRVirtDaxDMotCurrRegCfgDMotCurrRegCfgMotRVirtDax
      AssemblySwConnector_345: ecu-extract-reference=CalRegn01CmnDMotCurrRegCfgMotRVirtQaxDMotCurrRegCfgDMotCurrRegCfgMotRVirtQax
      AssemblySwConnector_346: ecu-extract-reference=CalRegn01CmnDMotCurrRegCfgMotVelFilFrqDMotCurrRegCfgDMotCurrRegCfgMotVelFilFrq
      AssemblySwConnector_347: ecu-extract-reference=CalRegn01CmnDMotRefMdlFbCtrlDiDMotCurrRegCfgDMotRefMdlFbCtrlDi
      AssemblySwConnector_348: ecu-extract-reference=CalRegn01CmnDMotDrvDiagcErrFilFrqDMotDrvDiagcDMotDrvDiagcErrFilFrq
      AssemblySwConnector_349: ecu-extract-reference=CalRegn01CmnDMotDrvDiagcErrOffsDMotDrvDiagcDMotDrvDiagcErrOffs
      AssemblySwConnector_350: ecu-extract-reference=CalRegn01CmnDMotDrvDiagcErrThdDMotDrvDiagcDMotDrvDiagcErrThd
      AssemblySwConnector_351: ecu-extract-reference=CalRegn01CmnDMotQuadDetnMotDirHysInstsDMotQuadDetnDMotQuadDetnMotDirHysInsts
      AssemblySwConnector_352: ecu-extract-reference=CalRegn01CmnDMotRefMdlCurrDaxBoostGainDMotRefMdlDMotRefMdlCurrDaxBoostGain
      AssemblySwConnector_353: ecu-extract-reference=CalRegn01CmnDMotRefMdlCurrDaxBoostTqScaXDMotRefMdlDMotRefMdlCurrDaxBoostTqScaX
      AssemblySwConnector_354: ecu-extract-reference=CalRegn01CmnDMotRefMdlCurrDaxBoostTqScaYDMotRefMdlDMotRefMdlCurrDaxBoostTqScaY
      AssemblySwConnector_355: ecu-extract-reference=CalRegn01CmnDMotRefMdlCurrDaxQaxRefDeltaDMotRefMdlDMotRefMdlCurrDaxQaxRefDelta
      AssemblySwConnector_357: ecu-extract-reference=CalRegn01CmnDMotRefMdlFbCtrlDiDMotRefMdlDMotRefMdlFbCtrlDi
      AssemblySwConnector_358: ecu-extract-reference=CalRegn01CmnDMotRefMdlIvtrDeadTiBrdgVltgScaDMotRefMdlDMotRefMdlIvtrDeadTiBrdgVltgSca
      AssemblySwConnector_360: ecu-extract-reference=CalRegn01CmnDMotRefMdlMotCurrDaxMaxScaDMotRefMdlDMotRefMdlMotCurrDaxMaxSca
      AssemblySwConnector_361: ecu-extract-reference=CalRegn01CmnDMotRefMdlMotVelLpFilFrqDMotRefMdlDMotRefMdlMotVelLpFilFrq
      AssemblySwConnector_362: ecu-extract-reference=CalRegn01CmnDMotRefMdlMotVltgDerivtvTiConDMotRefMdlDMotRefMdlMotVltgDerivtvTiCon
      AssemblySwConnector_370: ecu-extract-reference=CalRegn01CmnDMotRefMdlVltgModDynCmpEnaDMotRefMdlDMotRefMdlVltgModDynCmpEna
      AssemblySwConnector_372: ecu-extract-reference=CalRegn01CmnDMotTqTranlDampgVehSpdBlndYDMotTqTranlDampgDMotTqTranlDampgVehSpdBlndY
      AssemblySwConnector_373: ecu-extract-reference=CalRegn01CmnDBattVltgSwdMaxDPwrDiscnctDBattVltgSwdMax
      AssemblySwConnector_374: ecu-extract-reference=CalRegn01CmnDPwrDiscnctOpenThdDPwrDiscnctDPwrDiscnctOpenThd
      AssemblySwConnector_375: ecu-extract-reference=CalRegn01CmnDPwrLimrAssiRednLpFilFrqDPwrLimrDPwrLimrAssiRednLpFilFrq
      AssemblySwConnector_376: ecu-extract-reference=CalRegn01CmnDPwrLimrBackEmfConStdTDPwrLimrDPwrLimrBackEmfConStdT
      AssemblySwConnector_377: ecu-extract-reference=CalRegn01CmnDPwrLimrBrdgVltgAdjSlewDPwrLimrDPwrLimrBrdgVltgAdjSlew
      AssemblySwConnector_378: ecu-extract-reference=CalRegn01CmnDPwrLimrBrdgVltgAltFltAdjDPwrLimrDPwrLimrBrdgVltgAltFltAdj
      AssemblySwConnector_379: ecu-extract-reference=CalRegn01CmnDPwrLimrFilAssiRednThdDPwrLimrDPwrLimrFilAssiRednThd
      AssemblySwConnector_380: ecu-extract-reference=CalRegn01CmnDPwrLimrLoVoltAssiRcvrThdDPwrLimrDPwrLimrLoVoltAssiRcvrThd
      AssemblySwConnector_381: ecu-extract-reference=CalRegn01CmnDPwrLimrLoVoltAssiRcvrTiDPwrLimrDPwrLimrLoVoltAssiRcvrTi
      AssemblySwConnector_382: ecu-extract-reference=CalRegn01CmnDPwrLimrMotEnvlpXDPwrLimrDPwrLimrMotEnvlpX
      AssemblySwConnector_383: ecu-extract-reference=CalRegn01CmnDPwrLimrMotEnvlpYDPwrLimrDPwrLimrMotEnvlpY
      AssemblySwConnector_384: ecu-extract-reference=CalRegn01CmnDPwrLimrMotVelLpFilFrqDPwrLimrDPwrLimrMotVelLpFilFrq
      AssemblySwConnector_385: ecu-extract-reference=CalRegn01CmnDPwrLimrSpdAdjSlewDecDPwrLimrDPwrLimrSpdAdjSlewDec
      AssemblySwConnector_386: ecu-extract-reference=CalRegn01CmnDPwrLimrSpdAdjSlewEnaDPwrLimrDPwrLimrSpdAdjSlewEna
      AssemblySwConnector_387: ecu-extract-reference=CalRegn01CmnDPwrLimrSpdAdjSlewIncDPwrLimrDPwrLimrSpdAdjSlewInc
      AssemblySwConnector_388: ecu-extract-reference=CalRegn01CmnDPwrLimrStdOperMotEnvlpXDPwrLimrDPwrLimrStdOperMotEnvlpX
      AssemblySwConnector_389: ecu-extract-reference=CalRegn01CmnDPwrLimrStdOperMotEnvlpYDPwrLimrDPwrLimrStdOperMotEnvlpY
      AssemblySwConnector_390: ecu-extract-reference=CalRegn01CmnDPwrLimrVltgDptMotVelOffsXDPwrLimrDPwrLimrVltgDptMotVelOffsX
      AssemblySwConnector_391: ecu-extract-reference=CalRegn01CmnDPwrLimrVltgDptMotVelOffsYDPwrLimrDPwrLimrVltgDptMotVelOffsY
      AssemblySwConnector_392: ecu-extract-reference=CalRegn01CmnDPwrSplyNtc0x07BFailStepDPwrSplyDPwrSplyNtc0x07BFailStep
      AssemblySwConnector_393: ecu-extract-reference=CalRegn01CmnDPwrSplyNtc0x07BPassStepDPwrSplyDPwrSplyNtc0x07BPassStep
      AssemblySwConnector_394: ecu-extract-reference=CalRegn01CmnDPwrSplyNtc0x07CFailStepDPwrSplyDPwrSplyNtc0x07CFailStep
      AssemblySwConnector_395: ecu-extract-reference=CalRegn01CmnDPwrSplyNtc0x07CPassStepDPwrSplyDPwrSplyNtc0x07CPassStep
      AssemblySwConnector_396: ecu-extract-reference=CalRegn01CmnDPwrSplyNtc0x07DFailStepDPwrSplyDPwrSplyNtc0x07DFailStep
      AssemblySwConnector_397: ecu-extract-reference=CalRegn01CmnDPwrSplyNtc0x07DPassStepDPwrSplyDPwrSplyNtc0x07DPassStep
      AssemblySwConnector_419: ecu-extract-reference=CalRegn01CmnDVehSigCdngDftLatADVehSigCdngDVehSigCdngDftLatA
      AssemblySwConnector_420: ecu-extract-reference=CalRegn01CmnDVehSigCdngDftLgtADVehSigCdngDVehSigCdngDftLgtA
      AssemblySwConnector_421: ecu-extract-reference=CalRegn01CmnDVehSigCdngDftVehSpdDVehSigCdngDVehSigCdngDftVehSpd
      AssemblySwConnector_422: ecu-extract-reference=CalRegn01CmnDVehSigCdngDftYawRateDVehSigCdngDVehSigCdngDftYawRate
      AssemblySwConnector_423: ecu-extract-reference=CalRegn01CmnDVehSigCdngLatADifThdDVehSigCdngDVehSigCdngLatADifThd
      AssemblySwConnector_424: ecu-extract-reference=CalRegn01CmnDVehSigCdngLatAFilFrqDVehSigCdngDVehSigCdngLatAFilFrq
      AssemblySwConnector_425: ecu-extract-reference=CalRegn01CmnDVehSigCdngLtgADifThdDVehSigCdngDVehSigCdngLtgADifThd
      AssemblySwConnector_426: ecu-extract-reference=CalRegn01CmnDVehSigCdngVehSpdDifThdDVehSigCdngDVehSigCdngVehSpdDifThd
      AssemblySwConnector_427: ecu-extract-reference=CalRegn01CmnDVehSigCdngVehYawSlewRateDVehSigCdngDVehSigCdngVehYawSlewRate
      AssemblySwConnector_428: ecu-extract-reference=CalRegn01CmnDVehSigCdngYawRateDifThdDVehSigCdngDVehSigCdngYawRateDifThd
      AssemblySwConnector_429: ecu-extract-reference=CalRegn01CmnDVehSpdLimrMaxAssiXDVehSpdLimrDVehSpdLimrMaxAssiX
      AssemblySwConnector_430: ecu-extract-reference=CalRegn01CmnDVehSpdLimrMaxAssiYDVehSpdLimrDVehSpdLimrMaxAssiY
      AssemblySwConnector_431: ecu-extract-reference=CalRegn01CmnDVehSpdLimrPosMaxOffs1DVehSpdLimrDVehSpdLimrPosMaxOffs1
      AssemblySwConnector_432: ecu-extract-reference=CalRegn01CmnDVehSpdLimrPosMaxOffs2DVehSpdLimrDVehSpdLimrPosMaxOffs2
      AssemblySwConnector_440: ecu-extract-reference=CalRegn01Inin00DSysGlbPrmMotPoleCntDCDD_CurrMeasDSysGlbPrmMotPoleCnt
      AssemblySwConnector_441: ecu-extract-reference=CalRegn01Inin00DHwTq0MeasHwTq0PrtclFltFailStepDCDD_HwTq0MeasDHwTq0MeasHwTq0PrtclFltFailStep
      AssemblySwConnector_442: ecu-extract-reference=CalRegn01Inin00DHwTq0MeasHwTq0PrtclFltPassStepDCDD_HwTq0MeasDHwTq0MeasHwTq0PrtclFltPassStep
      AssemblySwConnector_443: ecu-extract-reference=CalRegn01Inin00DHwTq1MeasHwTq1PrtclFltFailStepDCDD_HwTq1MeasDHwTq1MeasHwTq1PrtclFltFailStep
      AssemblySwConnector_444: ecu-extract-reference=CalRegn01Inin00DHwTq1MeasHwTq1PrtclFltPassStepDCDD_HwTq1MeasDHwTq1MeasHwTq1PrtclFltPassStep
      AssemblySwConnector_449: ecu-extract-reference=CalRegn01Inin00DSysGlbPrmMotPoleCntDCDD_MotAgCmpDSysGlbPrmMotPoleCnt
      AssemblySwConnector_524: ecu-extract-reference=CalRegn01Inin00DGmVehPwrModOperRampRateDGmVehPwrModDGmVehPwrModOperRampRate
      AssemblySwConnector_527: ecu-extract-reference=CalRegn01Inin00DHiLoadStallLimrMotTqCmdFilFrqDHiLoadStallLimrDHiLoadStallLimrMotTqCmdFilFrq
      AssemblySwConnector_528: ecu-extract-reference=CalRegn01Inin00DHiLoadStallLimrMotVelMgnThdDHiLoadStallLimrDHiLoadStallLimrMotVelMgnThd
      AssemblySwConnector_529: ecu-extract-reference=CalRegn01Inin00DHiLoadStallLimrStallMotTqCmdLimXDHiLoadStallLimrDHiLoadStallLimrStallMotTqCmdLimX
      AssemblySwConnector_530: ecu-extract-reference=CalRegn01Inin00DHiLoadStallLimrStallMotTqCmdLimYDHiLoadStallLimrDHiLoadStallLimrStallMotTqCmdLimY
      AssemblySwConnector_531: ecu-extract-reference=CalRegn01Inin00DHiLoadStallLimrStallMotTqLimSlewRateDHiLoadStallLimrDHiLoadStallLimrStallMotTqLimSlewRate
      AssemblySwConnector_532: ecu-extract-reference=CalRegn01Inin00DHwAg0MeasHwAg0IfFltFailStepDHwAg0MeasDHwAg0MeasHwAg0IfFltFailStep
      AssemblySwConnector_533: ecu-extract-reference=CalRegn01Inin00DHwAg0MeasHwAg0IfFltPassStepDHwAg0MeasDHwAg0MeasHwAg0IfFltPassStep
      AssemblySwConnector_534: ecu-extract-reference=CalRegn01Inin00DHwAg0MeasHwAg0Snsr0PrtclFltFailStepDHwAg0MeasDHwAg0MeasHwAg0Snsr0PrtclFltFailStep
      AssemblySwConnector_535: ecu-extract-reference=CalRegn01Inin00DHwAg0MeasHwAg0Snsr0PrtclFltPassStepDHwAg0MeasDHwAg0MeasHwAg0Snsr0PrtclFltPassStep
      AssemblySwConnector_536: ecu-extract-reference=CalRegn01Inin00DHwAg0MeasHwAg0Snsr1PrtclFltFailStepDHwAg0MeasDHwAg0MeasHwAg0Snsr1PrtclFltFailStep
      AssemblySwConnector_537: ecu-extract-reference=CalRegn01Inin00DHwAg0MeasHwAg0Snsr1PrtclFltPassStepDHwAg0MeasDHwAg0MeasHwAg0Snsr1PrtclFltPassStep
      AssemblySwConnector_538: ecu-extract-reference=CalRegn01Inin00DHwAg0MeasSnsr0RevDHwAg0MeasDHwAg0MeasSnsr0Rev
      AssemblySwConnector_539: ecu-extract-reference=CalRegn01Inin00DHwAg0MeasSnsr1RevDHwAg0MeasDHwAg0MeasSnsr1Rev
      AssemblySwConnector_540: ecu-extract-reference=CalRegn01Inin00DHwAg0MeasStepDHwAg0MeasDHwAg0MeasStep
      AssemblySwConnector_541: ecu-extract-reference=CalRegn01Inin00DHwAg0MeasVrnrErrThdDHwAg0MeasDHwAg0MeasVrnrErrThd
      AssemblySwConnector_542: ecu-extract-reference=CalRegn01Inin00DHwAg1MeasHwAg1IfFltFailStepDHwAg1MeasDHwAg1MeasHwAg1IfFltFailStep
      AssemblySwConnector_543: ecu-extract-reference=CalRegn01Inin00DHwAg1MeasHwAg1IfFltPassStepDHwAg1MeasDHwAg1MeasHwAg1IfFltPassStep
      AssemblySwConnector_544: ecu-extract-reference=CalRegn01Inin00DHwAg1MeasHwAg1Snsr0PrtclFltFailStepDHwAg1MeasDHwAg1MeasHwAg1Snsr0PrtclFltFailStep
      AssemblySwConnector_545: ecu-extract-reference=CalRegn01Inin00DHwAg1MeasHwAg1Snsr0PrtclFltPassStepDHwAg1MeasDHwAg1MeasHwAg1Snsr0PrtclFltPassStep
      AssemblySwConnector_546: ecu-extract-reference=CalRegn01Inin00DHwAg1MeasHwAg1Snsr1PrtclFltFailStepDHwAg1MeasDHwAg1MeasHwAg1Snsr1PrtclFltFailStep
      AssemblySwConnector_547: ecu-extract-reference=CalRegn01Inin00DHwAg1MeasHwAg1Snsr1PrtclFltPassStepDHwAg1MeasDHwAg1MeasHwAg1Snsr1PrtclFltPassStep
      AssemblySwConnector_548: ecu-extract-reference=CalRegn01Inin00DHwAg1MeasSnsr0RevDHwAg1MeasDHwAg1MeasSnsr0Rev
      AssemblySwConnector_549: ecu-extract-reference=CalRegn01Inin00DHwAg1MeasSnsr1RevDHwAg1MeasDHwAg1MeasSnsr1Rev
      AssemblySwConnector_550: ecu-extract-reference=CalRegn01Inin00DHwAg1MeasStepDHwAg1MeasDHwAg1MeasStep
      AssemblySwConnector_551: ecu-extract-reference=CalRegn01Inin00DHwAg1MeasVrnrErrThdDHwAg1MeasDHwAg1MeasVrnrErrThd
      AssemblySwConnector_566: ecu-extract-reference=CalRegn01Inin00DSysGlbPrmTorsBarStfnDInertiaCmpVelDSysGlbPrmTorsBarStfn
      AssemblySwConnector_568: ecu-extract-reference=CalRegn01Inin00DLimrCdngGainDecSlewDLimrCdngDLimrCdngGainDecSlew
      AssemblySwConnector_569: ecu-extract-reference=CalRegn01Inin00DLimrCdngGainIncSlewXDLimrCdngDLimrCdngGainIncSlewX
      AssemblySwConnector_570: ecu-extract-reference=CalRegn01Inin00DLimrCdngGainIncSlewYDLimrCdngDLimrCdngGainIncSlewY
      AssemblySwConnector_571: ecu-extract-reference=CalRegn01Inin00DLimrCdngTqDecSlewDLimrCdngDLimrCdngTqDecSlew
      AssemblySwConnector_572: ecu-extract-reference=CalRegn01Inin00DLimrCdngTqIncSlewXDLimrCdngDLimrCdngTqIncSlewX
      AssemblySwConnector_573: ecu-extract-reference=CalRegn01Inin00DLimrCdngTqIncSlewYDLimrCdngDLimrCdngTqIncSlewY
      AssemblySwConnector_574: ecu-extract-reference=CalRegn01Inin00DSysGlbPrmMotPoleCntDMotAgCorrlnDSysGlbPrmMotPoleCnt
      AssemblySwConnector_575: ecu-extract-reference=CalRegn01Inin00DSysGlbPrmMotPoleCntDMotCurrRegCfgDSysGlbPrmMotPoleCnt
      AssemblySwConnector_576: ecu-extract-reference=CalRegn01Inin00DSysGlbPrmMotPoleCntDMotRefMdlDSysGlbPrmMotPoleCnt
      AssemblySwConnector_577: ecu-extract-reference=CalRegn01Inin00DMotTqTranlDampgCmdLimDMotTqTranlDampgDMotTqTranlDampgCmdLim
      AssemblySwConnector_578: ecu-extract-reference=CalRegn01Inin00DMotTqTranlDampgDampgCoeffDMotTqTranlDampgDMotTqTranlDampgDampgCoeff
      AssemblySwConnector_579: ecu-extract-reference=CalRegn01Inin00DMotTqTranlDampgRampEndDMotTqTranlDampgDMotTqTranlDampgRampEnd
      AssemblySwConnector_580: ecu-extract-reference=CalRegn01Inin00DMotTqTranlDampgTmrPt1DMotTqTranlDampgDMotTqTranlDampgTmrPt1
      AssemblySwConnector_581: ecu-extract-reference=CalRegn01Inin00DMotTqTranlDampgTmrPt2DMotTqTranlDampgDMotTqTranlDampgTmrPt2
      AssemblySwConnector_582: ecu-extract-reference=CalRegn01Inin00DMotTqTranlDampgVehSpdBlndXDMotTqTranlDampgDMotTqTranlDampgVehSpdBlndX
      AssemblySwConnector_583: ecu-extract-reference=CalRegn01Inin00DMotTqTranlDampgVelThdDMotTqTranlDampgDMotTqTranlDampgVelThd
      AssemblySwConnector_585: ecu-extract-reference=CalRegn01Inin00DPwrDiscnctNtc0x042FailStepDPwrDiscnctDPwrDiscnctNtc0x042FailStep
      AssemblySwConnector_586: ecu-extract-reference=CalRegn01Inin00DPwrDiscnctNtc0x042PassStepDPwrDiscnctDPwrDiscnctNtc0x042PassStep
      AssemblySwConnector_587: ecu-extract-reference=CalRegn01Inin00DPwrDiscnctNtc0x04AFailStepDPwrDiscnctDPwrDiscnctNtc0x04AFailStep
      AssemblySwConnector_588: ecu-extract-reference=CalRegn01Inin00DPwrDiscnctNtc0x04APassStepDPwrDiscnctDPwrDiscnctNtc0x04APassStep
      AssemblySwConnector_601: ecu-extract-reference=CalRegn01Inin00DTEstimnAmbPwrMplrDTEstimnDTEstimnAmbPwrMplr
      AssemblySwConnector_602: ecu-extract-reference=CalRegn01Inin00DTEstimnAmbTScaDTEstimnDTEstimnAmbTSca
      AssemblySwConnector_603: ecu-extract-reference=CalRegn01Inin00DTEstimnAssiMechAmbLpFilFrqDTEstimnDTEstimnAssiMechAmbLpFilFrq
      AssemblySwConnector_604: ecu-extract-reference=CalRegn01Inin00DTEstimnAssiMechAmbMplrDTEstimnDTEstimnAssiMechAmbMplr
      AssemblySwConnector_605: ecu-extract-reference=CalRegn01Inin00DTEstimnAssiMechCorrLimDTEstimnDTEstimnAssiMechCorrLim
      AssemblySwConnector_606: ecu-extract-reference=CalRegn01Inin00DTEstimnAssiMechDampgScaDTEstimnDTEstimnAssiMechDampgSca
      AssemblySwConnector_607: ecu-extract-reference=CalRegn01Inin00DTEstimnAssiMechDftTDTEstimnDTEstimnAssiMechDftT
      AssemblySwConnector_608: ecu-extract-reference=CalRegn01Inin00DTEstimnAssiMechLLFilCoeffA1DTEstimnDTEstimnAssiMechLLFilCoeffA1
      AssemblySwConnector_609: ecu-extract-reference=CalRegn01Inin00DTEstimnAssiMechLLFilCoeffB0DTEstimnDTEstimnAssiMechLLFilCoeffB0
      AssemblySwConnector_610: ecu-extract-reference=CalRegn01Inin00DTEstimnAssiMechLLFilCoeffB1DTEstimnDTEstimnAssiMechLLFilCoeffB1
      AssemblySwConnector_611: ecu-extract-reference=CalRegn01Inin00DTEstimnAssiMechSlewDTEstimnDTEstimnAssiMechSlew
      AssemblySwConnector_612: ecu-extract-reference=CalRegn01Inin00DTEstimnCorrnTAssiMechDTEstimnDTEstimnCorrnTAssiMech
      AssemblySwConnector_613: ecu-extract-reference=CalRegn01Inin00DTEstimnCorrnTCuDTEstimnDTEstimnCorrnTCu
      AssemblySwConnector_614: ecu-extract-reference=CalRegn01Inin00DTEstimnCorrnTMagDTEstimnDTEstimnCorrnTMag
      AssemblySwConnector_615: ecu-extract-reference=CalRegn01Inin00DTEstimnCorrnTSiDTEstimnDTEstimnCorrnTSi
      AssemblySwConnector_616: ecu-extract-reference=CalRegn01Inin00DTEstimnCuAmbLpFilFrqDTEstimnDTEstimnCuAmbLpFilFrq
      AssemblySwConnector_617: ecu-extract-reference=CalRegn01Inin00DTEstimnCuAmbMplrDTEstimnDTEstimnCuAmbMplr
      AssemblySwConnector_618: ecu-extract-reference=CalRegn01Inin00DTEstimnCuCorrnLimDTEstimnDTEstimnCuCorrnLim
      AssemblySwConnector_619: ecu-extract-reference=CalRegn01Inin00DTEstimnCuLLFilCoeffA1DTEstimnDTEstimnCuLLFilCoeffA1
      AssemblySwConnector_620: ecu-extract-reference=CalRegn01Inin00DTEstimnCuLLFilCoeffB0DTEstimnDTEstimnCuLLFilCoeffB0
      AssemblySwConnector_621: ecu-extract-reference=CalRegn01Inin00DTEstimnCuLLFilCoeffB1DTEstimnDTEstimnCuLLFilCoeffB1
      AssemblySwConnector_622: ecu-extract-reference=CalRegn01Inin00DTEstimnEngTScaDTEstimnDTEstimnEngTSca
      AssemblySwConnector_623: ecu-extract-reference=CalRegn01Inin00DTEstimnMagAmbLpFilFrqDTEstimnDTEstimnMagAmbLpFilFrq
      AssemblySwConnector_624: ecu-extract-reference=CalRegn01Inin00DTEstimnMagCorrnLimDTEstimnDTEstimnMagCorrnLim
      AssemblySwConnector_625: ecu-extract-reference=CalRegn01Inin00DTEstimnMagLLFilCoeffA1DTEstimnDTEstimnMagLLFilCoeffA1
      AssemblySwConnector_626: ecu-extract-reference=CalRegn01Inin00DTEstimnMagLLFilCoeffB0DTEstimnDTEstimnMagLLFilCoeffB0
      AssemblySwConnector_627: ecu-extract-reference=CalRegn01Inin00DTEstimnMagLLFilCoeffB1DTEstimnDTEstimnMagLLFilCoeffB1
      AssemblySwConnector_628: ecu-extract-reference=CalRegn01Inin00DTEstimnSiAmbLpFilFrqDTEstimnDTEstimnSiAmbLpFilFrq
      AssemblySwConnector_629: ecu-extract-reference=CalRegn01Inin00DTEstimnSiAmbMplrDTEstimnDTEstimnSiAmbMplr
      AssemblySwConnector_630: ecu-extract-reference=CalRegn01Inin00DTEstimnSiCorrnLimDTEstimnDTEstimnSiCorrnLim
      AssemblySwConnector_631: ecu-extract-reference=CalRegn01Inin00DTEstimnSiLLFilCoeffA1DTEstimnDTEstimnSiLLFilCoeffA1
      AssemblySwConnector_632: ecu-extract-reference=CalRegn01Inin00DTEstimnSiLLFilCoeffB0DTEstimnDTEstimnSiLLFilCoeffB0
      AssemblySwConnector_633: ecu-extract-reference=CalRegn01Inin00DTEstimnSiLLFilCoeffB1DTEstimnDTEstimnSiLLFilCoeffB1
      AssemblySwConnector_634: ecu-extract-reference=CalRegn01Inin00DTEstimnWghtAvrgTDiDTEstimnDTEstimnWghtAvrgTDi
      AssemblySwConnector_637: ecu-extract-reference=CalRegn01Inin00DVehSigCdngLatASlewRateDVehSigCdngDVehSigCdngLatASlewRate
      AssemblySwConnector_638: ecu-extract-reference=CalRegn01Inin00DVehSigCdngLtgASlewRateDVehSigCdngDVehSigCdngLtgASlewRate
      AssemblySwConnector_639: ecu-extract-reference=CalRegn01Inin00DVehSigCdngVehSpdSlewRateDVehSigCdngDVehSigCdngVehSpdSlewRate
      AssemblySwConnector_659: ecu-extract-reference=CalRegn01Rt00DTEstimnMagAmbMplrDTEstimnDTEstimnMagAmbMplr
      AssemblySwConnector_669: ecu-extract-reference=CalRegn02CmnDDiagcMgrFltRespDDiagcMgrDDiagcMgrFltResp
      AssemblySwConnector_670: ecu-extract-reference=CalRegn02CmnDDiagcMgrFltRespDDiagcMgrProxyAppl10DDiagcMgrFltResp
      AssemblySwConnector_671: ecu-extract-reference=CalRegn02CmnDDiagcMgrFltRespDDiagcMgrProxyAppl6DDiagcMgrFltResp
      AssemblySwConnector_674: ecu-extract-reference=CalRegn03CmnDDampgQuadHwTqBacklshDDampgDDampgQuadHwTqBacklsh
      AssemblySwConnector_675: ecu-extract-reference=CalRegn03CmnDDampgQuadMotVelBacklshDDampgDDampgQuadMotVelBacklsh
      AssemblySwConnector_726: ecu-extract-reference=CalRegn03CmnGroupADDampgHwTqXDDampgDDampgHwTqX
      AssemblySwConnector_727: ecu-extract-reference=CalRegn03CmnGroupADDampgHwTqYDDampgDDampgHwTqY
      AssemblySwConnector_734: ecu-extract-reference=CalRegn03CmnGroupADRtnVehSpdSelnDRtnDRtnVehSpdSeln
      AssemblySwConnector_736: ecu-extract-reference=CalRegn03Inin00DDampgHydAssiLimDDampgDDampgHydAssiLim
      AssemblySwConnector_737: ecu-extract-reference=CalRegn03Inin00DDampgHydBasCoeff1DDampgDDampgHydBasCoeff1
      AssemblySwConnector_738: ecu-extract-reference=CalRegn03Inin00DDampgHydBasCoeff2DDampgDDampgHydBasCoeff2
      AssemblySwConnector_739: ecu-extract-reference=CalRegn03Inin00DDampgHydBasCoeff3DDampgDDampgHydBasCoeff3
      AssemblySwConnector_740: ecu-extract-reference=CalRegn03Inin00DDampgHydBasCoeff4DDampgDDampgHydBasCoeff4
      AssemblySwConnector_741: ecu-extract-reference=CalRegn03Inin00DDampgHydOutpLimDDampgDDampgHydOutpLim
      AssemblySwConnector_742: ecu-extract-reference=CalRegn03Inin00DDampgMotVelLpFilFrqDDampgDDampgMotVelLpFilFrq
      AssemblySwConnector_743: ecu-extract-reference=CalRegn03Inin00DDampgQuad13MplrDDampgDDampgQuad13Mplr
      AssemblySwConnector_744: ecu-extract-reference=CalRegn03Inin00DDampgQuad24MplrDDampgDDampgQuad24Mplr
      AssemblySwConnector_745: ecu-extract-reference=CalRegn03Inin00DDampgQuadHwTqLpFilFrqDDampgDDampgQuadHwTqLpFilFrq
      AssemblySwConnector_746: ecu-extract-reference=CalRegn03Inin00DDampgQuadMotVelLpFilFrqDDampgDDampgQuadMotVelLpFilFrq
      AssemblySwConnector_747: ecu-extract-reference=CalRegn03Inin00DDampgQuadScaLpFilFrqDDampgDDampgQuadScaLpFilFrq
      AssemblySwConnector_748: ecu-extract-reference=CalRegn03Inin00DHysCmpAssiCmdLpFilFrqDHysCmpDHysCmpAssiCmdLpFilFrq
      AssemblySwConnector_750: ecu-extract-reference=CalRegn03Inin00DHysCmpFinalOutpLpFilFrqDHysCmpDHysCmpFinalOutpLpFilFrq
      AssemblySwConnector_753: ecu-extract-reference=CalRegn03Inin00DHysCmpHwTqLpFilFrqDHysCmpDHysCmpHwTqLpFilFrq
      AssemblySwConnector_754: ecu-extract-reference=CalRegn03Inin00DRtnHwAuthyScaXDRtnDRtnHwAuthyScaX
      AssemblySwConnector_755: ecu-extract-reference=CalRegn03Inin00DRtnHwAuthyScaYDRtnDRtnHwAuthyScaY
      AssemblySwConnector_756: ecu-extract-reference=CalRegn03Inin00DRtnHwAuthySlewDRtnDRtnHwAuthySlew
      AssemblySwConnector_757: ecu-extract-reference=CalRegn03Inin00DRtnOffsRngDRtnDRtnOffsRng
      AssemblySwConnector_758: ecu-extract-reference=CalRegn03Inin00DRtnOffsSlewDRtnDRtnOffsSlew
      AssemblySwConnector_761: ecu-extract-reference=CalRegn03Inin00GroupADDampgTScaXDDampgDDampgTScaX
      AssemblySwConnector_762: ecu-extract-reference=CalRegn03Inin00GroupADDampgTScaYDDampgDDampgTScaY
      AssemblySwConnector_764: ecu-extract-reference=CalRegn03Rt00GroupADAssiMotTqWhlImbRejctnMinXDAssiDAssiMotTqWhlImbRejctnMinX
      AssemblySwConnector_765: ecu-extract-reference=CalRegn03Rt00GroupADAssiMotTqWhlImbRejctnMinYDAssiDAssiMotTqWhlImbRejctnMinY
      AssemblySwConnector_766: ecu-extract-reference=CalRegn03Rt00GroupADAssiHiFrqGainYDAssiHiFrqDAssiHiFrqGainY
      AssemblySwConnector_767: ecu-extract-reference=CalRegn03Rt00GroupADAssiHiFrqTqXDAssiHiFrqDAssiHiFrqTqX
      AssemblySwConnector_768: ecu-extract-reference=CalRegn03Rt00GroupADDampgHydCoeff1ScaYDDampgDDampgHydCoeff1ScaY
      AssemblySwConnector_769: ecu-extract-reference=CalRegn03Rt00GroupADDampgHydCoeff2ScaYDDampgDDampgHydCoeff2ScaY
      AssemblySwConnector_770: ecu-extract-reference=CalRegn03Rt00GroupADDampgHydCoeff3ScaYDDampgDDampgHydCoeff3ScaY
      AssemblySwConnector_771: ecu-extract-reference=CalRegn03Rt00GroupADDampgHydCoeff4ScaYDDampgDDampgHydCoeff4ScaY
      AssemblySwConnector_772: ecu-extract-reference=CalRegn03Rt00GroupADDampgMotVelXDDampgDDampgMotVelX
      AssemblySwConnector_773: ecu-extract-reference=CalRegn03Rt00GroupADDampgMotVelYDDampgDDampgMotVelY
      AssemblySwConnector_774: ecu-extract-reference=CalRegn03Rt00GroupBDAssiMotTqWhlImbRejctnMaxXDAssiDAssiMotTqWhlImbRejctnMaxX
      AssemblySwConnector_775: ecu-extract-reference=CalRegn03Rt00GroupBDAssiMotTqWhlImbRejctnMaxYDAssiDAssiMotTqWhlImbRejctnMaxY
      AssemblySwConnector_776: ecu-extract-reference=CalRegn03Rt00GroupBDAssiWhlImbRejctnBlndScaXDAssiDAssiWhlImbRejctnBlndScaX
      AssemblySwConnector_777: ecu-extract-reference=CalRegn03Rt00GroupBDAssiWhlImbRejctnBlndScaYDAssiDAssiWhlImbRejctnBlndScaY
      AssemblySwConnector_778: ecu-extract-reference=CalRegn03Rt00GroupBDAssiHiFrqTqWhlImbRejctnTqXDAssiHiFrqDAssiHiFrqTqWhlImbRejctnTqX
      AssemblySwConnector_779: ecu-extract-reference=CalRegn03Rt00GroupBDAssiHiFrqWhlImbRejctnGainYDAssiHiFrqDAssiHiFrqWhlImbRejctnGainY
      AssemblySwConnector_780: ecu-extract-reference=CalRegn03Rt00GroupBDAssiHiFrqWhlImbRejtcnBlndXDAssiHiFrqDAssiHiFrqWhlImbRejtcnBlndX
      AssemblySwConnector_781: ecu-extract-reference=CalRegn03Rt00GroupBDAssiHiFrqWhlImbRejtcnBlndYDAssiHiFrqDAssiHiFrqWhlImbRejtcnBlndY
      AssemblySwConnector_782: ecu-extract-reference=CDD_Adc1CfgAndUseDAdc1CfgAndUseAdc1EnaCnvnDCDD_DmaCfgAndUseDAdc1CfgAndUseAdc1EnaCnvn
      AssemblySwConnector_783: ecu-extract-reference=CDD_CurrMeasDCurrMeasWrmIninTestCmplDCDD_MotCtrlMgrDMotCtrlCurrMeasWrmIninTestCmpl
      AssemblySwConnector_784: ecu-extract-reference=CDD_CurrMeasDMotCurrEolCalStDCDD_MotCtrlMgrDMotCurrEolCalSt
      AssemblySwConnector_785: ecu-extract-reference=CDD_CurrMeasDMotCurrEolCalStDCDD_TSG31CfgAndUseDMotCurrEolCalSt
      AssemblySwConnector_786: ecu-extract-reference=CDD_CurrMeasDCurrMeasEolGainReqDCmnMfgSrvDCurrMeasEolGainReq
      AssemblySwConnector_788: ecu-extract-reference=CDD_CurrMeasDCurrMeasEolOffsReqDCmnMfgSrvDCurrMeasEolOffsReq
      AssemblySwConnector_790: ecu-extract-reference=CDD_CurrMeasDCurrMeasGainReadReqDCmnMfgSrvDCurrMeasGainReadReq
      AssemblySwConnector_792: ecu-extract-reference=CDD_CurrMeasDCurrMeasOffsReadReqDCmnMfgSrvDCurrMeasOffsReadReq
      AssemblySwConnector_794: ecu-extract-reference=CDD_CurrMeasDMotCurrEolCalStDCurrMeasCorrlnDMotCurrEolCalSt
      AssemblySwConnector_795: ecu-extract-reference=CDD_CurrMeasDMotCurrEolCalStDMotCurrRegCfgDMotCurrEolCalSt
      AssemblySwConnector_796: ecu-extract-reference=CDD_CurrMeasDCurrMeasWrmIninTestCmplDPwrUpSeqDCurrMeasWrmIninTestCmpl
      AssemblySwConnector_797: ecu-extract-reference=CDD_DmaCfgAndUseDDmaEna2MilliSecToMotCtrlTrfDCDD_MotCtrlMgrDDmaEna2MilliSecToMotCtrlTrf
      AssemblySwConnector_798: ecu-extract-reference=CDD_DmaCfgAndUseDDmaWaitForMotCtrlTo2MilliSecTrfDCDD_MotCtrlMgrDDmaWaitForMotCtrlTo2MilliSecTrf
      AssemblySwConnector_799: ecu-extract-reference=CDD_EcmOutpAndDiagcDCtrlErrOutDTmplMonrDCtrlErrOut
      AssemblySwConnector_800: ecu-extract-reference=CDD_GmT1xxMcuCfgDBattVltgDBattVltgDBattVltg
      AssemblySwConnector_801: ecu-extract-reference=CDD_GmT1xxMcuCfgDBattVltgSwd1DBattVltgDBattVltgSwd1
      AssemblySwConnector_802: ecu-extract-reference=CDD_GmT1xxMcuCfgDBattVltgSwd2DBattVltgDBattVltgSwd2
      AssemblySwConnector_803: ecu-extract-reference=CDD_GmT1xxMcuCfgDBattVltgDBattVltgCorrlnDBattVltg
      AssemblySwConnector_804: ecu-extract-reference=CDD_GmT1xxMcuCfgDBattVltgSwd1DBattVltgCorrlnDBattVltgSwd1
      AssemblySwConnector_805: ecu-extract-reference=CDD_GmT1xxMcuCfgDBattVltgSwd2DBattVltgCorrlnDBattVltgSwd2
      AssemblySwConnector_806: ecu-extract-reference=CDD_GmT1xxMcuCfgDEcuTDEcuTMeasDEcuT
      AssemblySwConnector_809: ecu-extract-reference=CDD_GmT1xxMcuCfgDBattVltgDPwrDiscnctDBattVltg
      AssemblySwConnector_810: ecu-extract-reference=CDD_GmT1xxMcuCfgDBattVltgSwd1DPwrDiscnctDBattVltgSwd1
      AssemblySwConnector_811: ecu-extract-reference=CDD_GmT1xxMcuCfgDBattVltgSwd2DPwrDiscnctDBattVltgSwd2
      AssemblySwConnector_812: ecu-extract-reference=CDD_HwTq0MeasDHwTq0MeasHwTq0AutTrimDCmnMfgSrvDHwTq0MeasHwTq0AutTrim
      AssemblySwConnector_813: ecu-extract-reference=CDD_HwTq0MeasDHwTq0MeasHwTq0ClrTrimDCmnMfgSrvDHwTq0MeasHwTq0ClrTrim
      AssemblySwConnector_814: ecu-extract-reference=CDD_HwTq0MeasDHwTq0MeasHwTq0ReadTrimDCmnMfgSrvDHwTq0MeasHwTq0ReadTrim
      AssemblySwConnector_815: ecu-extract-reference=CDD_HwTq0MeasDHwTq0MeasHwTq0TrimPrfmdStsDCmnMfgSrvDHwTq0MeasHwTq0TrimPrfmdSts
      AssemblySwConnector_816: ecu-extract-reference=CDD_HwTq0MeasDHwTq0MeasHwTq0WrTrimDCmnMfgSrvDHwTq0MeasHwTq0WrTrim
      AssemblySwConnector_817: ecu-extract-reference=CDD_HwTq0MeasDRackLimrEotSig0AvlDEotLrngDHwAgEotSig0Avl
      AssemblySwConnector_818: ecu-extract-reference=CDD_HwTq0MeasDRackLimrCcwEotSig0DEotLrngDHwAgEotSig0Ccw
      AssemblySwConnector_819: ecu-extract-reference=CDD_HwTq0MeasDRackLimrCwEotSig0DEotLrngDHwAgEotSig0Cw
      AssemblySwConnector_820: ecu-extract-reference=CDD_HwTq0MeasDHwTq0DHwTqArbnDHwTqA
      AssemblySwConnector_821: ecu-extract-reference=CDD_HwTq0MeasDHwTq0QlfrDHwTqArbnDHwTqAQlfr
      AssemblySwConnector_822: ecu-extract-reference=CDD_HwTq0MeasDHwTq0RollgCntrDHwTqArbnDHwTqARollgCntr
      AssemblySwConnector_823: ecu-extract-reference=CDD_HwTq0MeasDHwTq0DHwTqCorrlnDHwTqA
      AssemblySwConnector_824: ecu-extract-reference=CDD_HwTq0MeasDHwTq0QlfrDHwTqCorrlnDHwTqAQlfr
      AssemblySwConnector_825: ecu-extract-reference=CDD_HwTq0MeasDHwTq0RollgCntrDHwTqCorrlnDHwTqARollgCntr
      AssemblySwConnector_826: ecu-extract-reference=CDD_HwTq1MeasDHwTq1MeasHwTq1AutTrimDCmnMfgSrvDHwTq1MeasHwTq1AutTrim
      AssemblySwConnector_827: ecu-extract-reference=CDD_HwTq1MeasDHwTq1MeasHwTq1ClrTrimDCmnMfgSrvDHwTq1MeasHwTq1ClrTrim
      AssemblySwConnector_828: ecu-extract-reference=CDD_HwTq1MeasDHwTq1MeasHwTq1ReadTrimDCmnMfgSrvDHwTq1MeasHwTq1ReadTrim
      AssemblySwConnector_829: ecu-extract-reference=CDD_HwTq1MeasDHwTq1MeasHwTq1TrimPrfmdStsDCmnMfgSrvDHwTq1MeasHwTq1TrimPrfmdSts
      AssemblySwConnector_830: ecu-extract-reference=CDD_HwTq1MeasDHwTq1MeasHwTq1WrTrimDCmnMfgSrvDHwTq1MeasHwTq1WrTrim
      AssemblySwConnector_831: ecu-extract-reference=CDD_HwTq1MeasDRackLimrEotSig1AvlDEotLrngDHwAgEotSig1Avl
      AssemblySwConnector_832: ecu-extract-reference=CDD_HwTq1MeasDRackLimrCcwEotSig1DEotLrngDHwAgEotSig1Ccw
      AssemblySwConnector_833: ecu-extract-reference=CDD_HwTq1MeasDRackLimrCwEotSig1DEotLrngDHwAgEotSig1Cw
      AssemblySwConnector_834: ecu-extract-reference=CDD_HwTq1MeasDHwTq1DHwTqArbnDHwTqB
      AssemblySwConnector_835: ecu-extract-reference=CDD_HwTq1MeasDHwTq1QlfrDHwTqArbnDHwTqBQlfr
      AssemblySwConnector_836: ecu-extract-reference=CDD_HwTq1MeasDHwTq1RollgCntrDHwTqArbnDHwTqBRollgCntr
      AssemblySwConnector_837: ecu-extract-reference=CDD_HwTq1MeasDHwTq1DHwTqCorrlnDHwTqB
      AssemblySwConnector_838: ecu-extract-reference=CDD_HwTq1MeasDHwTq1QlfrDHwTqCorrlnDHwTqBQlfr
      AssemblySwConnector_839: ecu-extract-reference=CDD_HwTq1MeasDHwTq1RollgCntrDHwTqCorrlnDHwTqBRollgCntr
      AssemblySwConnector_840: ecu-extract-reference=CDD_HwTq2MeasDHwTq2MeasHwTq2AutTrimDCmnMfgSrvDHwTq2MeasHwTq2AutTrim
      AssemblySwConnector_841: ecu-extract-reference=CDD_HwTq2MeasDHwTq2MeasHwTq2ClrTrimDCmnMfgSrvDHwTq2MeasHwTq2ClrTrim
      AssemblySwConnector_842: ecu-extract-reference=CDD_HwTq2MeasDHwTq2MeasHwTq2ReadTrimDCmnMfgSrvDHwTq2MeasHwTq2ReadTrim
      AssemblySwConnector_843: ecu-extract-reference=CDD_HwTq2MeasDHwTq2MeasHwTq2TrimPrfmdStsDCmnMfgSrvDHwTq2MeasHwTq2TrimPrfmdSts
      AssemblySwConnector_844: ecu-extract-reference=CDD_HwTq2MeasDHwTq2MeasHwTq2WrTrimDCmnMfgSrvDHwTq2MeasHwTq2WrTrim
      AssemblySwConnector_845: ecu-extract-reference=CDD_HwTq2MeasDHwTq2DHwTqArbnDHwTqC
      AssemblySwConnector_846: ecu-extract-reference=CDD_HwTq2MeasDHwTq2QlfrDHwTqArbnDHwTqCQlfr
      AssemblySwConnector_847: ecu-extract-reference=CDD_HwTq2MeasDHwTq2RollgCntrDHwTqArbnDHwTqCRollgCntr
      AssemblySwConnector_848: ecu-extract-reference=CDD_HwTq2MeasDHwTq2DHwTqCorrlnDHwTqC
      AssemblySwConnector_849: ecu-extract-reference=CDD_HwTq2MeasDHwTq2QlfrDHwTqCorrlnDHwTqCQlfr
      AssemblySwConnector_850: ecu-extract-reference=CDD_HwTq2MeasDHwTq2RollgCntrDHwTqCorrlnDHwTqCRollgCntr
      AssemblySwConnector_851: ecu-extract-reference=CDD_HwTq3MeasDHwTq3MeasHwTq3AutTrimDCmnMfgSrvDHwTq3MeasHwTq3AutTrim
      AssemblySwConnector_852: ecu-extract-reference=CDD_HwTq3MeasDHwTq3MeasHwTq3ClrTrimDCmnMfgSrvDHwTq3MeasHwTq3ClrTrim
      AssemblySwConnector_853: ecu-extract-reference=CDD_HwTq3MeasDHwTq3MeasHwTq3ReadTrimDCmnMfgSrvDHwTq3MeasHwTq3ReadTrim
      AssemblySwConnector_854: ecu-extract-reference=CDD_HwTq3MeasDHwTq3MeasHwTq3TrimPrfmdStsDCmnMfgSrvDHwTq3MeasHwTq3TrimPrfmdSts
      AssemblySwConnector_855: ecu-extract-reference=CDD_HwTq3MeasDHwTq3MeasHwTq3WrTrimDCmnMfgSrvDHwTq3MeasHwTq3WrTrim
      AssemblySwConnector_856: ecu-extract-reference=CDD_HwTq3MeasDHwTq3DHwTqArbnDHwTqD
      AssemblySwConnector_857: ecu-extract-reference=CDD_HwTq3MeasDHwTq3QlfrDHwTqArbnDHwTqDQlfr
      AssemblySwConnector_858: ecu-extract-reference=CDD_HwTq3MeasDHwTq3RollgCntrDHwTqArbnDHwTqDRollgCntr
      AssemblySwConnector_859: ecu-extract-reference=CDD_HwTq3MeasDHwTq3DHwTqCorrlnDHwTqD
      AssemblySwConnector_860: ecu-extract-reference=CDD_HwTq3MeasDHwTq3QlfrDHwTqCorrlnDHwTqDQlfr
      AssemblySwConnector_861: ecu-extract-reference=CDD_HwTq3MeasDHwTq3RollgCntrDHwTqCorrlnDHwTqDRollgCntr
      AssemblySwConnector_862: ecu-extract-reference=CDD_MotAg0MeasDMotAg0MeclQlfrDCDD_MotCtrlMgrDMotAg0MeclQlfr
      AssemblySwConnector_865: ecu-extract-reference=CDD_MotAg0MeasDMotAg0MeclQlfrDMotAgCorrlnDMotAgAMeclQlfr
      AssemblySwConnector_866: ecu-extract-reference=CDD_MotAg1MeasDMotAg1MeclQlfrDCDD_MotCtrlMgrDMotAg1MeclQlfr
      AssemblySwConnector_869: ecu-extract-reference=CDD_MotAg1MeasDMotAg1MeclQlfrDMotAgCorrlnDMotAgBMeclQlfr
      AssemblySwConnector_870: ecu-extract-reference=CDD_MotAgCmpDMotAgCmpBackEmfReadDCmnMfgSrvDMotAgCmpBackEmfRead
      AssemblySwConnector_871: ecu-extract-reference=CDD_MotAgCmpDMotAgCmpBackEmfWrDCmnMfgSrvDMotAgCmpBackEmfWr
      AssemblySwConnector_872: ecu-extract-reference=CDD_MotAgCmpDMotAgCumvAlgndMrfDMotQuadDetnDMotAgCumvAlgndMrf
      AssemblySwConnector_873: ecu-extract-reference=CDD_MotCtrlMgrDMotCurrAdcVlyADCDD_CurrMeasDMotCurrAdcVlyA
      AssemblySwConnector_874: ecu-extract-reference=CDD_MotCtrlMgrDMotCurrAdcVlyBDCDD_CurrMeasDMotCurrAdcVlyB
      AssemblySwConnector_875: ecu-extract-reference=CDD_MotCtrlMgrDMotCurrAdcVlyCDCDD_CurrMeasDMotCurrAdcVlyC
      AssemblySwConnector_879: ecu-extract-reference=CDD_MotCtrlMgrDNtc5DErrCntDCDD_CurrMeasDNtc5DErrCnt
      AssemblySwConnector_880: ecu-extract-reference=CDD_MotCtrlMgrDNtc6DErrCntDCDD_CurrMeasDNtc6DErrCnt
      AssemblySwConnector_887: ecu-extract-reference=CDD_MotCtrlMgrDMotAgCumvAlgndMrfRevDCDD_MotAgCmpDMotAgCumvAlgndMrfRev
      AssemblySwConnector_888: ecu-extract-reference=CDD_MotCtrlMgrDMotAgBufDCDD_MotVelDMotAgBuf
      AssemblySwConnector_889: ecu-extract-reference=CDD_MotCtrlMgrDMotAgBufIdxDCDD_MotVelDMotAgBufIdx
      AssemblySwConnector_890: ecu-extract-reference=CDD_MotCtrlMgrDMotAgTiBufDCDD_MotVelDMotAgTiBuf
      AssemblySwConnector_891: ecu-extract-reference=CDD_MotCtrlMgrDMotCurrCorrdADCurrMeasCorrlnDMotCurrCorrdA
      AssemblySwConnector_892: ecu-extract-reference=CDD_MotCtrlMgrDMotCurrCorrdBDCurrMeasCorrlnDMotCurrCorrdB
      AssemblySwConnector_893: ecu-extract-reference=CDD_MotCtrlMgrDMotCurrCorrdCDCurrMeasCorrlnDMotCurrCorrdC
      AssemblySwConnector_894: ecu-extract-reference=CDD_MotCtrlMgrDMotCurrCorrdDDCurrMeasCorrlnDMotCurrCorrdD
      AssemblySwConnector_895: ecu-extract-reference=CDD_MotCtrlMgrDMotCurrCorrdEDCurrMeasCorrlnDMotCurrCorrdE
      AssemblySwConnector_896: ecu-extract-reference=CDD_MotCtrlMgrDMotCurrCorrdFDCurrMeasCorrlnDMotCurrCorrdF
      AssemblySwConnector_899: ecu-extract-reference=CDD_MotCtrlMgrDMotCurrRollgCntr1DCurrMeasCorrlnDMotCurrRollgCntr1
      AssemblySwConnector_900: ecu-extract-reference=CDD_MotCtrlMgrDMotCurrRollgCntr2DCurrMeasCorrlnDMotCurrRollgCntr2
      AssemblySwConnector_901: ecu-extract-reference=CDD_MotCtrlMgrDMotAg0MeclDMotAgCorrlnDMotAgAMecl
      AssemblySwConnector_903: ecu-extract-reference=CDD_MotCtrlMgrDMotAg1MeclDMotAgCorrlnDMotAgBMecl
      AssemblySwConnector_905: ecu-extract-reference=CDD_MotCtrlMgrDMotCurrDaxDMotCurrPeakEstimnDMotCurrDax
      AssemblySwConnector_906: ecu-extract-reference=CDD_MotCtrlMgrDMotCurrQaxDMotCurrPeakEstimnDMotCurrQax
      AssemblySwConnector_907: ecu-extract-reference=CDD_MotCtrlMgrDPhaOnTiSumADMotDrvDiagcDPhaOnTiSumA
      AssemblySwConnector_908: ecu-extract-reference=CDD_MotCtrlMgrDPhaOnTiSumBDMotDrvDiagcDPhaOnTiSumB
      AssemblySwConnector_909: ecu-extract-reference=CDD_MotCtrlMgrDPhaOnTiSumCDMotDrvDiagcDPhaOnTiSumC
      AssemblySwConnector_910: ecu-extract-reference=CDD_MotVelDMotVelMrfDCDD_CurrMeasDMotVelMrf
      AssemblySwConnector_911: ecu-extract-reference=CDD_MotVelDMotVelMrfDCDD_MotCtrlMgrDMotVelMrf
      AssemblySwConnector_912: ecu-extract-reference=CDD_MotVelDMotVelCrfDDampgDMotVelCrf
      AssemblySwConnector_913: ecu-extract-reference=CDD_MotVelDMotVelCrfDDutyCycThermProtnDMotVelCrf
      AssemblySwConnector_914: ecu-extract-reference=CDD_MotVelDMotVelCrfDEotLrngDMotVelCrf
      AssemblySwConnector_915: ecu-extract-reference=CDD_MotVelDMotVelCrfDEotProtnDMotVelCrf
      AssemblySwConnector_916: ecu-extract-reference=CDD_MotVelDHwVelDFltInjDHwVel
      AssemblySwConnector_917: ecu-extract-reference=CDD_MotVelDHwVelDGmMsg1E5BusChassisExpDHwVel
      AssemblySwConnector_918: ecu-extract-reference=CDD_MotVelDHwVelDGmMsg1E5BusHiSpdDHwVel
      AssemblySwConnector_919: ecu-extract-reference=CDD_MotVelDHwVelDGmStrtStopDHwVel
      AssemblySwConnector_920: ecu-extract-reference=CDD_MotVelDMotVelCrfDHiLoadStallLimrDMotVelCrf
      AssemblySwConnector_921: ecu-extract-reference=CDD_MotVelDMotVelCrfDInertiaCmpVelDMotVelCrf
      AssemblySwConnector_922: ecu-extract-reference=CDD_MotVelDMotVelMrfDMotCurrRegCfgDMotVelMrf
      AssemblySwConnector_923: ecu-extract-reference=CDD_MotVelDMotVelMrfDMotRefMdlDMotVelMrf
      AssemblySwConnector_924: ecu-extract-reference=CDD_MotVelDMotVelCrfDMotTqTranlDampgDMotVelCrf
      AssemblySwConnector_925: ecu-extract-reference=CDD_MotVelDHwVelDPullCmpActvDHwVel
      AssemblySwConnector_926: ecu-extract-reference=CDD_MotVelDMotVelMrfDPwrLimrDMotVelMrf
      AssemblySwConnector_927: ecu-extract-reference=CDD_MotVelDHwVelDRtnDHwVel
      AssemblySwConnector_928: ecu-extract-reference=CDD_MotVelDHwVelDTEstimnDHwVel
      AssemblySwConnector_929: ecu-extract-reference=CDD_MotVelDMotVelCrfDTqLoaDMotVelCrf
      AssemblySwConnector_930: ecu-extract-reference=CDD_NxtrTiDGetRefTmr1MicroSec32bitDCDD_DmaCfgAndUseDGetRefTmr1MicroSec32bit
      AssemblySwConnector_931: ecu-extract-reference=CDD_NxtrTiDGetTiSpan1MicroSec32bitDCDD_DmaCfgAndUseDGetTiSpan1MicroSec32bit
      AssemblySwConnector_932: ecu-extract-reference=CDD_NxtrTiDGetRefTmr1MicroSec32bitDCDD_GmT1xxMcuCfgDGetRefTmr1MicroSec32bit
      AssemblySwConnector_933: ecu-extract-reference=CDD_NxtrTiDGetTiSpan1MicroSec32bitDCDD_GmT1xxMcuCfgDGetTiSpan1MicroSec32bit
      AssemblySwConnector_934: ecu-extract-reference=CDD_NxtrTiDGetRefTmr1MicroSec32bitDCDD_HwTq0MeasDGetRefTmr1MicroSec32bit
      AssemblySwConnector_935: ecu-extract-reference=CDD_NxtrTiDGetTiSpan1MicroSec32bitDCDD_HwTq0MeasDGetTiSpan1MicroSec32bit
      AssemblySwConnector_936: ecu-extract-reference=CDD_NxtrTiDGetRefTmr1MicroSec32bitDCDD_HwTq1MeasDGetRefTmr1MicroSec32bit
      AssemblySwConnector_937: ecu-extract-reference=CDD_NxtrTiDGetTiSpan1MicroSec32bitDCDD_HwTq1MeasDGetTiSpan1MicroSec32bit
      AssemblySwConnector_938: ecu-extract-reference=CDD_NxtrTiDGetRefTmr1MicroSec32bitDCDD_HwTq2MeasDGetRefTmr1MicroSec32bit
      AssemblySwConnector_939: ecu-extract-reference=CDD_NxtrTiDGetTiSpan1MicroSec32bitDCDD_HwTq2MeasDGetTiSpan1MicroSec32bit
      AssemblySwConnector_940: ecu-extract-reference=CDD_NxtrTiDGetRefTmr1MicroSec32bitDCDD_HwTq3MeasDGetRefTmr1MicroSec32bit
      AssemblySwConnector_941: ecu-extract-reference=CDD_NxtrTiDGetTiSpan1MicroSec32bitDCDD_HwTq3MeasDGetTiSpan1MicroSec32bit
      AssemblySwConnector_942: ecu-extract-reference=CDD_NxtrTiDGetRefTmr100MicroSec32bitDCmnMfgSrvDGetRefTmr100MicroSec32bit1
      AssemblySwConnector_943: ecu-extract-reference=CDD_NxtrTiDGetTiSpan100MicroSec32bitDCmnMfgSrvDGetTiSpan100MicroSec32bit1
      AssemblySwConnector_944: ecu-extract-reference=CDD_NxtrTiDGetRefTmr100MicroSec32bitDCustDiagcDGetRefTmr100MicroSec32bit
      AssemblySwConnector_945: ecu-extract-reference=CDD_NxtrTiDGetTiSpan100MicroSec32bitDCustDiagcDGetTiSpan100MicroSec32bit
      AssemblySwConnector_946: ecu-extract-reference=CDD_NxtrTiDGetRefTmr100MicroSec32bitDEotLrngDGetRefTmr100MicroSec32bit
      AssemblySwConnector_947: ecu-extract-reference=CDD_NxtrTiDGetTiSpan100MicroSec32bitDEotLrngDGetTiSpan100MicroSec32bit
      AssemblySwConnector_948: ecu-extract-reference=CDD_NxtrTiDGetRefTmr100MicroSec32bitDFltInjDGetRefTmr100MicroSec32bit
      AssemblySwConnector_949: ecu-extract-reference=CDD_NxtrTiDGetTiSpan100MicroSec32bitDFltInjDGetTiSpan100MicroSec32bit
      AssemblySwConnector_950: ecu-extract-reference=CDD_NxtrTiDGetRefTmr100MicroSec32bitDGmMsg0C9BusHiSpdDGetRefTmr100MicroSec32bit
      AssemblySwConnector_951: ecu-extract-reference=CDD_NxtrTiDGetTiSpan100MicroSec32bitDGmMsg0C9BusHiSpdDGetTiSpan100MicroSec32bit
      AssemblySwConnector_952: ecu-extract-reference=CDD_NxtrTiDGetRefTmr100MicroSec32bitDGmMsg17DBusHiSpdDGetRefTmr100MicroSec32bit
      AssemblySwConnector_953: ecu-extract-reference=CDD_NxtrTiDGetTiSpan100MicroSec32bitDGmMsg17DBusHiSpdDGetTiSpan100MicroSec32bit
      AssemblySwConnector_954: ecu-extract-reference=CDD_NxtrTiDGetRefTmr100MicroSec32bitDGmMsg180BusChassisExpDGetRefTmr100MicroSec32bit
      AssemblySwConnector_955: ecu-extract-reference=CDD_NxtrTiDGetTiSpan100MicroSec32bitDGmMsg180BusChassisExpDGetTiSpan100MicroSec32bit
      AssemblySwConnector_956: ecu-extract-reference=CDD_NxtrTiDGetRefTmr100MicroSec32bitDGmMsg180BusHiSpdDGetRefTmr100MicroSec32bit
      AssemblySwConnector_957: ecu-extract-reference=CDD_NxtrTiDGetTiSpan100MicroSec32bitDGmMsg180BusHiSpdDGetTiSpan100MicroSec32bit
      AssemblySwConnector_958: ecu-extract-reference=CDD_NxtrTiDGetRefTmr100MicroSec32bitDGmMsg182BusChassisExpDGetRefTmr100MicroSec32bit
      AssemblySwConnector_959: ecu-extract-reference=CDD_NxtrTiDGetTiSpan100MicroSec32bitDGmMsg182BusChassisExpDGetTiSpan100MicroSec32bit
      AssemblySwConnector_964: ecu-extract-reference=CDD_NxtrTiDGetRefTmr100MicroSec32bitDGmMsg1E9BusHiSpdDGetRefTmr100MicroSec32bit
      AssemblySwConnector_965: ecu-extract-reference=CDD_NxtrTiDGetTiSpan100MicroSec32bitDGmMsg1E9BusHiSpdDGetTiSpan100MicroSec32bit
      AssemblySwConnector_966: ecu-extract-reference=CDD_NxtrTiDGetTiSpan100MicroSec32bitDGmMsg1F1BusHiSpdDGetTiSpan100MicroSec32bit
      AssemblySwConnector_967: ecu-extract-reference=CDD_NxtrTiDGetRefTmr100MicroSec32bitDGmMsg1F5BusHiSpdDGetRefTmr100MicroSec32bit
      AssemblySwConnector_968: ecu-extract-reference=CDD_NxtrTiDGetTiSpan100MicroSec32bitDGmMsg1F5BusHiSpdDGetTiSpan100MicroSec32bit
      AssemblySwConnector_969: ecu-extract-reference=CDD_NxtrTiDGetRefTmr100MicroSec32bitDGmMsg214BusHiSpdDGetRefTmr100MicroSec32bit
      AssemblySwConnector_970: ecu-extract-reference=CDD_NxtrTiDGetTiSpan100MicroSec32bitDGmMsg214BusHiSpdDGetTiSpan100MicroSec32bit
      AssemblySwConnector_971: ecu-extract-reference=CDD_NxtrTiDGetTiSpan100MicroSec32bitDGmMsg232BusHiSpdDGetTiSpan100MicroSec32bit
      AssemblySwConnector_974: ecu-extract-reference=CDD_NxtrTiDGetRefTmr100MicroSec32bitDGmMsg337BusChassisExpDGetRefTmr100MicroSec32bit
      AssemblySwConnector_975: ecu-extract-reference=CDD_NxtrTiDGetTiSpan100MicroSec32bitDGmMsg337BusChassisExpDGetTiSpan100MicroSec32bit
      AssemblySwConnector_976: ecu-extract-reference=CDD_NxtrTiDGetRefTmr100MicroSec32bitDGmMsg348BusChassisExpDGetRefTmr100MicroSec32bit
      AssemblySwConnector_977: ecu-extract-reference=CDD_NxtrTiDGetTiSpan100MicroSec32bitDGmMsg348BusChassisExpDGetTiSpan100MicroSec32bit
      AssemblySwConnector_978: ecu-extract-reference=CDD_NxtrTiDGetRefTmr100MicroSec32bitDGmMsg348BusHiSpdDGetRefTmr100MicroSec32bit
      AssemblySwConnector_979: ecu-extract-reference=CDD_NxtrTiDGetTiSpan100MicroSec32bitDGmMsg348BusHiSpdDGetTiSpan100MicroSec32bit
      AssemblySwConnector_980: ecu-extract-reference=CDD_NxtrTiDGetRefTmr100MicroSec32bitDGmMsg34ABusChassisExpDGetRefTmr100MicroSec32bit
      AssemblySwConnector_981: ecu-extract-reference=CDD_NxtrTiDGetTiSpan100MicroSec32bitDGmMsg34ABusChassisExpDGetTiSpan100MicroSec32bit
      AssemblySwConnector_982: ecu-extract-reference=CDD_NxtrTiDGetRefTmr100MicroSec32bitDGmMsg34ABusHiSpdDGetRefTmr100MicroSec32bit
      AssemblySwConnector_983: ecu-extract-reference=CDD_NxtrTiDGetTiSpan100MicroSec32bitDGmMsg34ABusHiSpdDGetTiSpan100MicroSec32bit
      AssemblySwConnector_986: ecu-extract-reference=CDD_NxtrTiDGetRefTmr100MicroSec32bitDGmMsg3F1BusHiSpdDGetRefTmr100MicroSec32bit
      AssemblySwConnector_987: ecu-extract-reference=CDD_NxtrTiDGetTiSpan100MicroSec32bitDGmMsg3F1BusHiSpdDGetTiSpan100MicroSec32bit
      AssemblySwConnector_990: ecu-extract-reference=CDD_NxtrTiDGetRefTmr100MicroSec32bitDGmOvrlStMgrDGetRefTmr100MicroSec32bit
      AssemblySwConnector_991: ecu-extract-reference=CDD_NxtrTiDGetTiSpan100MicroSec32bitDGmOvrlStMgrDGetTiSpan100MicroSec32bit
      AssemblySwConnector_992: ecu-extract-reference=CDD_NxtrTiDGetRefTmr100MicroSec32bitDGmStrtStopDGetRefTmr100MicroSec32bit
      AssemblySwConnector_993: ecu-extract-reference=CDD_NxtrTiDGetTiSpan100MicroSec32bitDGmStrtStopDGetTiSpan100MicroSec32bit
      AssemblySwConnector_994: ecu-extract-reference=CDD_NxtrTiDGetRefTmr100MicroSec32bitDGmVehPwrModDGetRefTmr100MicroSec32bit
      AssemblySwConnector_995: ecu-extract-reference=CDD_NxtrTiDGetTiSpan100MicroSec32bitDGmVehPwrModDGetTiSpan100MicroSec32bit
      AssemblySwConnector_996: ecu-extract-reference=CDD_NxtrTiDGetRefTmr1MicroSec32bitDHwAg0MeasDGetRefTmr1MicroSec32bit
      AssemblySwConnector_997: ecu-extract-reference=CDD_NxtrTiDGetTiSpan1MicroSec32bitDHwAg0MeasDGetTiSpan1MicroSec32bit
      AssemblySwConnector_998: ecu-extract-reference=CDD_NxtrTiDGetRefTmr1MicroSec32bitDHwAg1MeasDGetRefTmr1MicroSec32bit
      AssemblySwConnector_999: ecu-extract-reference=CDD_NxtrTiDGetTiSpan1MicroSec32bitDHwAg1MeasDGetTiSpan1MicroSec32bit
      AssemblySwConnector_1000: ecu-extract-reference=CDD_NxtrTiDGetRefTmr100MicroSec32bitDHwAgSysArbnDGetRefTmr100MicroSec32bit
      AssemblySwConnector_1001: ecu-extract-reference=CDD_NxtrTiDGetTiSpan100MicroSec32bitDHwAgSysArbnDGetTiSpan100MicroSec32bit
      AssemblySwConnector_1002: ecu-extract-reference=CDD_NxtrTiDGetRefTmr100MicroSec32bitDMotTqTranlDampgDGetRefTmr100MicroSec32bit
      AssemblySwConnector_1003: ecu-extract-reference=CDD_NxtrTiDGetTiSpan100MicroSec32bitDMotTqTranlDampgDGetTiSpan100MicroSec32bit
      AssemblySwConnector_1004: ecu-extract-reference=CDD_NxtrTiDGetRefTmr100MicroSec32bitDPullCmpActvDGetRefTmr100MicroSec32bit
      AssemblySwConnector_1005: ecu-extract-reference=CDD_NxtrTiDGetTiSpan100MicroSec32bitDPullCmpActvDGetTiSpan100MicroSec32bit
      AssemblySwConnector_1006: ecu-extract-reference=CDD_NxtrTiDGetRefTmr100MicroSec32bitDPwrLimrDGetRefTmr100MicroSec32bit
      AssemblySwConnector_1007: ecu-extract-reference=CDD_NxtrTiDGetTiSpan100MicroSec32bitDPwrLimrDGetTiSpan100MicroSec32bit
      AssemblySwConnector_1008: ecu-extract-reference=CDD_NxtrTiDGetRefTmr100MicroSec32bitDSerlComInpProxyDGetRefTmr100MicroSec32bit
      AssemblySwConnector_1010: ecu-extract-reference=CDD_Tauj0CfgAndUseDPhaOnTiMeasdADMotDrvDiagcDPhaOnTiMeasdA
      AssemblySwConnector_1011: ecu-extract-reference=CDD_Tauj0CfgAndUseDPhaOnTiMeasdBDMotDrvDiagcDPhaOnTiMeasdB
      AssemblySwConnector_1012: ecu-extract-reference=CDD_Tauj0CfgAndUseDPhaOnTiMeasdCDMotDrvDiagcDPhaOnTiMeasdC
      AssemblySwConnector_1013: ecu-extract-reference=CDD_Tauj1CfgAndUseDPhaOnTiMeasdDDMotDrvDiagcDPhaOnTiMeasdD
      AssemblySwConnector_1014: ecu-extract-reference=CDD_Tauj1CfgAndUseDPhaOnTiMeasdEDMotDrvDiagcDPhaOnTiMeasdE
      AssemblySwConnector_1015: ecu-extract-reference=CDD_Tauj1CfgAndUseDPhaOnTiMeasdFDMotDrvDiagcDPhaOnTiMeasdF
      AssemblySwConnector_1016: ecu-extract-reference=CmnMfgSrvDAssiLnrGainDAssiDAssiLnrGain
      AssemblySwConnector_1017: ecu-extract-reference=CmnMfgSrvDAssiLnrGainEnaDAssiDAssiLnrGainEna
      AssemblySwConnector_1018: ecu-extract-reference=CmnMfgSrvDCmnMfgSrvCmnMfgSrvMaiFctDCmnMfgSrvIfDCmnMfgSrvCmnMfgSrvMaiFct
      AssemblySwConnector_1019: ecu-extract-reference=CmnMfgSrvDDampgCmdBasDiDDampgDDampgCmdBasDi
      AssemblySwConnector_1020: ecu-extract-reference=CmnMfgSrvDMfgDiagcInhbDDiagcMgrDMfgDiagcInhb
      AssemblySwConnector_1021: ecu-extract-reference=CmnMfgSrvDMfgEnaStDDiagcMgrDMfgEnaSt
      AssemblySwConnector_1022: ecu-extract-reference=CmnMfgSrvDEotProtnDiDEotProtnDEotProtnDi
      AssemblySwConnector_1024: ecu-extract-reference=CmnMfgSrvDStallMotTqLimDiDHiLoadStallLimrDStallMotTqLimDi
      AssemblySwConnector_1025: ecu-extract-reference=CmnMfgSrvDHysCmpCmdDiDHysCmpDHysCmpCmdDi
      AssemblySwConnector_1026: ecu-extract-reference=CmnMfgSrvDInertiaCmpVelCmdDiDInertiaCmpVelDInertiaCmpVelCmdDi
      AssemblySwConnector_1027: ecu-extract-reference=CmnMfgSrvDPullCmpCmdDiDPullCmpActvDPullCmpCmdDi
      AssemblySwConnector_1028: ecu-extract-reference=CmnMfgSrvDPullCmpLrngDiDPullCmpActvDPullCmpLrngDi
      AssemblySwConnector_1029: ecu-extract-reference=CmnMfgSrvDRtnCmdDiDRtnDRtnCmdDi
      AssemblySwConnector_1030: ecu-extract-reference=CmnMfgSrvDAssiMechTEstimnDiDTEstimnDAssiMechTEstimnDi
      AssemblySwConnector_1031: ecu-extract-reference=CmnMfgSrvIfDCmnMfgSrvIfCmnMfgSrvIfImdtTxDCmnMfgSrvDCmnMfgSrvIfCmnMfgSrvIfImdtTx
      AssemblySwConnector_1032: ecu-extract-reference=CurrMeasCorrlnDCurrMeasCorrlnStsDCDD_MotCtrlMgrDCurrMeasCorrlnSts
      AssemblySwConnector_1033: ecu-extract-reference=CurrMeasCorrlnDCurrMeasIdptSigDLoaMgrDCurrMeasIdptSig
      AssemblySwConnector_1036: ecu-extract-reference=DiagcMgrDDiagcStsIvtr1InactvDBattVltgCorrlnDDiagcStsIvtr1Inactv
      AssemblySwConnector_1037: ecu-extract-reference=DiagcMgrDDiagcStsIvtr2InactvDBattVltgCorrlnDDiagcStsIvtr2Inactv
      AssemblySwConnector_1038: ecu-extract-reference=DiagcMgrDDiagcStsIvtr1InactvDCDD_CurrMeasDDiagcStsIvtr1Inactv
      AssemblySwConnector_1039: ecu-extract-reference=DiagcMgrDDiagcStsIvtr2InactvDCDD_CurrMeasDDiagcStsIvtr2Inactv
      AssemblySwConnector_1040: ecu-extract-reference=DiagcMgrDDiagcStsIvtr1InactvDCDD_MotCtrlMgrDDiagcStsIvtr1Inactv
      AssemblySwConnector_1041: ecu-extract-reference=DiagcMgrDDiagcStsIvtr2InactvDCDD_MotCtrlMgrDDiagcStsIvtr2Inactv
      AssemblySwConnector_1043: ecu-extract-reference=DiagcMgrDReadNtcFltAryDCmnMfgSrvDReadNtcFltAry
      AssemblySwConnector_1044: ecu-extract-reference=DiagcMgrDDiagcStsIvtr1InactvDCurrMeasCorrlnDDiagcStsIvtr1Inactv
      AssemblySwConnector_1045: ecu-extract-reference=DiagcMgrDDiagcStsIvtr2InactvDCurrMeasCorrlnDDiagcStsIvtr2Inactv
      AssemblySwConnector_1047: ecu-extract-reference=DiagcMgrDDiagcMgrIninCoreDDiagcMgrProxyAppl10DDiagcMgrIninCore
      AssemblySwConnector_1048: ecu-extract-reference=DiagcMgrDGetNtcActvCoreDDiagcMgrProxyAppl10DGetNtcActvCore
      AssemblySwConnector_1049: ecu-extract-reference=DiagcMgrDGetNtcQlfrStsCoreDDiagcMgrProxyAppl10DGetNtcQlfrStsCore
      AssemblySwConnector_1050: ecu-extract-reference=DiagcMgrDGetNtcStsCoreDDiagcMgrProxyAppl10DGetNtcStsCore
      AssemblySwConnector_1051: ecu-extract-reference=DiagcMgrDSetNtcStsCoreDDiagcMgrProxyAppl10DSetNtcStsCore
      AssemblySwConnector_1053: ecu-extract-reference=DiagcMgrDDiagcMgrIninCoreDDiagcMgrProxyAppl6DDiagcMgrIninCore
      AssemblySwConnector_1054: ecu-extract-reference=DiagcMgrDGetNtcActvCoreDDiagcMgrProxyAppl6DGetNtcActvCore
      AssemblySwConnector_1055: ecu-extract-reference=DiagcMgrDGetNtcQlfrStsCoreDDiagcMgrProxyAppl6DGetNtcQlfrStsCore
      AssemblySwConnector_1056: ecu-extract-reference=DiagcMgrDGetNtcStsCoreDDiagcMgrProxyAppl6DGetNtcStsCore
      AssemblySwConnector_1057: ecu-extract-reference=DiagcMgrDSetNtcStsCoreDDiagcMgrProxyAppl6DSetNtcStsCore
      AssemblySwConnector_1058: ecu-extract-reference=DiagcMgrDDiagcStsLimdTPrfmncDDutyCycThermProtnDDiagcStsLimdTPrfmnc
      AssemblySwConnector_1059: ecu-extract-reference=DiagcMgrDDiagcStsLimdTPrfmncDEcuTMeasDDiagcStsLimdTPrfmnc
      AssemblySwConnector_1063: ecu-extract-reference=DiagcMgrDSysStFltOutpReqDiDGmMsg184BusHiSpdDSysStFltOutpReqDi
      AssemblySwConnector_1064: ecu-extract-reference=DiagcMgrDDiagcStsIvtr1InactvDLoaMgrDDiagcStsIvtr1Inactv
      AssemblySwConnector_1065: ecu-extract-reference=DiagcMgrDDiagcStsIvtr2InactvDLoaMgrDDiagcStsIvtr2Inactv
      AssemblySwConnector_1066: ecu-extract-reference=DiagcMgrDDiagcStsIvtr1InactvDMotDrvDiagcDDiagcStsIvtr1Inactv
      AssemblySwConnector_1067: ecu-extract-reference=DiagcMgrDDiagcStsIvtr2InactvDMotDrvDiagcDDiagcStsIvtr2Inactv
      AssemblySwConnector_1068: ecu-extract-reference=DiagcMgrDDiagcStsCtrldShtDwnFltPrsntDMotTqTranlDampgDDiagcStsCtrldShtDwnFltPrsnt
      AssemblySwConnector_1069: ecu-extract-reference=DiagcMgrDSysDiMotTqCmdScaDStOutpCtrlDSysDiMotTqCmdSca
      AssemblySwConnector_1070: ecu-extract-reference=DiagcMgrDSysDiRampRateDStOutpCtrlDSysDiRampRate
      AssemblySwConnector_1072: ecu-extract-reference=DiagcMgrDSysStFltOutpReqDiDSysStModDSysStFltOutpReqDi
      AssemblySwConnector_1073: ecu-extract-reference=DiagcMgrProxyAppl10DGetNtcQlfrSts10DAssiSumLimDGetNtcQlfrSts
      AssemblySwConnector_1074: ecu-extract-reference=DiagcMgrProxyAppl10DSetNtcSts10DAssiSumLimDSetNtcSts
      AssemblySwConnector_1075: ecu-extract-reference=DiagcMgrProxyAppl10DGetNtcQlfrSts10DBattVltgCorrlnDGetNtcQlfrSts
      AssemblySwConnector_1076: ecu-extract-reference=DiagcMgrProxyAppl10DSetNtcSts10DBattVltgCorrlnDSetNtcSts
      AssemblySwConnector_1077: ecu-extract-reference=DiagcMgrProxyAppl10DGetNtcQlfrSts10DCDD_CurrMeasDGetNtcQlfrSts
      AssemblySwConnector_1078: ecu-extract-reference=DiagcMgrProxyAppl10DSetNtcSts10DCDD_CurrMeasDSetNtcSts
      AssemblySwConnector_1079: ecu-extract-reference=DiagcMgrProxyAppl10DSetNtcSts10DCDD_ExcpnHndlgDSetNtcSts
      AssemblySwConnector_1080: ecu-extract-reference=DiagcMgrProxyAppl10DGetNtcQlfrSts10DCDD_FlsMemDGetNtcQlfrSts
      AssemblySwConnector_1081: ecu-extract-reference=DiagcMgrProxyAppl10DSetNtcSts10DCDD_FlsMemDSetNtcSts
      AssemblySwConnector_1082: ecu-extract-reference=DiagcMgrProxyAppl10DGetNtcQlfrSts10DCDD_HwTq0MeasDGetNtcQlfrSts
      AssemblySwConnector_1083: ecu-extract-reference=DiagcMgrProxyAppl10DSetNtcSts10DCDD_HwTq0MeasDSetNtcSts
      AssemblySwConnector_1084: ecu-extract-reference=DiagcMgrProxyAppl10DGetNtcQlfrSts10DCDD_HwTq1MeasDGetNtcQlfrSts
      AssemblySwConnector_1085: ecu-extract-reference=DiagcMgrProxyAppl10DSetNtcSts10DCDD_HwTq1MeasDSetNtcSts
      AssemblySwConnector_1086: ecu-extract-reference=DiagcMgrProxyAppl10DGetNtcQlfrSts10DCDD_HwTq2MeasDGetNtcQlfrSts
      AssemblySwConnector_1087: ecu-extract-reference=DiagcMgrProxyAppl10DSetNtcSts10DCDD_HwTq2MeasDSetNtcSts
      AssemblySwConnector_1088: ecu-extract-reference=DiagcMgrProxyAppl10DGetNtcQlfrSts10DCDD_HwTq3MeasDGetNtcQlfrSts
      AssemblySwConnector_1089: ecu-extract-reference=DiagcMgrProxyAppl10DSetNtcSts10DCDD_HwTq3MeasDSetNtcSts
      AssemblySwConnector_1090: ecu-extract-reference=DiagcMgrProxyAppl10DGetNtcQlfrSts10DCDD_MotAg0MeasDGetNtcQlfrSts
      AssemblySwConnector_1091: ecu-extract-reference=DiagcMgrProxyAppl10DSetNtcSts10DCDD_MotAg0MeasDSetNtcSts
      AssemblySwConnector_1092: ecu-extract-reference=DiagcMgrProxyAppl10DGetNtcQlfrSts10DCDD_MotAg1MeasDGetNtcQlfrSts
      AssemblySwConnector_1093: ecu-extract-reference=DiagcMgrProxyAppl10DSetNtcSts10DCDD_MotAg1MeasDSetNtcSts
      AssemblySwConnector_1094: ecu-extract-reference=DiagcMgrProxyAppl10DSetNtcSts10DCDD_NxtrTiDSetNtcSts
      AssemblySwConnector_1095: ecu-extract-reference=DiagcMgrProxyAppl10DSetNtcSts10DCDD_RamMemDSetNtcSts
      AssemblySwConnector_1096: ecu-extract-reference=DiagcMgrProxyAppl10DGetNtcQlfrSts10DCurrMeasCorrlnDGetNtcQlfrSts
      AssemblySwConnector_1097: ecu-extract-reference=DiagcMgrProxyAppl10DSetNtcSts10DCurrMeasCorrlnDSetNtcSts
      AssemblySwConnector_1098: ecu-extract-reference=DiagcMgrProxyAppl10DGetDiagcDataAppl10DDiagcMgrDGetDiagcDataAppl10
      AssemblySwConnector_1099: ecu-extract-reference=DiagcMgrProxyAppl10DGetNtcInfoAppl10DDiagcMgrDGetNtcInfoAppl10
      AssemblySwConnector_1100: ecu-extract-reference=DiagcMgrProxyAppl10DSetNtcSts10DDutyCycThermProtnDSetNtcSts
      AssemblySwConnector_1101: ecu-extract-reference=DiagcMgrProxyAppl10DSetNtcSts10DEcuTMeasDSetNtcSts
      AssemblySwConnector_1102: ecu-extract-reference=DiagcMgrProxyAppl10DGetNtcQlfrSts10DEotLrngDGetNtcQlfrSts
      AssemblySwConnector_1103: ecu-extract-reference=DiagcMgrProxyAppl10DSetNtcSts10DEotLrngDSetNtcSts
      AssemblySwConnector_1106: ecu-extract-reference=DiagcMgrProxyAppl10DSetNtcSts10DGmVehSpdArbnDSetNtcSts
      AssemblySwConnector_1107: ecu-extract-reference=DiagcMgrProxyAppl10DGetNtcQlfrSts10DHwAg0MeasDGetNtcQlfrSts
      AssemblySwConnector_1108: ecu-extract-reference=DiagcMgrProxyAppl10DSetNtcSts10DHwAg0MeasDSetNtcSts
      AssemblySwConnector_1109: ecu-extract-reference=DiagcMgrProxyAppl10DGetNtcQlfrSts10DHwAg1MeasDGetNtcQlfrSts
      AssemblySwConnector_1110: ecu-extract-reference=DiagcMgrProxyAppl10DSetNtcSts10DHwAg1MeasDSetNtcSts
      AssemblySwConnector_1113: ecu-extract-reference=DiagcMgrProxyAppl10DGetNtcQlfrSts10DHwTqCorrlnDGetNtcQlfrSts
      AssemblySwConnector_1114: ecu-extract-reference=DiagcMgrProxyAppl10DSetNtcSts10DHwTqCorrlnDSetNtcSts
      AssemblySwConnector_1115: ecu-extract-reference=DiagcMgrProxyAppl10DSetNtcSts10DLoaMgrDSetNtcSts
      AssemblySwConnector_1118: ecu-extract-reference=DiagcMgrProxyAppl10DGetNtcQlfrSts10DMotAgCorrlnDGetNtcQlfrSts
      AssemblySwConnector_1119: ecu-extract-reference=DiagcMgrProxyAppl10DSetNtcSts10DMotAgCorrlnDSetNtcSts
      AssemblySwConnector_1120: ecu-extract-reference=DiagcMgrProxyAppl10DSetNtcSts10DMotDrvDiagcDSetNtcSts
      AssemblySwConnector_1122: ecu-extract-reference=DiagcMgrProxyAppl10DGetNtcQlfrSts10DPwrDiscnctDGetNtcQlfrSts
      AssemblySwConnector_1123: ecu-extract-reference=DiagcMgrProxyAppl10DSetNtcSts10DPwrDiscnctDSetNtcSts
      AssemblySwConnector_1124: ecu-extract-reference=DiagcMgrProxyAppl10DSetNtcSts10DPwrLimrDSetNtcSts
      AssemblySwConnector_1125: ecu-extract-reference=DiagcMgrProxyAppl10DSetNtcSts10DPwrSplyDSetNtcSts
      AssemblySwConnector_1126: ecu-extract-reference=DiagcMgrProxyAppl10DSetNtcSts10DTmplMonrDSetNtcSts
      AssemblySwConnector_1127: ecu-extract-reference=DiagcMgrProxyAppl10DSetNtcSts10DTunSelnMngtDSetNtcSts
      AssemblySwConnector_1128: ecu-extract-reference=DiagcMgrProxyAppl6DGetDiagcDataAppl6DDiagcMgrDGetDiagcDataAppl6
      AssemblySwConnector_1129: ecu-extract-reference=DiagcMgrProxyAppl6DGetNtcInfoAppl6DDiagcMgrDGetNtcInfoAppl6
      AssemblySwConnector_1130: ecu-extract-reference=DiagcMgrProxyAppl6DSetNtcSts6DGmMsg0C9BusHiSpdDSetNtcSts
      AssemblySwConnector_1131: ecu-extract-reference=DiagcMgrProxyAppl6DSetNtcSts6DGmMsg17DBusHiSpdDSetNtcSts
      AssemblySwConnector_1132: ecu-extract-reference=DiagcMgrProxyAppl6DSetNtcSts6DGmMsg180BusChassisExpDSetNtcSts
      AssemblySwConnector_1133: ecu-extract-reference=DiagcMgrProxyAppl6DSetNtcSts6DGmMsg180BusHiSpdDSetNtcSts
      AssemblySwConnector_1134: ecu-extract-reference=DiagcMgrProxyAppl6DSetNtcSts6DGmMsg182BusChassisExpDSetNtcSts
      AssemblySwConnector_1135: ecu-extract-reference=DiagcMgrProxyAppl6DSetNtcSts6DGmMsg1E9BusHiSpdDSetNtcSts
      AssemblySwConnector_1136: ecu-extract-reference=DiagcMgrProxyAppl6DSetNtcSts6DGmMsg1F1BusHiSpdDSetNtcSts
      AssemblySwConnector_1137: ecu-extract-reference=DiagcMgrProxyAppl6DSetNtcSts6DGmMsg1F5BusHiSpdDSetNtcSts
      AssemblySwConnector_1138: ecu-extract-reference=DiagcMgrProxyAppl6DSetNtcSts6DGmMsg214BusHiSpdDSetNtcSts
      AssemblySwConnector_1139: ecu-extract-reference=DiagcMgrProxyAppl6DSetNtcSts6DGmMsg232BusHiSpdDSetNtcSts
      AssemblySwConnector_1140: ecu-extract-reference=DiagcMgrProxyAppl6DSetNtcSts6DGmMsg337BusChassisExpDSetNtcSts
      AssemblySwConnector_1141: ecu-extract-reference=DiagcMgrProxyAppl6DSetNtcSts6DGmMsg348BusChassisExpDSetNtcSts
      AssemblySwConnector_1142: ecu-extract-reference=DiagcMgrProxyAppl6DSetNtcSts6DGmMsg348BusHiSpdDSetNtcSts
      AssemblySwConnector_1143: ecu-extract-reference=DiagcMgrProxyAppl6DSetNtcSts6DGmMsg34ABusChassisExpDSetNtcSts
      AssemblySwConnector_1144: ecu-extract-reference=DiagcMgrProxyAppl6DSetNtcSts6DGmMsg34ABusHiSpdDSetNtcSts
      AssemblySwConnector_1146: ecu-extract-reference=DiagcMgrProxyAppl6DSetNtcSts6DGmMsg3F1BusHiSpdDSetNtcSts
      AssemblySwConnector_1148: ecu-extract-reference=DiagcMgrProxyAppl6DSetNtcSts6DPartNrDSetNtcSts
      AssemblySwConnector_1150: ecu-extract-reference=DutyCycThermProtnDThermLimSlowFilMaxDAssiDThermLimSlowFilMax
      AssemblySwConnector_1151: ecu-extract-reference=DutyCycThermProtnDThermRednFacDAssiSumLimDThermRednFac
      AssemblySwConnector_1152: ecu-extract-reference=DutyCycThermProtnDThermMotTqLimDLimrCdngDThermMotTqLim
      AssemblySwConnector_1153: ecu-extract-reference=EcuTMeasDEcuTFildDCDD_MotCtrlMgrDEcuTFild
      AssemblySwConnector_1154: ecu-extract-reference=EcuTMeasDEcuTFildDDutyCycThermProtnDEcuTFild
      AssemblySwConnector_1155: ecu-extract-reference=EcuTMeasDEcuTFildDTEstimnDEcuTFild
      AssemblySwConnector_1156: ecu-extract-reference=EotLrngDSerlComRstEotDCmnMfgSrvDSerlComRstEot
      AssemblySwConnector_1157: ecu-extract-reference=EotLrngDHwAgCcwDetdDEotProtnDHwAgCcwDetd
      AssemblySwConnector_1158: ecu-extract-reference=EotLrngDHwAgCwDetdDEotProtnDHwAgCwDetd
      AssemblySwConnector_1159: ecu-extract-reference=EotLrngDHwAgEotCcwDEotProtnDHwAgEotCcw
      AssemblySwConnector_1160: ecu-extract-reference=EotLrngDHwAgEotCwDEotProtnDHwAgEotCw
      AssemblySwConnector_1161: ecu-extract-reference=EotLrngDHwAgEotCcwDGmOvrlStMgrDHwAgEotCcw
      AssemblySwConnector_1162: ecu-extract-reference=EotLrngDHwAgEotCwDGmOvrlStMgrDHwAgEotCw
      AssemblySwConnector_1163: ecu-extract-reference=EotLrngDHwAgEotCcwDVehSpdLimrDHwAgEotCcw
      AssemblySwConnector_1164: ecu-extract-reference=EotLrngDHwAgEotCwDVehSpdLimrDHwAgEotCw
      AssemblySwConnector_1167: ecu-extract-reference=EotProtnDEotAssiScaDLimrCdngDEotAssiSca
      AssemblySwConnector_1168: ecu-extract-reference=EotProtnDEotMotTqLimDLimrCdngDEotMotTqLim
      AssemblySwConnector_1169: ecu-extract-reference=FltInjDFltInj_f32DAssiDFltInj_f32
      AssemblySwConnector_1170: ecu-extract-reference=FltInjDFltInj_f32DCDD_HwTq0MeasDFltInj_f32
      AssemblySwConnector_1171: ecu-extract-reference=FltInjDFltInj_u08DCDD_HwTq0MeasDFltInj_u08
      AssemblySwConnector_1172: ecu-extract-reference=FltInjDFltInj_f32DCDD_HwTq2MeasDFltInj_f32
      AssemblySwConnector_1173: ecu-extract-reference=FltInjDFltInj_f32DDampgDFltInj_f32
      AssemblySwConnector_1174: ecu-extract-reference=FltInjDFltInj_f32DHwAg0MeasDFltInj_f32
      AssemblySwConnector_1175: ecu-extract-reference=FltInjDFltInj_u08DHwAg0MeasDFltInj_u08
      AssemblySwConnector_1177: ecu-extract-reference=FltInjDFltInj_f32DHwAgSysArbnDFltInj_f32
      AssemblySwConnector_1178: ecu-extract-reference=FltInjDFltInj_u08DHwTqCorrlnDFltInj_u08
      AssemblySwConnector_1179: ecu-extract-reference=FltInjDFltInj_f32DHysCmpDFltInj_f32
      AssemblySwConnector_1180: ecu-extract-reference=FltInjDFltInj_f32DInertiaCmpVelDFltInj_f32
      AssemblySwConnector_1181: ecu-extract-reference=FltInjDFltInj_f32DLimrCdngDFltInj_f32
      AssemblySwConnector_1183: ecu-extract-reference=FltInjDFltInj_u08DMotAgCorrlnDFltInj_u08
      AssemblySwConnector_1184: ecu-extract-reference=FltInjDFltInj_f32DRtnDFltInj_f32
      AssemblySwConnector_1185: ecu-extract-reference=FltInjDFltInj_f32DStabyCmpDFltInj_f32
      AssemblySwConnector_1186: ecu-extract-reference=FltInjDFltInj_f32DVehSigCdngDFltInj_f32
      AssemblySwConnector_1188: ecu-extract-reference=GmMsg0C9BusHiSpdDEngRunActvDGmMsg1F1BusHiSpdDEngRunActv
      AssemblySwConnector_1189: ecu-extract-reference=GmMsg0C9BusHiSpdDEngSpdDGmStrtStopDEngSpd
      AssemblySwConnector_1190: ecu-extract-reference=GmMsg0C9BusHiSpdDInvldMsg0C9DGmStrtStopDMsg0C9BusHiSpdInvld
      AssemblySwConnector_1191: ecu-extract-reference=GmMsg0C9BusHiSpdDMissMsg0C9DGmStrtStopDMsg0C9BusHiSpdMiss
      AssemblySwConnector_1192: ecu-extract-reference=GmMsg0C9BusHiSpdDEngRunActvDGmVehPwrModDEngRunActv
      AssemblySwConnector_1193: ecu-extract-reference=GmMsg0C9BusHiSpdDMissMsg0C9DGmVehPwrModDMsg0C9Miss
      AssemblySwConnector_1194: ecu-extract-reference=GmMsg17DBusHiSpdDInvldMsg17DDGmOvrlStMgrDMsg17DBusHiSpdInvld
      AssemblySwConnector_1195: ecu-extract-reference=GmMsg17DBusHiSpdDMissMsg17DDGmOvrlStMgrDMsg17DBusHiSpdMiss
      AssemblySwConnector_1197: ecu-extract-reference=GmMsg180BusChassisExpDInvldMsg180BusChassisExpDGmOvrlStMgrDMsg180BusChassisExpInvld
      AssemblySwConnector_1198: ecu-extract-reference=GmMsg180BusChassisExpDMissMsg180BusChassisExpDGmOvrlStMgrDMsg180BusChassisExpMiss
      AssemblySwConnector_1199: ecu-extract-reference=GmMsg180BusChassisExpDEscCmdDGmTqArbnDEscCmd
      AssemblySwConnector_1201: ecu-extract-reference=GmMsg180BusHiSpdDInvldMsg180BusHiSpdDGmOvrlStMgrDMsg180BusHiSpdInvld
      AssemblySwConnector_1202: ecu-extract-reference=GmMsg180BusHiSpdDMissMsg180BusHiSpdDGmOvrlStMgrDMsg180BusHiSpdMiss
      AssemblySwConnector_1203: ecu-extract-reference=GmMsg182BusChassisExpDSerlComVehLgtADVehSigCdngDVehLgtASerlCom
      AssemblySwConnector_1204: ecu-extract-reference=GmMsg184BusHiSpdDHandsOffSteerWhlDetnModDSerlComOutpProxyDHandsOffSteerWhlDetnMod
      AssemblySwConnector_1205: ecu-extract-reference=GmMsg184BusHiSpdDHandsOffSteerWhlDetnStDSerlComOutpProxyDHandsOffSteerWhlDetnSt
      AssemblySwConnector_1206: ecu-extract-reference=GmMsg184BusHiSpdDHandsOffSteerWhlDetnStVldDSerlComOutpProxyDHandsOffSteerWhlDetnStVld
      AssemblySwConnector_1207: ecu-extract-reference=GmMsg184BusHiSpdDLkaDrvrAppldTqDSerlComOutpProxyDLkaDrvrAppldTq
      AssemblySwConnector_1208: ecu-extract-reference=GmMsg184BusHiSpdDLkaDrvrAppldTqVldDSerlComOutpProxyDLkaDrvrAppldTqVld
      AssemblySwConnector_1209: ecu-extract-reference=GmMsg184BusHiSpdDLkaElecPwrSteerTotTqDlvdDSerlComOutpProxyDLkaElecPwrSteerTotTqDlvd
      AssemblySwConnector_1210: ecu-extract-reference=GmMsg184BusHiSpdDLkaTqOvrlDeltaTqDlvdDSerlComOutpProxyDLkaTqOvrlDeltaTqDlvd
      AssemblySwConnector_1211: ecu-extract-reference=GmMsg184BusHiSpdDLkaTqOvrlDlvdRollgCntrDSerlComOutpProxyDLkaTqOvrlDlvdRollgCntr
      AssemblySwConnector_1212: ecu-extract-reference=GmMsg184BusHiSpdDLkaTqOvrlStsChksDSerlComOutpProxyDLkaTqOvrlStsChks
      AssemblySwConnector_1213: ecu-extract-reference=GmMsg184BusHiSpdDLkaTqOvrlTqDlvdStsDSerlComOutpProxyDLkaTqOvrlTqDlvdSts
      AssemblySwConnector_1214: ecu-extract-reference=GmMsg1CABusChassisExpDElecPwrSteerTotTqDlvdDSerlComOutpProxyDElecPwrSteerTotTqDlvd
      AssemblySwConnector_1215: ecu-extract-reference=GmMsg1CABusChassisExpDTqOvrlDeltaTqDlvdDSerlComOutpProxyDTqOvrlDeltaTqDlvd
      AssemblySwConnector_1216: ecu-extract-reference=GmMsg1CABusChassisExpDTqOvrlDlvdChksDSerlComOutpProxyDTqOvrlDlvdChks
      AssemblySwConnector_1217: ecu-extract-reference=GmMsg1CABusChassisExpDTqOvrlDlvdRollgCntrDSerlComOutpProxyDTqOvrlDlvdRollgCntr
      AssemblySwConnector_1218: ecu-extract-reference=GmMsg1CABusChassisExpDTqOvrlTqDlvdStsDSerlComOutpProxyDTqOvrlTqDlvdSts
      AssemblySwConnector_1219: ecu-extract-reference=GmMsg1E5BusChassisExpDSteerWhlAgAlvRollgCntBusChassisExpDSerlComOutpProxyDSteerWhlAgAlvRollgCntBusChassisExp
      AssemblySwConnector_1220: ecu-extract-reference=GmMsg1E5BusChassisExpDSteerWhlAgBusChassisExpDSerlComOutpProxyDSteerWhlAgBusChassisExp
      AssemblySwConnector_1221: ecu-extract-reference=GmMsg1E5BusChassisExpDSteerWhlAgGrdtBusChassisExpDSerlComOutpProxyDSteerWhlAgGrdtBusChassisExp
      AssemblySwConnector_1222: ecu-extract-reference=GmMsg1E5BusChassisExpDSteerWhlAgGrdtMaskBusChassisExpDSerlComOutpProxyDSteerWhlAgGrdtMaskBusChassisExp
      AssemblySwConnector_1223: ecu-extract-reference=GmMsg1E5BusChassisExpDSteerWhlAgGrdtVldBusChassisExpDSerlComOutpProxyDSteerWhlAgGrdtVldBusChassisExp
      AssemblySwConnector_1224: ecu-extract-reference=GmMsg1E5BusChassisExpDSteerWhlAgMaskBusChassisExpDSerlComOutpProxyDSteerWhlAgMaskBusChassisExp
      AssemblySwConnector_1225: ecu-extract-reference=GmMsg1E5BusChassisExpDSteerWhlAgSnsrCalStsBusChassisExpDSerlComOutpProxyDSteerWhlAgSnsrCalStsBusChassisExp
      AssemblySwConnector_1226: ecu-extract-reference=GmMsg1E5BusChassisExpDSteerWhlAgSnsrChksBusChassisExpDSerlComOutpProxyDSteerWhlAgSnsrChksBusChassisExp
      AssemblySwConnector_1227: ecu-extract-reference=GmMsg1E5BusChassisExpDSteerWhlAgSnsrTypBusChassisExpDSerlComOutpProxyDSteerWhlAgSnsrTypBusChassisExp
      AssemblySwConnector_1228: ecu-extract-reference=GmMsg1E5BusChassisExpDSteerWhlAgVldBusChassisExpDSerlComOutpProxyDSteerWhlAgVldBusChassisExp
      AssemblySwConnector_1229: ecu-extract-reference=GmMsg1E5BusHiSpdDSteerWhlAgAlvRollgCntBusHiSpdDSerlComOutpProxyDSteerWhlAgAlvRollgCntBusHiSpd
      AssemblySwConnector_1230: ecu-extract-reference=GmMsg1E5BusHiSpdDSteerWhlAgBusHiSpdDSerlComOutpProxyDSteerWhlAgBusHiSpd
      AssemblySwConnector_1231: ecu-extract-reference=GmMsg1E5BusHiSpdDSteerWhlAgGrdtBusHiSpdDSerlComOutpProxyDSteerWhlAgGrdtBusHiSpd
      AssemblySwConnector_1232: ecu-extract-reference=GmMsg1E5BusHiSpdDSteerWhlAgGrdtMaskBusHiSpdDSerlComOutpProxyDSteerWhlAgGrdtMaskBusHiSpd
      AssemblySwConnector_1233: ecu-extract-reference=GmMsg1E5BusHiSpdDSteerWhlAgGrdtVldBusHiSpdDSerlComOutpProxyDSteerWhlAgGrdtVldBusHiSpd
      AssemblySwConnector_1234: ecu-extract-reference=GmMsg1E5BusHiSpdDSteerWhlAgMaskBusHiSpdDSerlComOutpProxyDSteerWhlAgMaskBusHiSpd
      AssemblySwConnector_1235: ecu-extract-reference=GmMsg1E5BusHiSpdDSteerWhlAgSnsrCalStsBusHiSpdDSerlComOutpProxyDSteerWhlAgSnsrCalStsBusHiSpd
      AssemblySwConnector_1236: ecu-extract-reference=GmMsg1E5BusHiSpdDSteerWhlAgSnsrChksBusHiSpdDSerlComOutpProxyDSteerWhlAgSnsrChksBusHiSpd
      AssemblySwConnector_1237: ecu-extract-reference=GmMsg1E5BusHiSpdDSteerWhlAgSnsrTypBusHiSpdDSerlComOutpProxyDSteerWhlAgSnsrTypBusHiSpd
      AssemblySwConnector_1238: ecu-extract-reference=GmMsg1E5BusHiSpdDSteerWhlAgVldBusHiSpdDSerlComOutpProxyDSteerWhlAgVldBusHiSpd
      AssemblySwConnector_1239: ecu-extract-reference=GmMsg1E9BusHiSpdDVehStabyEnhmtActvDGmMsg214BusHiSpdDVehStabyEnhmtActv
      AssemblySwConnector_1240: ecu-extract-reference=GmMsg1E9BusHiSpdDInvldMsg1E9DGmOvrlStMgrDMsg1E9BusHiSpdInvld
      AssemblySwConnector_1241: ecu-extract-reference=GmMsg1E9BusHiSpdDMissMsg1E9DGmOvrlStMgrDMsg1E9BusHiSpdMiss
      AssemblySwConnector_1242: ecu-extract-reference=GmMsg1E9BusHiSpdDVehStabyEnhmtActvDGmOvrlStMgrDVehStabyEnhmtActv
      AssemblySwConnector_1243: ecu-extract-reference=GmMsg1E9BusHiSpdDSerlComLatADVehSigCdngDVehLatASerlCom
      AssemblySwConnector_1245: ecu-extract-reference=GmMsg1F1BusHiSpdDMissMsg1F1DGmVehPwrModDMsg1F1Miss
      AssemblySwConnector_1246: ecu-extract-reference=GmMsg1F1BusHiSpdDSysPwrModRunDGmVehPwrModDSysPwrModRun
      AssemblySwConnector_1247: ecu-extract-reference=GmMsg1F1BusHiSpdDSysPwrModRunDPartNrDSysPwrModRun
      AssemblySwConnector_1248: ecu-extract-reference=GmMsg1F5BusHiSpdDInvldMsg1F5DGmOvrlStMgrDMsg1F5BusHiSpdInvld
      AssemblySwConnector_1249: ecu-extract-reference=GmMsg1F5BusHiSpdDShiftLvrInRvsDGmOvrlStMgrDShiftLvrRvs
      AssemblySwConnector_1250: ecu-extract-reference=GmMsg214BusHiSpdDRdntVehStabyEnhmtActvDGmMsg1E9BusHiSpdDRdntVehStabyEnhmtActv
      AssemblySwConnector_1251: ecu-extract-reference=GmMsg214BusHiSpdDAbsProtdDGmOvrlStMgrDAbsActvProtd
      AssemblySwConnector_1252: ecu-extract-reference=GmMsg214BusHiSpdDVehStabyEnhmtInvldDGmOvrlStMgrDMsg214BusHiSpdInvld
      AssemblySwConnector_1253: ecu-extract-reference=GmMsg214BusHiSpdDMissMsg214DGmOvrlStMgrDMsg214BusHiSpdMiss
      AssemblySwConnector_1255: ecu-extract-reference=GmMsg335BusChassisExpDDrvrSteerIntvDetdDSerlComOutpProxyDDrvrSteerIntvDetd
      AssemblySwConnector_1256: ecu-extract-reference=GmMsg335BusChassisExpDDrvrSteerIntvDetdProtnValDSerlComOutpProxyDDrvrSteerIntvDetdProtnVal
      AssemblySwConnector_1257: ecu-extract-reference=GmMsg335BusChassisExpDDrvrSteerIntvDetdRollgCntrDSerlComOutpProxyDDrvrSteerIntvDetdRollgCntr
      AssemblySwConnector_1258: ecu-extract-reference=GmMsg335BusChassisExpDDrvrSteerIntvDetdVldDSerlComOutpProxyDDrvrSteerIntvDetdVld
      AssemblySwConnector_1259: ecu-extract-reference=GmMsg335BusChassisExpDElecPowerSteerAvlStsDSerlComOutpProxyDElecPowerSteerAvlSts
      AssemblySwConnector_1260: ecu-extract-reference=GmMsg335BusChassisExpDElecPowerSteerAvlStsProtnValDSerlComOutpProxyDElecPowerSteerAvlStsProtnVal
      AssemblySwConnector_1261: ecu-extract-reference=GmMsg335BusChassisExpDElecPowerSteerAvlStsRollgCntrDSerlComOutpProxyDElecPowerSteerAvlStsRollgCntr
      AssemblySwConnector_1263: ecu-extract-reference=GmMsg337BusChassisExpDSteerWhlAgReqTarAgDGmOvrlStMgrDHwAgTar
      AssemblySwConnector_1264: ecu-extract-reference=GmMsg337BusChassisExpDFbReqActvDGmOvrlStMgrDHwHaptcEna
      AssemblySwConnector_1265: ecu-extract-reference=GmMsg337BusChassisExpDInvldMsg337DGmOvrlStMgrDMsg337BusChassisExpInvld
      AssemblySwConnector_1266: ecu-extract-reference=GmMsg337BusChassisExpDMissMsg337DGmOvrlStMgrDMsg337BusChassisExpMiss
      AssemblySwConnector_1267: ecu-extract-reference=GmMsg348BusChassisExpDWhlGndVelLeDrvnBusChassisExpDGmVehSpdArbnDWhlGndVelLeDrvnBusChassisExp
      AssemblySwConnector_1268: ecu-extract-reference=GmMsg348BusChassisExpDWhlGndVelLeDrvnStuckBusChassisExpDGmVehSpdArbnDWhlGndVelLeDrvnStuckBusChassisExp
      AssemblySwConnector_1269: ecu-extract-reference=GmMsg348BusChassisExpDWhlGndVelLeDrvnVldBusChassisExpDGmVehSpdArbnDWhlGndVelLeDrvnVldBusChassisExp
      AssemblySwConnector_1270: ecu-extract-reference=GmMsg348BusChassisExpDWhlGndVelRiDrvnBusChassisExpDGmVehSpdArbnDWhlGndVelRiDrvnBusChassisExp
      AssemblySwConnector_1271: ecu-extract-reference=GmMsg348BusChassisExpDWhlGndVelRiDrvnStuckBusChassisExpDGmVehSpdArbnDWhlGndVelRiDrvnStuckBusChassisExp
      AssemblySwConnector_1272: ecu-extract-reference=GmMsg348BusChassisExpDWhlGndVelRiDrvnVldBusChassisExpDGmVehSpdArbnDWhlGndVelRiDrvnVldBusChassisExp
      AssemblySwConnector_1273: ecu-extract-reference=GmMsg348BusHiSpdDWhlGndVelLeDrvnBusHiSpdDGmVehSpdArbnDWhlGndVelLeDrvnBusHiSpd
      AssemblySwConnector_1274: ecu-extract-reference=GmMsg348BusHiSpdDWhlGndVelLeDrvnStuckBusHiSpdDGmVehSpdArbnDWhlGndVelLeDrvnStuckBusHiSpd
      AssemblySwConnector_1275: ecu-extract-reference=GmMsg348BusHiSpdDWhlGndVelLeDrvnVldBusHiSpdDGmVehSpdArbnDWhlGndVelLeDrvnVldBusHiSpd
      AssemblySwConnector_1276: ecu-extract-reference=GmMsg348BusHiSpdDWhlGndVelRiDrvnBusHiSpdDGmVehSpdArbnDWhlGndVelRiDrvnBusHiSpd
      AssemblySwConnector_1277: ecu-extract-reference=GmMsg348BusHiSpdDWhlGndVelRiDrvnStuckBusHiSpdDGmVehSpdArbnDWhlGndVelRiDrvnStuckBusHiSpd
      AssemblySwConnector_1278: ecu-extract-reference=GmMsg348BusHiSpdDWhlGndVelRiDrvnVldBusHiSpdDGmVehSpdArbnDWhlGndVelRiDrvnVldBusHiSpd
      AssemblySwConnector_1279: ecu-extract-reference=GmMsg34ABusChassisExpDWhlGndVelLeNonDrvnBusChassisExpDGmVehSpdArbnDWhlGndVelLeNonDrvnBusChassisExp
      AssemblySwConnector_1280: ecu-extract-reference=GmMsg34ABusChassisExpDWhlGndVelLeNonDrvnStuckBusChassisExpDGmVehSpdArbnDWhlGndVelLeNonDrvnStuckBusChassisExp
      AssemblySwConnector_1281: ecu-extract-reference=GmMsg34ABusChassisExpDWhlGndVelLeNonDrvnVldBusChassisExpDGmVehSpdArbnDWhlGndVelLeNonDrvnVldBusChassisExp
      AssemblySwConnector_1282: ecu-extract-reference=GmMsg34ABusChassisExpDWhlGndVelRiNonDrvnBusChassisExpDGmVehSpdArbnDWhlGndVelRiNonDrvnBusChassisExp
      AssemblySwConnector_1283: ecu-extract-reference=GmMsg34ABusChassisExpDWhlGndVelRiNonDrvnStuckBusChassisExpDGmVehSpdArbnDWhlGndVelRiNonDrvnStuckBusChassisExp
      AssemblySwConnector_1284: ecu-extract-reference=GmMsg34ABusChassisExpDWhlGndVelRiNonDrvnVldBusChassisExpDGmVehSpdArbnDWhlGndVelRiNonDrvnVldBusChassisExp
      AssemblySwConnector_1285: ecu-extract-reference=GmMsg34ABusHiSpdDWhlGndVelLeNonDrvnBusHiSpdDGmVehSpdArbnDWhlGndVelLeNonDrvnBusHiSpd
      AssemblySwConnector_1286: ecu-extract-reference=GmMsg34ABusHiSpdDWhlGndVelLeNonDrvnStuckBusHiSpdDGmVehSpdArbnDWhlGndVelLeNonDrvnStuckBusHiSpd
      AssemblySwConnector_1287: ecu-extract-reference=GmMsg34ABusHiSpdDWhlGndVelLeNonDrvnVldBusHiSpdDGmVehSpdArbnDWhlGndVelLeNonDrvnVldBusHiSpd
      AssemblySwConnector_1288: ecu-extract-reference=GmMsg34ABusHiSpdDWhlGndVelRiNonDrvnBusHiSpdDGmVehSpdArbnDWhlGndVelRiNonDrvnBusHiSpd
      AssemblySwConnector_1289: ecu-extract-reference=GmMsg34ABusHiSpdDWhlGndVelRiNonDrvnStuckBusHiSpdDGmVehSpdArbnDWhlGndVelRiNonDrvnStuckBusHiSpd
      AssemblySwConnector_1290: ecu-extract-reference=GmMsg34ABusHiSpdDWhlGndVelRiNonDrvnVldBusHiSpdDGmVehSpdArbnDWhlGndVelRiNonDrvnVldBusHiSpd
      AssemblySwConnector_1291: ecu-extract-reference=GmMsg3F1BusHiSpdDAmbTDTEstimnDAmbT
      AssemblySwConnector_1292: ecu-extract-reference=GmOvrlStMgrDLkaStDGmMsg184BusHiSpdDLkaSt
      AssemblySwConnector_1293: ecu-extract-reference=GmOvrlStMgrDEscStDGmMsg1CABusChassisExpDEscSt
      AssemblySwConnector_1294: ecu-extract-reference=GmOvrlStMgrDApaDrvrIntvDetdDGmMsg335BusChassisExpDApaDrvrIntvDetd
      AssemblySwConnector_1295: ecu-extract-reference=GmOvrlStMgrDApaStDGmMsg335BusChassisExpDApaSt
      AssemblySwConnector_1296: ecu-extract-reference=GmOvrlStMgrDEscStDGmTqArbnDEscSt
      AssemblySwConnector_1298: ecu-extract-reference=GmStrtStopDStrtStopScaDStOutpCtrlDVehStrtStopMotTqCmdSca
      AssemblySwConnector_1299: ecu-extract-reference=GmStrtStopDStrtStopRateLimDStOutpCtrlDVehStrtStopRampRate
      AssemblySwConnector_1300: ecu-extract-reference=GmTqArbnDAssiCmdBasScaDAssiDAssiCmdBasSca
      AssemblySwConnector_1301: ecu-extract-reference=GmTqArbnDHwTqOvrlDAssiDHwTqOvrl
      AssemblySwConnector_1302: ecu-extract-reference=GmTqArbnDMotTqCmdOvrlDAssiSumLimDMotTqCmdOvrl
      AssemblySwConnector_1303: ecu-extract-reference=GmTqArbnDDampgCmdScaDDampgDDampgCmdSca
      AssemblySwConnector_1304: ecu-extract-reference=GmTqArbnDRtnCmdScaDRtnDRtnCmdSca
      AssemblySwConnector_1305: ecu-extract-reference=GmTqArbnDAssiCmdBasScaDStabyCmpDAssiCmdBasSca
      AssemblySwConnector_1306: ecu-extract-reference=GmVehPwrModDVehPwrModDftVehSpdEnaDGmVehSpdArbnDVehPwrModDftVehSpdEna
      AssemblySwConnector_1307: ecu-extract-reference=GmVehPwrModDSysOperMotTqCmdScaDStOutpCtrlDSysOperMotTqCmdSca
      AssemblySwConnector_1308: ecu-extract-reference=GmVehPwrModDSysOperRampRateDStOutpCtrlDSysOperRampRate
      AssemblySwConnector_1309: ecu-extract-reference=GmVehPwrModDPwrSplyEnaReqDSysStModDPwrSplyEnReq
      AssemblySwConnector_1310: ecu-extract-reference=GmVehPwrModDSysStReqEnaDSysStModDSysStReqEn
      AssemblySwConnector_1311: ecu-extract-reference=GmVehSpdArbnDVehSpdMaxSecurDGmOvrlStMgrDVehSpdSecurMax
      AssemblySwConnector_1312: ecu-extract-reference=GmVehSpdArbnDVehSpdMinSecurDGmOvrlStMgrDVehSpdSecurMin
      AssemblySwConnector_1313: ecu-extract-reference=GmVehSpdArbnDVehSpdMaxSecurDGmTqArbnDVehSpdMaxSecur
      AssemblySwConnector_1314: ecu-extract-reference=GmVehSpdArbnDVehSpdArbdDGmVehPwrModDVehSpdArbd
      AssemblySwConnector_1315: ecu-extract-reference=GmVehSpdArbnDVehSpdSnsrVldDGmVehPwrModDVehSpdSnsrVld
      AssemblySwConnector_1316: ecu-extract-reference=GmVehSpdArbnDVehSpdArbdDVehSigCdngDVehSpdSerlCom
      AssemblySwConnector_1317: ecu-extract-reference=GmVehSpdArbnDVehSpdArbdVldDVehSigCdngDVehSpdVldSerlCom
      AssemblySwConnector_1318: ecu-extract-reference=HiLoadStallLimrDStallMotTqLimDLimrCdngDStallMotTqLim
      AssemblySwConnector_1319: ecu-extract-reference=HwAg0MeasDHwAg0MeasHwAg0AutTrimDCmnMfgSrvDHwAg0MeasHwAg0AutoTrim
      AssemblySwConnector_1320: ecu-extract-reference=HwAg0MeasDHwAg0MeasHwAg0ClrTrimDCmnMfgSrvDHwAg0MeasHwAg0ClrTrim
      AssemblySwConnector_1321: ecu-extract-reference=HwAg0MeasDHwAg0MeasHwAg0ReadTrimDCmnMfgSrvDHwAg0MeasHwAg0ReadTrim
      AssemblySwConnector_1322: ecu-extract-reference=HwAg0MeasDHwAg0MeasHwAg0TrimPrfmdStsDCmnMfgSrvDHwAg0MeasHwAg0TrimPrfmdSts
      AssemblySwConnector_1323: ecu-extract-reference=HwAg0MeasDHwAg0MeasHwAg0WrTrimDCmnMfgSrvDHwAg0MeasHwAg0WrTrim
      AssemblySwConnector_1324: ecu-extract-reference=HwAg0MeasDHwAg0DHwAgArbnDHwAgA
      AssemblySwConnector_1325: ecu-extract-reference=HwAg0MeasDHwAg0QlfrDHwAgArbnDHwAgAQlfr
      AssemblySwConnector_1327: ecu-extract-reference=HwAg0MeasDHwAg0DHwAgCorrlnDHwAgA
      AssemblySwConnector_1328: ecu-extract-reference=HwAg0MeasDHwAg0QlfrDHwAgCorrlnDHwAgAQlfr
      AssemblySwConnector_1329: ecu-extract-reference=HwAg0MeasDHwAg0RollgCntrDHwAgCorrlnDHwAgARollgCntr
      AssemblySwConnector_1330: ecu-extract-reference=HwAg1MeasDHwAg1MeasHwAg1AutTrimDCmnMfgSrvDHwAg1MeasHwAg1AutoTrim
      AssemblySwConnector_1331: ecu-extract-reference=HwAg1MeasDHwAg1MeasHwAg1ClrTrimDCmnMfgSrvDHwAg1MeasHwAg1ClrTrim
      AssemblySwConnector_1332: ecu-extract-reference=HwAg1MeasDHwAg1MeasHwAg1ReadTrimDCmnMfgSrvDHwAg1MeasHwAg1ReadTrim
      AssemblySwConnector_1333: ecu-extract-reference=HwAg1MeasDHwAg1MeasHwAg1TrimPrfmdStsDCmnMfgSrvDHwAg1MeasHwAg1TrimPrfmdSts
      AssemblySwConnector_1334: ecu-extract-reference=HwAg1MeasDHwAg1MeasHwAg1WrTrimDCmnMfgSrvDHwAg1MeasHwAg1WrTrim
      AssemblySwConnector_1342: ecu-extract-reference=HwAgCorrlnDHwAgCorrlnStDHwAgArbnDHwAgCorrlnSt
      AssemblySwConnector_1343: ecu-extract-reference=HwAgCorrlnDHwAgIdptSigDHwAgSysArbnDHwAg0IdptSig
      AssemblySwConnector_1345: ecu-extract-reference=HwAgSysArbnDPinionAgConfDEotLrngDHwAgAuthy
      AssemblySwConnector_1347: ecu-extract-reference=HwAgSysArbnDPinionAgConfDEotProtnDHwAgAuthy
      AssemblySwConnector_1348: ecu-extract-reference=HwAgSysArbnDHwAgToSerlComDGmMsg1E5BusChassisExpDHwAg
      AssemblySwConnector_1349: ecu-extract-reference=HwAgSysArbnDHwAgStsToSerlComDGmMsg1E5BusChassisExpDHwAgStsToSerlCom
      AssemblySwConnector_1350: ecu-extract-reference=HwAgSysArbnDHwAgToSerlComDGmMsg1E5BusHiSpdDHwAg
      AssemblySwConnector_1351: ecu-extract-reference=HwAgSysArbnDHwAgStsToSerlComDGmMsg1E5BusHiSpdDHwAgStsToSerlCom
      AssemblySwConnector_1352: ecu-extract-reference=HwAgSysArbnDPinionAgDMotTqTranlDampgDHwAg
      AssemblySwConnector_1354: ecu-extract-reference=HwAgSysArbnDPinionAgConfDPullCmpActvDPinionAgConf
      AssemblySwConnector_1355: ecu-extract-reference=HwAgSysArbnDPinionAgDRtnDHwAg
      AssemblySwConnector_1356: ecu-extract-reference=HwAgSysArbnDPinionAgConfDRtnDHwAgAuthySca
      AssemblySwConnector_1357: ecu-extract-reference=HwAgSysArbnDPinionAgDTqLoaDPinionAg
      AssemblySwConnector_1358: ecu-extract-reference=HwAgSysArbnDPinionAgConfDTqLoaDPinionAgConf
      AssemblySwConnector_1359: ecu-extract-reference=HwAgSysArbnDHwAgFinalDVehSpdLimrDHwAg
      AssemblySwConnector_1360: ecu-extract-reference=HwAgSysArbnDPinionAgConfDVehSpdLimrDHwAgAuthy
      AssemblySwConnector_1372: ecu-extract-reference=HwTqArbnDHwTqChADHwTqCorrlnDHwTqChA
      AssemblySwConnector_1373: ecu-extract-reference=HwTqArbnDHwTqChBDHwTqCorrlnDHwTqChB
      AssemblySwConnector_1380: ecu-extract-reference=HwTqCorrlnDHwTqCorrlnStsDHwTqArbnDHwTqCorrlnSts
      AssemblySwConnector_1381: ecu-extract-reference=HwTqCorrlnDHwTqIdptSigDLoaMgrDHwTqIdptSig
      AssemblySwConnector_1384: ecu-extract-reference=IoHwAbDSetFctGpioPhaALowrCmdDCDD_TSG31CfgAndUseDIoHwAb_SetFctGpioPhaALowrCmd
      AssemblySwConnector_1385: ecu-extract-reference=IoHwAbDSetFctGpioPhaAUpprCmdDCDD_TSG31CfgAndUseDIoHwAb_SetFctGpioPhaAUpprCmd
      AssemblySwConnector_1386: ecu-extract-reference=IoHwAbDSetFctGpioPhaBLowrCmdDCDD_TSG31CfgAndUseDIoHwAb_SetFctGpioPhaBLowrCmd
      AssemblySwConnector_1387: ecu-extract-reference=IoHwAbDSetFctGpioPhaBUpprCmdDCDD_TSG31CfgAndUseDIoHwAb_SetFctGpioPhaBUpprCmd
      AssemblySwConnector_1388: ecu-extract-reference=IoHwAbDSetFctGpioPhaCLowrCmdDCDD_TSG31CfgAndUseDIoHwAb_SetFctGpioPhaCLowrCmd
      AssemblySwConnector_1389: ecu-extract-reference=IoHwAbDSetFctGpioPhaCUpprCmdDCDD_TSG31CfgAndUseDIoHwAb_SetFctGpioPhaCUpprCmd
      AssemblySwConnector_1390: ecu-extract-reference=IoHwAbDSetFctPeriphPhaALowrCmdDCDD_TSG31CfgAndUseDIoHwAb_SetFctPeriphPhaALowrCmd
      AssemblySwConnector_1391: ecu-extract-reference=IoHwAbDSetFctPeriphPhaAUpprCmdDCDD_TSG31CfgAndUseDIoHwAb_SetFctPeriphPhaAUpprCmd
      AssemblySwConnector_1392: ecu-extract-reference=IoHwAbDSetFctPeriphPhaBLowrCmdDCDD_TSG31CfgAndUseDIoHwAb_SetFctPeriphPhaBLowrCmd
      AssemblySwConnector_1393: ecu-extract-reference=IoHwAbDSetFctPeriphPhaBUpprCmdDCDD_TSG31CfgAndUseDIoHwAb_SetFctPeriphPhaBUpprCmd
      AssemblySwConnector_1394: ecu-extract-reference=IoHwAbDSetFctPeriphPhaCLowrCmdDCDD_TSG31CfgAndUseDIoHwAb_SetFctPeriphPhaCLowrCmd
      AssemblySwConnector_1395: ecu-extract-reference=IoHwAbDSetFctPeriphPhaCUpprCmdDCDD_TSG31CfgAndUseDIoHwAb_SetFctPeriphPhaCUpprCmd
      AssemblySwConnector_1396: ecu-extract-reference=IoHwAbDSetGpioPhaALowrCmdDCDD_TSG31CfgAndUseDIoHwAb_SetGpioPhaALowrCmd
      AssemblySwConnector_1397: ecu-extract-reference=IoHwAbDSetGpioPhaAUpprCmdDCDD_TSG31CfgAndUseDIoHwAb_SetGpioPhaAUpprCmd
      AssemblySwConnector_1398: ecu-extract-reference=IoHwAbDSetGpioPhaBLowrCmdDCDD_TSG31CfgAndUseDIoHwAb_SetGpioPhaBLowrCmd
      AssemblySwConnector_1399: ecu-extract-reference=IoHwAbDSetGpioPhaBUpprCmdDCDD_TSG31CfgAndUseDIoHwAb_SetGpioPhaBUpprCmd
      AssemblySwConnector_1400: ecu-extract-reference=IoHwAbDSetGpioPhaCLowrCmdDCDD_TSG31CfgAndUseDIoHwAb_SetGpioPhaCLowrCmd
      AssemblySwConnector_1401: ecu-extract-reference=IoHwAbDSetGpioPhaCUpprCmdDCDD_TSG31CfgAndUseDIoHwAb_SetGpioPhaCUpprCmd
      AssemblySwConnector_1408: ecu-extract-reference=IoHwAbDGetGpioMcuEnaDGmVehPwrModDIoHwAb_GetGpioMcuEna
      AssemblySwConnector_1409: ecu-extract-reference=IoHwAbDGetGpioPwrOutpEnaFbDTmplMonrDIoHwAb_GetGpioPwrOutpEnaFb
      AssemblySwConnector_1410: ecu-extract-reference=IoHwAbDSetGpioSysFlt2ADTmplMonrDIoHwAb_SetGpioSysFlt2A
      AssemblySwConnector_1412: ecu-extract-reference=IoHwAbDSetGpioTmplMonrWdgDTmplMonrDIoHwAb_SetGpioTmplMonrWdg
      AssemblySwConnector_1413: ecu-extract-reference=LimrCdngDEotAssiScaCdndDAssiSumLimDEotAssiSca
      AssemblySwConnector_1414: ecu-extract-reference=LimrCdngDEotMotTqLimCdndDAssiSumLimDEotMotTqLim
      AssemblySwConnector_1415: ecu-extract-reference=LimrCdngDStallMotTqLimCdndDAssiSumLimDStallMotTqLim
      AssemblySwConnector_1416: ecu-extract-reference=LimrCdngDSysMotTqCmdScaCdndDAssiSumLimDSysMotTqCmdSca
      AssemblySwConnector_1417: ecu-extract-reference=LimrCdngDThermMotTqLimCdndDAssiSumLimDThermMotTqLim
      AssemblySwConnector_1418: ecu-extract-reference=LimrCdngDVehSpdMotTqLimCdndDAssiSumLimDVehSpdMotTqLim
      AssemblySwConnector_1419: ecu-extract-reference=LoaMgrDHwTqLoaMtgtnEnaDAssiSumLimDHwTqLoaMtgtnEna
      AssemblySwConnector_1420: ecu-extract-reference=LoaMgrDIvtrLoaMtgtnEnaDCDD_MotCtrlMgrDIvtrLoaMtgtnEn
      AssemblySwConnector_1421: ecu-extract-reference=LoaMgrDCurrMeasLoaMtgtnEnaDCDD_MotCtrlMgrDMotCurrLoaMtgtnEn
      AssemblySwConnector_1422: ecu-extract-reference=LoaMgrDLoaStDGmOvrlStMgrDLoaSt
      AssemblySwConnector_1423: ecu-extract-reference=LoaMgrDCurrMeasLoaMtgtnEnaDMotCurrPeakEstimnDMotCurrLoaMtgtnEna
      AssemblySwConnector_1424: ecu-extract-reference=LoaMgrDIvtrLoaMtgtnEnaDMotCurrRegCfgDIvtrLoaMtgtnEna
      AssemblySwConnector_1425: ecu-extract-reference=LoaMgrDCurrMeasLoaMtgtnEnaDMotCurrRegCfgDMotCurrLoaMtgtnEna
      AssemblySwConnector_1426: ecu-extract-reference=LoaMgrDIvtrLoaMtgtnEnaDMotRefMdlDIvtrLoaMtgtnEna
      AssemblySwConnector_1427: ecu-extract-reference=LoaMgrDCurrMeasLoaMtgtnEnaDMotRefMdlDMotCurrLoaMtgtnEna
      AssemblySwConnector_1428: ecu-extract-reference=LoaMgrDLoaStDMotTqTranlDampgDLoaSt
      AssemblySwConnector_1429: ecu-extract-reference=LoaMgrDIvtrLoaMtgtnEnaDPwrLimrDIvtrLoaMtgtnEna
      AssemblySwConnector_1430: ecu-extract-reference=LoaMgrDLoaScaDStOutpCtrlDLoaMotTqCmdSca
      AssemblySwConnector_1431: ecu-extract-reference=LoaMgrDLoaRateLimDStOutpCtrlDLoaRampRate
      AssemblySwConnector_1432: ecu-extract-reference=LoaMgrDMotAgLoaMtgtnEnaDTqLoaDMotAgLoaMtgtnEna
      AssemblySwConnector_1438: ecu-extract-reference=MotAgCorrlnDMotAgMeclCorrlnStDCDD_MotCtrlMgrDMotAgMeclCorrlnSt
      AssemblySwConnector_1439: ecu-extract-reference=MotAgCorrlnDMotAgMeclIdptSigDLoaMgrDMotAgMeclIdptSig
      AssemblySwConnector_1440: ecu-extract-reference=MotCtrlPrmEstimnDGetMotPrmNomEolDCmnMfgSrvDGetMotPrmNomEol
      AssemblySwConnector_1441: ecu-extract-reference=MotCtrlPrmEstimnDSetMotPrmNomEolDCmnMfgSrvDSetMotPrmNomEol
      AssemblySwConnector_1442: ecu-extract-reference=MotCtrlPrmEstimnDMotInduDaxEstimdDMotCurrRegCfgDMotInduDaxEstimd
      AssemblySwConnector_1443: ecu-extract-reference=MotCtrlPrmEstimnDMotInduQaxEstimdDMotCurrRegCfgDMotInduQaxEstimd
      AssemblySwConnector_1444: ecu-extract-reference=MotCtrlPrmEstimnDMotREstimdDMotCurrRegCfgDMotREstimd
      AssemblySwConnector_1445: ecu-extract-reference=MotCtrlPrmEstimnDMotBackEmfConEstimdDMotRefMdlDMotBackEmfConEstimd
      AssemblySwConnector_1446: ecu-extract-reference=MotCtrlPrmEstimnDMotInduDaxEstimdDMotRefMdlDMotInduDaxEstimd
      AssemblySwConnector_1447: ecu-extract-reference=MotCtrlPrmEstimnDMotInduQaxEstimdDMotRefMdlDMotInduQaxEstimd
      AssemblySwConnector_1448: ecu-extract-reference=MotCtrlPrmEstimnDMotREstimdDMotRefMdlDMotREstimd
      AssemblySwConnector_1449: ecu-extract-reference=MotCtrlPrmEstimnDMotBackEmfConEstimdDPwrLimrDMotBackEmfConEstimd
      AssemblySwConnector_1450: ecu-extract-reference=MotCurrPeakEstimnDMotCurrPeakEstimdDDutyCycThermProtnDMotCurrPeakEstimd
      AssemblySwConnector_1451: ecu-extract-reference=MotCurrPeakEstimnDMotCurrPeakEstimdFildDDutyCycThermProtnDMotCurrPeakEstimdFild
      AssemblySwConnector_1452: ecu-extract-reference=MotCurrPeakEstimnDMotCurrPeakEstimdFildDTEstimnDMotCurrPeakEstimd
      AssemblySwConnector_1453: ecu-extract-reference=MotCurrRegCfgDMotAgElecDlyDCDD_MotCtrlMgrDMotAgElecDly
      AssemblySwConnector_1454: ecu-extract-reference=MotCurrRegCfgDMotDampgDaxDCDD_MotCtrlMgrDMotDampgDax
      AssemblySwConnector_1455: ecu-extract-reference=MotCurrRegCfgDMotDampgQaxDCDD_MotCtrlMgrDMotDampgQax
      AssemblySwConnector_1456: ecu-extract-reference=MotCurrRegCfgDMotIntglGainDaxDCDD_MotCtrlMgrDMotIntglGainDax
      AssemblySwConnector_1457: ecu-extract-reference=MotCurrRegCfgDMotIntglGainQaxDCDD_MotCtrlMgrDMotIntglGainQax
      AssemblySwConnector_1458: ecu-extract-reference=MotCurrRegCfgDMotPropGainDaxDCDD_MotCtrlMgrDMotPropGainDax
      AssemblySwConnector_1459: ecu-extract-reference=MotCurrRegCfgDMotPropGainQaxDCDD_MotCtrlMgrDMotPropGainQax
      AssemblySwConnector_1460: ecu-extract-reference=MotQuadDetnDMotQuadDMotRefMdlDMotQuad
      AssemblySwConnector_1461: ecu-extract-reference=MotRefMdlDMotCurrDaxCmdDCDD_MotCtrlMgrDMotCurrDaxCmd
      AssemblySwConnector_1462: ecu-extract-reference=MotRefMdlDMotCurrDaxMaxDCDD_MotCtrlMgrDMotCurrDaxMax
      AssemblySwConnector_1463: ecu-extract-reference=MotRefMdlDMotCurrQaxCmdDCDD_MotCtrlMgrDMotCurrQaxCmd
      AssemblySwConnector_1464: ecu-extract-reference=MotRefMdlDMotReacncDaxDCDD_MotCtrlMgrDMotReacncDax
      AssemblySwConnector_1465: ecu-extract-reference=MotRefMdlDMotReacncQaxDCDD_MotCtrlMgrDMotReacncQax
      AssemblySwConnector_1466: ecu-extract-reference=MotRefMdlDMotVltgDaxFfDCDD_MotCtrlMgrDMotVltgDaxFf
      AssemblySwConnector_1467: ecu-extract-reference=MotRefMdlDMotVltgQaxFfDCDD_MotCtrlMgrDMotVltgQaxFf
      AssemblySwConnector_1468: ecu-extract-reference=MotRefMdlDMotCurrDaxCmdDMotCtrlPrmEstimnDMotCurrDaxCmd
      AssemblySwConnector_1469: ecu-extract-reference=MotRefMdlDMotCurrQaxCmdDMotCtrlPrmEstimnDMotCurrQaxCmd
      AssemblySwConnector_1470: ecu-extract-reference=MotRefMdlDMotCurrDaxCmdDMotCurrPeakEstimnDMotCurrDaxCmd
      AssemblySwConnector_1471: ecu-extract-reference=MotRefMdlDMotCurrQaxCmdDMotCurrPeakEstimnDMotCurrQaxCmd
      AssemblySwConnector_1472: ecu-extract-reference=MotTqTranlDampgDMotTqCmdMrfDampdDPwrLimrDMotTqCmdMrf
      AssemblySwConnector_1473: ecu-extract-reference=PartNrDCustMfgEnStDCustDiagcDMfgEnaSt
      AssemblySwConnector_1474: ecu-extract-reference=PartNrDPartNrBasMdlPartNrAlphaCodRdDCustDiagcDPartNrBasMdlPartNrAlphaCodRd
      AssemblySwConnector_1475: ecu-extract-reference=PartNrDPartNrBasMdlPartNrRdDCustDiagcDPartNrBasMdlPartNrRd
      AssemblySwConnector_1476: ecu-extract-reference=PartNrDPartNrCalProgdStsRdDCustDiagcDPartNrCalProgdStsRd
      AssemblySwConnector_1477: ecu-extract-reference=PartNrDPartNrCalProgdStsWrDCustDiagcDPartNrCalProgdStsWr
      AssemblySwConnector_1478: ecu-extract-reference=PartNrDPartNrCcaMfgTrakgRdDCustDiagcDPartNrCcaMfgTrakgRd
      AssemblySwConnector_1479: ecu-extract-reference=PartNrDPartNrCmpdVehPartnProdtStructRdDCustDiagcDPartNrCmpdVehPartnProdtStructRd
      AssemblySwConnector_1480: ecu-extract-reference=PartNrDPartNrCtrlPidKeyChkDCustDiagcDPartNrCtrlPidKeyChk
      AssemblySwConnector_1481: ecu-extract-reference=PartNrDPartNrCtrlPidKeyWrDCustDiagcDPartNrCtrlPidKeyWr
      AssemblySwConnector_1482: ecu-extract-reference=PartNrDPartNrCtrlPidSeedRdDCustDiagcDPartNrCtrlPidSeedRd
      AssemblySwConnector_1483: ecu-extract-reference=PartNrDPartNrCustMfgEnaCntrRdDCustDiagcDPartNrCustMfgEnaCntrRd
      AssemblySwConnector_1484: ecu-extract-reference=PartNrDPartNrCustMfgEnaCntrWrDCustDiagcDPartNrCustMfgEnaCntrWr
      AssemblySwConnector_1485: ecu-extract-reference=PartNrDPartNrDataUniversalNrSysIdRdDCustDiagcDPartNrDataUniversalNrSysIdRd
      AssemblySwConnector_1486: ecu-extract-reference=PartNrDPartNrEndMdlPartNrAlphaCodRdDCustDiagcDPartNrEndMdlPartNrAlphaCodRd
      AssemblySwConnector_1487: ecu-extract-reference=PartNrDPartNrEndMdlPartNrAlphaCodWrDCustDiagcDPartNrEndMdlPartNrAlphaCodWr
      AssemblySwConnector_1488: ecu-extract-reference=PartNrDPartNrEndMdlPartNrRdDCustDiagcDPartNrEndMdlPartNrRd
      AssemblySwConnector_1489: ecu-extract-reference=PartNrDPartNrEndMdlPartNrWrDCustDiagcDPartNrEndMdlPartNrWr
      AssemblySwConnector_1490: ecu-extract-reference=PartNrDPartNrLstRepairShopCodRdDCustDiagcDPartNrLstRepairShopCodRd
      AssemblySwConnector_1491: ecu-extract-reference=PartNrDPartNrNxtrMfgTrakgRdDCustDiagcDPartNrNxtrMfgTrakgRd
      AssemblySwConnector_1492: ecu-extract-reference=PartNrDPartNrNxtrMfgTrakgWrDCustDiagcDPartNrNxtrMfgTrakgWr
      AssemblySwConnector_1493: ecu-extract-reference=PartNrDPartNrProgmDateRdDCustDiagcDPartNrProgmDateRd
      AssemblySwConnector_1494: ecu-extract-reference=PartNrDPartNrProgmDateWrDCustDiagcDPartNrProgmDateWr
      AssemblySwConnector_1495: ecu-extract-reference=PartNrDPartNrProgmSessionKeyChkDCustDiagcDPartNrProgmSessionKeyChk
      AssemblySwConnector_1496: ecu-extract-reference=PartNrDPartNrProgmSessionSeedRdDCustDiagcDPartNrProgmSessionSeedRd
      AssemblySwConnector_1497: ecu-extract-reference=PartNrDPartNrRepairShopCodRdDCustDiagcDPartNrRepairShopCodRd
      AssemblySwConnector_1498: ecu-extract-reference=PartNrDPartNrRepairShopCodWrDCustDiagcDPartNrRepairShopCodWr
      AssemblySwConnector_1499: ecu-extract-reference=PartNrDPartNrSysCodVersNrRdDCustDiagcDPartNrSysCodVersNrRd
      AssemblySwConnector_1500: ecu-extract-reference=PartNrDPartNrSysCodVersNrWrDCustDiagcDPartNrSysCodVersNrWr
      AssemblySwConnector_1501: ecu-extract-reference=PartNrDPartNrSysNameRdDCustDiagcDPartNrSysNameRd
      AssemblySwConnector_1502: ecu-extract-reference=PartNrDPartNrSysNameWrDCustDiagcDPartNrSysNameWr
      AssemblySwConnector_1503: ecu-extract-reference=PartNrDPartNrVinDataRdDCustDiagcDPartNrVinDataRd
      AssemblySwConnector_1504: ecu-extract-reference=PartNrDPartNrVinDataWrDCustDiagcDPartNrVinDataWr
      AssemblySwConnector_1505: ecu-extract-reference=PolarityCfgDHwTq0PolarityDCDD_HwTq0MeasDHwTq0Polarity
      AssemblySwConnector_1506: ecu-extract-reference=PolarityCfgDHwTq1PolarityDCDD_HwTq1MeasDHwTq1Polarity
      AssemblySwConnector_1507: ecu-extract-reference=PolarityCfgDHwTq2PolarityDCDD_HwTq2MeasDHwTq2Polarity
      AssemblySwConnector_1508: ecu-extract-reference=PolarityCfgDHwTq3PolarityDCDD_HwTq3MeasDHwTq3Polarity
      AssemblySwConnector_1509: ecu-extract-reference=PolarityCfgDAssiMechPolarityDCDD_MotAgCmpDAssiMechPolarity
      AssemblySwConnector_1510: ecu-extract-reference=PolarityCfgDMotAgMecl0PolarityDCDD_MotCtrlMgrDMotAgMecl0Polarity
      AssemblySwConnector_1511: ecu-extract-reference=PolarityCfgDMotAgMecl1PolarityDCDD_MotCtrlMgrDMotAgMecl1Polarity
      AssemblySwConnector_1512: ecu-extract-reference=PolarityCfgDMotElecMeclPolarityDCDD_MotCtrlMgrDMotElecMeclPolarity
      AssemblySwConnector_1513: ecu-extract-reference=PolarityCfgDAssiMechPolarityDCDD_MotVelDAssiMechPolarity
      AssemblySwConnector_1514: ecu-extract-reference=PolarityCfgDMotElecMeclPolarityDCDD_SinVltgGennDMotElecMeclPolarity
      AssemblySwConnector_1515: ecu-extract-reference=PolarityCfgDPolarityCfgReadDCmnMfgSrvDPolarityCfgRead
      AssemblySwConnector_1516: ecu-extract-reference=PolarityCfgDPolarityCfgWrDCmnMfgSrvDPolarityCfgWr
      AssemblySwConnector_1517: ecu-extract-reference=PolarityCfgDHwAg0PolarityDHwAg0MeasDHwAg0Polarity
      AssemblySwConnector_1518: ecu-extract-reference=PolarityCfgDHwAg1PolarityDHwAg1MeasDHwAg1Polarity
      AssemblySwConnector_1520: ecu-extract-reference=PolarityCfgDAssiMechPolarityDMotTqTranlDampgDAssiMechPolarity
      AssemblySwConnector_1521: ecu-extract-reference=PullCmpActvDPullCmpCmdDAssiSumLimDPullCmpCmd
      AssemblySwConnector_1522: ecu-extract-reference=PullCmpActvDGetPullCmpPrmDCmnMfgSrvDGetPullCmpPrm
      AssemblySwConnector_1523: ecu-extract-reference=PullCmpActvDRstPullCmpDCmnMfgSrvDRstPullCmp
      AssemblySwConnector_1524: ecu-extract-reference=PullCmpActvDSetPullCmpLongTermDCmnMfgSrvDSetPullCmpLongTerm
      AssemblySwConnector_1525: ecu-extract-reference=PullCmpActvDSetPullCmpShoTermDCmnMfgSrvDSetPullCmpShoTerm
      AssemblySwConnector_1526: ecu-extract-reference=PwrDiscnctDPwrDiscnctATestCmplDPwrUpSeqDPwrDiscnctATestCmpl
      AssemblySwConnector_1527: ecu-extract-reference=PwrDiscnctDPwrDiscnctBTestCmplDPwrUpSeqDPwrDiscnctBTestCmpl
      AssemblySwConnector_1528: ecu-extract-reference=PwrLimrDPwrLimrRednFacDAssiSumLimDPwrLimrRednFac
      AssemblySwConnector_1531: ecu-extract-reference=PwrUpSeqDStrtUpStDBattVltgCorrlnDStrtUpSt
      AssemblySwConnector_1532: ecu-extract-reference=PwrUpSeqDStrtUpStDCDD_CurrMeasDStrtUpSt
      AssemblySwConnector_1535: ecu-extract-reference=PwrUpSeqDStrtUpStDPwrDiscnctDStrtUpSt
      AssemblySwConnector_1536: ecu-extract-reference=PwrUpSeqDStrtUpStDSysStModDStrtUpSt
      AssemblySwConnector_1537: ecu-extract-reference=PwrUpSeqDSysStWrmIninCmplDSysStModDSysStWrmIninCmpl
      AssemblySwConnector_1538: ecu-extract-reference=PwrUpSeqDStrtUpStDTmplMonrDStrtUpSt
      AssemblySwConnector_1540: ecu-extract-reference=SerlComInpProxyDSerlComInpProxyGmLanIdRdDCustDiagcDPartNrGmLanIdRd
      AssemblySwConnector_1541: ecu-extract-reference=SerlComInpProxyDEngRunActvRawDGmMsg0C9BusHiSpdDEngRunActvRaw
      AssemblySwConnector_1542: ecu-extract-reference=SerlComInpProxyDEngSpdRawDGmMsg0C9BusHiSpdDEngSpdRaw
      AssemblySwConnector_1543: ecu-extract-reference=SerlComInpProxyDEngSpdStsRawDGmMsg0C9BusHiSpdDEngSpdStsRaw
      AssemblySwConnector_1544: ecu-extract-reference=SerlComInpProxyDLstRxnTiMsg0C9DGmMsg0C9BusHiSpdDLstRxnTiMsg0C9
      AssemblySwConnector_1545: ecu-extract-reference=SerlComInpProxyDPtCrkActvRawDGmMsg0C9BusHiSpdDPtCrkActvRaw
      AssemblySwConnector_1546: ecu-extract-reference=SerlComInpProxyDLstRxnTiMsg17DDGmMsg17DBusHiSpdDLstRxnTiMsg17D
      AssemblySwConnector_1547: ecu-extract-reference=SerlComInpProxyDVehStabyEnhmtStsRawDGmMsg17DBusHiSpdDVehStabyEnhmtStsRaw
      AssemblySwConnector_1548: ecu-extract-reference=SerlComInpProxyDLstRxnTiMsg180BusChassisExpDGmMsg180BusChassisExpDLstRxnTiMsg180BusChassisExp
      AssemblySwConnector_1549: ecu-extract-reference=SerlComInpProxyDTqOvrlAlvRollgCntrRawDGmMsg180BusChassisExpDTqOvrlAlvRollgCntrRaw
      AssemblySwConnector_1550: ecu-extract-reference=SerlComInpProxyDTqOvrlCmdChksRawDGmMsg180BusChassisExpDTqOvrlCmdChksRaw
      AssemblySwConnector_1551: ecu-extract-reference=SerlComInpProxyDTqOvrlDeltaTqCmdActvRawDGmMsg180BusChassisExpDTqOvrlDeltaTqCmdActvRaw
      AssemblySwConnector_1552: ecu-extract-reference=SerlComInpProxyDTqOvrlDeltaTqCmdValRawDGmMsg180BusChassisExpDTqOvrlDeltaTqCmdValRaw
      AssemblySwConnector_1553: ecu-extract-reference=SerlComInpProxyDLkaCmdProtnValRawDGmMsg180BusHiSpdDLkaCmdProtnValRaw
      AssemblySwConnector_1554: ecu-extract-reference=SerlComInpProxyDLkaCmdRollgCntrRawDGmMsg180BusHiSpdDLkaCmdRollgCntrRaw
      AssemblySwConnector_1555: ecu-extract-reference=SerlComInpProxyDLkaCmdTqReqActvRawDGmMsg180BusHiSpdDLkaCmdTqReqActvRaw
      AssemblySwConnector_1556: ecu-extract-reference=SerlComInpProxyDLkaCmdTqValRawDGmMsg180BusHiSpdDLkaCmdTqValRaw
      AssemblySwConnector_1557: ecu-extract-reference=SerlComInpProxyDLstRxnTiMsg180BusHiSpdDGmMsg180BusHiSpdDLstRxnTiMsg180BusHiSpd
      AssemblySwConnector_1558: ecu-extract-reference=SerlComInpProxyDLstRxnTiMsg182DGmMsg182BusChassisExpDLstRxnTiMsg182
      AssemblySwConnector_1559: ecu-extract-reference=SerlComInpProxyDVehDynOverUnderSteerVldRawDGmMsg182BusChassisExpDVehDynOverUnderSteerVldRaw
      AssemblySwConnector_1560: ecu-extract-reference=SerlComInpProxyDVehStabyEnhmtLgtALoReslRawDGmMsg182BusChassisExpDVehStabyEnhmtLgtALoReslRaw
      AssemblySwConnector_1561: ecu-extract-reference=SerlComInpProxyDVehStabyEnhmtLgtALoReslVldRawDGmMsg182BusChassisExpDVehStabyEnhmtLgtALoReslVldRaw
      AssemblySwConnector_1562: ecu-extract-reference=SerlComInpProxyDAbsActvRawDGmMsg1E9BusHiSpdDAbsActvRaw
      AssemblySwConnector_1563: ecu-extract-reference=SerlComInpProxyDAbsFaildRawDGmMsg1E9BusHiSpdDAbsFaildRaw
      AssemblySwConnector_1564: ecu-extract-reference=SerlComInpProxyDLstRxnTiMsg1E9DGmMsg1E9BusHiSpdDLstRxnTiMsg1E9
      AssemblySwConnector_1565: ecu-extract-reference=SerlComInpProxyDTracCtrlSysActvRawDGmMsg1E9BusHiSpdDTracCtrlSysActvRaw
      AssemblySwConnector_1566: ecu-extract-reference=SerlComInpProxyDTracCtrlSysEnaRawDGmMsg1E9BusHiSpdDTracCtrlSysEnaRaw
      AssemblySwConnector_1567: ecu-extract-reference=SerlComInpProxyDVehDynCtrlSysStRawDGmMsg1E9BusHiSpdDVehDynCtrlSysStRaw
      AssemblySwConnector_1568: ecu-extract-reference=SerlComInpProxyDVehDynYawRateRawDGmMsg1E9BusHiSpdDVehDynYawRateRaw
      AssemblySwConnector_1569: ecu-extract-reference=SerlComInpProxyDVehDynYawRateVldRawDGmMsg1E9BusHiSpdDVehDynYawRateVldRaw
      AssemblySwConnector_1570: ecu-extract-reference=SerlComInpProxyDVehStabyEnhmtActvRawDGmMsg1E9BusHiSpdDVehStabyEnhmtActvRaw
      AssemblySwConnector_1571: ecu-extract-reference=SerlComInpProxyDVehStabyEnhmtLatARawDGmMsg1E9BusHiSpdDVehStabyEnhmtLatARaw
      AssemblySwConnector_1572: ecu-extract-reference=SerlComInpProxyDVehStabyEnhmtLatAVldRawDGmMsg1E9BusHiSpdDVehStabyEnhmtLatAVldRaw
      AssemblySwConnector_1573: ecu-extract-reference=SerlComInpProxyDBackUpPwrModMstVirtDevAuthyRawDGmMsg1F1BusHiSpdDBackUpPwrModMstVirtDevAuthyRaw
      AssemblySwConnector_1574: ecu-extract-reference=SerlComInpProxyDLstRxnTiMsg1F1DGmMsg1F1BusHiSpdDLstRxnTiMsg1F1
      AssemblySwConnector_1575: ecu-extract-reference=SerlComInpProxyDSysBackUpPwrModEnaRawDGmMsg1F1BusHiSpdDSysBackUpPwrModEnaRaw
      AssemblySwConnector_1576: ecu-extract-reference=SerlComInpProxyDSysBackUpPwrModRawDGmMsg1F1BusHiSpdDSysBackUpPwrModRaw
      AssemblySwConnector_1577: ecu-extract-reference=SerlComInpProxyDSysPwrModRawDGmMsg1F1BusHiSpdDSysPwrModRaw
      AssemblySwConnector_1578: ecu-extract-reference=SerlComInpProxyDLstRxnTiMsg1F5DGmMsg1F5BusHiSpdDLstRxnTiMsg1F5
      AssemblySwConnector_1579: ecu-extract-reference=SerlComInpProxyDShiftLvrPosnRawDGmMsg1F5BusHiSpdDShiftLvrPosnRaw
      AssemblySwConnector_1580: ecu-extract-reference=SerlComInpProxyDShiftLvrPosnVldRawDGmMsg1F5BusHiSpdDShiftLvrPosnVldRaw
      AssemblySwConnector_1581: ecu-extract-reference=SerlComInpProxyDAbsActvProtdProtnValRawDGmMsg214BusHiSpdDAbsActvProtdProtnValRaw
      AssemblySwConnector_1582: ecu-extract-reference=SerlComInpProxyDAbsActvProtdRawDGmMsg214BusHiSpdDAbsActvProtdRaw
      AssemblySwConnector_1583: ecu-extract-reference=SerlComInpProxyDAbsActvProtdRollgCntrRawDGmMsg214BusHiSpdDAbsActvProtdRollgCntrRaw
      AssemblySwConnector_1584: ecu-extract-reference=SerlComInpProxyDLstRxnTiMsg214DGmMsg214BusHiSpdDLstRxnTiMsg214
      AssemblySwConnector_1585: ecu-extract-reference=SerlComInpProxyDRdntVehStabyEnhmtSysActvRawDGmMsg214BusHiSpdDRdntVehStabyEnhmtSysActvRaw
      AssemblySwConnector_1586: ecu-extract-reference=SerlComInpProxyDRdntVehStabyEnhmtSysActvRollgCntrRawDGmMsg214BusHiSpdDRdntVehStabyEnhmtSysActvRollgCntrRaw
      AssemblySwConnector_1587: ecu-extract-reference=SerlComInpProxyDLstRxnTiMsg232DGmMsg232BusHiSpdDLstRxnTiMsg232
      AssemblySwConnector_1588: ecu-extract-reference=SerlComInpProxyDSteerSysPrfmncModReqRawDGmMsg232BusHiSpdDSteerSysPrfmncModReqRaw
      AssemblySwConnector_1589: ecu-extract-reference=SerlComInpProxyDLstRxnTiMsg337BusChassisExpDGmMsg337BusChassisExpDLstRxnTiMsg337BusChassisExp
      AssemblySwConnector_1590: ecu-extract-reference=SerlComInpProxyDSteerWhlAgReqActvRawDGmMsg337BusChassisExpDSteerWhlAgReqActvRaw
      AssemblySwConnector_1591: ecu-extract-reference=SerlComInpProxyDSteerWhlAgReqActvVldRawDGmMsg337BusChassisExpDSteerWhlAgReqActvVldRaw
      AssemblySwConnector_1592: ecu-extract-reference=SerlComInpProxyDSteerWhlAgReqProtnValRawDGmMsg337BusChassisExpDSteerWhlAgReqProtnValRaw
      AssemblySwConnector_1593: ecu-extract-reference=SerlComInpProxyDSteerWhlAgReqRollgCntrRawDGmMsg337BusChassisExpDSteerWhlAgReqRollgCntrRaw
      AssemblySwConnector_1594: ecu-extract-reference=SerlComInpProxyDSteerWhlAgReqTarAgRawDGmMsg337BusChassisExpDSteerWhlAgReqTarAgRaw
      AssemblySwConnector_1595: ecu-extract-reference=SerlComInpProxyDSteerWhlFbReqActvProtnValRawDGmMsg337BusChassisExpDSteerWhlFbReqActvProtnValRaw
      AssemblySwConnector_1596: ecu-extract-reference=SerlComInpProxyDSteerWhlFbReqActvRawDGmMsg337BusChassisExpDSteerWhlFbReqActvRaw
      AssemblySwConnector_1597: ecu-extract-reference=SerlComInpProxyDSteerWhlFbReqActvRollgCntrRawDGmMsg337BusChassisExpDSteerWhlFbReqActvRollgCntrRaw
      AssemblySwConnector_1598: ecu-extract-reference=SerlComInpProxyDLstRxnTiMsg348BusChassisExpDGmMsg348BusChassisExpDLstRxnTiMsg348BusChassisExp
      AssemblySwConnector_1599: ecu-extract-reference=SerlComInpProxyDWhlGndVelLeDrvnRawBusChassisExpDGmMsg348BusChassisExpDWhlGndVelLeDrvnRawBusChassisExp
      AssemblySwConnector_1600: ecu-extract-reference=SerlComInpProxyDWhlGndVelLeDrvnVldRawBusChassisExpDGmMsg348BusChassisExpDWhlGndVelLeDrvnVldRawBusChassisExp
      AssemblySwConnector_1601: ecu-extract-reference=SerlComInpProxyDWhlGndVelRiDrvnRawBusChassisExpDGmMsg348BusChassisExpDWhlGndVelRiDrvnRawBusChassisExp
      AssemblySwConnector_1602: ecu-extract-reference=SerlComInpProxyDWhlGndVelRiDrvnVldRawBusChassisExpDGmMsg348BusChassisExpDWhlGndVelRiDrvnVldRawBusChassisExp
      AssemblySwConnector_1603: ecu-extract-reference=SerlComInpProxyDLstRxnTiMsg348BusHiSpdDGmMsg348BusHiSpdDLstRxnTiMsg348BusHiSpd
      AssemblySwConnector_1604: ecu-extract-reference=SerlComInpProxyDWhlGndVelLeDrvnRawBusHiSpdDGmMsg348BusHiSpdDWhlGndVelLeDrvnRawBusHiSpd
      AssemblySwConnector_1605: ecu-extract-reference=SerlComInpProxyDWhlGndVelLeDrvnVldRawBusHiSpdDGmMsg348BusHiSpdDWhlGndVelLeDrvnVldRawBusHiSpd
      AssemblySwConnector_1606: ecu-extract-reference=SerlComInpProxyDWhlGndVelRiDrvnRawBusHiSpdDGmMsg348BusHiSpdDWhlGndVelRiDrvnRawBusHiSpd
      AssemblySwConnector_1607: ecu-extract-reference=SerlComInpProxyDWhlGndVelRiDrvnVldRawBusHiSpdDGmMsg348BusHiSpdDWhlGndVelRiDrvnVldRawBusHiSpd
      AssemblySwConnector_1608: ecu-extract-reference=SerlComInpProxyDLstRxnTiMsg34ABusChassisExpDGmMsg34ABusChassisExpDLstRxnTiMsg34ABusChassisExp
      AssemblySwConnector_1609: ecu-extract-reference=SerlComInpProxyDWhlGndVelLeNonDrvnRawBusChassisExpDGmMsg34ABusChassisExpDWhlGndVelLeNonDrvnRawBusChassisExp
      AssemblySwConnector_1610: ecu-extract-reference=SerlComInpProxyDWhlGndVelLeNonDrvnVldRawBusChassisExpDGmMsg34ABusChassisExpDWhlGndVelLeNonDrvnVldRawBusChassisExp
      AssemblySwConnector_1611: ecu-extract-reference=SerlComInpProxyDWhlGndVelRiNonDrvnRawBusChassisExpDGmMsg34ABusChassisExpDWhlGndVelRiNonDrvnRawBusChassisExp
      AssemblySwConnector_1612: ecu-extract-reference=SerlComInpProxyDWhlGndVelRiNonDrvnVldRawBusChassisExpDGmMsg34ABusChassisExpDWhlGndVelRiNonDrvnVldRawBusChassisExp
      AssemblySwConnector_1613: ecu-extract-reference=SerlComInpProxyDLstRxnTiMsg34ABusHiSpdDGmMsg34ABusHiSpdDLstRxnTiMsg34ABusHiSpd
      AssemblySwConnector_1614: ecu-extract-reference=SerlComInpProxyDWhlGndVelLeNonDrvnRawBusHiSpdDGmMsg34ABusHiSpdDWhlGndVelLeNonDrvnRawBusHiSpd
      AssemblySwConnector_1615: ecu-extract-reference=SerlComInpProxyDWhlGndVelLeNonDrvnVldRawBusHiSpdDGmMsg34ABusHiSpdDWhlGndVelLeNonDrvnVldRawBusHiSpd
      AssemblySwConnector_1616: ecu-extract-reference=SerlComInpProxyDWhlGndVelRiNonDrvnRawBusHiSpdDGmMsg34ABusHiSpdDWhlGndVelRiNonDrvnRawBusHiSpd
      AssemblySwConnector_1617: ecu-extract-reference=SerlComInpProxyDWhlGndVelRiNonDrvnVldRawBusHiSpdDGmMsg34ABusHiSpdDWhlGndVelRiNonDrvnVldRawBusHiSpd
      AssemblySwConnector_1621: ecu-extract-reference=SerlComInpProxyDLstRxnTiMsg3F1DGmMsg3F1BusHiSpdDLstRxnTiMsg3F1
      AssemblySwConnector_1622: ecu-extract-reference=SerlComInpProxyDOutdAirTCorrdValMaskRawDGmMsg3F1BusHiSpdDOutdAirTCorrdValMaskRaw
      AssemblySwConnector_1623: ecu-extract-reference=SerlComInpProxyDOutdAirTCorrdValRawDGmMsg3F1BusHiSpdDOutdAirTCorrdValRaw
      AssemblySwConnector_1624: ecu-extract-reference=SerlComInpProxyDOutdAirTCorrdValVldRawDGmMsg3F1BusHiSpdDOutdAirTCorrdValVldRaw
      AssemblySwConnector_1629: ecu-extract-reference=StabyCmpDAssiCmdDAssiSumLimDAssiCmd
      AssemblySwConnector_1630: ecu-extract-reference=StOutpCtrlDSysMotTqCmdScaDEotProtnDSysMotTqCmdSca
      AssemblySwConnector_1631: ecu-extract-reference=StOutpCtrlDSysMotTqCmdScaDLimrCdngDSysMotTqCmdSca
      AssemblySwConnector_1632: ecu-extract-reference=StOutpCtrlDSysStReqDiDSysStModDSysStReqDi
      AssemblySwConnector_1633: ecu-extract-reference=SysStModDSysStDBattVltgCorrlnDSysSt
      AssemblySwConnector_1634: ecu-extract-reference=SysStModDSysStDCDD_CurrMeasDSysSt
      AssemblySwConnector_1635: ecu-extract-reference=SysStModDSysStDCDD_MotCtrlMgrDSysSt
      AssemblySwConnector_1636: ecu-extract-reference=SysStModDSysStDCDD_TSG31CfgAndUseDSysSt
      AssemblySwConnector_1637: ecu-extract-reference=SysStModDSysStDCmnMfgSrvDSysSt
      AssemblySwConnector_1638: ecu-extract-reference=SysStModDSysStDCurrMeasCorrlnDSysSt
      AssemblySwConnector_1639: ecu-extract-reference=SysStModDSysStDDiagcMgrDSysSt
      AssemblySwConnector_1641: ecu-extract-reference=SysStModDSysStDMotDrvDiagcDSysSt
      AssemblySwConnector_1642: ecu-extract-reference=SysStModDSysStDMotTqTranlDampgDSysSt
      AssemblySwConnector_1643: ecu-extract-reference=SysStModDSysStDPwrDiscnctDSysSt
      AssemblySwConnector_1644: ecu-extract-reference=SysStModDSysStDPwrSplyDSysSt
      AssemblySwConnector_1645: ecu-extract-reference=SysStModDSysStDPwrUpSeqDSysSt
      AssemblySwConnector_1646: ecu-extract-reference=TEstimnDAssiMechTDDampgDAssiMechT
      AssemblySwConnector_1647: ecu-extract-reference=TEstimnDMotFetTDDutyCycThermProtnDMotFetT
      AssemblySwConnector_1648: ecu-extract-reference=TEstimnDMotMagTDDutyCycThermProtnDMotMagT
      AssemblySwConnector_1649: ecu-extract-reference=TEstimnDMotWidgTDDutyCycThermProtnDMotWidgT
      AssemblySwConnector_1650: ecu-extract-reference=TEstimnDAssiMechTDHysCmpDAssiMechT
      AssemblySwConnector_1651: ecu-extract-reference=TEstimnDMotFetTDMotCtrlPrmEstimnDMotFetT
      AssemblySwConnector_1652: ecu-extract-reference=TEstimnDMotMagTDMotCtrlPrmEstimnDMotMagT
      AssemblySwConnector_1653: ecu-extract-reference=TEstimnDMotWidgTDMotCtrlPrmEstimnDMotWidgT
