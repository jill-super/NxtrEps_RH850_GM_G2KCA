[part 3 of 4: package /COM/VECTOR/CFG/WORKFLOW/SYSDESC/SYNC]
AUTOSAR XML (schema 4-0-3)
package /COM/VECTOR/CFG/WORKFLOW/SYSDESC/SYNC  (continued)
  flat map FLATMAP  (continued)
    3171 x flat instance descriptor:  (continued)
      AssemblySwConnector_690: ecu-extract-reference=CalRegn02Inin00GroupCDGmStrtStopStopMod2VehSpdTranThdDGmStrtStopDGmStrtStopStopMod2VehSpdTranThd
      AssemblySwConnector_691: ecu-extract-reference=CalRegn02Inin00GroupCDGmStrtStopStopModScaDGmStrtStopDGmStrtStopStopModSca
      AssemblySwConnector_692: ecu-extract-reference=CalRegn02Inin00GroupCDGmTqArbnApaDiRateXDGmTqArbnDGmTqArbnApaDiRateX
      AssemblySwConnector_724: ecu-extract-reference=CalRegn02Inin00GroupCDGmTqArbnLkaSlewEnaDGmTqArbnDGmTqArbnLkaSlewEna
      AssemblySwConnector_725: ecu-extract-reference=CalRegn02Rt00GroupCDGmOvrlStMgrHwAgTarLimrDGmOvrlStMgrDGmOvrlStMgrHwAgTarLimr
      AssemblySwConnector_728: ecu-extract-reference=CalRegn02Rt00GroupCDGmOvrlStMgrShiftLvrTiThdDGmOvrlStMgrDGmOvrlStMgrShiftLvrTiThd
      AssemblySwConnector_729: ecu-extract-reference=CalRegn02Rt00GroupCDGmOvrlStMgrStandStillThdDGmOvrlStMgrDGmOvrlStMgrStandStillThd
      AssemblySwConnector_730: ecu-extract-reference=CalRegn02Rt00GroupCDGmOvrlStMgrStandStillTiThdDGmOvrlStMgrDGmOvrlStMgrStandStillTiThd
      AssemblySwConnector_731: ecu-extract-reference=CalRegn02Rt00GroupCDGmTqArbnApaDiRateYDGmTqArbnDGmTqArbnApaDiRateY
      AssemblySwConnector_732: ecu-extract-reference=CalRegn02Rt00GroupCDGmTqArbnApaEnaRateDGmTqArbnDGmTqArbnApaEnaRate
      AssemblySwConnector_733: ecu-extract-reference=CalRegn02Rt00GroupCDGmTqArbnApaSmotngHwTqLpFilFrqDGmTqArbnDGmTqArbnApaSmotngHwTqLpFilFrq
      AssemblySwConnector_749: ecu-extract-reference=CalRegn02Rt00GroupCDGmTqArbnApaSmotngXDGmTqArbnDGmTqArbnApaSmotngX
      AssemblySwConnector_751: ecu-extract-reference=CalRegn02Rt00GroupCDGmTqArbnApaSmotngYDGmTqArbnDGmTqArbnApaSmotngY
      AssemblySwConnector_752: ecu-extract-reference=CalRegn02Rt00GroupCDGmTqArbnLkaSlewXDGmTqArbnDGmTqArbnLkaSlewX
      AssemblySwConnector_759: ecu-extract-reference=CalRegn02Rt00GroupCDGmTqArbnLkaSlewYDGmTqArbnDGmTqArbnLkaSlewY
      AssemblySwConnector_760: ecu-extract-reference=CalRegn02Rt01GroupCDGmOvrlStMgrHwAgTarLimrDCalRegn02Rt01GroupC_DummyDGmOvrlStMgrHwAgTarLimr
      AssemblySwConnector_763: ecu-extract-reference=CalRegn02Rt01GroupCDGmOvrlStMgrShiftLvrTiThdDCalRegn02Rt01GroupC_DummyDGmOvrlStMgrShiftLvrTiThd
      AssemblySwConnector_1035: ecu-extract-reference=CalRegn02Rt01GroupCDGmOvrlStMgrStandStillThdDCalRegn02Rt01GroupC_DummyDGmOvrlStMgrStandStillThd
      AssemblySwConnector_1165: ecu-extract-reference=CalRegn02Rt01GroupCDGmOvrlStMgrStandStillTiThdDCalRegn02Rt01GroupC_DummyDGmOvrlStMgrStandStillTiThd
      AssemblySwConnector_1166: ecu-extract-reference=CalRegn02Rt01GroupCDGmTqArbnApaDiRateYDCalRegn02Rt01GroupC_DummyDGmTqArbnApaDiRateY
      AssemblySwConnector_1371: ecu-extract-reference=CalRegn02Rt01GroupCDGmTqArbnApaEnaRateDCalRegn02Rt01GroupC_DummyDGmTqArbnApaEnaRate
      AssemblySwConnector_1379: ecu-extract-reference=CalRegn02Rt01GroupCDGmTqArbnApaSmotngHwTqLpFilFrqDCalRegn02Rt01GroupC_DummyDGmTqArbnApaSmotngHwTqLpFilFrq
      AssemblySwConnector_1628: ecu-extract-reference=CalRegn02Rt01GroupCDGmTqArbnApaSmotngXDCalRegn02Rt01GroupC_DummyDGmTqArbnApaSmotngX
      AssemblySwConnector_1704: ecu-extract-reference=CalRegn02Rt01GroupCDGmTqArbnApaSmotngYDCalRegn02Rt01GroupC_DummyDGmTqArbnApaSmotngY
      AssemblySwConnector_1773: ecu-extract-reference=CalRegn02Rt01GroupCDGmTqArbnLkaSlewXDCalRegn02Rt01GroupC_DummyDGmTqArbnLkaSlewX
      AssemblySwConnector_1795: ecu-extract-reference=CalRegn02Rt01GroupCDGmTqArbnLkaSlewYDCalRegn02Rt01GroupC_DummyDGmTqArbnLkaSlewY
      AssemblySwConnector_1802: ecu-extract-reference=CalRegn02Rt02GroupCDGmOvrlStMgrHwAgTarLimrDCalRegn02Rt01GroupC_Dummy_1DGmOvrlStMgrHwAgTarLimr
      AssemblySwConnector_1808: ecu-extract-reference=CalRegn02Rt02GroupCDGmOvrlStMgrShiftLvrTiThdDCalRegn02Rt01GroupC_Dummy_1DGmOvrlStMgrShiftLvrTiThd
      AssemblySwConnector_1809: ecu-extract-reference=CalRegn02Rt02GroupCDGmOvrlStMgrStandStillThdDCalRegn02Rt01GroupC_Dummy_1DGmOvrlStMgrStandStillThd
      AssemblySwConnector_1810: ecu-extract-reference=CalRegn02Rt02GroupCDGmOvrlStMgrStandStillTiThdDCalRegn02Rt01GroupC_Dummy_1DGmOvrlStMgrStandStillTiThd
      AssemblySwConnector_1811: ecu-extract-reference=CalRegn02Rt02GroupCDGmTqArbnApaDiRateYDCalRegn02Rt01GroupC_Dummy_1DGmTqArbnApaDiRateY
      AssemblySwConnector_1812: ecu-extract-reference=CalRegn02Rt02GroupCDGmTqArbnApaEnaRateDCalRegn02Rt01GroupC_Dummy_1DGmTqArbnApaEnaRate
      AssemblySwConnector_1813: ecu-extract-reference=CalRegn02Rt02GroupCDGmTqArbnApaSmotngHwTqLpFilFrqDCalRegn02Rt01GroupC_Dummy_1DGmTqArbnApaSmotngHwTqLpFilFrq
      AssemblySwConnector_1814: ecu-extract-reference=CalRegn02Rt02GroupCDGmTqArbnApaSmotngXDCalRegn02Rt01GroupC_Dummy_1DGmTqArbnApaSmotngX
      AssemblySwConnector_1815: ecu-extract-reference=CalRegn02Rt02GroupCDGmTqArbnApaSmotngYDCalRegn02Rt01GroupC_Dummy_1DGmTqArbnApaSmotngY
      AssemblySwConnector_1816: ecu-extract-reference=CalRegn02Rt02GroupCDGmTqArbnLkaSlewXDCalRegn02Rt01GroupC_Dummy_1DGmTqArbnLkaSlewX
      AssemblySwConnector_1817: ecu-extract-reference=CalRegn02Rt02GroupCDGmTqArbnLkaSlewYDCalRegn02Rt01GroupC_Dummy_1DGmTqArbnLkaSlewY
      AssemblySwConnector_1818: ecu-extract-reference=CalRegn02Rt03GroupCDGmOvrlStMgrHwAgTarLimrDCalRegn02Rt01GroupC_Dummy_2DGmOvrlStMgrHwAgTarLimr
      AssemblySwConnector_1819: ecu-extract-reference=CalRegn02Rt03GroupCDGmOvrlStMgrShiftLvrTiThdDCalRegn02Rt01GroupC_Dummy_2DGmOvrlStMgrShiftLvrTiThd
      AssemblySwConnector_1820: ecu-extract-reference=CalRegn02Rt03GroupCDGmOvrlStMgrStandStillThdDCalRegn02Rt01GroupC_Dummy_2DGmOvrlStMgrStandStillThd
      AssemblySwConnector_1821: ecu-extract-reference=CalRegn02Rt03GroupCDGmOvrlStMgrStandStillTiThdDCalRegn02Rt01GroupC_Dummy_2DGmOvrlStMgrStandStillTiThd
      AssemblySwConnector_1822: ecu-extract-reference=CalRegn02Rt03GroupCDGmTqArbnApaDiRateYDCalRegn02Rt01GroupC_Dummy_2DGmTqArbnApaDiRateY
      AssemblySwConnector_1823: ecu-extract-reference=CalRegn02Rt03GroupCDGmTqArbnApaEnaRateDCalRegn02Rt01GroupC_Dummy_2DGmTqArbnApaEnaRate
      AssemblySwConnector_1824: ecu-extract-reference=CalRegn02Rt03GroupCDGmTqArbnApaSmotngHwTqLpFilFrqDCalRegn02Rt01GroupC_Dummy_2DGmTqArbnApaSmotngHwTqLpFilFrq
      AssemblySwConnector_1825: ecu-extract-reference=CalRegn02Rt03GroupCDGmTqArbnApaSmotngXDCalRegn02Rt01GroupC_Dummy_2DGmTqArbnApaSmotngX
      AssemblySwConnector_1826: ecu-extract-reference=CalRegn02Rt03GroupCDGmTqArbnApaSmotngYDCalRegn02Rt01GroupC_Dummy_2DGmTqArbnApaSmotngY
      AssemblySwConnector_1827: ecu-extract-reference=CalRegn02Rt03GroupCDGmTqArbnLkaSlewXDCalRegn02Rt01GroupC_Dummy_2DGmTqArbnLkaSlewX
      AssemblySwConnector_1829: ecu-extract-reference=CalRegn02Rt03GroupCDGmTqArbnLkaSlewYDCalRegn02Rt01GroupC_Dummy_2DGmTqArbnLkaSlewY
      AssemblySwConnector_1832: ecu-extract-reference=CalRegn02Rt04GroupCDGmOvrlStMgrHwAgTarLimrDCalRegn02Rt01GroupC_Dummy_3DGmOvrlStMgrHwAgTarLimr
      AssemblySwConnector_1833: ecu-extract-reference=CalRegn02Rt04GroupCDGmOvrlStMgrShiftLvrTiThdDCalRegn02Rt01GroupC_Dummy_3DGmOvrlStMgrShiftLvrTiThd
      AssemblySwConnector_1834: ecu-extract-reference=CalRegn02Rt04GroupCDGmOvrlStMgrStandStillThdDCalRegn02Rt01GroupC_Dummy_3DGmOvrlStMgrStandStillThd
      AssemblySwConnector_1839: ecu-extract-reference=CalRegn02Rt04GroupCDGmOvrlStMgrStandStillTiThdDCalRegn02Rt01GroupC_Dummy_3DGmOvrlStMgrStandStillTiThd
      AssemblySwConnector_1841: ecu-extract-reference=CalRegn02Rt04GroupCDGmTqArbnApaDiRateYDCalRegn02Rt01GroupC_Dummy_3DGmTqArbnApaDiRateY
      AssemblySwConnector_1842: ecu-extract-reference=CalRegn02Rt04GroupCDGmTqArbnApaEnaRateDCalRegn02Rt01GroupC_Dummy_3DGmTqArbnApaEnaRate
      AssemblySwConnector_1843: ecu-extract-reference=CalRegn02Rt04GroupCDGmTqArbnApaSmotngHwTqLpFilFrqDCalRegn02Rt01GroupC_Dummy_3DGmTqArbnApaSmotngHwTqLpFilFrq
      AssemblySwConnector_1844: ecu-extract-reference=CalRegn02Rt04GroupCDGmTqArbnApaSmotngXDCalRegn02Rt01GroupC_Dummy_3DGmTqArbnApaSmotngX
      AssemblySwConnector_1845: ecu-extract-reference=CalRegn02Rt04GroupCDGmTqArbnApaSmotngYDCalRegn02Rt01GroupC_Dummy_3DGmTqArbnApaSmotngY
      AssemblySwConnector_1846: ecu-extract-reference=CalRegn02Rt04GroupCDGmTqArbnLkaSlewXDCalRegn02Rt01GroupC_Dummy_3DGmTqArbnLkaSlewX
      AssemblySwConnector_1847: ecu-extract-reference=CalRegn02Rt04GroupCDGmTqArbnLkaSlewYDCalRegn02Rt01GroupC_Dummy_3DGmTqArbnLkaSlewY
      AssemblySwConnector_1848: ecu-extract-reference=CalRegn03CmnDEotProtnSoftEndStopAuthyThdDEotProtnDEotProtnSoftEndStopAuthyThd
      AssemblySwConnector_1849: ecu-extract-reference=CalRegn03CmnDTqLoaDrvrTqNomDTqLoaDTqLoaDrvrTqNom
      AssemblySwConnector_1850: ecu-extract-reference=CalRegn03CmnDTqLoaMotTqCmdLimDTqLoaDTqLoaMotTqCmdLim
      AssemblySwConnector_1851: ecu-extract-reference=CalRegn03CmnDTqLoaMotVelAndTqBasdScaFacFallRateDTqLoaDTqLoaMotVelAndTqBasdScaFacFallRate
      AssemblySwConnector_1880: ecu-extract-reference=CalRegn03CmnDTqLoaMotVelAndTqBasdScaFacMaxDTqLoaDTqLoaMotVelAndTqBasdScaFacMax
      AssemblySwConnector_1885: ecu-extract-reference=CalRegn03CmnDTqLoaMotVelAndTqBasdScaFacMinDTqLoaDTqLoaMotVelAndTqBasdScaFacMin
      AssemblySwConnector_1886: ecu-extract-reference=CalRegn03CmnDTqLoaMotVelAndTqBasdScaFacRiseRateDTqLoaDTqLoaMotVelAndTqBasdScaFacRiseRate
      AssemblySwConnector_1889: ecu-extract-reference=CalRegn03CmnDTqLoaMotVelMgnThdDTqLoaDTqLoaMotVelMgnThd
      AssemblySwConnector_1892: ecu-extract-reference=CalRegn03CmnDTqLoaTqCmdLimYDTqLoaDTqLoaTqCmdLimY
      AssemblySwConnector_1893: ecu-extract-reference=CalRegn03CmnDTqLoaTqCmdMgnThdDTqLoaDTqLoaTqCmdMgnThd
      AssemblySwConnector_1947: ecu-extract-reference=CalRegn03CmnDTqLoaVehLatADifScaFacFallRateDTqLoaDTqLoaVehLatADifScaFacFallRate
      AssemblySwConnector_1948: ecu-extract-reference=CalRegn03CmnDTqLoaVehLatADifScaFacRiseRateDTqLoaDTqLoaVehLatADifScaFacRiseRate
      AssemblySwConnector_1949: ecu-extract-reference=CalRegn03CmnDTqLoaVehLatADifScaFacXDTqLoaDTqLoaVehLatADifScaFacX
      AssemblySwConnector_1950: ecu-extract-reference=CalRegn03CmnDTqLoaVehLatADifScaFacYDTqLoaDTqLoaVehLatADifScaFacY
      AssemblySwConnector_1951: ecu-extract-reference=CalRegn03CmnDTqLoaVehLatAEstimnFilFrqDTqLoaDTqLoaVehLatAEstimnFilFrq
      AssemblySwConnector_1952: ecu-extract-reference=CalRegn03CmnDTqLoaVehLatAGainYDTqLoaDTqLoaVehLatAGainY
      AssemblySwConnector_1954: ecu-extract-reference=CalRegn03CmnDTqLoaVehSpdScaFacXDTqLoaDTqLoaVehSpdScaFacX
      AssemblySwConnector_1955: ecu-extract-reference=CalRegn03CmnDTqLoaVehSpdScaFacYDTqLoaDTqLoaVehSpdScaFacY
      AssemblySwConnector_1956: ecu-extract-reference=CalRegn03CmnDTqLoaVehSpdXDTqLoaDTqLoaVehSpdX
      AssemblySwConnector_1957: ecu-extract-reference=CalRegn03CmnDTqLoaVehSteerRatDTqLoaDTqLoaVehSteerRat
      AssemblySwConnector_1958: ecu-extract-reference=CalRegn03CmnDTqLoaVehUnderSteerGrdtDTqLoaDTqLoaVehUnderSteerGrdt
      AssemblySwConnector_1959: ecu-extract-reference=CalRegn03CmnDTqLoaVehWhlBasDTqLoaDTqLoaVehWhlBas
      AssemblySwConnector_1960: ecu-extract-reference=CalRegn03CmnGroupBDEotProtnActvRegnBypMaxThdDEotProtnDEotProtnActvRegnBypMaxThd
      AssemblySwConnector_1961: ecu-extract-reference=CalRegn03CmnGroupBDEotProtnDeltaTqThdDEotProtnDEotProtnDeltaTqThd
      AssemblySwConnector_1962: ecu-extract-reference=CalRegn03CmnGroupBDEotProtnMotSpdIncptYDEotProtnDEotProtnMotSpdIncptY
      AssemblySwConnector_1963: ecu-extract-reference=CalRegn03CmnGroupBDInertiaCmpVelDampgWhlImbRejctnBlndXDInertiaCmpVelDInertiaCmpVelDampgWhlImbRejctnBlndX
      AssemblySwConnector_1964: ecu-extract-reference=CalRegn03CmnGroupBDInertiaCmpVelDampgWhlImbRejctnBlndYDInertiaCmpVelDInertiaCmpVelDampgWhlImbRejctnBlndY
      AssemblySwConnector_1965: ecu-extract-reference=CalRegn03CmnGroupBDPullCmpActvCmpLrnTiDecShoTermDPullCmpActvDPullCmpActvCmpLrnTiDecShoTerm
      AssemblySwConnector_1966: ecu-extract-reference=CalRegn03CmnGroupBDPullCmpActvCmpLrnTiIncShoTermDPullCmpActvDPullCmpActvCmpLrnTiIncShoTerm
      AssemblySwConnector_1967: ecu-extract-reference=CalRegn03CmnGroupBDPullCmpActvCmpLrnTiLongTermDPullCmpActvDPullCmpActvCmpLrnTiLongTerm
      AssemblySwConnector_1968: ecu-extract-reference=CalRegn03CmnGroupBDPullCmpActvCmpShoTermRstHwAgThdDPullCmpActvDPullCmpActvCmpShoTermRstHwAgThd
      AssemblySwConnector_1969: ecu-extract-reference=CalRegn03CmnGroupBDPullCmpActvCmpShoTermRstHwTqThdDPullCmpActvDPullCmpActvCmpShoTermRstHwTqThd
      AssemblySwConnector_1970: ecu-extract-reference=CalRegn03CmnGroupBDPullCmpActvCmpShoTermRstLatAThdDPullCmpActvDPullCmpActvCmpShoTermRstLatAThd
      AssemblySwConnector_1971: ecu-extract-reference=CalRegn03CmnGroupBDPullCmpActvCmpShoTermRstYawRateThdDPullCmpActvDPullCmpActvCmpShoTermRstYawRateThd
      AssemblySwConnector_1972: ecu-extract-reference=CalRegn03CmnGroupBDPullCmpActvHwTqFilFrqLongTermDPullCmpActvDPullCmpActvHwTqFilFrqLongTerm
      AssemblySwConnector_1973: ecu-extract-reference=CalRegn03CmnGroupBDPullCmpActvHwTqFilFrqLrngEnaDPullCmpActvDPullCmpActvHwTqFilFrqLrngEna
      AssemblySwConnector_1974: ecu-extract-reference=CalRegn03CmnGroupBDPullCmpActvHwTqFilFrqShoTermDPullCmpActvDPullCmpActvHwTqFilFrqShoTerm
      AssemblySwConnector_1975: ecu-extract-reference=CalRegn03CmnGroupBDPullCmpActvLongTermLimDPullCmpActvDPullCmpActvLongTermLim
      AssemblySwConnector_1976: ecu-extract-reference=CalRegn03CmnGroupBDPullCmpActvLrngEnaAgConfMinMgnDPullCmpActvDPullCmpActvLrngEnaAgConfMinMgn
      AssemblySwConnector_1977: ecu-extract-reference=CalRegn03CmnGroupBDPullCmpActvLrngEnaHwAgMaxMgnDPullCmpActvDPullCmpActvLrngEnaHwAgMaxMgn
      AssemblySwConnector_1978: ecu-extract-reference=CalRegn03CmnGroupBDPullCmpActvLrngEnaHwTqMaxMgnDPullCmpActvDPullCmpActvLrngEnaHwTqMaxMgn
      AssemblySwConnector_1979: ecu-extract-reference=CalRegn03CmnGroupBDPullCmpActvLrngEnaHwVelMaxMgnDPullCmpActvDPullCmpActvLrngEnaHwVelMaxMgn
      AssemblySwConnector_1980: ecu-extract-reference=CalRegn03CmnGroupBDPullCmpActvLrngEnaLatAMaxMgnDPullCmpActvDPullCmpActvLrngEnaLatAMaxMgn
      AssemblySwConnector_1981: ecu-extract-reference=CalRegn03CmnGroupBDPullCmpActvLrngEnaTiThdDPullCmpActvDPullCmpActvLrngEnaTiThd
      AssemblySwConnector_1982: ecu-extract-reference=CalRegn03CmnGroupBDPullCmpActvLrngEnaVehSpdMaxMgnDPullCmpActvDPullCmpActvLrngEnaVehSpdMaxMgn
      AssemblySwConnector_1983: ecu-extract-reference=CalRegn03CmnGroupBDPullCmpActvLrngEnaVehSpdMinMgnDPullCmpActvDPullCmpActvLrngEnaVehSpdMinMgn
      AssemblySwConnector_1984: ecu-extract-reference=CalRegn03CmnGroupBDPullCmpActvLrngEnaVehSpdRateMaxMgnDPullCmpActvDPullCmpActvLrngEnaVehSpdRateMaxMgn
      AssemblySwConnector_1985: ecu-extract-reference=CalRegn03CmnGroupBDPullCmpActvLrngEnaYawRateMaxMgnDPullCmpActvDPullCmpActvLrngEnaYawRateMaxMgn
      AssemblySwConnector_1986: ecu-extract-reference=CalRegn03CmnGroupBDPullCmpActvOpstSignTiShoTermDPullCmpActvDPullCmpActvOpstSignTiShoTerm
      AssemblySwConnector_1987: ecu-extract-reference=CalRegn03CmnGroupBDPullCmpActvOutpMaxRateDPullCmpActvDPullCmpActvOutpMaxRate
      AssemblySwConnector_1988: ecu-extract-reference=CalRegn03CmnGroupBDPullCmpActvPullCmpShoTermLimDPullCmpActvDPullCmpActvPullCmpShoTermLim
      AssemblySwConnector_1989: ecu-extract-reference=CalRegn03CmnGroupBDPullCmpActvPullCmpTotLimDPullCmpActvDPullCmpActvPullCmpTotLim
      AssemblySwConnector_1990: ecu-extract-reference=CalRegn03CmnGroupBDPullCmpActvPullErrLimLongTermDPullCmpActvDPullCmpActvPullErrLimLongTerm
      AssemblySwConnector_1991: ecu-extract-reference=CalRegn03CmnGroupBDPullCmpActvPullErrMgnThdDPullCmpActvDPullCmpActvPullErrMgnThd
      AssemblySwConnector_1992: ecu-extract-reference=CalRegn03CmnGroupBDPullCmpActvPullErrShoTermLimDPullCmpActvDPullCmpActvPullErrShoTermLim
      AssemblySwConnector_1993: ecu-extract-reference=CalRegn03CmnGroupBDPullCmpActvShoTermRampTiDPullCmpActvDPullCmpActvShoTermRampTi
      AssemblySwConnector_2006: ecu-extract-reference=CalRegn03CmnGroupBDPullCmpActvVehSpdScaTblXDPullCmpActvDPullCmpActvVehSpdScaTblX
      AssemblySwConnector_2022: ecu-extract-reference=CalRegn03CmnGroupBDPullCmpActvVehSpdScaTblYDPullCmpActvDPullCmpActvVehSpdScaTblY
      AssemblySwConnector_2023: ecu-extract-reference=CalRegn03CmnGroupCDGmOvrlStMgrLoaMtgtnHaptcFbOffTiDGmOvrlStMgrDGmOvrlStMgrLoaMtgtnHaptcFbOffTi
      AssemblySwConnector_2024: ecu-extract-reference=CalRegn03CmnGroupCDGmOvrlStMgrLoaMtgtnHaptcFbOnTiDGmOvrlStMgrDGmOvrlStMgrLoaMtgtnHaptcFbOnTi
      AssemblySwConnector_2025: ecu-extract-reference=CalRegn03CmnGroupCDGmOvrlStMgrLoaMtgtnHaptcFbTqMaxDGmOvrlStMgrDGmOvrlStMgrLoaMtgtnHaptcFbTqMax
      AssemblySwConnector_2026: ecu-extract-reference=CalRegn03CmnGroupCDGmOvrlStMgrLoaMtgtnHaptcFbTqMinDGmOvrlStMgrDGmOvrlStMgrLoaMtgtnHaptcFbTqMin
      AssemblySwConnector_2027: ecu-extract-reference=CalRegn03CmnGroupCDGmOvrlStMgrLoaMtgtnHaptcFbVehSpdMaxDGmOvrlStMgrDGmOvrlStMgrLoaMtgtnHaptcFbVehSpdMax
      AssemblySwConnector_2028: ecu-extract-reference=CalRegn03CmnGroupCDGmOvrlStMgrLoaMtgtnHaptcFbVehSpdMinDGmOvrlStMgrDGmOvrlStMgrLoaMtgtnHaptcFbVehSpdMin
      AssemblySwConnector_2029: ecu-extract-reference=CalRegn03CmnGroupCDGmOvrlStMgrLoaMtgtnHaptcFrqDGmOvrlStMgrDGmOvrlStMgrLoaMtgtnHaptcFrq
      AssemblySwConnector_2030: ecu-extract-reference=CalRegn03CmnGroupCDGmOvrlStMgrLoaMtgtnTqOscnAmpYDGmOvrlStMgrDGmOvrlStMgrLoaMtgtnTqOscnAmpY
      AssemblySwConnector_2031: ecu-extract-reference=CalRegn03CmnGroupCDGmOvrlStMgrLoaMtgtnVehSpdXDGmOvrlStMgrDGmOvrlStMgrLoaMtgtnVehSpdX
      AssemblySwConnector_2032: ecu-extract-reference=CalRegn03Inin00DEotLrngRackTrvlMinDCustDiagcDEotLrngRackTrvlMin
      AssemblySwConnector_2037: ecu-extract-reference=CalRegn03Inin00DEotLrngEotLrnTmrDEotLrngDEotLrngEotLrnTmr
      AssemblySwConnector_2038: ecu-extract-reference=CalRegn03Inin00DEotLrngHwTqEotLrnDEotLrngDEotLrngHwTqEotLrn
      AssemblySwConnector_2039: ecu-extract-reference=CalRegn03Inin00DEotLrngMotVelEotLrnDEotLrngDEotLrngMotVelEotLrn
      AssemblySwConnector_2040: ecu-extract-reference=CalRegn03Inin00DEotLrngRackTrvlMaxDEotLrngDEotLrngRackTrvlMax
      AssemblySwConnector_2041: ecu-extract-reference=CalRegn03Inin00DEotLrngRstAuthyMinDEotLrngDEotLrngRstAuthyMin
      AssemblySwConnector_2042: ecu-extract-reference=CalRegn03Inin00DEotProtnDftPosnDEotProtnDEotProtnDftPosn
      AssemblySwConnector_2043: ecu-extract-reference=CalRegn03Inin00DEotProtnEntrStLpFilFrqDEotProtnDEotProtnEntrStLpFilFrq
      AssemblySwConnector_2044: ecu-extract-reference=CalRegn03Inin00DEotProtnExitStLpFilFrqDEotProtnDEotProtnExitStLpFilFrq
      AssemblySwConnector_2045: ecu-extract-reference=CalRegn03Inin00DEotProtnHwAgMaxDEotProtnDEotProtnHwAgMax
      AssemblySwConnector_2048: ecu-extract-reference=CalRegn03Inin00DEotProtnHwTqLpFilFrqDEotProtnDEotProtnHwTqLpFilFrq
      AssemblySwConnector_2049: ecu-extract-reference=CalRegn03Inin00DEotProtnMotSpdIncptScaDEotProtnDEotProtnMotSpdIncptSca
      AssemblySwConnector_2050: ecu-extract-reference=CalRegn03Inin00DEotProtnMotSpdIncptXDEotProtnDEotProtnMotSpdIncptX
      AssemblySwConnector_2051: ecu-extract-reference=CalRegn03Inin00DEotProtnPosnRampStepDEotProtnDEotProtnPosnRampStep
      AssemblySwConnector_2052: ecu-extract-reference=CalRegn03Inin00DEotProtnRackTrvlLimrAuthyThdDEotProtnDEotProtnRackTrvlLimrAuthyThd
      AssemblySwConnector_2053: ecu-extract-reference=CalRegn03Inin00DEotProtnRackTrvlLimrAuthyThdLimdDEotProtnDEotProtnRackTrvlLimrAuthyThdLimd
      AssemblySwConnector_2054: ecu-extract-reference=CalRegn03Inin00DEotProtnRackTrvlLimrEnaDEotProtnDEotProtnRackTrvlLimrEna
      AssemblySwConnector_2055: ecu-extract-reference=CalRegn03Inin00DEotProtnRunEotVelImpctAndSoftEndStopDEotProtnDEotProtnRunEotVelImpctAndSoftEndStop
      AssemblySwConnector_2056: ecu-extract-reference=CalRegn03Inin00DEotProtnSoftEndStopEnaDEotProtnDEotProtnSoftEndStopEna
      AssemblySwConnector_2057: ecu-extract-reference=CalRegn03Inin00DEotProtnHwAgMinDEotProtnFwlDEotProtnHwAgMin
      AssemblySwConnector_2058: ecu-extract-reference=CalRegn03Inin00DGmOvrlStMgrLoaMtgtnHaptcFbStrtOnTiDGmOvrlStMgrDGmOvrlStMgrLoaMtgtnHaptcFbStrtOnTi
      AssemblySwConnector_2059: ecu-extract-reference=CalRegn03Inin00DGmOvrlStMgrLoaMtgtnStrtHaptcAmpDGmOvrlStMgrDGmOvrlStMgrLoaMtgtnStrtHaptcAmp
      AssemblySwConnector_2060: ecu-extract-reference=CalRegn03Inin00DGmOvrlStMgrLoaStIgnCntrThdDGmOvrlStMgrDGmOvrlStMgrLoaStIgnCntrThd
      AssemblySwConnector_2061: ecu-extract-reference=CalRegn03Inin00DSysGlbPrmSysTqRatDHwAgSnsrlsDSysGlbPrmSysTqRat
      AssemblySwConnector_2062: ecu-extract-reference=CalRegn03Inin00DInertiaCmpVelMotInertiaDInertiaCmpVelDInertiaCmpVelMotInertia
      AssemblySwConnector_2063: ecu-extract-reference=CalRegn03Inin00DInertiaCmpVelNotchFilStructDInertiaCmpVelDInertiaCmpVelNotchFilStruct
      AssemblySwConnector_2064: ecu-extract-reference=CalRegn03Inin00DInertiaCmpVelTqSnsrVelFilFrqDInertiaCmpVelDInertiaCmpVelTqSnsrVelFilFrq
      AssemblySwConnector_2066: ecu-extract-reference=CalRegn03Inin00DSysGlbPrmSysKineRatDInertiaCmpVelDSysGlbPrmSysKineRat
      AssemblySwConnector_2067: ecu-extract-reference=CalRegn03Inin00DPullCmpActvYawRateFilFrqDPullCmpActvDPullCmpActvYawRateFilFrq
      AssemblySwConnector_2085: ecu-extract-reference=CalRegn03Inin00DPwrpkCmpbltyChkGearIdDPwrpkCmpbltyChkDPwrpkCmpbltyChkGearId
      AssemblySwConnector_2086: ecu-extract-reference=CalRegn03Inin00DStabyCmpAssiScaBlndXDStabyCmpDStabyCmpAssiScaBlndX
      AssemblySwConnector_2087: ecu-extract-reference=CalRegn03Inin00DStabyCmpAssiScaBlndYDStabyCmpDStabyCmpAssiScaBlndY
      AssemblySwConnector_2088: ecu-extract-reference=CalRegn03Inin00DStabyCmpHwTqLpFilFrqDStabyCmpDStabyCmpHwTqLpFilFrq
      AssemblySwConnector_2089: ecu-extract-reference=CalRegn03Inin00DStabyCmpNotchFil1StructDStabyCmpDStabyCmpNotchFil1Struct
      AssemblySwConnector_2090: ecu-extract-reference=CalRegn03Inin00DStabyCmpNotchFil2StructDStabyCmpDStabyCmpNotchFil2Struct
      AssemblySwConnector_2091: ecu-extract-reference=CalRegn03Inin00DStabyCmpNotchFil3StructDStabyCmpDStabyCmpNotchFil3Struct
      AssemblySwConnector_2098: ecu-extract-reference=CalRegn03Inin00DStabyCmpNotchFil4StructDStabyCmpDStabyCmpNotchFil4Struct
      AssemblySwConnector_2099: ecu-extract-reference=CalRegn03Inin00DStabyCmpNotchFilBlnd04YDStabyCmpDStabyCmpNotchFilBlnd04Y
      AssemblySwConnector_2129: ecu-extract-reference=CalRegn03Inin00DStabyCmpNotchFilBlnd34TqXDStabyCmpDStabyCmpNotchFilBlnd34TqX
      AssemblySwConnector_2226: ecu-extract-reference=CalRegn03Inin00DStabyCmpNotchFilBlnd34YDStabyCmpDStabyCmpNotchFilBlnd34Y
      AssemblySwConnector_2227: ecu-extract-reference=CalRegn03Inin00DEotLrngAuthyStrtLrnDStHlthSigNormnDEotLrngAuthyStrtLrn
      AssemblySwConnector_2231: ecu-extract-reference=CalRegn03Inin00GroupADInertiaCmpVelCmdScaYDInertiaCmpVelDInertiaCmpVelCmdScaY
      AssemblySwConnector_2232: ecu-extract-reference=CalRegn03Inin00GroupADInertiaCmpVelDampgDecelGainDInertiaCmpVelDInertiaCmpVelDampgDecelGain
      AssemblySwConnector_2234: ecu-extract-reference=CalRegn03Inin00GroupADInertiaCmpVelDampgDecelGainFallSlewDInertiaCmpVelDInertiaCmpVelDampgDecelGainFallSlew
      AssemblySwConnector_2240: ecu-extract-reference=CalRegn03Inin00GroupADInertiaCmpVelDampgDecelGainRisngSlewXDInertiaCmpVelDInertiaCmpVelDampgDecelGainRisngSlewX
      AssemblySwConnector_2242: ecu-extract-reference=CalRegn03Inin00GroupADInertiaCmpVelDampgDecelGainRisngSlewYDInertiaCmpVelDInertiaCmpVelDampgDecelGainRisngSlewY
      AssemblySwConnector_2243: ecu-extract-reference=CalRegn03Inin00GroupADInertiaCmpVelDampgGainOffThdDInertiaCmpVelDInertiaCmpVelDampgGainOffThd
      AssemblySwConnector_2244: ecu-extract-reference=CalRegn03Inin00GroupADInertiaCmpVelDampgGainOnThdDInertiaCmpVelDInertiaCmpVelDampgGainOnThd
      AssemblySwConnector_2245: ecu-extract-reference=CalRegn03Inin00GroupADInertiaCmpVelMotVelBasdOutpScagXDInertiaCmpVelDInertiaCmpVelMotVelBasdOutpScagX
      AssemblySwConnector_2246: ecu-extract-reference=CalRegn03Inin00GroupADInertiaCmpVelMotVelBasdOutpScagYDInertiaCmpVelDInertiaCmpVelMotVelBasdOutpScagY
      AssemblySwConnector_2254: ecu-extract-reference=CalRegn03Inin00GroupADInertiaCmpVelTqSnsrVelScaDInertiaCmpVelDInertiaCmpVelTqSnsrVelSca
      AssemblySwConnector_2255: ecu-extract-reference=CalRegn03Inin00GroupADStabyCmpNotchFilBilnrBlndVehSpdDStabyCmpDStabyCmpNotchFilBilnrBlndVehSpd
      AssemblySwConnector_2256: ecu-extract-reference=CalRegn03Inin00GroupADStabyCmpNotchFilBlnd02YDStabyCmpDStabyCmpNotchFilBlnd02Y
      AssemblySwConnector_2258: ecu-extract-reference=CalRegn03Inin00GroupADStabyCmpNotchFilBlnd12TqXDStabyCmpDStabyCmpNotchFilBlnd12TqX
      AssemblySwConnector_2259: ecu-extract-reference=CalRegn03Inin00GroupADStabyCmpNotchFilBlnd12YDStabyCmpDStabyCmpNotchFilBlnd12Y
      AssemblySwConnector_2268: ecu-extract-reference=CalRegn03Inin00GroupBDEotProtnDampgSlewDEotProtnDEotProtnDampgSlew
      AssemblySwConnector_2271: ecu-extract-reference=CalRegn03Inin00GroupBDEotProtnHwAgGainDEotProtnDEotProtnHwAgGain
      AssemblySwConnector_2349: ecu-extract-reference=CalRegn03Inin00GroupBDEotProtnHwTqScaXDEotProtnDEotProtnHwTqScaX
      AssemblySwConnector_2351: ecu-extract-reference=CalRegn03Inin00GroupBDEotProtnMotVelGainDEotProtnDEotProtnMotVelGain
      AssemblySwConnector_2352: ecu-extract-reference=CalRegn03Inin00GroupBDEotProtnRackTrvlLimrRngLimdDEotProtnDEotProtnRackTrvlLimrRngLimd
      AssemblySwConnector_2353: ecu-extract-reference=CalRegn03Inin00GroupBDEotProtnRackTrvlLimrVehSpdThdDEotProtnDEotProtnRackTrvlLimrVehSpdThd
      AssemblySwConnector_2354: ecu-extract-reference=CalRegn03Inin00GroupBDEotProtnSoftEndStopVehSpdThdDEotProtnDEotProtnSoftEndStopVehSpdThd
      AssemblySwConnector_2355: ecu-extract-reference=CalRegn03Inin00GroupBDEotProtnRackTrvlLimrRngDEotProtnFwlDEotProtnRackTrvlLimrRng
      AssemblySwConnector_2356: ecu-extract-reference=CalRegn03Rt00GroupADInertiaCmpVelAssiBasdDampgCoeffXDInertiaCmpVelDInertiaCmpVelAssiBasdDampgCoeffX
      AssemblySwConnector_2357: ecu-extract-reference=CalRegn03Rt00GroupADInertiaCmpVelAssiBasdDampgRollgYDInertiaCmpVelDInertiaCmpVelAssiBasdDampgRollgY
      AssemblySwConnector_2358: ecu-extract-reference=CalRegn03Rt00GroupADInertiaCmpVelAssiBasdDampgStatYDInertiaCmpVelDInertiaCmpVelAssiBasdDampgStatY
      AssemblySwConnector_2359: ecu-extract-reference=CalRegn03Rt00GroupADInertiaCmpVelDampgSpdBlndYDInertiaCmpVelDInertiaCmpVelDampgSpdBlndY
      AssemblySwConnector_2360: ecu-extract-reference=CalRegn03Rt00GroupADInertiaCmpVelNotchBlndYDInertiaCmpVelDInertiaCmpVelNotchBlndY
      AssemblySwConnector_2361: ecu-extract-reference=CalRegn03Rt00GroupBDEotProtnDampgVehSpdTblDEotProtnDEotProtnDampgVehSpdTbl
      AssemblySwConnector_2362: ecu-extract-reference=CalRegn03Rt00GroupBDEotProtnEntrGainVehSpdTblDEotProtnDEotProtnEntrGainVehSpdTbl
      AssemblySwConnector_2363: ecu-extract-reference=CalRegn03Rt00GroupBDEotProtnEntrGainXDEotProtnDEotProtnEntrGainX
      AssemblySwConnector_2364: ecu-extract-reference=CalRegn03Rt00GroupBDEotProtnEntrGainYDEotProtnDEotProtnEntrGainY
      AssemblySwConnector_2365: ecu-extract-reference=CalRegn03Rt00GroupBDEotProtnExitDampgYDEotProtnDEotProtnExitDampgY
      AssemblySwConnector_2366: ecu-extract-reference=CalRegn03Rt00GroupBDEotProtnNormDampgYDEotProtnDEotProtnNormDampgY
      AssemblySwConnector_2367: ecu-extract-reference=CalRegn03Rt00GroupBDEotProtnHwDegDampgXDEotProtnFwlDEotProtnHwDegDampgX
      AssemblySwConnector_2368: ecu-extract-reference=CalRegn03Rt00GroupBDInertiaCmpVelAssiBasdDampgRollgWhlImbRejctnOnYDInertiaCmpVelDInertiaCmpVelAssiBasdDampgRollgWhlIm_c5d67e92
      AssemblySwConnector_2370: ecu-extract-reference=CalRegn03Rt01GroupADInertiaCmpVelAssiBasdDampgCoeffXDCalRegn03Rt01GroupA_DummyDInertiaCmpVelAssiBasdDampgCoeffX
      AssemblySwConnector_2371: ecu-extract-reference=CalRegn03Rt01GroupADInertiaCmpVelAssiBasdDampgRollgYDCalRegn03Rt01GroupA_DummyDInertiaCmpVelAssiBasdDampgRollgY
      AssemblySwConnector_2372: ecu-extract-reference=CalRegn03Rt01GroupADInertiaCmpVelAssiBasdDampgStatYDCalRegn03Rt01GroupA_DummyDInertiaCmpVelAssiBasdDampgStatY
      AssemblySwConnector_2373: ecu-extract-reference=CalRegn03Rt01GroupADInertiaCmpVelDampgSpdBlndYDCalRegn03Rt01GroupA_DummyDInertiaCmpVelDampgSpdBlndY
      AssemblySwConnector_2374: ecu-extract-reference=CalRegn03Rt01GroupADInertiaCmpVelNotchBlndYDCalRegn03Rt01GroupA_DummyDInertiaCmpVelNotchBlndY
      AssemblySwConnector_2375: ecu-extract-reference=CalRegn03Rt01GroupBDEotProtnDampgVehSpdTblDCalRegn03Rt01GroupB_DummyDEotProtnDampgVehSpdTbl
      AssemblySwConnector_2376: ecu-extract-reference=CalRegn03Rt01GroupBDEotProtnEntrGainVehSpdTblDCalRegn03Rt01GroupB_DummyDEotProtnEntrGainVehSpdTbl
      AssemblySwConnector_2377: ecu-extract-reference=CalRegn03Rt01GroupBDEotProtnEntrGainXDCalRegn03Rt01GroupB_DummyDEotProtnEntrGainX
      AssemblySwConnector_2378: ecu-extract-reference=CalRegn03Rt01GroupBDEotProtnEntrGainYDCalRegn03Rt01GroupB_DummyDEotProtnEntrGainY
      AssemblySwConnector_2379: ecu-extract-reference=CalRegn03Rt01GroupBDEotProtnExitDampgYDCalRegn03Rt01GroupB_DummyDEotProtnExitDampgY
      AssemblySwConnector_2380: ecu-extract-reference=CalRegn03Rt01GroupBDEotProtnHwDegDampgXDCalRegn03Rt01GroupB_DummyDEotProtnHwDegDampgX
      AssemblySwConnector_2381: ecu-extract-reference=CalRegn03Rt01GroupBDEotProtnNormDampgYDCalRegn03Rt01GroupB_DummyDEotProtnNormDampgY
      AssemblySwConnector_2382: ecu-extract-reference=CalRegn03Rt01GroupBDInertiaCmpVelAssiBasdDampgRollgWhlImbRejctnOnYDCalRegn03Rt01GroupB_DummyDInertiaCmpVelAssiBasdDam_4f8a0f3c
      AssemblySwConnector_2383: ecu-extract-reference=CalRegn03Rt02GroupADInertiaCmpVelAssiBasdDampgCoeffXDCalRegn03Rt01GroupA_Dummy_1DInertiaCmpVelAssiBasdDampgCoeffX
      AssemblySwConnector_2384: ecu-extract-reference=CalRegn03Rt02GroupADInertiaCmpVelAssiBasdDampgRollgYDCalRegn03Rt01GroupA_Dummy_1DInertiaCmpVelAssiBasdDampgRollgY
      AssemblySwConnector_2385: ecu-extract-reference=CalRegn03Rt02GroupADInertiaCmpVelAssiBasdDampgStatYDCalRegn03Rt01GroupA_Dummy_1DInertiaCmpVelAssiBasdDampgStatY
      AssemblySwConnector_2386: ecu-extract-reference=CalRegn03Rt02GroupADInertiaCmpVelDampgSpdBlndYDCalRegn03Rt01GroupA_Dummy_1DInertiaCmpVelDampgSpdBlndY
      AssemblySwConnector_2387: ecu-extract-reference=CalRegn03Rt02GroupADInertiaCmpVelNotchBlndYDCalRegn03Rt01GroupA_Dummy_1DInertiaCmpVelNotchBlndY
      AssemblySwConnector_2389: ecu-extract-reference=CalRegn03Rt02GroupBDEotProtnDampgVehSpdTblDCalRegn03Rt01GroupB_Dummy_1DEotProtnDampgVehSpdTbl
      AssemblySwConnector_2390: ecu-extract-reference=CalRegn03Rt02GroupBDEotProtnEntrGainVehSpdTblDCalRegn03Rt01GroupB_Dummy_1DEotProtnEntrGainVehSpdTbl
      AssemblySwConnector_2391: ecu-extract-reference=CalRegn03Rt02GroupBDEotProtnEntrGainXDCalRegn03Rt01GroupB_Dummy_1DEotProtnEntrGainX
      AssemblySwConnector_2392: ecu-extract-reference=CalRegn03Rt02GroupBDEotProtnEntrGainYDCalRegn03Rt01GroupB_Dummy_1DEotProtnEntrGainY
      AssemblySwConnector_2393: ecu-extract-reference=CalRegn03Rt02GroupBDEotProtnExitDampgYDCalRegn03Rt01GroupB_Dummy_1DEotProtnExitDampgY
      AssemblySwConnector_2394: ecu-extract-reference=CalRegn03Rt02GroupBDEotProtnHwDegDampgXDCalRegn03Rt01GroupB_Dummy_1DEotProtnHwDegDampgX
      AssemblySwConnector_2395: ecu-extract-reference=CalRegn03Rt02GroupBDEotProtnNormDampgYDCalRegn03Rt01GroupB_Dummy_1DEotProtnNormDampgY
      AssemblySwConnector_2396: ecu-extract-reference=CalRegn03Rt02GroupBDInertiaCmpVelAssiBasdDampgRollgWhlImbRejctnOnYDCalRegn03Rt01GroupB_Dummy_1DInertiaCmpVelAssiBasdD_7684c8e6
      AssemblySwConnector_2397: ecu-extract-reference=CalRegn03Rt03GroupADInertiaCmpVelAssiBasdDampgCoeffXDCalRegn03Rt01GroupA_Dummy_2DInertiaCmpVelAssiBasdDampgCoeffX
      AssemblySwConnector_2398: ecu-extract-reference=CalRegn03Rt03GroupADInertiaCmpVelAssiBasdDampgRollgYDCalRegn03Rt01GroupA_Dummy_2DInertiaCmpVelAssiBasdDampgRollgY
      AssemblySwConnector_2399: ecu-extract-reference=CalRegn03Rt03GroupADInertiaCmpVelAssiBasdDampgStatYDCalRegn03Rt01GroupA_Dummy_2DInertiaCmpVelAssiBasdDampgStatY
      AssemblySwConnector_2400: ecu-extract-reference=CalRegn03Rt03GroupADInertiaCmpVelDampgSpdBlndYDCalRegn03Rt01GroupA_Dummy_2DInertiaCmpVelDampgSpdBlndY
      AssemblySwConnector_2401: ecu-extract-reference=CalRegn03Rt03GroupADInertiaCmpVelNotchBlndYDCalRegn03Rt01GroupA_Dummy_2DInertiaCmpVelNotchBlndY
      AssemblySwConnector_2402: ecu-extract-reference=CalRegn03Rt03GroupBDEotProtnDampgVehSpdTblDCalRegn03Rt01GroupB_Dummy_2DEotProtnDampgVehSpdTbl
      AssemblySwConnector_2403: ecu-extract-reference=CalRegn03Rt03GroupBDEotProtnEntrGainVehSpdTblDCalRegn03Rt01GroupB_Dummy_2DEotProtnEntrGainVehSpdTbl
      AssemblySwConnector_2404: ecu-extract-reference=CalRegn03Rt03GroupBDEotProtnEntrGainXDCalRegn03Rt01GroupB_Dummy_2DEotProtnEntrGainX
      AssemblySwConnector_2405: ecu-extract-reference=CalRegn03Rt03GroupBDEotProtnEntrGainYDCalRegn03Rt01GroupB_Dummy_2DEotProtnEntrGainY
      AssemblySwConnector_2406: ecu-extract-reference=CalRegn03Rt03GroupBDEotProtnExitDampgYDCalRegn03Rt01GroupB_Dummy_2DEotProtnExitDampgY
      AssemblySwConnector_2408: ecu-extract-reference=CalRegn03Rt03GroupBDEotProtnHwDegDampgXDCalRegn03Rt01GroupB_Dummy_2DEotProtnHwDegDampgX
      AssemblySwConnector_2409: ecu-extract-reference=CalRegn03Rt03GroupBDEotProtnNormDampgYDCalRegn03Rt01GroupB_Dummy_2DEotProtnNormDampgY
      AssemblySwConnector_2410: ecu-extract-reference=CalRegn03Rt03GroupBDInertiaCmpVelAssiBasdDampgRollgWhlImbRejctnOnYDCalRegn03Rt01GroupB_Dummy_2DInertiaCmpVelAssiBasdD_531ebb46
      AssemblySwConnector_2411: ecu-extract-reference=CalRegn03Rt04GroupADInertiaCmpVelAssiBasdDampgCoeffXDCalRegn03Rt01GroupA_Dummy_3DInertiaCmpVelAssiBasdDampgCoeffX
      AssemblySwConnector_2412: ecu-extract-reference=CalRegn03Rt04GroupADInertiaCmpVelAssiBasdDampgRollgYDCalRegn03Rt01GroupA_Dummy_3DInertiaCmpVelAssiBasdDampgRollgY
      AssemblySwConnector_2413: ecu-extract-reference=CalRegn03Rt04GroupADInertiaCmpVelAssiBasdDampgStatYDCalRegn03Rt01GroupA_Dummy_3DInertiaCmpVelAssiBasdDampgStatY
      AssemblySwConnector_2414: ecu-extract-reference=CalRegn03Rt04GroupADInertiaCmpVelDampgSpdBlndYDCalRegn03Rt01GroupA_Dummy_3DInertiaCmpVelDampgSpdBlndY
      AssemblySwConnector_2415: ecu-extract-reference=CalRegn03Rt04GroupADInertiaCmpVelNotchBlndYDCalRegn03Rt01GroupA_Dummy_3DInertiaCmpVelNotchBlndY
      AssemblySwConnector_2416: ecu-extract-reference=CalRegn03Rt04GroupBDEotProtnDampgVehSpdTblDCalRegn03Rt01GroupB_Dummy_3DEotProtnDampgVehSpdTbl
      AssemblySwConnector_2417: ecu-extract-reference=CalRegn03Rt04GroupBDEotProtnEntrGainVehSpdTblDCalRegn03Rt01GroupB_Dummy_3DEotProtnEntrGainVehSpdTbl
      AssemblySwConnector_2418: ecu-extract-reference=CalRegn03Rt04GroupBDEotProtnEntrGainXDCalRegn03Rt01GroupB_Dummy_3DEotProtnEntrGainX
      AssemblySwConnector_2419: ecu-extract-reference=CalRegn03Rt04GroupBDEotProtnEntrGainYDCalRegn03Rt01GroupB_Dummy_3DEotProtnEntrGainY
      AssemblySwConnector_2420: ecu-extract-reference=CalRegn03Rt04GroupBDEotProtnExitDampgYDCalRegn03Rt01GroupB_Dummy_3DEotProtnExitDampgY
      AssemblySwConnector_2421: ecu-extract-reference=CalRegn03Rt04GroupBDEotProtnHwDegDampgXDCalRegn03Rt01GroupB_Dummy_3DEotProtnHwDegDampgX
      AssemblySwConnector_2422: ecu-extract-reference=CalRegn03Rt04GroupBDEotProtnNormDampgYDCalRegn03Rt01GroupB_Dummy_3DEotProtnNormDampgY
      AssemblySwConnector_2423: ecu-extract-reference=CalRegn03Rt04GroupBDInertiaCmpVelAssiBasdDampgRollgWhlImbRejctnOnYDCalRegn03Rt01GroupB_Dummy_3DInertiaCmpVelAssiBasdD_d76ff278
      ComponentPrototype_207: upstream-reference=ECU_Composition.CalRegn03Rt04, ecu-extract-reference=COMPOSITIONTYPE.CalRegn03Rt04
      ComponentPrototype_208: upstream-reference=ECU_Composition.CalRegn03Rt03, ecu-extract-reference=COMPOSITIONTYPE.CalRegn03Rt03
      ComponentPrototype_209: upstream-reference=ECU_Composition.CalRegn03Rt02, ecu-extract-reference=COMPOSITIONTYPE.CalRegn03Rt02
      ComponentPrototype_210: upstream-reference=ECU_Composition.CalRegn03Rt01_Dummy_3, ecu-extract-reference=COMPOSITIONTYPE.CalRegn03Rt01_Dummy_3
      ComponentPrototype_211: upstream-reference=ECU_Composition.CalRegn03Rt01_Dummy_2, ecu-extract-reference=COMPOSITIONTYPE.CalRegn03Rt01_Dummy_2
      ComponentPrototype_212: upstream-reference=ECU_Composition.CalRegn03Rt01_Dummy_1, ecu-extract-reference=COMPOSITIONTYPE.CalRegn03Rt01_Dummy_1
      ComponentPrototype_213: upstream-reference=ECU_Composition.CalRegn03Rt01_Dummy, ecu-extract-reference=COMPOSITIONTYPE.CalRegn03Rt01_Dummy
      ComponentPrototype_215: upstream-reference=ECU_Composition.CalRegn03Rt01, ecu-extract-reference=COMPOSITIONTYPE.CalRegn03Rt01
      ComponentPrototype_216: upstream-reference=ECU_Composition.CalRegn03Rt00, ecu-extract-reference=COMPOSITIONTYPE.CalRegn03Rt00
      AssemblySwConnector_2424: ecu-extract-reference=CalRegn03Rt00DInertiaCmpVelDampgFilFrqDInertiaCmpVelDInertiaCmpVelDampgFilFrq
      AssemblySwConnector_2425: ecu-extract-reference=CalRegn03Rt00DInertiaCmpVelDampgFilFrqWhlImbRejctnOnDInertiaCmpVelDInertiaCmpVelDampgFilFrqWhlImbRejctnOn
      AssemblySwConnector_2426: ecu-extract-reference=CalRegn03Rt01DInertiaCmpVelDampgFilFrqDCalRegn03Rt01_DummyDInertiaCmpVelDampgFilFrq
      AssemblySwConnector_2427: ecu-extract-reference=CalRegn03Rt01DInertiaCmpVelDampgFilFrqWhlImbRejctnOnDCalRegn03Rt01_DummyDInertiaCmpVelDampgFilFrqWhlImbRejctnOn
      AssemblySwConnector_2428: ecu-extract-reference=CalRegn03Rt02DInertiaCmpVelDampgFilFrqDCalRegn03Rt01_Dummy_1DInertiaCmpVelDampgFilFrq
      AssemblySwConnector_2429: ecu-extract-reference=CalRegn03Rt02DInertiaCmpVelDampgFilFrqWhlImbRejctnOnDCalRegn03Rt01_Dummy_1DInertiaCmpVelDampgFilFrqWhlImbRejctnOn
      AssemblySwConnector_2516: ecu-extract-reference=CalRegn03Rt03DInertiaCmpVelDampgFilFrqDCalRegn03Rt01_Dummy_2DInertiaCmpVelDampgFilFrq
      AssemblySwConnector_2547: ecu-extract-reference=CalRegn03Rt03DInertiaCmpVelDampgFilFrqWhlImbRejctnOnDCalRegn03Rt01_Dummy_2DInertiaCmpVelDampgFilFrqWhlImbRejctnOn
      AssemblySwConnector_2621: ecu-extract-reference=CalRegn03Rt04DInertiaCmpVelDampgFilFrqDCalRegn03Rt01_Dummy_3DInertiaCmpVelDampgFilFrq
      AssemblySwConnector_2737: ecu-extract-reference=CalRegn03Rt04DInertiaCmpVelDampgFilFrqWhlImbRejctnOnDCalRegn03Rt01_Dummy_3DInertiaCmpVelDampgFilFrqWhlImbRejctnOn
      AssemblySwConnector_2738: ecu-extract-reference=CalRegn01CmnGroupBDWhlImbRejctnFrqDiagcEnaDWhlImbRejctnDWhlImbRejctnFrqDiagcEna
      AssemblySwConnector_2766: ecu-extract-reference=CalRegn01CmnGroupBDWhlImbRejctnFrqDiagcUgrPoleMgnDWhlImbRejctnDWhlImbRejctnFrqDiagcUgrPoleMgn
      AssemblySwConnector_2767: ecu-extract-reference=CalRegn03CmnDEotProtnSoftEndStopAuthyThdDEotProtnFwlDEotProtnSoftEndStopAuthyThd
      AssemblySwConnector_2823: ecu-extract-reference=CalRegn03CmnGroupBDPullCmpActvCmpShoTermRstYawRateThdDPullCmpActvDPullCmpActvCmpShoTermRstYawRate
      AssemblySwConnector_2837: ecu-extract-reference=CalRegn03Inin00DSysGlbPrmSysKineRatDCDD_MotVelDSysGlbPrmSysKineRat
      AssemblySwConnector_2838: ecu-extract-reference=CalRegn03Inin00DEotLrngAuthyStrtLrnDEotLrngDEotLrngAuthyStrtLrn
      AssemblySwConnector_2839: ecu-extract-reference=CalRegn03Inin00DEotLrngRackTrvlMinDEotLrngDEotLrngRackTrvlMin
      AssemblySwConnector_2840: ecu-extract-reference=CalRegn03Inin00DEotProtnRackTrvlLimrEnaDEotLrngDEotProtnRackTrvlLimrEna
      AssemblySwConnector_2842: ecu-extract-reference=CalRegn03Inin00DEotProtnHwAgMinDEotProtnDEotProtnHwAgMin
      AssemblySwConnector_2843: ecu-extract-reference=CalRegn03Inin00DSysGlbPrmSysKineRatDHwAgSnsrlsDSysGlbPrmSysKineRat
      AssemblySwConnector_2844: ecu-extract-reference=CalRegn03Inin00DSysGlbPrmSysTqRatDHysCmpDSysGlbPrmSysTqRat
      AssemblySwConnector_2845: ecu-extract-reference=CalRegn03Inin00DSysGlbPrmSysTqRatDPullCmpActvDSysGlbPrmSysTqRat
      AssemblySwConnector_2846: ecu-extract-reference=CalRegn03Inin00DSysGlbPrmSysTqRatDSnsrOffsLrngDSysGlbPrmSysTqRat
      AssemblySwConnector_2847: ecu-extract-reference=CalRegn03Inin00GroupBDEotProtnRackTrvlLimrRngDEotProtnDEotProtnRackTrvlLimrRng
      AssemblySwConnector_2849: ecu-extract-reference=FltInjDFltInj_u08DCurrMeasCorrlnDFltInj_u08
      AssemblySwConnector_1533: ecu-extract-reference=CalRegn01CmnDStHlthSigNormnMaxFricThdDStHlthSigNormnDStHlthSigNormnMaxFricThd
      AssemblySwConnector_2850: ecu-extract-reference=CalRegn01CmnDStHlthSigNormnWhlImbRejctnThdDStHlthSigNormnDStHlthSigNormnWhlImbRejctnThd
      AssemblySwConnector_2851: ecu-extract-reference=SysFricLrngDGetFricLrngDataDStHlthSigNormnDGetFricLrngData
      AssemblySwConnector_2852: ecu-extract-reference=SysFricLrngDMaxLrndFricDStHlthSigNormnDMaxLrndFric
      AssemblySwConnector_2853: ecu-extract-reference=WhlImbRejctnDWhlImbRejctnCmdDStHlthSigNormnDWhlImbRejctnCmd
      AssemblySwConnector_2854: ecu-extract-reference=StHlthSigNormnDFricEstimnStHlthDStHlthSigStcDFricEstimnStHlth
      AssemblySwConnector_2855: ecu-extract-reference=StHlthSigNormnDWhlImbMaxCmpStHlthDStHlthSigStcDWhlImbMaxCmpStHlth
      ComponentPrototype_218: upstream-reference=ECU_Composition.CalRegn03Rt01GroupB_Dummy_4, ecu-extract-reference=COMPOSITIONTYPE.CalRegn03Rt01GroupB_Dummy_4
      ComponentPrototype_219: upstream-reference=ECU_Composition.CalRegn03Rt01GroupA_Dummy_4, ecu-extract-reference=COMPOSITIONTYPE.CalRegn03Rt01GroupA_Dummy_4
      ComponentPrototype_221: upstream-reference=ECU_Composition.CalRegn03Rt01_Dummy_4, ecu-extract-reference=COMPOSITIONTYPE.CalRegn03Rt01_Dummy_4
      ComponentPrototype_222: upstream-reference=ECU_Composition.CalRegn02Rt01GroupC_Dummy_4, ecu-extract-reference=COMPOSITIONTYPE.CalRegn02Rt01GroupC_Dummy_4
      ComponentPrototype_223: upstream-reference=ECU_Composition.CalRegn01Rt01_Dummy_4, ecu-extract-reference=COMPOSITIONTYPE.CalRegn01Rt01_Dummy_4
      AssemblySwConnector_2848: ecu-extract-reference=CalRegn01Rt00DTEstimnMagAmbMplrDCalRegn01Rt01_Dummy_4DTEstimnMagAmbMplr
      AssemblySwConnector_2856: ecu-extract-reference=CalRegn01Rt00DTunSelnAuthyHwTqYDCalRegn01Rt01_Dummy_4DTunSelnAuthyHwTqY
      AssemblySwConnector_2857: ecu-extract-reference=CalRegn01Rt00DTunSelnAuthyHwVelYDCalRegn01Rt01_Dummy_4DTunSelnAuthyHwVelY
      AssemblySwConnector_2858: ecu-extract-reference=CalRegn02Rt00GroupCDGmOvrlStMgrHwAgTarLimrDCalRegn02Rt01GroupC_Dummy_4DGmOvrlStMgrHwAgTarLimr
      AssemblySwConnector_2859: ecu-extract-reference=CalRegn02Rt00GroupCDGmOvrlStMgrShiftLvrTiThdDCalRegn02Rt01GroupC_Dummy_4DGmOvrlStMgrShiftLvrTiThd
      AssemblySwConnector_2860: ecu-extract-reference=CalRegn02Rt00GroupCDGmOvrlStMgrStandStillThdDCalRegn02Rt01GroupC_Dummy_4DGmOvrlStMgrStandStillThd
      AssemblySwConnector_2861: ecu-extract-reference=CalRegn02Rt00GroupCDGmOvrlStMgrStandStillTiThdDCalRegn02Rt01GroupC_Dummy_4DGmOvrlStMgrStandStillTiThd
      AssemblySwConnector_2862: ecu-extract-reference=CalRegn02Rt00GroupCDGmTqArbnApaDiRateYDCalRegn02Rt01GroupC_Dummy_4DGmTqArbnApaDiRateY
      AssemblySwConnector_2863: ecu-extract-reference=CalRegn02Rt00GroupCDGmTqArbnApaEnaRateDCalRegn02Rt01GroupC_Dummy_4DGmTqArbnApaEnaRate
      AssemblySwConnector_2864: ecu-extract-reference=CalRegn02Rt00GroupCDGmTqArbnApaSmotngHwTqLpFilFrqDCalRegn02Rt01GroupC_Dummy_4DGmTqArbnApaSmotngHwTqLpFilFrq
      AssemblySwConnector_2865: ecu-extract-reference=CalRegn02Rt00GroupCDGmTqArbnApaSmotngXDCalRegn02Rt01GroupC_Dummy_4DGmTqArbnApaSmotngX
      AssemblySwConnector_2866: ecu-extract-reference=CalRegn02Rt00GroupCDGmTqArbnApaSmotngYDCalRegn02Rt01GroupC_Dummy_4DGmTqArbnApaSmotngY
      AssemblySwConnector_2867: ecu-extract-reference=CalRegn02Rt00GroupCDGmTqArbnLkaSlewXDCalRegn02Rt01GroupC_Dummy_4DGmTqArbnLkaSlewX
      AssemblySwConnector_2868: ecu-extract-reference=CalRegn02Rt00GroupCDGmTqArbnLkaSlewYDCalRegn02Rt01GroupC_Dummy_4DGmTqArbnLkaSlewY
      AssemblySwConnector_2869: ecu-extract-reference=CalRegn03Rt00DInertiaCmpVelDampgFilFrqDCalRegn03Rt01_Dummy_4DInertiaCmpVelDampgFilFrq
      AssemblySwConnector_2870: ecu-extract-reference=CalRegn03Rt00DInertiaCmpVelDampgFilFrqWhlImbRejctnOnDCalRegn03Rt01_Dummy_4DInertiaCmpVelDampgFilFrqWhlImbRejctnOn
      AssemblySwConnector_2871: ecu-extract-reference=CalRegn03Rt00GroupADAssiHiFrqGainYDCalRegn03Rt01GroupA_Dummy_4DAssiHiFrqGainY
      AssemblySwConnector_2872: ecu-extract-reference=CalRegn03Rt00GroupADAssiHiFrqTqXDCalRegn03Rt01GroupA_Dummy_4DAssiHiFrqTqX
      AssemblySwConnector_2873: ecu-extract-reference=CalRegn03Rt00GroupADAssiMotTqWhlImbRejctnMinXDCalRegn03Rt01GroupA_Dummy_4DAssiMotTqWhlImbRejctnMinX
      AssemblySwConnector_2874: ecu-extract-reference=CalRegn03Rt00GroupADAssiMotTqWhlImbRejctnMinYDCalRegn03Rt01GroupA_Dummy_4DAssiMotTqWhlImbRejctnMinY
      AssemblySwConnector_2875: ecu-extract-reference=CalRegn03Rt00GroupADDampgHydCoeff1ScaYDCalRegn03Rt01GroupA_Dummy_4DDampgHydCoeff1ScaY
      AssemblySwConnector_2876: ecu-extract-reference=CalRegn03Rt00GroupADDampgHydCoeff2ScaYDCalRegn03Rt01GroupA_Dummy_4DDampgHydCoeff2ScaY
      AssemblySwConnector_2877: ecu-extract-reference=CalRegn03Rt00GroupADDampgHydCoeff3ScaYDCalRegn03Rt01GroupA_Dummy_4DDampgHydCoeff3ScaY
      AssemblySwConnector_2878: ecu-extract-reference=CalRegn03Rt00GroupADDampgHydCoeff4ScaYDCalRegn03Rt01GroupA_Dummy_4DDampgHydCoeff4ScaY
      AssemblySwConnector_2879: ecu-extract-reference=CalRegn03Rt00GroupADDampgMotVelXDCalRegn03Rt01GroupA_Dummy_4DDampgMotVelX
      AssemblySwConnector_2880: ecu-extract-reference=CalRegn03Rt00GroupADDampgMotVelYDCalRegn03Rt01GroupA_Dummy_4DDampgMotVelY
      AssemblySwConnector_2881: ecu-extract-reference=CalRegn03Rt00GroupADHysCmpFricWhlImbRejctnBlndXDCalRegn03Rt01GroupA_Dummy_4DHysCmpFricWhlImbRejctnBlndX
      AssemblySwConnector_2882: ecu-extract-reference=CalRegn03Rt00GroupADHysCmpFricWhlImbRejctnBlndYDCalRegn03Rt01GroupA_Dummy_4DHysCmpFricWhlImbRejctnBlndY
      AssemblySwConnector_2883: ecu-extract-reference=CalRegn03Rt00GroupADHysCmpFricWhlImbRejctnOffYDCalRegn03Rt01GroupA_Dummy_4DHysCmpFricWhlImbRejctnOffY
      AssemblySwConnector_2884: ecu-extract-reference=CalRegn03Rt00GroupADHysCmpFricWhlImbRejctnOnYDCalRegn03Rt01GroupA_Dummy_4DHysCmpFricWhlImbRejctnOnY
      AssemblySwConnector_2885: ecu-extract-reference=CalRegn03Rt00GroupADInertiaCmpVelAssiBasdDampgCoeffXDCalRegn03Rt01GroupA_Dummy_4DInertiaCmpVelAssiBasdDampgCoeffX
      AssemblySwConnector_2886: ecu-extract-reference=CalRegn03Rt00GroupADInertiaCmpVelAssiBasdDampgRollgYDCalRegn03Rt01GroupA_Dummy_4DInertiaCmpVelAssiBasdDampgRollgY
      AssemblySwConnector_2887: ecu-extract-reference=CalRegn03Rt00GroupADInertiaCmpVelAssiBasdDampgStatYDCalRegn03Rt01GroupA_Dummy_4DInertiaCmpVelAssiBasdDampgStatY
      AssemblySwConnector_2888: ecu-extract-reference=CalRegn03Rt00GroupADInertiaCmpVelDampgSpdBlndYDCalRegn03Rt01GroupA_Dummy_4DInertiaCmpVelDampgSpdBlndY
      AssemblySwConnector_2889: ecu-extract-reference=CalRegn03Rt00GroupADInertiaCmpVelNotchBlndYDCalRegn03Rt01GroupA_Dummy_4DInertiaCmpVelNotchBlndY
      AssemblySwConnector_2890: ecu-extract-reference=CalRegn03Rt00GroupADRtnHwAgOffsCalcdXDCalRegn03Rt01GroupA_Dummy_4DRtnHwAgOffsCalcdX
      AssemblySwConnector_2891: ecu-extract-reference=CalRegn03Rt00GroupADRtnHwAgOffsCalcdYDCalRegn03Rt01GroupA_Dummy_4DRtnHwAgOffsCalcdY
      AssemblySwConnector_2892: ecu-extract-reference=CalRegn03Rt00GroupADRtnScaTqXDCalRegn03Rt01GroupA_Dummy_4DRtnScaTqX
      AssemblySwConnector_2893: ecu-extract-reference=CalRegn03Rt00GroupADRtnScaTqYDCalRegn03Rt01GroupA_Dummy_4DRtnScaTqY
      AssemblySwConnector_2894: ecu-extract-reference=CalRegn03Rt00GroupADRtnScaVelXDCalRegn03Rt01GroupA_Dummy_4DRtnScaVelX
      AssemblySwConnector_2895: ecu-extract-reference=CalRegn03Rt00GroupADRtnScaVelYDCalRegn03Rt01GroupA_Dummy_4DRtnScaVelY
      AssemblySwConnector_2896: ecu-extract-reference=CalRegn03Rt00GroupBDAssiHiFrqTqWhlImbRejctnTqXDCalRegn03Rt01GroupB_Dummy_4DAssiHiFrqTqWhlImbRejctnTqX
      AssemblySwConnector_2897: ecu-extract-reference=CalRegn03Rt00GroupBDAssiHiFrqWhlImbRejctnGainYDCalRegn03Rt01GroupB_Dummy_4DAssiHiFrqWhlImbRejctnGainY
      AssemblySwConnector_2898: ecu-extract-reference=CalRegn03Rt00GroupBDAssiHiFrqWhlImbRejtcnBlndXDCalRegn03Rt01GroupB_Dummy_4DAssiHiFrqWhlImbRejtcnBlndX
      AssemblySwConnector_2899: ecu-extract-reference=CalRegn03Rt00GroupBDAssiHiFrqWhlImbRejtcnBlndYDCalRegn03Rt01GroupB_Dummy_4DAssiHiFrqWhlImbRejtcnBlndY
      AssemblySwConnector_2900: ecu-extract-reference=CalRegn03Rt00GroupBDAssiMotTqWhlImbRejctnMaxXDCalRegn03Rt01GroupB_Dummy_4DAssiMotTqWhlImbRejctnMaxX
      AssemblySwConnector_2901: ecu-extract-reference=CalRegn03Rt00GroupBDAssiMotTqWhlImbRejctnMaxYDCalRegn03Rt01GroupB_Dummy_4DAssiMotTqWhlImbRejctnMaxY
      AssemblySwConnector_2902: ecu-extract-reference=CalRegn03Rt00GroupBDAssiWhlImbRejctnBlndScaXDCalRegn03Rt01GroupB_Dummy_4DAssiWhlImbRejctnBlndScaX
      AssemblySwConnector_2903: ecu-extract-reference=CalRegn03Rt00GroupBDAssiWhlImbRejctnBlndScaYDCalRegn03Rt01GroupB_Dummy_4DAssiWhlImbRejctnBlndScaY
      AssemblySwConnector_2904: ecu-extract-reference=CalRegn03Rt00GroupBDEotProtnDampgVehSpdTblDCalRegn03Rt01GroupB_Dummy_4DEotProtnDampgVehSpdTbl
      AssemblySwConnector_2905: ecu-extract-reference=CalRegn03Rt00GroupBDEotProtnEntrGainVehSpdTblDCalRegn03Rt01GroupB_Dummy_4DEotProtnEntrGainVehSpdTbl
      AssemblySwConnector_2906: ecu-extract-reference=CalRegn03Rt00GroupBDEotProtnEntrGainXDCalRegn03Rt01GroupB_Dummy_4DEotProtnEntrGainX
      AssemblySwConnector_2907: ecu-extract-reference=CalRegn03Rt00GroupBDEotProtnEntrGainYDCalRegn03Rt01GroupB_Dummy_4DEotProtnEntrGainY
      AssemblySwConnector_2908: ecu-extract-reference=CalRegn03Rt00GroupBDEotProtnExitDampgYDCalRegn03Rt01GroupB_Dummy_4DEotProtnExitDampgY
      AssemblySwConnector_2909: ecu-extract-reference=CalRegn03Rt00GroupBDEotProtnHwDegDampgXDCalRegn03Rt01GroupB_Dummy_4DEotProtnHwDegDampgX
      AssemblySwConnector_2910: ecu-extract-reference=CalRegn03Rt00GroupBDEotProtnNormDampgYDCalRegn03Rt01GroupB_Dummy_4DEotProtnNormDampgY
      AssemblySwConnector_2911: ecu-extract-reference=CalRegn03Rt00GroupBDInertiaCmpVelAssiBasdDampgRollgWhlImbRejctnOnYDCalRegn03Rt01GroupB_Dummy_4DInertiaCmpVelAssiBasdD_84c6b74b
      AssemblySwConnector_2912: ecu-extract-reference=CalRegn03Rt00GroupBDEotProtnHwDegDampgXDEotProtnDEotProtnHwDegDampgX
      AssemblySwConnector_2913: ecu-extract-reference=GmMsg232BusHiSpdDDesRtIdxDTunSelnMngtDDesRtIdx
      AssemblySwConnector_2914: ecu-extract-reference=CalRegn01CmnDMotCurrRegVltgLimrDualEcuLoaScarSlewRateDCDD_MotCurrRegVltgLimrDMotCurrRegVltgLimrDualEcuLoaScarSlewRate
      AssemblySwConnector_2915: ecu-extract-reference=CalRegn01CmnDMotCurrRegVltgLimrMotCurrPredEnaDCDD_MotCurrRegVltgLimrDMotCurrRegVltgLimrMotCurrPredEna
      AssemblySwConnector_2916: ecu-extract-reference=CalRegn01CmnDMotCurrRegVltgLimrMotCurrPredTiDCDD_MotCurrRegVltgLimrDMotCurrRegVltgLimrMotCurrPredTi
      ComponentPrototype_224: upstream-reference=ECU_Composition.ElecPwrCns, ecu-extract-reference=COMPOSITIONTYPE.ElecPwrCns
      ComponentPrototype_225: upstream-reference=ECU_Composition.CalRegn01CmnGroupA, ecu-extract-reference=COMPOSITIONTYPE.CalRegn01CmnGroupA
      AssemblySwConnector_2917: ecu-extract-reference=BattVltgDBrdgVltgDElecPwrCnsDBrdgVltg
      AssemblySwConnector_2918: ecu-extract-reference=CalRegn01CmnDElecPwrCnsCtrlrInpRDElecPwrCnsDElecPwrCnsCtrlrInpR
      AssemblySwConnector_2919: ecu-extract-reference=CalRegn01CmnGroupADElecPwrCnsPrstcPwrLossDElecPwrCnsDElecPwrCnsPrstcPwrLoss
      AssemblySwConnector_2920: ecu-extract-reference=CDD_MotCtrlMgrDMotCurrDaxDElecPwrCnsDMotCtrlMotCurrDax
      AssemblySwConnector_2921: ecu-extract-reference=CDD_MotCtrlMgrDMotCurrQaxDElecPwrCnsDMotCtrlMotCurrQax
      AssemblySwConnector_2922: ecu-extract-reference=LoaMgrDCurrMeasLoaMtgtnEnaDElecPwrCnsDCurrMeasLoaMtgtnEna
      AssemblySwConnector_2923: ecu-extract-reference=LoaMgrDIvtrLoaMtgtnEnaDElecPwrCnsDIvtrLoaMtgtnEna
      AssemblySwConnector_2924: ecu-extract-reference=MotRefMdlDMotCurrDaxCmdDElecPwrCnsDMotCurrDaxCmd
      AssemblySwConnector_2925: ecu-extract-reference=MotRefMdlDMotCurrQaxCmdDElecPwrCnsDMotCurrQaxCmd
      ComponentPrototype_226: upstream-reference=ECU_Composition.CDD_MotAg4Meas, ecu-extract-reference=COMPOSITIONTYPE.CDD_MotAg4Meas
      ComponentPrototype_227: upstream-reference=ECU_Composition.CDD_MotAg3Meas, ecu-extract-reference=COMPOSITIONTYPE.CDD_MotAg3Meas
      AssemblySwConnector_2926: ecu-extract-reference=PolarityCfgDMotAgMecl3PolarityDCDD_MotAg3MeasDMotAgMecl3Polarity
      AssemblySwConnector_2927: ecu-extract-reference=PolarityCfgDMotAgMecl4PolarityDCDD_MotAg4MeasDMotAgMecl4Polarity
      AssemblySwConnector_2928: ecu-extract-reference=CDD_MotAg3MeasDGetMotAg3MeclDCDD_MotAg0MeasDGetMotAg3Mecl
      AssemblySwConnector_2929: ecu-extract-reference=CDD_MotAg4MeasDGetMotAg4MeclDCDD_MotAg1MeasDGetMotAg4Mecl
      AssemblySwConnector_2931: ecu-extract-reference=CDD_NxtrTiDGetRefTmr1MicroSec32bitDCDD_MotAg0MeasDGetRefTmr1MicroSec32bit
      AssemblySwConnector_2932: ecu-extract-reference=CDD_NxtrTiDGetTiSpan1MicroSec32bitDCDD_MotAg0MeasDGetTiSpan1MicroSec32bit
      AssemblySwConnector_2933: ecu-extract-reference=PolarityCfgDMotAgMecl0PolarityDCDD_MotAg0MeasDMotAgMecl0Polarity
      AssemblySwConnector_2935: ecu-extract-reference=CDD_NxtrTiDGetRefTmr1MicroSec32bitDCDD_MotAg1MeasDGetRefTmr1MicroSec32bit
      AssemblySwConnector_2936: ecu-extract-reference=CDD_NxtrTiDGetTiSpan1MicroSec32bitDCDD_MotAg1MeasDGetTiSpan1MicroSec32bit
      AssemblySwConnector_2937: ecu-extract-reference=IoHwAbDSetFctGpioMotAg0DCDD_MotAg0MeasDIoHwAb_SetFctGpioMotAg0
      AssemblySwConnector_2938: ecu-extract-reference=IoHwAbDSetFctPeriphMotAg0DCDD_MotAg0MeasDIoHwAb_SetFctPrphlCsihMotAg0
      AssemblySwConnector_2939: ecu-extract-reference=IoHwAbDSetGpioMotAg0DCDD_MotAg0MeasDIoHwAb_SetGpioMotAg0CsihCs
      AssemblySwConnector_2940: ecu-extract-reference=IoHwAbDSetFctGpioMotAg1DCDD_MotAg1MeasDIoHwAb_SetFctGpioMotAg1
      AssemblySwConnector_2941: ecu-extract-reference=IoHwAbDSetFctPeriphMotAg1DCDD_MotAg1MeasDIoHwAb_SetFctPrphlCsihMotAg1
      AssemblySwConnector_2942: ecu-extract-reference=IoHwAbDSetGpioMotAg1DCDD_MotAg1MeasDIoHwAb_SetGpioMotAg1CsihCs
      AssemblySwConnector_2943: ecu-extract-reference=PolarityCfgDMotAgMecl1PolarityDCDD_MotAg1MeasDMotAgMecl1Polarity
      AssemblySwConnector_863: ecu-extract-reference=CDD_MotAg0MeasDMotAg0CoeffTblReadDCmnMfgSrvDMotAg0MeasMotAg0CoeffTblRead
      AssemblySwConnector_864: ecu-extract-reference=CDD_MotAg0MeasDMotAg0CoeffTblWrDCmnMfgSrvDMotAg0MeasMotAg0CoeffTblWr
      AssemblySwConnector_867: ecu-extract-reference=CDD_MotAg1MeasDMotAg1CoeffTblReadDCmnMfgSrvDMotAg1MeasMotAg1CoeffTblRead
      AssemblySwConnector_868: ecu-extract-reference=CDD_MotAg1MeasDMotAg1CoeffTblWrDCmnMfgSrvDMotAg1MeasMotAg1CoeffTblWr
      AssemblySwConnector_881: ecu-extract-reference=CalRegn01Inin00DMotAg1MeasMotAgOffsDCDD_MotAg1MeasDMotAg1MeasMotAgOffs
      AssemblySwConnector_882: ecu-extract-reference=CDD_MotAg0MeasDMotAg0MeclRollgCntrDCDD_MotCtrlMgrDMotAg0MeclRollgCntr
      AssemblySwConnector_883: ecu-extract-reference=CDD_MotAg0MeasDMotAg0OffsDCDD_MotCtrlMgrDMotAg0Offs
      AssemblySwConnector_884: ecu-extract-reference=CDD_MotAg1MeasDMotAg1MeclRollgCntrDCDD_MotCtrlMgrDMotAg1MeclRollgCntr
      AssemblySwConnector_885: ecu-extract-reference=CDD_MotAg1MeasDMotAg1OffsDCDD_MotCtrlMgrDMotAg1Offs
      AssemblySwConnector_307: ecu-extract-reference=CDD_MotAg0MeasDMotAg0MeclRollgCntrDMotAgCorrlnDMotAgAMeclRollgCntr
      AssemblySwConnector_335: ecu-extract-reference=CDD_MotAg1MeasDMotAg1MeclRollgCntrDMotAgCorrlnDMotAgBMeclRollgCntr
      AssemblySwConnector_339: ecu-extract-reference=LoaMgrDIvtrLoaMtgtnEnaDMotCurrPeakEstimnDIvtrLoaMtgtnEna
      AssemblySwConnector_217: ecu-extract-reference=HwAg0MeasDHwAg0QlfrDHwAgArbnDHwAgARollgCntr
      ComponentPrototype_029: upstream-reference=ECU_Composition.CurrReasbnDiagc, ecu-extract-reference=COMPOSITIONTYPE.CurrReasbnDiagc
      AssemblySwConnector_218: ecu-extract-reference=AssiSumLimDMotTqCmdDCurrReasbnDiagcDMotTqCmdLimrMin
      AssemblySwConnector_219: ecu-extract-reference=CalRegn01CmnDCurrReasbnDiagcCurrDiagcMotEnvlpTblMaxDCurrReasbnDiagcDCurrReasbnDiagcCurrDiagcMotEnvlpTblMax
      AssemblySwConnector_220: ecu-extract-reference=CalRegn01CmnDCurrReasbnDiagcCurrDiagcPrimErrThdDCurrReasbnDiagcDCurrReasbnDiagcCurrDiagcPrimErrThd
      AssemblySwConnector_221: ecu-extract-reference=CalRegn01CmnDCurrReasbnDiagcCurrDiagcSecdryErrThdDCurrReasbnDiagcDCurrReasbnDiagcCurrDiagcSecdryErrThd
      AssemblySwConnector_398: ecu-extract-reference=CalRegn01CmnDCurrReasbnDiagcCurrDiagcSecdryTqLimThdDCurrReasbnDiagcDCurrReasbnDiagcCurrDiagcSecdryTqLimThd
      AssemblySwConnector_807: ecu-extract-reference=CalRegn01CmnDCurrReasbnDiagcDiagFildLimDCurrReasbnDiagcDCurrReasbnDiagcDiagFildLim
      AssemblySwConnector_808: ecu-extract-reference=CalRegn01CmnDCurrReasbnDiagcDiagVltgLpFilEnaDCurrReasbnDiagcDCurrReasbnDiagcDiagVltgLpFilEna
      AssemblySwConnector_886: ecu-extract-reference=CalRegn01CmnDCurrReasbnDiagcDiagVltgLpFilFrqDCurrReasbnDiagcDCurrReasbnDiagcDiagVltgLpFilFrq
      AssemblySwConnector_902: ecu-extract-reference=CalRegn01CmnDCurrReasbnDiagcLpFilScaDCurrReasbnDiagcDCurrReasbnDiagcLpFilSca
      AssemblySwConnector_904: ecu-extract-reference=CalRegn01CmnDCurrReasbnDiagcMotVelHiLimDCurrReasbnDiagcDCurrReasbnDiagcMotVelHiLim
      AssemblySwConnector_1111: ecu-extract-reference=CalRegn01CmnDCurrReasbnDiagcMotVelLoLimDCurrReasbnDiagcDCurrReasbnDiagcMotVelLoLim
      AssemblySwConnector_1112: ecu-extract-reference=CalRegn01CmnDCurrReasbnDiagcMotVltgDaxLpFilFrqDCurrReasbnDiagcDCurrReasbnDiagcMotVltgDaxLpFilFrq
      AssemblySwConnector_1116: ecu-extract-reference=CalRegn01CmnDCurrReasbnDiagcMotVltgQaxDaxFilEnaDCurrReasbnDiagcDCurrReasbnDiagcMotVltgQaxDaxFilEna
      AssemblySwConnector_1117: ecu-extract-reference=CalRegn01CmnDCurrReasbnDiagcMotVltgQaxLpFilFrqDCurrReasbnDiagcDCurrReasbnDiagcMotVltgQaxLpFilFrq
      AssemblySwConnector_1176: ecu-extract-reference=CalRegn01CmnDCurrReasbnDiagcVelLpFilEnaDCurrReasbnDiagcDCurrReasbnDiagcVelLpFilEna
      AssemblySwConnector_1182: ecu-extract-reference=CalRegn01CmnDCurrReasbnDiagcVelLpFilFrqDCurrReasbnDiagcDCurrReasbnDiagcVelLpFilFrq
      AssemblySwConnector_1326: ecu-extract-reference=CalRegn01Inin00DSysGlbPrmMotPoleCntDCurrReasbnDiagcDSysGlbPrmMotPoleCnt
      AssemblySwConnector_1335: ecu-extract-reference=CDD_MotVelDMotVelMrfDCurrReasbnDiagcDMotVelMrf
      AssemblySwConnector_1336: ecu-extract-reference=DiagcMgrProxyAppl10DSetNtcSts10DCurrReasbnDiagcDSetNtcSts
      AssemblySwConnector_1337: ecu-extract-reference=MotRefMdlDMotVltgDaxFfStatDCurrReasbnDiagcDMotVltgDaxFfStat
      AssemblySwConnector_1339: ecu-extract-reference=MotRefMdlDMotVltgQaxFfStatDCurrReasbnDiagcDMotVltgQaxFfStat
      AssemblySwConnector_1433: ecu-extract-reference=StOutpCtrlDSysMotTqCmdScaDCurrReasbnDiagcDSysMotTqCmdSca
      AssemblySwConnector_1338: ecu-extract-reference=CDD_MotCtrlMgrDMotVltgDaxFildDCurrReasbnDiagcDMotVltgDaxFild
      AssemblySwConnector_1340: ecu-extract-reference=CDD_MotCtrlMgrDMotVltgQaxFildDCurrReasbnDiagcDMotVltgQaxFild
      AssemblySwConnector_520: ecu-extract-reference=CalRegn01CmnDHwAgSnsrlsCorrdPinionAgHwConfDHwAgSnsrlsDHwAgSnsrlsCorrdPinionAgHwConf
      ComponentPrototype_206: upstream-reference=ECU_Composition.DualEcuIdn, ecu-extract-reference=COMPOSITIONTYPE.DualEcuIdn
      AssemblySwConnector_521: ecu-extract-reference=DiagcMgrProxyAppl6DSetNtcSts6DDualEcuIdnDSetNtcSts
      AssemblySwConnector_555: ecu-extract-reference=IoHwAbDGetGpioEcuIdnPin1DDualEcuIdnDIoHwAb_GetGpioEcuIdnPin1
      AssemblySwConnector_648: ecu-extract-reference=IoHwAbDGetGpioEcuIdnPin2DDualEcuIdnDIoHwAb_GetGpioEcuIdnPin2
      ComponentPrototype_228: upstream-reference=ECU_Composition.ImcArbn, ecu-extract-reference=COMPOSITIONTYPE.ImcArbn
      AssemblySwConnector_1060: ecu-extract-reference=CDD_NxtrTiDGetRefTmr100MicroSec32bitDImcArbnDGetRefTmr100MicroSec32bit
      AssemblySwConnector_1061: ecu-extract-reference=CDD_NxtrTiDGetTiSpan100MicroSec32bitDImcArbnDGetTiSpan100MicroSec32bit
      AssemblySwConnector_1104: ecu-extract-reference=DiagcMgrProxyAppl6DSetNtcSts6DImcArbnDSetNtcSts
      AssemblySwConnector_1105: ecu-extract-reference=DualEcuIdnDEcuIdDImcArbnDEcuId
      AssemblySwConnector_1187: ecu-extract-reference=ImcArbnDGetSigImcData_u08DDualEcuIdnDGetSigImcData_u08
      AssemblySwConnector_1404: ecu-extract-reference=ImcArbnDGetTxSigGroupDSerlComOutpProxyDGetTxSigGroup
      AssemblySwConnector_1405: ecu-extract-reference=ImcArbnDSetRxSigGroupDSerlComInpProxyDSetRxSigGroup
      AssemblySwConnector_1406: ecu-extract-reference=CalRegn01CmnDDutyCycThermProtnThermLimScaFacDDutyCycThermProtnDDutyCycThermProtnThermLimScaFac
      AssemblySwConnector_1407: ecu-extract-reference=CalRegn01CmnDImcArbnEcuIninTiOutThdDImcArbnDImcArbnEcuIninTiOutThd
      AssemblySwConnector_1411: ecu-extract-reference=CalRegn01CmnDImcArbnFrmFltThdDImcArbnDImcArbnFrmFltThd
      AssemblySwConnector_1434: ecu-extract-reference=LoaMgrDIvtrLoaMtgtnEnaDDutyCycThermProtnDIvtrLoaMtgtnEna
      ComponentPrototype_229: upstream-reference=ECU_Composition.CDD_Sci30CfgAndUse, ecu-extract-reference=COMPOSITIONTYPE.CDD_Sci30CfgAndUse
      AssemblySwConnector_1402: ecu-extract-reference=ImcArbnDGetTxRateGroupDCDD_Sci30CfgAndUseDGetTxRateGroup
      AssemblySwConnector_1403: ecu-extract-reference=ImcArbnDSetRxSigGroupDCDD_Sci30CfgAndUseDSetRxSigGroup
      AssemblySwConnector_876: ecu-extract-reference=CDD_MotCtrlMgrDMotCurrAdcVlyADCDD_CurrMeasDMotCurrAdcVlyD
      AssemblySwConnector_877: ecu-extract-reference=CDD_MotCtrlMgrDMotCurrAdcVlyBDCDD_CurrMeasDMotCurrAdcVlyE
      AssemblySwConnector_878: ecu-extract-reference=CDD_MotCtrlMgrDMotCurrAdcVlyCDCDD_CurrMeasDMotCurrAdcVlyF
      AssemblySwConnector_1435: ecu-extract-reference=CalRegn03CmnDEotLrngHwAgOverTrvlEntrDEotLrngDEotLrngHwAgOverTrvlEntr
      AssemblySwConnector_1436: ecu-extract-reference=CalRegn03CmnDEotLrngHwAgOverTrvlExitDEotLrngDEotLrngHwAgOverTrvlExit
  system SYSTEM
    system mapping MAPPINGS
    root-software-compositions:
      root sw composition prototype COMPOSITIONTYPE: flat-map=FLATMAP, software-composition=COMPOSITIONTYPE
  composition sw component type COMPOSITIONTYPE
    245 x component:
      BswM: type=BswM
      Det: type=Det
      EcuM: type=EcuM
      Dem: type=Dem
      NvM: type=NvM
      VehSpdLimr: type=VehSpdLimr
      VehSigCdng: type=VehSigCdng
      TunSelnMngt: type=TunSelnMngt
      TunSelnAuthy: type=TunSelnAuthy
      TqLoa: type=TqLoa
      TmplMonr: type=TmplMonr
      TEstimn: type=TEstimn
      SysStMod: type=SysStMod
      StOutpCtrl: type=StOutpCtrl
      StabyCmp: type=StabyCmp
      SerlComOutpProxy: type=SerlComOutpProxy
      SerlComInpProxy: type=SerlComInpProxy
      Rtn: type=Rtn
      PwrUpSeq: type=PwrUpSeq
      PwrSply: type=PwrSply
      PwrLimr: type=PwrLimr
      PwrDiscnct: type=PwrDiscnct
      PullCmpActv: type=PullCmpActv
      PolarityCfg: type=PolarityCfg
      PartNr: type=PartNr
      MotTqTranlDampg: type=MotTqTranlDampg
      MotRefMdl: type=MotRefMdl
      MotQuadDetn: type=MotQuadDetn
      MotDrvDiagc: type=MotDrvDiagc
      MotCurrRegCfg: type=MotCurrRegCfg
      MotCurrPeakEstimn: type=MotCurrPeakEstimn
      MotCtrlPrmEstimn: type=MotCtrlPrmEstimn
      MotAgCorrln: type=MotAgCorrln
      LoaMgr: type=LoaMgr
      LimrCdng: type=LimrCdng
      IoHwAb: type=IoHwAb
      InertiaCmpVel: type=InertiaCmpVel
      HysCmp: type=HysCmp
      HwTqCorrln: type=HwTqCorrln
      HwTqArbn: type=HwTqArbn
      HwAgSysArbn: type=HwAgSysArbn
      HwAgCorrln: type=HwAgCorrln
      HwAgArbn: type=HwAgArbn
      HwAg1Meas: type=HwAg1Meas
      HwAg0Meas: type=HwAg0Meas
      HiLoadStallLimr: type=HiLoadStallLimr
      GmVehSpdArbn: type=GmVehSpdArbn
      GmVehPwrMod: type=GmVehPwrMod
      GmTqArbn: type=GmTqArbn
      GmStrtStop: type=GmStrtStop
      GmOvrlStMgr: type=GmOvrlStMgr
      GmMsg3F1BusHiSpd: type=GmMsg3F1BusHiSpd
      GmMsg34ABusHiSpd: type=GmMsg34ABusHiSpd
      GmMsg34ABusChassisExp: type=GmMsg34ABusChassisExp
      GmMsg348BusHiSpd: type=GmMsg348BusHiSpd
      GmMsg348BusChassisExp: type=GmMsg348BusChassisExp
      GmMsg337BusChassisExp: type=GmMsg337BusChassisExp
      GmMsg335BusChassisExp: type=GmMsg335BusChassisExp
      GmMsg232BusHiSpd: type=GmMsg232BusHiSpd
      GmMsg214BusHiSpd: type=GmMsg214BusHiSpd
      GmMsg1F5BusHiSpd: type=GmMsg1F5BusHiSpd
      GmMsg1F1BusHiSpd: type=GmMsg1F1BusHiSpd
      GmMsg1E9BusHiSpd: type=GmMsg1E9BusHiSpd
      GmMsg1E5BusHiSpd: type=GmMsg1E5BusHiSpd
      GmMsg1E5BusChassisExp: type=GmMsg1E5BusChassisExp
      GmMsg1CABusChassisExp: type=GmMsg1CABusChassisExp
      GmMsg184BusHiSpd: type=GmMsg184BusHiSpd
      GmMsg182BusChassisExp: type=GmMsg182BusChassisExp
      GmMsg180BusHiSpd: type=GmMsg180BusHiSpd
      GmMsg180BusChassisExp: type=GmMsg180BusChassisExp
      GmMsg17DBusHiSpd: type=GmMsg17DBusHiSpd
      GmMsg0C9BusHiSpd: type=GmMsg0C9BusHiSpd
      FltInj: type=FltInj
      EotProtn: type=EotProtn
      EotLrng: type=EotLrng
      EcuTMeas: type=EcuTMeas
      DutyCycThermProtn: type=DutyCycThermProtn
      DiagcMgrProxyAppl6: type=DiagcMgrProxyAppl6
      DiagcMgrProxyAppl10: type=DiagcMgrProxyAppl10
      DiagcMgr: type=DiagcMgr
      Dampg: type=Dampg
      CustDiagc: type=CustDiagc
      CurrMeasCorrln: type=CurrMeasCorrln
      CmnMfgSrvIf: type=CmnMfgSrvIf
      CmnMfgSrv: type=CmnMfgSrv
      CDD_XcpIf: type=CDD_XcpIf
      CDD_TSG31CfgAndUse: type=CDD_TSG31CfgAndUse
      CDD_Tauj1CfgAndUse: type=CDD_Tauj1CfgAndUse
      CDD_Tauj0CfgAndUse: type=CDD_Tauj0CfgAndUse
      CDD_SyncCrc: type=CDD_SyncCrc
      CDD_SnsrMeasStrt: type=CDD_SnsrMeasStrt
      CDD_SinVltgGenn: type=CDD_SinVltgGenn
      CDD_RamMem: type=CDD_RamMem
      CDD_NxtrTi: type=CDD_NxtrTi
      CDD_MotVel: type=CDD_MotVel
      CDD_MotCurrRegVltgLimr: type=CDD_MotCurrRegVltgLimr
      CDD_MotCtrlMgr: type=CDD_MotCtrlMgr
      CDD_MotAgCmp: type=CDD_MotAgCmp
      CDD_MotAgArbn: type=CDD_MotAgArbn
      CDD_MotAg1Meas: type=CDD_MotAg1Meas
      CDD_MotAg0Meas: type=CDD_MotAg0Meas
      CDD_McuCoreCfgAndDiagc: type=CDD_McuCoreCfgAndDiagc
      CDD_HwTq3Meas: type=CDD_HwTq3Meas
      CDD_HwTq2Meas: type=CDD_HwTq2Meas
      CDD_HwTq1Meas: type=CDD_HwTq1Meas
      CDD_HwTq0Meas: type=CDD_HwTq0Meas
      CDD_GuardCfgAndDiagc: type=CDD_GuardCfgAndDiagc
      CDD_GmG2kcaMcuCfg: type=CDD_GmG2kcaMcuCfg
      CDD_GMLANSdl: type=CDD_GMLANSdl
      CDD_FlsMem: type=CDD_FlsMem
      CDD_ExcpnHndlg: type=CDD_ExcpnHndlg
      CDD_EcmOutpAndDiagc: type=CDD_EcmOutpAndDiagc
      CDD_DmaCfgAndUse: type=CDD_DmaCfgAndUse
      CDD_CurrMeasArbn: type=CDD_CurrMeasArbn
      CDD_CurrMeas: type=CDD_CurrMeas
      CDD_ChkPtAppl6: type=CDD_ChkPtAppl6
      CDD_ChkPtAppl10: type=CDD_ChkPtAppl10
      CDD_Adc1CfgAndUse: type=CDD_Adc1CfgAndUse
      CDD_Adc0CfgAndUse: type=CDD_Adc0CfgAndUse
      CalRegn03Rt00GroupB: type=CalRegn03Rt00GroupB
      CalRegn03Rt00GroupA: type=CalRegn03Rt00GroupA
      CalRegn03Inin00GroupA: type=CalRegn03Inin00GroupA
      CalRegn03Inin00: type=CalRegn03Inin00
      CalRegn03CmnGroupA: type=CalRegn03CmnGroupA
      CalRegn03Cmn: type=CalRegn03Cmn
      CalRegn02Cmn: type=CalRegn02Cmn
      CalRegn01Rt00: type=CalRegn01Rt00
      CalRegn01Inin00GroupB: type=CalRegn01Inin00GroupB
      CalRegn01Inin00: type=CalRegn01Inin00
      CalRegn01CmnGroupB: type=CalRegn01CmnGroupB
      CalRegn01Cmn: type=CalRegn01Cmn
      BattVltgCorrln: type=BattVltgCorrln
      BattVltg: type=BattVltg
      AssiSumLim: type=AssiSumLim
      AssiHiFrq: type=AssiHiFrq
      Assi: type=Assi
      WdgM: type=WdgM
      ProgMfgSrv: type=ProgMfgSrv
      NxtrSwIds: type=NxtrSwIds
      NxtrCalIds: type=NxtrCalIds
      CDD_VrfyCritReg: type=CDD_VrfyCritReg
      HwAgTrakgServo: type=HwAgTrakgServo
      CmplncErr: type=CmplncErr
      MotTqCmdSca: type=MotTqCmdSca
      CDD_NvMProxy: type=CDD_NvMProxy
      NvMProxy: type=NvMProxy
      GmMsg4D1BusHiSpd: type=GmMsg4D1BusHiSpd
      GmMsg500BusHiSpd: type=GmMsg500BusHiSpd
      GmMsg0C5BusHiSpd: type=GmMsg0C5BusHiSpd
      Swp: type=Swp
      CDD_AdcDiagc: type=CDD_AdcDiagc
      TqOscn: type=TqOscn
      SnsrOffsLrng: type=SnsrOffsLrng
      SnsrOffsCorrn: type=SnsrOffsCorrn
      HwAgTrajGenn: type=HwAgTrajGenn
      RtnPahFwl: type=RtnPahFwl
      EotProtnFwl: type=EotProtnFwl
      DampgPahFwl: type=DampgPahFwl
      AssiPahFwl: type=AssiPahFwl
      MotRplCoggCfg: type=MotRplCoggCfg
      CDD_MotRplCoggCmd: type=CDD_MotRplCoggCmd
      StHlthSigStc: type=StHlthSigStc
      StHlthSigNormn: type=StHlthSigNormn
      HowDetn: type=HowDetn
      MotVelCtrl: type=MotVelCtrl
      HwAgVehCentrTrim: type=HwAgVehCentrTrim
      CalRegn01CmnGroupC: type=CalRegn01CmnGroupC
      DiagcMgrStub: type=DiagcMgrStub
      CalRegn03Inin00GroupC: type=CalRegn03Inin00GroupC
      CalRegn02Inin00: type=CalRegn02Inin00
      CalRegn02CmnGroupC: type=CalRegn02CmnGroupC
      CalRegn01Inin00GroupC: type=CalRegn01Inin00GroupC
      GmRoadWhlInQlfr: type=GmRoadWhlInQlfr
      CDD_DataAndAdrPar: type=CDD_DataAndAdrPar
      WhlImbRejctn: type=WhlImbRejctn
      CalRegn03Inin00GroupB: type=CalRegn03Inin00GroupB
      CalRegn03CmnGroupB: type=CalRegn03CmnGroupB
      SysFricLrng: type=SysFricLrng
      CalRegn03Rt04GroupB: type=CalRegn03Rt04GroupB
      CalRegn03Rt04GroupA: type=CalRegn03Rt04GroupA
      CalRegn03Rt03GroupB: type=CalRegn03Rt03GroupB
      CalRegn03Rt03GroupA: type=CalRegn03Rt03GroupA
      CalRegn03Rt02GroupB: type=CalRegn03Rt02GroupB
      CalRegn03Rt02GroupA: type=CalRegn03Rt02GroupA
      CalRegn03Rt01GroupB_Dummy_3: type=CalRegn03Rt01GroupB_Dummy
      CalRegn03Rt01GroupB_Dummy_2: type=CalRegn03Rt01GroupB_Dummy
      CalRegn03Rt01GroupB_Dummy_1: type=CalRegn03Rt01GroupB_Dummy
      CalRegn03Rt01GroupB_Dummy: type=CalRegn03Rt01GroupB_Dummy
      CalRegn03Rt01GroupB: type=CalRegn03Rt01GroupB
      CalRegn03Rt01GroupA_Dummy_3: type=CalRegn03Rt01GroupA_Dummy
      CalRegn03Rt01GroupA_Dummy_2: type=CalRegn03Rt01GroupA_Dummy
      CalRegn03Rt01GroupA_Dummy_1: type=CalRegn03Rt01GroupA_Dummy
      CalRegn03Rt01GroupA_Dummy: type=CalRegn03Rt01GroupA_Dummy
      CalRegn03Rt01GroupA: type=CalRegn03Rt01GroupA
      CalRegn01Rt04: type=CalRegn01Rt04
      CalRegn01Rt03: type=CalRegn01Rt03
      CalRegn01Rt02: type=CalRegn01Rt02
      CalRegn01Rt01_Dummy_3: type=CalRegn01Rt01_Dummy
      CalRegn01Rt01_Dummy_2: type=CalRegn01Rt01_Dummy
      CalRegn01Rt01_Dummy_1: type=CalRegn01Rt01_Dummy
      CalRegn01Rt01_Dummy: type=CalRegn01Rt01_Dummy
      CalRegn01Rt01: type=CalRegn01Rt01
      PwrpkCmpbltyChk: type=PwrpkCmpbltyChk
      CDD_McuDiagc: type=CDD_McuDiagc
      GmMsg778BusHiSpd: type=GmMsg778BusHiSpd
      GmMsg148BusHiSpd: type=GmMsg148BusHiSpd
      CalRegn02CmnGroupB: type=CalRegn02CmnGroupB
      CalRegn02CmnGroupA: type=CalRegn02CmnGroupA
      HwAgSnsrls: type=HwAgSnsrls
      GmFctDiArbn: type=GmFctDiArbn
      GateDrv0Ctrl: type=GateDrv0Ctrl
      CalRegn03CmnGroupC: type=CalRegn03CmnGroupC
      CalRegn02Rt04GroupC: type=CalRegn02Rt04GroupC
      CalRegn02Rt03GroupC: type=CalRegn02Rt03GroupC
      CalRegn02Rt02GroupC: type=CalRegn02Rt02GroupC
      CalRegn02Rt01GroupC_Dummy_3: type=CalRegn02Rt01GroupC_Dummy
      CalRegn02Rt01GroupC_Dummy_2: type=CalRegn02Rt01GroupC_Dummy
      CalRegn02Rt01GroupC_Dummy_1: type=CalRegn02Rt01GroupC_Dummy
      CalRegn02Rt01GroupC_Dummy: type=CalRegn02Rt01GroupC_Dummy
      CalRegn02Rt01GroupC: type=CalRegn02Rt01GroupC
      CalRegn02Rt00GroupC: type=CalRegn02Rt00GroupC
      CalRegn02Inin00GroupC: type=CalRegn02Inin00GroupC
      CalRegn02Inin00GroupA: type=CalRegn02Inin00GroupA
      CalRegn03Rt04: type=CalRegn03Rt04
      CalRegn03Rt03: type=CalRegn03Rt03
      CalRegn03Rt02: type=CalRegn03Rt02
      CalRegn03Rt01_Dummy_3: type=CalRegn03Rt01_Dummy
      CalRegn03Rt01_Dummy_2: type=CalRegn03Rt01_Dummy
      CalRegn03Rt01_Dummy_1: type=CalRegn03Rt01_Dummy
      CalRegn03Rt01_Dummy: type=CalRegn03Rt01_Dummy
      CalRegn03Rt01: type=CalRegn03Rt01
      CalRegn03Rt00: type=CalRegn03Rt00
      CalRegn03Rt01GroupB_Dummy_4: type=CalRegn03Rt01GroupB_Dummy
      CalRegn03Rt01GroupA_Dummy_4: type=CalRegn03Rt01GroupA_Dummy
      CalRegn03Rt01_Dummy_4: type=CalRegn03Rt01_Dummy
      CalRegn02Rt01GroupC_Dummy_4: type=CalRegn02Rt01GroupC_Dummy
      CalRegn01Rt01_Dummy_4: type=CalRegn01Rt01_Dummy
      ElecPwrCns: type=ElecPwrCns
      CalRegn01CmnGroupA: type=CalRegn01CmnGroupA
      CDD_MotAg4Meas: type=CDD_MotAg4Meas
      CDD_MotAg3Meas: type=CDD_MotAg3Meas
      CurrReasbnDiagc: type=CurrReasbnDiagc
      DualEcuIdn: type=DualEcuIdn
      ImcArbn: type=ImcArbn
      CDD_Sci30CfgAndUse: type=CDD_Sci30CfgAndUse
    connect Assi.AssiCmdBas -> Dampg.AssiCmdBas
    connect Assi.AssiCmdBas -> HysCmp.AssiCmdBas
    connect Assi.AssiCmdBas -> InertiaCmpVel.AssiCmdBas
    connect AssiSumLim.SetManTqCmd -> CmnMfgSrv.SetManTqCmd
    connect AssiSumLim.MotTqCmdLimdPreStall -> HiLoadStallLimr.MotTqCmdLimdPreStall
    connect BattVltg.BrdgVltg -> CDD_CurrMeas.BrdgVltg
    connect BattVltg.BrdgVltg -> CDD_MotCtrlMgr.BrdgVltg
    connect BattVltg.BrdgVltg -> MotRefMdl.BrdgVltg
    connect BattVltg.BrdgVltg -> PwrLimr.BrdgVltg
    connect BattVltgCorrln.BattSwdVltgCorrlnSts -> BattVltg.BattSwdVltgCorrlnSts
    connect CalRegn01Cmn.AssiSumLimNtc0x0C4FailStep -> AssiSumLim.AssiSumLimNtc0x0C4FailStep
    connect CalRegn01Cmn.AssiSumLimNtc0x0C4PassStep -> AssiSumLim.AssiSumLimNtc0x0C4PassStep
    connect CalRegn01Cmn.AssiSumLimPullCmpLim -> AssiSumLim.AssiSumLimPullCmpLim
    connect CalRegn01Cmn.BattVltgSwdMax -> BattVltg.BattVltgSwdMax
    connect CalRegn01Cmn.BattVltgCorrlnAllwdVltgDif -> BattVltgCorrln.BattVltgCorrlnAllwdVltgDif
    connect CalRegn01Cmn.BattVltgCorrlnBattLoVltg -> BattVltgCorrln.BattVltgCorrlnBattLoVltg
    connect CalRegn01Cmn.BattVltgCorrlnBattOverVltg -> BattVltgCorrln.BattVltgCorrlnBattOverVltg
    connect CalRegn01Cmn.BattVltgCorrlnBattUnderVltg -> BattVltgCorrln.BattVltgCorrlnBattUnderVltg
    connect CalRegn01Cmn.BattVltgCorrlnNtc0x03C0x0440x04CFailStep -> BattVltgCorrln.BattVltgCorrlnNtc0x03C0x0440x04CFailStep
    connect CalRegn01Cmn.BattVltgCorrlnNtc0x03C0x0440x04CPassStep -> BattVltgCorrln.BattVltgCorrlnNtc0x03C0x0440x04CPassStep
    connect CalRegn01Cmn.BattVltgCorrlnNtc0x0B0FailStep -> BattVltgCorrln.BattVltgCorrlnNtc0x0B0FailStep
    connect CalRegn01Cmn.BattVltgCorrlnNtc0x0B0PassStep -> BattVltgCorrln.BattVltgCorrlnNtc0x0B0PassStep
    connect CalRegn01Cmn.BattVltgCorrlnNtc0x0B1FailStep -> BattVltgCorrln.BattVltgCorrlnNtc0x0B1FailStep
    connect CalRegn01Cmn.BattVltgCorrlnNtc0x0B1PassStep -> BattVltgCorrln.BattVltgCorrlnNtc0x0B1PassStep
    connect CalRegn01Cmn.BattVltgCorrlnNtc0x0B5FailStep -> BattVltgCorrln.BattVltgCorrlnNtc0x0B5FailStep
    connect CalRegn01Cmn.BattVltgCorrlnNtc0x0B5PassStep -> BattVltgCorrln.BattVltgCorrlnNtc0x0B5PassStep
    connect CalRegn01Cmn.BattVltgCorrlnRcvrlBattLoVltg -> BattVltgCorrln.BattVltgCorrlnRcvrlBattLoVltg
    connect CalRegn01Cmn.BattVltgCorrlnRcvrlBattOverVltg -> BattVltgCorrln.BattVltgCorrlnRcvrlBattOverVltg
    connect CalRegn01Cmn.BattVltgCorrlnRcvrlBattUnderVltg -> BattVltgCorrln.BattVltgCorrlnRcvrlBattUnderVltg
    connect CalRegn01Cmn.BattVltgSwdMax -> BattVltgCorrln.BattVltgSwdMax
    connect CalRegn01Cmn.CurrMeasEolFixdPwmPerd -> CDD_CurrMeas.CurrMeasEolFixdPwmPerd
    connect CalRegn01Cmn.CurrMeasEolGainMax -> CDD_CurrMeas.CurrMeasEolGainMax
    connect CalRegn01Cmn.CurrMeasEolGainMin -> CDD_CurrMeas.CurrMeasEolGainMin
    connect CalRegn01Cmn.CurrMeasEolGainNrOfSample -> CDD_CurrMeas.CurrMeasEolGainNrOfSample
    connect CalRegn01Cmn.CurrMeasEolGainNumer -> CDD_CurrMeas.CurrMeasEolGainNumer
    connect CalRegn01Cmn.CurrMeasEolMaxMotVel -> CDD_CurrMeas.CurrMeasEolMaxMotVel
    connect CalRegn01Cmn.CurrMeasEolOffsHiBrdgVltgMin -> CDD_CurrMeas.CurrMeasEolOffsHiBrdgVltgMin
    connect CalRegn01Cmn.CurrMeasEolOffsHiCmuOffs -> CDD_CurrMeas.CurrMeasEolOffsHiCmuOffs
    connect CalRegn01Cmn.CurrMeasEolOffsLoCmuOffs -> CDD_CurrMeas.CurrMeasEolOffsLoCmuOffs
    connect CalRegn01Cmn.CurrMeasEolOffsMax -> CDD_CurrMeas.CurrMeasEolOffsMax
    connect CalRegn01Cmn.CurrMeasEolOffsMin -> CDD_CurrMeas.CurrMeasEolOffsMin
    connect CalRegn01Cmn.CurrMeasEolOffsNrOfSample -> CDD_CurrMeas.CurrMeasEolOffsNrOfSample
    connect CalRegn01Cmn.CurrMeasEolTranCntrThd -> CDD_CurrMeas.CurrMeasEolTranCntrThd
    connect CalRegn01Cmn.CurrMeasMinRqrdPhaOnTi -> CDD_CurrMeas.CurrMeasMinRqrdPhaOnTi
    connect CalRegn01Cmn.CurrMeasMotAgCompuDly -> CDD_CurrMeas.CurrMeasMotAgCompuDly
    connect CalRegn01Cmn.CurrMeasMotCurrAdcVlyWrmIninMax -> CDD_CurrMeas.CurrMeasMotCurrAdcVlyWrmIninMax
    connect CalRegn01Cmn.CurrMeasMotCurrAdcVlyWrmIninMin -> CDD_CurrMeas.CurrMeasMotCurrAdcVlyWrmIninMin
    connect CalRegn01Cmn.CurrMeasNtc0x05DFailStep -> CDD_CurrMeas.CurrMeasNtc0x05DFailStep
    connect CalRegn01Cmn.CurrMeasNtc0x05DPassStep -> CDD_CurrMeas.CurrMeasNtc0x05DPassStep
    connect CalRegn01Cmn.CurrMeasNtc0x06DFailStep -> CDD_CurrMeas.CurrMeasNtc0x06DFailStep
    connect CalRegn01Cmn.CurrMeasNtc0x06DPassStep -> CDD_CurrMeas.CurrMeasNtc0x06DPassStep
    connect CalRegn01Cmn.CurrMeasArbnMaxStallCntr -> CDD_CurrMeasArbn.CurrMeasArbnMaxStallCntr
    connect CalRegn01Cmn.MotCurrRegCfgMotRVirtDax -> CDD_MotCurrRegVltgLimr.MotCurrRegCfgMotRVirtDax
    connect CalRegn01Cmn.MotCurrRegCfgMotRVirtQax -> CDD_MotCurrRegVltgLimr.MotCurrRegCfgMotRVirtQax
    connect CalRegn01Cmn.MotCurrRegVltgLimrCurrLoaScarSlewRate -> CDD_MotCurrRegVltgLimr.MotCurrRegVltgLimrCurrLoaScarSlewRate
    connect CalRegn01Cmn.MotCurrRegVltgLimrDaxAntiWdupCoeff -> CDD_MotCurrRegVltgLimr.MotCurrRegVltgLimrDaxAntiWdupCoeff
    connect CalRegn01Cmn.MotCurrRegVltgLimrIvtrLoaScarSlewRate -> CDD_MotCurrRegVltgLimr.MotCurrRegVltgLimrIvtrLoaScarSlewRate
    connect CalRegn01Cmn.MotCurrRegVltgLimrQaxAntiWdupCoeff -> CDD_MotCurrRegVltgLimr.MotCurrRegVltgLimrQaxAntiWdupCoeff
    connect CalRegn01Cmn.MotCurrRegVltgLimrQaxAntiWdupScagDi -> CDD_MotCurrRegVltgLimr.MotCurrRegVltgLimrQaxAntiWdupScagDi
    connect CalRegn01Cmn.MotRefMdlFbCtrlDi -> CDD_MotCurrRegVltgLimr.MotRefMdlFbCtrlDi
    connect CalRegn01Cmn.MotRefMdlIvtrDeadTiBrdgVltgSca -> CDD_MotCurrRegVltgLimr.MotRefMdlIvtrDeadTiBrdgVltgSca
    connect CalRegn01Cmn.CurrMeasEolFixdPwmPerd -> CDD_TSG31CfgAndUse.CurrMeasEolFixdPwmPerd
    connect CalRegn01Cmn.CurrMeasEolOffsHiCmuOffs -> CDD_TSG31CfgAndUse.CurrMeasEolOffsHiCmuOffs
    connect CalRegn01Cmn.CurrMeasEolOffsLoCmuOffs -> CDD_TSG31CfgAndUse.CurrMeasEolOffsLoCmuOffs
    connect CalRegn01Cmn.TSG31CfgAndUseAdcStrtOfCnvn2Offs -> CDD_TSG31CfgAndUse.TSG31CfgAndUseAdcStrtOfCnvn2Offs
    connect CalRegn01Cmn.TSG31CfgAndUseAdcStrtOfCnvnMotCtrlPeakOffs -> CDD_TSG31CfgAndUse.TSG31CfgAndUseAdcStrtOfCnvnMotCtrlPeakOffs
    connect CalRegn01Cmn.TSG31CfgAndUseAdcStrtOfCnvnMotCtrlVlyOffs -> CDD_TSG31CfgAndUse.TSG31CfgAndUseAdcStrtOfCnvnMotCtrlVlyOffs
    connect CalRegn01Cmn.TSG31CfgAndUseMtrAg0SPIStart -> CDD_TSG31CfgAndUse.TSG31CfgAndUseMtrAg0SPIStart
    connect CalRegn01Cmn.TSG31CfgAndUsePwmDbnd -> CDD_TSG31CfgAndUse.TSG31CfgAndUsePwmDbnd
    connect CalRegn01Cmn.CmnMfgSrvSecuAcsAtmptTiOut -> CmnMfgSrv.CmnMfgSrvSecuAcsAtmptTiOut
    connect CalRegn01Cmn.CmnMfgSrvSecuAcsMaxNrAtmpt -> CmnMfgSrv.CmnMfgSrvSecuAcsMaxNrAtmpt
    connect CalRegn01Cmn.CurrMeasCorrlnMaxErrCurr -> CurrMeasCorrln.CurrMeasCorrlnMaxErrCurr
    connect CalRegn01Cmn.CurrMeasCorrlnMaxStallCntr -> CurrMeasCorrln.CurrMeasCorrlnMaxStallCntr
    connect CalRegn01Cmn.CurrMeasCorrlnNtc0x04DFailStep -> CurrMeasCorrln.CurrMeasCorrlnNtc0x04DFailStep
    connect CalRegn01Cmn.CurrMeasCorrlnNtc0x04DPassStep -> CurrMeasCorrln.CurrMeasCorrlnNtc0x04DPassStep
    connect CalRegn01Cmn.CurrMeasCorrlnNtc0x04EFailStep -> CurrMeasCorrln.CurrMeasCorrlnNtc0x04EFailStep
    connect CalRegn01Cmn.CurrMeasCorrlnNtc0x04EPassStep -> CurrMeasCorrln.CurrMeasCorrlnNtc0x04EPassStep
    connect CalRegn01Cmn.DutyCycThermProtnAbsltCtrlTTblX -> DutyCycThermProtn.DutyCycThermProtnAbsltCtrlTTblX
    connect CalRegn01Cmn.DutyCycThermProtnAbsltCtrlTTqTblY -> DutyCycThermProtn.DutyCycThermProtnAbsltCtrlTTqTblY
    connect CalRegn01Cmn.DutyCycThermProtnAbsltCuTTblX -> DutyCycThermProtn.DutyCycThermProtnAbsltCuTTblX
    connect CalRegn01Cmn.DutyCycThermProtnAbsltCuTTqTblY -> DutyCycThermProtn.DutyCycThermProtnAbsltCuTTqTblY
    connect CalRegn01Cmn.DutyCycThermProtnAbsltMotVelBreakPt -> DutyCycThermProtn.DutyCycThermProtnAbsltMotVelBreakPt
    connect CalRegn01Cmn.DutyCycThermProtnAbsltTTqSlewHiLim -> DutyCycThermProtn.DutyCycThermProtnAbsltTTqSlewHiLim
    connect CalRegn01Cmn.DutyCycThermProtnAbsltTTqSlewLoLim -> DutyCycThermProtn.DutyCycThermProtnAbsltTTqSlewLoLim
    connect CalRegn01Cmn.DutyCycThermProtnCtrlT -> DutyCycThermProtn.DutyCycThermProtnCtrlT
    connect CalRegn01Cmn.DutyCycThermProtnCtrlTSeln -> DutyCycThermProtn.DutyCycThermProtnCtrlTSeln
    connect CalRegn01Cmn.DutyCycThermProtnDutyCycFildThd -> DutyCycThermProtn.DutyCycThermProtnDutyCycFildThd
    connect CalRegn01Cmn.DutyCycThermProtnIgnOffCtrlEna -> DutyCycThermProtn.DutyCycThermProtnIgnOffCtrlEna
    connect CalRegn01Cmn.DutyCycThermProtnIgnOffMsgWaitTi -> DutyCycThermProtn.DutyCycThermProtnIgnOffMsgWaitTi
    connect CalRegn01Cmn.DutyCycThermProtnLstTblValNonStall -> DutyCycThermProtn.DutyCycThermProtnLstTblValNonStall
    connect CalRegn01Cmn.DutyCycThermProtnLstTblValStall -> DutyCycThermProtn.DutyCycThermProtnLstTblValStall
    connect CalRegn01Cmn.DutyCycThermProtnMotPrTSeln -> DutyCycThermProtn.DutyCycThermProtnMotPrTSeln
    connect CalRegn01Cmn.DutyCycThermProtnMplr1NonStallTblY -> DutyCycThermProtn.DutyCycThermProtnMplr1NonStallTblY
    connect CalRegn01Cmn.DutyCycThermProtnMplr1StallTblY -> DutyCycThermProtn.DutyCycThermProtnMplr1StallTblY
    connect CalRegn01Cmn.DutyCycThermProtnMplr2NonStallTblY -> DutyCycThermProtn.DutyCycThermProtnMplr2NonStallTblY
    connect CalRegn01Cmn.DutyCycThermProtnMplr2StallTblY -> DutyCycThermProtn.DutyCycThermProtnMplr2StallTblY
    connect CalRegn01Cmn.DutyCycThermProtnMplr3NonStallTblY -> DutyCycThermProtn.DutyCycThermProtnMplr3NonStallTblY
    connect CalRegn01Cmn.DutyCycThermProtnMplr3StallTblY -> DutyCycThermProtn.DutyCycThermProtnMplr3StallTblY
    connect CalRegn01Cmn.DutyCycThermProtnMplr4NonStallTblY -> DutyCycThermProtn.DutyCycThermProtnMplr4NonStallTblY
    connect CalRegn01Cmn.DutyCycThermProtnMplr4StallTblY -> DutyCycThermProtn.DutyCycThermProtnMplr4StallTblY
    connect CalRegn01Cmn.DutyCycThermProtnMplr5NonStallTblY -> DutyCycThermProtn.DutyCycThermProtnMplr5NonStallTblY
    connect CalRegn01Cmn.DutyCycThermProtnMplr5StallTblY -> DutyCycThermProtn.DutyCycThermProtnMplr5StallTblY
    connect CalRegn01Cmn.DutyCycThermProtnMplr6NonStallTblY -> DutyCycThermProtn.DutyCycThermProtnMplr6NonStallTblY
    connect CalRegn01Cmn.DutyCycThermProtnMplr6StallTblY -> DutyCycThermProtn.DutyCycThermProtnMplr6StallTblY
    connect CalRegn01Cmn.DutyCycThermProtnMplrTblX -> DutyCycThermProtn.DutyCycThermProtnMplrTblX
    connect CalRegn01Cmn.DutyCycThermProtnMplrTSeln -> DutyCycThermProtn.DutyCycThermProtnMplrTSeln
    connect CalRegn01Cmn.DutyCycThermProtnSlowFilTSeln -> DutyCycThermProtn.DutyCycThermProtnSlowFilTSeln
    connect CalRegn01Cmn.DutyCycThermProtnThermLoadLimTblX -> DutyCycThermProtn.DutyCycThermProtnThermLoadLimTblX
    connect CalRegn01Cmn.DutyCycThermProtnThermLoadLimTblY -> DutyCycThermProtn.DutyCycThermProtnThermLoadLimTblY
    connect CalRegn01Cmn.DutyCycThermProtnTqCmdSlewDwn -> DutyCycThermProtn.DutyCycThermProtnTqCmdSlewDwn
    connect CalRegn01Cmn.DutyCycThermProtnTqCmdSlewUp -> DutyCycThermProtn.DutyCycThermProtnTqCmdSlewUp
    connect CalRegn01Cmn.EcuTMeasDftT -> EcuTMeas.EcuTMeasDftT
    connect CalRegn01Cmn.EcuTMeasFilTau -> EcuTMeas.EcuTMeasFilTau
    connect CalRegn01Cmn.EcuTMeasNtc0x045FailStep -> EcuTMeas.EcuTMeasNtc0x045FailStep
    connect CalRegn01Cmn.EcuTMeasNtc0x045PassStep -> EcuTMeas.EcuTMeasNtc0x045PassStep
    connect CalRegn01Cmn.EcuTMeasRngDiagcMax -> EcuTMeas.EcuTMeasRngDiagcMax
    connect CalRegn01Cmn.EcuTMeasRngDiagcMin -> EcuTMeas.EcuTMeasRngDiagcMin
    connect CalRegn01Cmn.EcuTMeasScag -> EcuTMeas.EcuTMeasScag
    connect CalRegn01Cmn.EcuTMeasScagOffs -> EcuTMeas.EcuTMeasScagOffs
    connect CalRegn01Cmn.GmMsg0C9BusHiSpdInvldTiOut -> GmMsg0C9BusHiSpd.GmMsg0C9BusHiSpdInvldTiOut
    connect CalRegn01Cmn.GmMsg0C9BusHiSpdMissTiOut -> GmMsg0C9BusHiSpd.GmMsg0C9BusHiSpdMissTiOut
    connect CalRegn01Cmn.GmMsg0C9BusHiSpdVehSpdThd -> GmMsg0C9BusHiSpd.GmMsg0C9BusHiSpdVehSpdThd
    connect CalRegn01Cmn.GmMsg17DBusHiSpdInvldTiOut -> GmMsg17DBusHiSpd.GmMsg17DBusHiSpdInvldTiOut
    connect CalRegn01Cmn.GmMsg17DBusHiSpdMissTiOut -> GmMsg17DBusHiSpd.GmMsg17DBusHiSpdMissTiOut
    connect CalRegn01Cmn.GmMsg180BusChassisExpInvldProtnValTiOut -> GmMsg180BusChassisExp.GmMsg180BusChassisExpInvldProtnValTiOut
    connect CalRegn01Cmn.GmMsg180BusChassisExpMissTiOut -> GmMsg180BusChassisExp.GmMsg180BusChassisExpMissTiOut
    connect CalRegn01Cmn.GmMsg180BusChassisExpRollgCntrInvldTiOut -> GmMsg180BusChassisExp.GmMsg180BusChassisExpRollgCntrInvldTiOut
    connect CalRegn01Cmn.GmMsg180BusChassisExpTqPolarity -> GmMsg180BusChassisExp.GmMsg180BusChassisExpTqPolarity
    connect CalRegn01Cmn.GmMsg180BusHiSpdCrcInvldTiOut -> GmMsg180BusHiSpd.GmMsg180BusHiSpdCrcInvldTiOut
    connect CalRegn01Cmn.GmMsg180BusHiSpdMissTiOut -> GmMsg180BusHiSpd.GmMsg180BusHiSpdMissTiOut
    connect CalRegn01Cmn.GmMsg180BusHiSpdRollgCntrInvldTiOut -> GmMsg180BusHiSpd.GmMsg180BusHiSpdRollgCntrInvldTiOut
    connect CalRegn01Cmn.GmMsg180BusHiSpdTqPolarity -> GmMsg180BusHiSpd.GmMsg180BusHiSpdTqPolarity
    connect CalRegn01Cmn.GmMsg182BusChassisExpInvldTiOut -> GmMsg182BusChassisExp.GmMsg182BusChassisExpInvldTiOut
    connect CalRegn01Cmn.GmMsg182BusChassisExpMissTiOut -> GmMsg182BusChassisExp.GmMsg182BusChassisExpMissTiOut
    connect CalRegn01Cmn.GmMsg184BusHiSpdHandsOnThd -> GmMsg184BusHiSpd.GmMsg184BusHiSpdHandsOnThd
    connect CalRegn01Cmn.GmMsg184BusHiSpdTqPolarity -> GmMsg184BusHiSpd.GmMsg184BusHiSpdTqPolarity
    connect CalRegn01Cmn.GmMsg1CaBusChassisExpTqPolarity -> GmMsg1CABusChassisExp.GmMsg1CaBusChassisExpTqPolarity
    connect CalRegn01Cmn.GmMsg1E9BusHiSpdAbsFaildTiOut -> GmMsg1E9BusHiSpd.GmMsg1E9BusHiSpdAbsFaildTiOut
    connect CalRegn01Cmn.GmMsg1E9BusHiSpdLatADft -> GmMsg1E9BusHiSpd.GmMsg1E9BusHiSpdLatADft
    connect CalRegn01Cmn.GmMsg1E9BusHiSpdLatAInvldTiOut -> GmMsg1E9BusHiSpd.GmMsg1E9BusHiSpdLatAInvldTiOut
    connect CalRegn01Cmn.GmMsg1E9BusHiSpdMissTiOut -> GmMsg1E9BusHiSpd.GmMsg1E9BusHiSpdMissTiOut
    connect CalRegn01Cmn.GmMsg1E9BusHiSpdTcsDisadTiOut -> GmMsg1E9BusHiSpd.GmMsg1E9BusHiSpdTcsDisadTiOut
    connect CalRegn01Cmn.GmMsg1E9BusHiSpdVehDynCtrlStTiOut -> GmMsg1E9BusHiSpd.GmMsg1E9BusHiSpdVehDynCtrlStTiOut
    connect CalRegn01Cmn.GmMsg1E9BusHiSpdVehStabyEnhmtActvVldTiOut -> GmMsg1E9BusHiSpd.GmMsg1E9BusHiSpdVehStabyEnhmtActvVldTiOut
    connect CalRegn01Cmn.GmMsg1E9BusHiSpdYawRateDft -> GmMsg1E9BusHiSpd.GmMsg1E9BusHiSpdYawRateDft
    connect CalRegn01Cmn.GmMsg1E9BusHiSpdYawRateInvldTiOut -> GmMsg1E9BusHiSpd.GmMsg1E9BusHiSpdYawRateInvldTiOut
    connect CalRegn01Cmn.GmMsg1F1BusHiSpdMissTiOut -> GmMsg1F1BusHiSpd.GmMsg1F1BusHiSpdMissTiOut
    connect CalRegn01Cmn.GmMsg1F5BusHiSpdInvldTiOut -> GmMsg1F5BusHiSpd.GmMsg1F5BusHiSpdInvldTiOut
    connect CalRegn01Cmn.GmMsg1F5BusHiSpdMissTiOut -> GmMsg1F5BusHiSpd.GmMsg1F5BusHiSpdMissTiOut
    connect CalRegn01Cmn.GmMsg214BusHiSpdAbsActvProtdProtnValInvldTiOut -> GmMsg214BusHiSpd.GmMsg214BusHiSpdAbsActvProtdProtnValInvldTiOut
    connect CalRegn01Cmn.GmMsg214BusHiSpdAbsActvProtdRollgCntrInvldTiOut -> GmMsg214BusHiSpd.GmMsg214BusHiSpdAbsActvProtdRollgCntrInvldTiOut
    connect CalRegn01Cmn.GmMsg214BusHiSpdMissTiOut -> GmMsg214BusHiSpd.GmMsg214BusHiSpdMissTiOut
    connect CalRegn01Cmn.GmMsg214BusHiSpdRdntVehStabyEnhmtActvInvldTiOut -> GmMsg214BusHiSpd.GmMsg214BusHiSpdRdntVehStabyEnhmtActvInvldTiOut
    connect CalRegn01Cmn.GmMsg214BusHiSpdRdntVehStabyEnhmtActvRollgCntrInvldTiOut -> GmMsg214BusHiSpd.GmMsg214BusHiSpdRdntVehStabyEnhmtActvRollgCntrInvldTiOut
    connect CalRegn01Cmn.GmMsg232BusHiSpdMissTiOut -> GmMsg232BusHiSpd.GmMsg232BusHiSpdMissTiOut
    connect CalRegn01Cmn.GmMsg337BusChassisExpInvldDiagcTiOut -> GmMsg337BusChassisExp.GmMsg337BusChassisExpInvldDiagcTiOut
    connect CalRegn01Cmn.GmMsg337BusChassisExpMissTiOut -> GmMsg337BusChassisExp.GmMsg337BusChassisExpMissTiOut
    connect CalRegn01Cmn.GmMsg337BusChassisExpTarAgPolarity -> GmMsg337BusChassisExp.GmMsg337BusChassisExpTarAgPolarity
    connect CalRegn01Cmn.GmMsg348BusChassisExpInvldTiOut -> GmMsg348BusChassisExp.GmMsg348BusChassisExpInvldTiOut
    connect CalRegn01Cmn.GmMsg348BusChassisExpMissTiOut -> GmMsg348BusChassisExp.GmMsg348BusChassisExpMissTiOut
    connect CalRegn01Cmn.GmMsg348BusChassisExpStuckTiOut -> GmMsg348BusChassisExp.GmMsg348BusChassisExpStuckTiOut
    connect CalRegn01Cmn.GmMsg348BusHiSpdInvldTiOut -> GmMsg348BusHiSpd.GmMsg348BusHiSpdInvldTiOut
    connect CalRegn01Cmn.GmMsg348BusHiSpdMissTiOut -> GmMsg348BusHiSpd.GmMsg348BusHiSpdMissTiOut
    connect CalRegn01Cmn.GmMsg348BusHiSpdStuckTiOut -> GmMsg348BusHiSpd.GmMsg348BusHiSpdStuckTiOut
    connect CalRegn01Cmn.GmMsg34ABusChassisExpInvldTiOut -> GmMsg34ABusChassisExp.GmMsg34ABusChassisExpInvldTiOut
    connect CalRegn01Cmn.GmMsg34ABusChassisExpMissTiOut -> GmMsg34ABusChassisExp.GmMsg34ABusChassisExpMissTiOut
    connect CalRegn01Cmn.GmMsg34ABusChassisExpStuckTiOut -> GmMsg34ABusChassisExp.GmMsg34ABusChassisExpStuckTiOut
    connect CalRegn01Cmn.GmMsg34ABusHiSpdInvldTiOut -> GmMsg34ABusHiSpd.GmMsg34ABusHiSpdInvldTiOut
    connect CalRegn01Cmn.GmMsg34ABusHiSpdMissTiOut -> GmMsg34ABusHiSpd.GmMsg34ABusHiSpdMissTiOut
    connect CalRegn01Cmn.GmMsg34ABusHiSpdStuckTiOut -> GmMsg34ABusHiSpd.GmMsg34ABusHiSpdStuckTiOut
    connect CalRegn01Cmn.GmMsg3F1BusHiSpdAmbTDft -> GmMsg3F1BusHiSpd.GmMsg3F1BusHiSpdAmbTDft
    connect CalRegn01Cmn.GmMsg3F1BusHiSpdInvldTiOut -> GmMsg3F1BusHiSpd.GmMsg3F1BusHiSpdInvldTiOut
    connect CalRegn01Cmn.GmMsg3F1BusHiSpdMissTiOut -> GmMsg3F1BusHiSpd.GmMsg3F1BusHiSpdMissTiOut
    connect CalRegn01Cmn.HwAgSysArbnHwAgSlewRate -> HwAgSysArbn.HwAgSysArbnHwAgSlewRate
    connect CalRegn01Cmn.HwAgSysArbnSlewRateTmr -> HwAgSysArbn.HwAgSysArbnSlewRateTmr
    connect CalRegn01Cmn.HwTqArbnMaxStallTqA -> HwTqArbn.HwTqArbnMaxStallTqA
    connect CalRegn01Cmn.HwTqArbnMaxStallTqB -> HwTqArbn.HwTqArbnMaxStallTqB
    connect CalRegn01Cmn.HwTqArbnMaxStallTqC -> HwTqArbn.HwTqArbnMaxStallTqC
    connect CalRegn01Cmn.HwTqArbnMaxStallTqD -> HwTqArbn.HwTqArbnMaxStallTqD
    connect CalRegn01Cmn.HwTqCorrlnChACmnModCmpLpFilActvnThd -> HwTqCorrln.HwTqCorrlnChACmnModCmpLpFilActvnThd
    connect CalRegn01Cmn.HwTqCorrlnChACmnModCmpLpFilFrq -> HwTqCorrln.HwTqCorrlnChACmnModCmpLpFilFrq
    connect CalRegn01Cmn.HwTqCorrlnChACmnModCmpLpFilOutpLim -> HwTqCorrln.HwTqCorrlnChACmnModCmpLpFilOutpLim
    connect CalRegn01Cmn.HwTqCorrlnChAImdtCorrlnChkFailThd -> HwTqCorrln.HwTqCorrlnChAImdtCorrlnChkFailThd
    connect CalRegn01Cmn.HwTqCorrlnChAImdtCorrlnChkPassThd -> HwTqCorrln.HwTqCorrlnChAImdtCorrlnChkPassThd
    connect CalRegn01Cmn.HwTqCorrlnChAStabStClrFltThd -> HwTqCorrln.HwTqCorrlnChAStabStClrFltThd
    connect CalRegn01Cmn.HwTqCorrlnChAStabStLpFilFrq -> HwTqCorrln.HwTqCorrlnChAStabStLpFilFrq
    connect CalRegn01Cmn.HwTqCorrlnChAStabStSetFltThd -> HwTqCorrln.HwTqCorrlnChAStabStSetFltThd
    connect CalRegn01Cmn.HwTqCorrlnChATqSumMaxLim -> HwTqCorrln.HwTqCorrlnChATqSumMaxLim
    connect CalRegn01Cmn.HwTqCorrlnChATraLpFilX -> HwTqCorrln.HwTqCorrlnChATraLpFilX
    connect CalRegn01Cmn.HwTqCorrlnChATraLpFilY -> HwTqCorrln.HwTqCorrlnChATraLpFilY
    connect CalRegn01Cmn.HwTqCorrlnChATraSumClrFltThd -> HwTqCorrln.HwTqCorrlnChATraSumClrFltThd
    connect CalRegn01Cmn.HwTqCorrlnChATraSumSetFltThd -> HwTqCorrln.HwTqCorrlnChATraSumSetFltThd
    connect CalRegn01Cmn.HwTqCorrlnChBCmnModCmpLpFilActvnThd -> HwTqCorrln.HwTqCorrlnChBCmnModCmpLpFilActvnThd
    connect CalRegn01Cmn.HwTqCorrlnChBCmnModCmpLpFilFrq -> HwTqCorrln.HwTqCorrlnChBCmnModCmpLpFilFrq
    connect CalRegn01Cmn.HwTqCorrlnChBCmnModCmpLpFilOutpLim -> HwTqCorrln.HwTqCorrlnChBCmnModCmpLpFilOutpLim
    connect CalRegn01Cmn.HwTqCorrlnChBImdtCorrlnChkFailThd -> HwTqCorrln.HwTqCorrlnChBImdtCorrlnChkFailThd
    connect CalRegn01Cmn.HwTqCorrlnChBImdtCorrlnChkPassThd -> HwTqCorrln.HwTqCorrlnChBImdtCorrlnChkPassThd
    connect CalRegn01Cmn.HwTqCorrlnChBStabStClrFltThd -> HwTqCorrln.HwTqCorrlnChBStabStClrFltThd
    connect CalRegn01Cmn.HwTqCorrlnChBStabStLpFilFrq -> HwTqCorrln.HwTqCorrlnChBStabStLpFilFrq
    connect CalRegn01Cmn.HwTqCorrlnChBStabStSetFltThd -> HwTqCorrln.HwTqCorrlnChBStabStSetFltThd
    connect CalRegn01Cmn.HwTqCorrlnChBTqSumMaxLim -> HwTqCorrln.HwTqCorrlnChBTqSumMaxLim
    connect CalRegn01Cmn.HwTqCorrlnChBTraLpFilX -> HwTqCorrln.HwTqCorrlnChBTraLpFilX
    connect CalRegn01Cmn.HwTqCorrlnChBTraLpFilY -> HwTqCorrln.HwTqCorrlnChBTraLpFilY
    connect CalRegn01Cmn.HwTqCorrlnChBTraSumClrFltThd -> HwTqCorrln.HwTqCorrlnChBTraSumClrFltThd
    connect CalRegn01Cmn.HwTqCorrlnChBTraSumSetFltThd -> HwTqCorrln.HwTqCorrlnChBTraSumSetFltThd
    connect CalRegn01Cmn.HwTqCorrlnMaxStallTqA -> HwTqCorrln.HwTqCorrlnMaxStallTqA
    connect CalRegn01Cmn.HwTqCorrlnMaxStallTqB -> HwTqCorrln.HwTqCorrlnMaxStallTqB
    connect CalRegn01Cmn.HwTqCorrlnMaxStallTqC -> HwTqCorrln.HwTqCorrlnMaxStallTqC
    connect CalRegn01Cmn.HwTqCorrlnMaxStallTqD -> HwTqCorrln.HwTqCorrlnMaxStallTqD
    connect CalRegn01Cmn.LoaMgrCurrIvtrMtgtnRate -> LoaMgr.LoaMgrCurrIvtrMtgtnRate
    connect CalRegn01Cmn.LoaMgrCurrIvtrMtgtnSca -> LoaMgr.LoaMgrCurrIvtrMtgtnSca
    connect CalRegn01Cmn.LoaMgrCurrIvtrMtgtnScaZeroEna -> LoaMgr.LoaMgrCurrIvtrMtgtnScaZeroEna
    connect CalRegn01Cmn.LoaMgrCurrMeasIdptSig{0..2}Resp -> LoaMgr.LoaMgrCurrMeasIdptSig{0..2}Resp
    connect CalRegn01Cmn.LoaMgrCurrMeasIdptSigFltThd -> LoaMgr.LoaMgrCurrMeasIdptSigFltThd
    connect CalRegn01Cmn.LoaMgrCurrMeasMtgtnRate -> LoaMgr.LoaMgrCurrMeasMtgtnRate
    connect CalRegn01Cmn.LoaMgrCurrMeasMtgtnSca -> LoaMgr.LoaMgrCurrMeasMtgtnSca
    connect CalRegn01Cmn.LoaMgrCurrMeasMtgtnScaZeroEna -> LoaMgr.LoaMgrCurrMeasMtgtnScaZeroEna
    connect CalRegn01Cmn.LoaMgrFadeOutStRate -> LoaMgr.LoaMgrFadeOutStRate
    connect CalRegn01Cmn.LoaMgrHwTqIdptSig0NoTqLoaResp -> LoaMgr.LoaMgrHwTqIdptSig0NoTqLoaResp
    connect CalRegn01Cmn.LoaMgrHwTqIdptSig1NoTqLoaResp -> LoaMgr.LoaMgrHwTqIdptSig1NoTqLoaResp
    connect CalRegn01Cmn.LoaMgrHwTqIdptSig2Resp -> LoaMgr.LoaMgrHwTqIdptSig2Resp
    connect CalRegn01Cmn.LoaMgrHwTqIdptSig4Resp -> LoaMgr.LoaMgrHwTqIdptSig4Resp
    connect CalRegn01Cmn.LoaMgrHwTqIdptSigFltThd -> LoaMgr.LoaMgrHwTqIdptSigFltThd
    connect CalRegn01Cmn.LoaMgrHwTqLoaAvlResp -> LoaMgr.LoaMgrHwTqLoaAvlResp
    connect CalRegn01Cmn.LoaMgrIvtrIdptSig{0..2}Resp -> LoaMgr.LoaMgrIvtrIdptSig{0..2}Resp
    connect CalRegn01Cmn.LoaMgrIvtrIdptSigFltThd -> LoaMgr.LoaMgrIvtrIdptSigFltThd
    connect CalRegn01Cmn.LoaMgrIvtrMtgtnRate -> LoaMgr.LoaMgrIvtrMtgtnRate
    connect CalRegn01Cmn.LoaMgrIvtrMtgtnSca -> LoaMgr.LoaMgrIvtrMtgtnSca
    connect CalRegn01Cmn.LoaMgrIvtrMtgtnScaZeroEna -> LoaMgr.LoaMgrIvtrMtgtnScaZeroEna
    connect CalRegn01Cmn.LoaMgrLimdStRate -> LoaMgr.LoaMgrLimdStRate
    connect CalRegn01Cmn.LoaMgrLimdStSca -> LoaMgr.LoaMgrLimdStSca
    connect CalRegn01Cmn.LoaMgrMotAgAvlSnsrlsResp -> LoaMgr.LoaMgrMotAgAvlSnsrlsResp
    connect CalRegn01Cmn.LoaMgrMotAgIdptSig0NoSnsrlsResp -> LoaMgr.LoaMgrMotAgIdptSig0NoSnsrlsResp
    connect CalRegn01Cmn.LoaMgrMotAgIdptSig1NoSnsrlsResp -> LoaMgr.LoaMgrMotAgIdptSig1NoSnsrlsResp
    connect CalRegn01Cmn.LoaMgrMotAgIdptSig2Resp -> LoaMgr.LoaMgrMotAgIdptSig2Resp
    connect CalRegn01Cmn.LoaMgrMotAgIdptSig3Resp -> LoaMgr.LoaMgrMotAgIdptSig3Resp
    connect CalRegn01Cmn.LoaMgrMotAgIdptSigFltThd -> LoaMgr.LoaMgrMotAgIdptSigFltThd
    connect CalRegn01Cmn.LoaMgrMotAgMtgtnRate -> LoaMgr.LoaMgrMotAgMtgtnRate
    connect CalRegn01Cmn.LoaMgrMotAgMtgtnSca -> LoaMgr.LoaMgrMotAgMtgtnSca
    connect CalRegn01Cmn.LoaMgrMotAgMtgtnScaZeroEna -> LoaMgr.LoaMgrMotAgMtgtnScaZeroEna
    connect CalRegn01Cmn.MotCtrlPrmEstimnFetRNom -> MotCtrlPrmEstimn.MotCtrlPrmEstimnFetRNom
    connect CalRegn01Cmn.MotCtrlPrmEstimnFetThermCoeff -> MotCtrlPrmEstimn.MotCtrlPrmEstimnFetThermCoeff
    connect CalRegn01Cmn.MotCtrlPrmEstimnMagThermCoeff -> MotCtrlPrmEstimn.MotCtrlPrmEstimnMagThermCoeff
    connect CalRegn01Cmn.MotCtrlPrmEstimnMotBackEmfConHiLim -> MotCtrlPrmEstimn.MotCtrlPrmEstimnMotBackEmfConHiLim
    connect CalRegn01Cmn.MotCtrlPrmEstimnMotBackEmfConLoLim -> MotCtrlPrmEstimn.MotCtrlPrmEstimnMotBackEmfConLoLim
    connect CalRegn01Cmn.MotCtrlPrmEstimnMotBackEmfConNom -> MotCtrlPrmEstimn.MotCtrlPrmEstimnMotBackEmfConNom
    connect CalRegn01Cmn.MotCtrlPrmEstimnMotBackEmfConSatnX -> MotCtrlPrmEstimn.MotCtrlPrmEstimnMotBackEmfConSatnX
    connect CalRegn01Cmn.MotCtrlPrmEstimnMotBackEmfConSatnY -> MotCtrlPrmEstimn.MotCtrlPrmEstimnMotBackEmfConSatnY
    connect CalRegn01Cmn.MotCtrlPrmEstimnMotCurrDaxInduSatnBilnrSeln -> MotCtrlPrmEstimn.MotCtrlPrmEstimnMotCurrDaxInduSatnBilnrSeln
    connect CalRegn01Cmn.MotCtrlPrmEstimnMotCurrQaxInduSatnX -> MotCtrlPrmEstimn.MotCtrlPrmEstimnMotCurrQaxInduSatnX
    connect CalRegn01Cmn.MotCtrlPrmEstimnMotInduDaxHiLim -> MotCtrlPrmEstimn.MotCtrlPrmEstimnMotInduDaxHiLim
    connect CalRegn01Cmn.MotCtrlPrmEstimnMotInduDaxLoLim -> MotCtrlPrmEstimn.MotCtrlPrmEstimnMotInduDaxLoLim
    connect CalRegn01Cmn.MotCtrlPrmEstimnMotInduDaxNom -> MotCtrlPrmEstimn.MotCtrlPrmEstimnMotInduDaxNom
    connect CalRegn01Cmn.MotCtrlPrmEstimnMotInduDaxSatnScaY -> MotCtrlPrmEstimn.MotCtrlPrmEstimnMotInduDaxSatnScaY
    connect CalRegn01Cmn.MotCtrlPrmEstimnMotInduQaxHiLim -> MotCtrlPrmEstimn.MotCtrlPrmEstimnMotInduQaxHiLim
    connect CalRegn01Cmn.MotCtrlPrmEstimnMotInduQaxLoLim -> MotCtrlPrmEstimn.MotCtrlPrmEstimnMotInduQaxLoLim
    connect CalRegn01Cmn.MotCtrlPrmEstimnMotInduQaxNom -> MotCtrlPrmEstimn.MotCtrlPrmEstimnMotInduQaxNom
    connect CalRegn01Cmn.MotCtrlPrmEstimnMotInduQaxSatnScaY -> MotCtrlPrmEstimn.MotCtrlPrmEstimnMotInduQaxSatnScaY
    connect CalRegn01Cmn.MotCtrlPrmEstimnMotRHiLim -> MotCtrlPrmEstimn.MotCtrlPrmEstimnMotRHiLim
    connect CalRegn01Cmn.MotCtrlPrmEstimnMotRLoLim -> MotCtrlPrmEstimn.MotCtrlPrmEstimnMotRLoLim
    connect CalRegn01Cmn.MotCtrlPrmEstimnMotRNom -> MotCtrlPrmEstimn.MotCtrlPrmEstimnMotRNom
    connect CalRegn01Cmn.MotCtrlPrmEstimnMotWidgThermCoeff -> MotCtrlPrmEstimn.MotCtrlPrmEstimnMotWidgThermCoeff
    connect CalRegn01Cmn.MotCtrlPrmEstimnTNom -> MotCtrlPrmEstimn.MotCtrlPrmEstimnTNom
    connect CalRegn01Cmn.MotCurrPeakEstimnCurrFilFrq -> MotCurrPeakEstimn.MotCurrPeakEstimnCurrFilFrq
    connect CalRegn01Cmn.MotCurrPeakEstimnCurrPeakEstimdFilFrq -> MotCurrPeakEstimn.MotCurrPeakEstimnCurrPeakEstimdFilFrq
    connect CalRegn01Cmn.MotCurrRegCfgCtrlrDynGainVehSpdCutOff -> MotCurrRegCfg.MotCurrRegCfgCtrlrDynGainVehSpdCutOff
    connect CalRegn01Cmn.MotCurrRegCfgMotAgCompuDly -> MotCurrRegCfg.MotCurrRegCfgMotAgCompuDly
    connect CalRegn01Cmn.MotCurrRegCfgMotClsdLoopBwDaxY -> MotCurrRegCfg.MotCurrRegCfgMotClsdLoopBwDaxY
    connect CalRegn01Cmn.MotCurrRegCfgMotClsdLoopBwQaxY -> MotCurrRegCfg.MotCurrRegCfgMotClsdLoopBwQaxY
    connect CalRegn01Cmn.MotCurrRegCfgMotDampgRatDax -> MotCurrRegCfg.MotCurrRegCfgMotDampgRatDax
    connect CalRegn01Cmn.MotCurrRegCfgMotDampgRatQax -> MotCurrRegCfg.MotCurrRegCfgMotDampgRatQax
    connect CalRegn01Cmn.MotCurrRegCfgMotNatFrqDaxY -> MotCurrRegCfg.MotCurrRegCfgMotNatFrqDaxY
    connect CalRegn01Cmn.MotCurrRegCfgMotNatFrqQaxY -> MotCurrRegCfg.MotCurrRegCfgMotNatFrqQaxY
    connect CalRegn01Cmn.MotCurrRegCfgMotRVirtDax -> MotCurrRegCfg.MotCurrRegCfgMotRVirtDax
    connect CalRegn01Cmn.MotCurrRegCfgMotRVirtQax -> MotCurrRegCfg.MotCurrRegCfgMotRVirtQax
    connect CalRegn01Cmn.MotCurrRegCfgMotVelFilFrq -> MotCurrRegCfg.MotCurrRegCfgMotVelFilFrq
    connect CalRegn01Cmn.MotRefMdlFbCtrlDi -> MotCurrRegCfg.MotRefMdlFbCtrlDi
    connect CalRegn01Cmn.MotDrvDiagcErrFilFrq -> MotDrvDiagc.MotDrvDiagcErrFilFrq
    connect CalRegn01Cmn.MotDrvDiagcErrOffs -> MotDrvDiagc.MotDrvDiagcErrOffs
    connect CalRegn01Cmn.MotDrvDiagcErrThd -> MotDrvDiagc.MotDrvDiagcErrThd
    connect CalRegn01Cmn.MotQuadDetnMotDirHysInsts -> MotQuadDetn.MotQuadDetnMotDirHysInsts
    connect CalRegn01Cmn.MotRefMdlCurrDaxBoostGain -> MotRefMdl.MotRefMdlCurrDaxBoostGain
    connect CalRegn01Cmn.MotRefMdlCurrDaxBoostTqScaX -> MotRefMdl.MotRefMdlCurrDaxBoostTqScaX
    connect CalRegn01Cmn.MotRefMdlCurrDaxBoostTqScaY -> MotRefMdl.MotRefMdlCurrDaxBoostTqScaY
    connect CalRegn01Cmn.MotRefMdlCurrDaxQaxRefDelta -> MotRefMdl.MotRefMdlCurrDaxQaxRefDelta
    connect CalRegn01Cmn.MotRefMdlFbCtrlDi -> MotRefMdl.MotRefMdlFbCtrlDi
    connect CalRegn01Cmn.MotRefMdlIvtrDeadTiBrdgVltgSca -> MotRefMdl.MotRefMdlIvtrDeadTiBrdgVltgSca
    connect CalRegn01Cmn.MotRefMdlMotCurrDaxMaxSca -> MotRefMdl.MotRefMdlMotCurrDaxMaxSca
    connect CalRegn01Cmn.MotRefMdlMotVelLpFilFrq -> MotRefMdl.MotRefMdlMotVelLpFilFrq
    connect CalRegn01Cmn.MotRefMdlMotVltgDerivtvTiCon -> MotRefMdl.MotRefMdlMotVltgDerivtvTiCon
    connect CalRegn01Cmn.MotRefMdlVltgModDynCmpEna -> MotRefMdl.MotRefMdlVltgModDynCmpEna
    connect CalRegn01Cmn.MotTqTranlDampgVehSpdBlndY -> MotTqTranlDampg.MotTqTranlDampgVehSpdBlndY
    connect CalRegn01Cmn.BattVltgSwdMax -> PwrDiscnct.BattVltgSwdMax
    connect CalRegn01Cmn.PwrDiscnctOpenThd -> PwrDiscnct.PwrDiscnctOpenThd
    connect CalRegn01Cmn.PwrLimrAssiRednLpFilFrq -> PwrLimr.PwrLimrAssiRednLpFilFrq
    connect CalRegn01Cmn.PwrLimrBackEmfConStdT -> PwrLimr.PwrLimrBackEmfConStdT
    connect CalRegn01Cmn.PwrLimrBrdgVltgAdjSlew -> PwrLimr.PwrLimrBrdgVltgAdjSlew
    connect CalRegn01Cmn.PwrLimrBrdgVltgAltFltAdj -> PwrLimr.PwrLimrBrdgVltgAltFltAdj
    connect CalRegn01Cmn.PwrLimrFilAssiRednThd -> PwrLimr.PwrLimrFilAssiRednThd
    connect CalRegn01Cmn.PwrLimrLoVoltAssiRcvrThd -> PwrLimr.PwrLimrLoVoltAssiRcvrThd
    connect CalRegn01Cmn.PwrLimrLoVoltAssiRcvrTi -> PwrLimr.PwrLimrLoVoltAssiRcvrTi
    connect CalRegn01Cmn.PwrLimrMotEnvlpX -> PwrLimr.PwrLimrMotEnvlpX
    connect CalRegn01Cmn.PwrLimrMotEnvlpY -> PwrLimr.PwrLimrMotEnvlpY
    connect CalRegn01Cmn.PwrLimrMotVelLpFilFrq -> PwrLimr.PwrLimrMotVelLpFilFrq
    connect CalRegn01Cmn.PwrLimrSpdAdjSlewDec -> PwrLimr.PwrLimrSpdAdjSlewDec
    connect CalRegn01Cmn.PwrLimrSpdAdjSlewEna -> PwrLimr.PwrLimrSpdAdjSlewEna
    connect CalRegn01Cmn.PwrLimrSpdAdjSlewInc -> PwrLimr.PwrLimrSpdAdjSlewInc
    connect CalRegn01Cmn.PwrLimrStdOperMotEnvlpX -> PwrLimr.PwrLimrStdOperMotEnvlpX
    connect CalRegn01Cmn.PwrLimrStdOperMotEnvlpY -> PwrLimr.PwrLimrStdOperMotEnvlpY
    connect CalRegn01Cmn.PwrLimrVltgDptMotVelOffsX -> PwrLimr.PwrLimrVltgDptMotVelOffsX
    connect CalRegn01Cmn.PwrLimrVltgDptMotVelOffsY -> PwrLimr.PwrLimrVltgDptMotVelOffsY
    connect CalRegn01Cmn.PwrSplyNtc0x07BFailStep -> PwrSply.PwrSplyNtc0x07BFailStep
    connect CalRegn01Cmn.PwrSplyNtc0x07BPassStep -> PwrSply.PwrSplyNtc0x07BPassStep
    connect CalRegn01Cmn.PwrSplyNtc0x07CFailStep -> PwrSply.PwrSplyNtc0x07CFailStep
    connect CalRegn01Cmn.PwrSplyNtc0x07CPassStep -> PwrSply.PwrSplyNtc0x07CPassStep
    connect CalRegn01Cmn.PwrSplyNtc0x07DFailStep -> PwrSply.PwrSplyNtc0x07DFailStep
    connect CalRegn01Cmn.PwrSplyNtc0x07DPassStep -> PwrSply.PwrSplyNtc0x07DPassStep
    connect CalRegn01Cmn.VehSigCdngDftLatA -> VehSigCdng.VehSigCdngDftLatA
    connect CalRegn01Cmn.VehSigCdngDftLgtA -> VehSigCdng.VehSigCdngDftLgtA
    connect CalRegn01Cmn.VehSigCdngDftVehSpd -> VehSigCdng.VehSigCdngDftVehSpd
    connect CalRegn01Cmn.VehSigCdngDftYawRate -> VehSigCdng.VehSigCdngDftYawRate
    connect CalRegn01Cmn.VehSigCdngLatADifThd -> VehSigCdng.VehSigCdngLatADifThd
    connect CalRegn01Cmn.VehSigCdngLatAFilFrq -> VehSigCdng.VehSigCdngLatAFilFrq
    connect CalRegn01Cmn.VehSigCdngLtgADifThd -> VehSigCdng.VehSigCdngLtgADifThd
    connect CalRegn01Cmn.VehSigCdngVehSpdDifThd -> VehSigCdng.VehSigCdngVehSpdDifThd
    connect CalRegn01Cmn.VehSigCdngVehYawSlewRate -> VehSigCdng.VehSigCdngVehYawSlewRate
    connect CalRegn01Cmn.VehSigCdngYawRateDifThd -> VehSigCdng.VehSigCdngYawRateDifThd
    connect CalRegn01Cmn.VehSpdLimrMaxAssiX -> VehSpdLimr.VehSpdLimrMaxAssiX
    connect CalRegn01Cmn.VehSpdLimrMaxAssiY -> VehSpdLimr.VehSpdLimrMaxAssiY
    connect CalRegn01Cmn.VehSpdLimrPosMaxOffs1 -> VehSpdLimr.VehSpdLimrPosMaxOffs1
    connect CalRegn01Cmn.VehSpdLimrPosMaxOffs2 -> VehSpdLimr.VehSpdLimrPosMaxOffs2
    connect CalRegn01Inin00.SysGlbPrmMotPoleCnt -> CDD_CurrMeas.SysGlbPrmMotPoleCnt
    connect CalRegn01Inin00.HwTq0MeasHwTq0PrtclFltFailStep -> CDD_HwTq0Meas.HwTq0MeasHwTq0PrtclFltFailStep
    connect CalRegn01Inin00.HwTq0MeasHwTq0PrtclFltPassStep -> CDD_HwTq0Meas.HwTq0MeasHwTq0PrtclFltPassStep
    connect CalRegn01Inin00.HwTq1MeasHwTq1PrtclFltFailStep -> CDD_HwTq1Meas.HwTq1MeasHwTq1PrtclFltFailStep
    connect CalRegn01Inin00.HwTq1MeasHwTq1PrtclFltPassStep -> CDD_HwTq1Meas.HwTq1MeasHwTq1PrtclFltPassStep
    connect CalRegn01Inin00.SysGlbPrmMotPoleCnt -> CDD_MotAgCmp.SysGlbPrmMotPoleCnt
    connect CalRegn01Inin00.GmVehPwrModOperRampRate -> GmVehPwrMod.GmVehPwrModOperRampRate
    connect CalRegn01Inin00.HiLoadStallLimrMotTqCmdFilFrq -> HiLoadStallLimr.HiLoadStallLimrMotTqCmdFilFrq
    connect CalRegn01Inin00.HiLoadStallLimrMotVelMgnThd -> HiLoadStallLimr.HiLoadStallLimrMotVelMgnThd
    connect CalRegn01Inin00.HiLoadStallLimrStallMotTqCmdLimX -> HiLoadStallLimr.HiLoadStallLimrStallMotTqCmdLimX
    connect CalRegn01Inin00.HiLoadStallLimrStallMotTqCmdLimY -> HiLoadStallLimr.HiLoadStallLimrStallMotTqCmdLimY
    connect CalRegn01Inin00.HiLoadStallLimrStallMotTqLimSlewRate -> HiLoadStallLimr.HiLoadStallLimrStallMotTqLimSlewRate
    connect CalRegn01Inin00.HwAg0MeasHwAg0IfFltFailStep -> HwAg0Meas.HwAg0MeasHwAg0IfFltFailStep
    connect CalRegn01Inin00.HwAg0MeasHwAg0IfFltPassStep -> HwAg0Meas.HwAg0MeasHwAg0IfFltPassStep
    connect CalRegn01Inin00.HwAg0MeasHwAg0Snsr0PrtclFltFailStep -> HwAg0Meas.HwAg0MeasHwAg0Snsr0PrtclFltFailStep
    connect CalRegn01Inin00.HwAg0MeasHwAg0Snsr0PrtclFltPassStep -> HwAg0Meas.HwAg0MeasHwAg0Snsr0PrtclFltPassStep
    connect CalRegn01Inin00.HwAg0MeasHwAg0Snsr1PrtclFltFailStep -> HwAg0Meas.HwAg0MeasHwAg0Snsr1PrtclFltFailStep
    connect CalRegn01Inin00.HwAg0MeasHwAg0Snsr1PrtclFltPassStep -> HwAg0Meas.HwAg0MeasHwAg0Snsr1PrtclFltPassStep
    connect CalRegn01Inin00.HwAg0MeasSnsr0Rev -> HwAg0Meas.HwAg0MeasSnsr0Rev
    connect CalRegn01Inin00.HwAg0MeasSnsr1Rev -> HwAg0Meas.HwAg0MeasSnsr1Rev
    connect CalRegn01Inin00.HwAg0MeasStep -> HwAg0Meas.HwAg0MeasStep
    connect CalRegn01Inin00.HwAg0MeasVrnrErrThd -> HwAg0Meas.HwAg0MeasVrnrErrThd
    connect CalRegn01Inin00.HwAg1MeasHwAg1IfFltFailStep -> HwAg1Meas.HwAg1MeasHwAg1IfFltFailStep
    connect CalRegn01Inin00.HwAg1MeasHwAg1IfFltPassStep -> HwAg1Meas.HwAg1MeasHwAg1IfFltPassStep
    connect CalRegn01Inin00.HwAg1MeasHwAg1Snsr0PrtclFltFailStep -> HwAg1Meas.HwAg1MeasHwAg1Snsr0PrtclFltFailStep
    connect CalRegn01Inin00.HwAg1MeasHwAg1Snsr0PrtclFltPassStep -> HwAg1Meas.HwAg1MeasHwAg1Snsr0PrtclFltPassStep
    connect CalRegn01Inin00.HwAg1MeasHwAg1Snsr1PrtclFltFailStep -> HwAg1Meas.HwAg1MeasHwAg1Snsr1PrtclFltFailStep
    connect CalRegn01Inin00.HwAg1MeasHwAg1Snsr1PrtclFltPassStep -> HwAg1Meas.HwAg1MeasHwAg1Snsr1PrtclFltPassStep
    connect CalRegn01Inin00.HwAg1MeasSnsr0Rev -> HwAg1Meas.HwAg1MeasSnsr0Rev
    connect CalRegn01Inin00.HwAg1MeasSnsr1Rev -> HwAg1Meas.HwAg1MeasSnsr1Rev
    connect CalRegn01Inin00.HwAg1MeasStep -> HwAg1Meas.HwAg1MeasStep
    connect CalRegn01Inin00.HwAg1MeasVrnrErrThd -> HwAg1Meas.HwAg1MeasVrnrErrThd
    connect CalRegn01Inin00.SysGlbPrmTorsBarStfn -> InertiaCmpVel.SysGlbPrmTorsBarStfn
    connect CalRegn01Inin00.LimrCdngGainDecSlew -> LimrCdng.LimrCdngGainDecSlew
    connect CalRegn01Inin00.LimrCdngGainIncSlewX -> LimrCdng.LimrCdngGainIncSlewX
    connect CalRegn01Inin00.LimrCdngGainIncSlewY -> LimrCdng.LimrCdngGainIncSlewY
    connect CalRegn01Inin00.LimrCdngTqDecSlew -> LimrCdng.LimrCdngTqDecSlew
    connect CalRegn01Inin00.LimrCdngTqIncSlewX -> LimrCdng.LimrCdngTqIncSlewX
    connect CalRegn01Inin00.LimrCdngTqIncSlewY -> LimrCdng.LimrCdngTqIncSlewY
    connect CalRegn01Inin00.SysGlbPrmMotPoleCnt -> MotAgCorrln.SysGlbPrmMotPoleCnt
    connect CalRegn01Inin00.SysGlbPrmMotPoleCnt -> MotCurrRegCfg.SysGlbPrmMotPoleCnt
    connect CalRegn01Inin00.SysGlbPrmMotPoleCnt -> MotRefMdl.SysGlbPrmMotPoleCnt
    connect CalRegn01Inin00.MotTqTranlDampgCmdLim -> MotTqTranlDampg.MotTqTranlDampgCmdLim
    connect CalRegn01Inin00.MotTqTranlDampgDampgCoeff -> MotTqTranlDampg.MotTqTranlDampgDampgCoeff
    connect CalRegn01Inin00.MotTqTranlDampgRampEnd -> MotTqTranlDampg.MotTqTranlDampgRampEnd
    connect CalRegn01Inin00.MotTqTranlDampgTmrPt1 -> MotTqTranlDampg.MotTqTranlDampgTmrPt1
    connect CalRegn01Inin00.MotTqTranlDampgTmrPt2 -> MotTqTranlDampg.MotTqTranlDampgTmrPt2
    connect CalRegn01Inin00.MotTqTranlDampgVehSpdBlndX -> MotTqTranlDampg.MotTqTranlDampgVehSpdBlndX
    connect CalRegn01Inin00.MotTqTranlDampgVelThd -> MotTqTranlDampg.MotTqTranlDampgVelThd
    connect CalRegn01Inin00.PwrDiscnctNtc0x042FailStep -> PwrDiscnct.PwrDiscnctNtc0x042FailStep
    connect CalRegn01Inin00.PwrDiscnctNtc0x042PassStep -> PwrDiscnct.PwrDiscnctNtc0x042PassStep
    connect CalRegn01Inin00.PwrDiscnctNtc0x04AFailStep -> PwrDiscnct.PwrDiscnctNtc0x04AFailStep
    connect CalRegn01Inin00.PwrDiscnctNtc0x04APassStep -> PwrDiscnct.PwrDiscnctNtc0x04APassStep
    connect CalRegn01Inin00.TEstimnAmbPwrMplr -> TEstimn.TEstimnAmbPwrMplr
    connect CalRegn01Inin00.TEstimnAmbTSca -> TEstimn.TEstimnAmbTSca
    connect CalRegn01Inin00.TEstimnAssiMechAmbLpFilFrq -> TEstimn.TEstimnAssiMechAmbLpFilFrq
    connect CalRegn01Inin00.TEstimnAssiMechAmbMplr -> TEstimn.TEstimnAssiMechAmbMplr
    connect CalRegn01Inin00.TEstimnAssiMechCorrLim -> TEstimn.TEstimnAssiMechCorrLim
    connect CalRegn01Inin00.TEstimnAssiMechDampgSca -> TEstimn.TEstimnAssiMechDampgSca
    connect CalRegn01Inin00.TEstimnAssiMechDftT -> TEstimn.TEstimnAssiMechDftT
    connect CalRegn01Inin00.TEstimnAssiMechLLFilCoeffA1 -> TEstimn.TEstimnAssiMechLLFilCoeffA1
    connect CalRegn01Inin00.TEstimnAssiMechLLFilCoeffB0 -> TEstimn.TEstimnAssiMechLLFilCoeffB0
    connect CalRegn01Inin00.TEstimnAssiMechLLFilCoeffB1 -> TEstimn.TEstimnAssiMechLLFilCoeffB1
    connect CalRegn01Inin00.TEstimnAssiMechSlew -> TEstimn.TEstimnAssiMechSlew
    connect CalRegn01Inin00.TEstimnCorrnTAssiMech -> TEstimn.TEstimnCorrnTAssiMech
    connect CalRegn01Inin00.TEstimnCorrnTCu -> TEstimn.TEstimnCorrnTCu
    connect CalRegn01Inin00.TEstimnCorrnTMag -> TEstimn.TEstimnCorrnTMag
    connect CalRegn01Inin00.TEstimnCorrnTSi -> TEstimn.TEstimnCorrnTSi
    connect CalRegn01Inin00.TEstimnCuAmbLpFilFrq -> TEstimn.TEstimnCuAmbLpFilFrq
    connect CalRegn01Inin00.TEstimnCuAmbMplr -> TEstimn.TEstimnCuAmbMplr
    connect CalRegn01Inin00.TEstimnCuCorrnLim -> TEstimn.TEstimnCuCorrnLim
    connect CalRegn01Inin00.TEstimnCuLLFilCoeffA1 -> TEstimn.TEstimnCuLLFilCoeffA1
    connect CalRegn01Inin00.TEstimnCuLLFilCoeffB0 -> TEstimn.TEstimnCuLLFilCoeffB0
    connect CalRegn01Inin00.TEstimnCuLLFilCoeffB1 -> TEstimn.TEstimnCuLLFilCoeffB1
    connect CalRegn01Inin00.TEstimnEngTSca -> TEstimn.TEstimnEngTSca
    connect CalRegn01Inin00.TEstimnMagAmbLpFilFrq -> TEstimn.TEstimnMagAmbLpFilFrq
    connect CalRegn01Inin00.TEstimnMagCorrnLim -> TEstimn.TEstimnMagCorrnLim
    connect CalRegn01Inin00.TEstimnMagLLFilCoeffA1 -> TEstimn.TEstimnMagLLFilCoeffA1
    connect CalRegn01Inin00.TEstimnMagLLFilCoeffB0 -> TEstimn.TEstimnMagLLFilCoeffB0
    connect CalRegn01Inin00.TEstimnMagLLFilCoeffB1 -> TEstimn.TEstimnMagLLFilCoeffB1
    connect CalRegn01Inin00.TEstimnSiAmbLpFilFrq -> TEstimn.TEstimnSiAmbLpFilFrq
    connect CalRegn01Inin00.TEstimnSiAmbMplr -> TEstimn.TEstimnSiAmbMplr
    connect CalRegn01Inin00.TEstimnSiCorrnLim -> TEstimn.TEstimnSiCorrnLim
    connect CalRegn01Inin00.TEstimnSiLLFilCoeffA1 -> TEstimn.TEstimnSiLLFilCoeffA1
    connect CalRegn01Inin00.TEstimnSiLLFilCoeffB0 -> TEstimn.TEstimnSiLLFilCoeffB0
    connect CalRegn01Inin00.TEstimnSiLLFilCoeffB1 -> TEstimn.TEstimnSiLLFilCoeffB1
    connect CalRegn01Inin00.TEstimnWghtAvrgTDi -> TEstimn.TEstimnWghtAvrgTDi
    connect CalRegn01Inin00.VehSigCdngLatASlewRate -> VehSigCdng.VehSigCdngLatASlewRate
    connect CalRegn01Inin00.VehSigCdngLtgASlewRate -> VehSigCdng.VehSigCdngLtgASlewRate
    connect CalRegn01Inin00.VehSigCdngVehSpdSlewRate -> VehSigCdng.VehSigCdngVehSpdSlewRate
    connect CalRegn01Rt00.TEstimnMagAmbMplr -> TEstimn.TEstimnMagAmbMplr
    connect CalRegn02Cmn.DiagcMgrFltResp -> DiagcMgr.DiagcMgrFltResp
    connect CalRegn02Cmn.DiagcMgrFltResp -> DiagcMgrProxyAppl10.DiagcMgrFltResp
    connect CalRegn02Cmn.DiagcMgrFltResp -> DiagcMgrProxyAppl6.DiagcMgrFltResp
    connect CalRegn03Cmn.DampgQuadHwTqBacklsh -> Dampg.DampgQuadHwTqBacklsh
    connect CalRegn03Cmn.DampgQuadMotVelBacklsh -> Dampg.DampgQuadMotVelBacklsh
    connect CalRegn03CmnGroupA.DampgHwTqX -> Dampg.DampgHwTqX
    connect CalRegn03CmnGroupA.DampgHwTqY -> Dampg.DampgHwTqY
    connect CalRegn03CmnGroupA.RtnVehSpdSeln -> Rtn.RtnVehSpdSeln
    connect CalRegn03Inin00.DampgHydAssiLim -> Dampg.DampgHydAssiLim
    connect CalRegn03Inin00.DampgHydBasCoeff{1..4} -> Dampg.DampgHydBasCoeff{1..4}
    connect CalRegn03Inin00.DampgHydOutpLim -> Dampg.DampgHydOutpLim
    connect CalRegn03Inin00.DampgMotVelLpFilFrq -> Dampg.DampgMotVelLpFilFrq
    connect CalRegn03Inin00.DampgQuad13Mplr -> Dampg.DampgQuad13Mplr
    connect CalRegn03Inin00.DampgQuad24Mplr -> Dampg.DampgQuad24Mplr
    connect CalRegn03Inin00.DampgQuadHwTqLpFilFrq -> Dampg.DampgQuadHwTqLpFilFrq
    connect CalRegn03Inin00.DampgQuadMotVelLpFilFrq -> Dampg.DampgQuadMotVelLpFilFrq
    connect CalRegn03Inin00.DampgQuadScaLpFilFrq -> Dampg.DampgQuadScaLpFilFrq
    connect CalRegn03Inin00.HysCmpAssiCmdLpFilFrq -> HysCmp.HysCmpAssiCmdLpFilFrq
    connect CalRegn03Inin00.HysCmpFinalOutpLpFilFrq -> HysCmp.HysCmpFinalOutpLpFilFrq
    connect CalRegn03Inin00.HysCmpHwTqLpFilFrq -> HysCmp.HysCmpHwTqLpFilFrq
    connect CalRegn03Inin00.RtnHwAuthyScaX -> Rtn.RtnHwAuthyScaX
    connect CalRegn03Inin00.RtnHwAuthyScaY -> Rtn.RtnHwAuthyScaY
    connect CalRegn03Inin00.RtnHwAuthySlew -> Rtn.RtnHwAuthySlew
    connect CalRegn03Inin00.RtnOffsRng -> Rtn.RtnOffsRng
    connect CalRegn03Inin00.RtnOffsSlew -> Rtn.RtnOffsSlew
    connect CalRegn03Inin00GroupA.DampgTScaX -> Dampg.DampgTScaX
    connect CalRegn03Inin00GroupA.DampgTScaY -> Dampg.DampgTScaY
    connect CalRegn03Rt00GroupA.AssiMotTqWhlImbRejctnMinX -> Assi.AssiMotTqWhlImbRejctnMinX
    connect CalRegn03Rt00GroupA.AssiMotTqWhlImbRejctnMinY -> Assi.AssiMotTqWhlImbRejctnMinY
    connect CalRegn03Rt00GroupA.AssiHiFrqGainY -> AssiHiFrq.AssiHiFrqGainY
    connect CalRegn03Rt00GroupA.AssiHiFrqTqX -> AssiHiFrq.AssiHiFrqTqX
    connect CalRegn03Rt00GroupA.DampgHydCoeff{1..4}ScaY -> Dampg.DampgHydCoeff{1..4}ScaY
    connect CalRegn03Rt00GroupA.DampgMotVelX -> Dampg.DampgMotVelX
    connect CalRegn03Rt00GroupA.DampgMotVelY -> Dampg.DampgMotVelY
    connect CalRegn03Rt00GroupB.AssiMotTqWhlImbRejctnMaxX -> Assi.AssiMotTqWhlImbRejctnMaxX
    connect CalRegn03Rt00GroupB.AssiMotTqWhlImbRejctnMaxY -> Assi.AssiMotTqWhlImbRejctnMaxY
    connect CalRegn03Rt00GroupB.AssiWhlImbRejctnBlndScaX -> Assi.AssiWhlImbRejctnBlndScaX
    connect CalRegn03Rt00GroupB.AssiWhlImbRejctnBlndScaY -> Assi.AssiWhlImbRejctnBlndScaY
    connect CalRegn03Rt00GroupB.AssiHiFrqTqWhlImbRejctnTqX -> AssiHiFrq.AssiHiFrqTqWhlImbRejctnTqX
    connect CalRegn03Rt00GroupB.AssiHiFrqWhlImbRejctnGainY -> AssiHiFrq.AssiHiFrqWhlImbRejctnGainY
    connect CalRegn03Rt00GroupB.AssiHiFrqWhlImbRejtcnBlndX -> AssiHiFrq.AssiHiFrqWhlImbRejtcnBlndX
    connect CalRegn03Rt00GroupB.AssiHiFrqWhlImbRejtcnBlndY -> AssiHiFrq.AssiHiFrqWhlImbRejtcnBlndY
    connect CDD_Adc1CfgAndUse.Adc1CfgAndUseAdc1EnaCnvn -> CDD_DmaCfgAndUse.Adc1CfgAndUseAdc1EnaCnvn
    connect CDD_CurrMeas.CurrMeasWrmIninTestCmpl -> CDD_MotCtrlMgr.CurrMeasWrmIninTestCmpl
    connect CDD_CurrMeas.MotCurrEolCalSt -> CDD_MotCtrlMgr.MotCurrEolCalSt
    connect CDD_CurrMeas.MotCurrEolCalSt -> CDD_TSG31CfgAndUse.MotCurrEolCalSt
    connect CDD_CurrMeas.CurrMeasEolGainReq -> CmnMfgSrv.CurrMeasEolGainReq
    connect CDD_CurrMeas.CurrMeasEolOffsReq -> CmnMfgSrv.CurrMeasEolOffsReq
    connect CDD_CurrMeas.CurrMeasGainReadReq -> CmnMfgSrv.CurrMeasGainReadReq
    connect CDD_CurrMeas.CurrMeasOffsReadReq -> CmnMfgSrv.CurrMeasOffsReadReq
    connect CDD_CurrMeas.MotCurrEolCalSt -> CurrMeasCorrln.MotCurrEolCalSt
    connect CDD_CurrMeas.MotCurrEolCalSt -> MotCurrRegCfg.MotCurrEolCalSt
    connect CDD_CurrMeas.CurrMeasWrmIninTestCmpl -> PwrUpSeq.CurrMeasWrmIninTestCmpl
    connect CDD_DmaCfgAndUse.DmaEna2MilliSecToMotCtrlTrf -> CDD_MotCtrlMgr.DmaEna2MilliSecToMotCtrlTrf
    connect CDD_DmaCfgAndUse.DmaWaitForMotCtrlTo2MilliSecTrf -> CDD_MotCtrlMgr.DmaWaitForMotCtrlTo2MilliSecTrf
    connect CDD_EcmOutpAndDiagc.CtrlErrOut -> TmplMonr.CtrlErrOut
    connect CDD_GmG2kcaMcuCfg.BattVltg -> BattVltg.BattVltg
    connect CDD_GmG2kcaMcuCfg.BattVltgSwd1 -> BattVltg.BattVltgSwd1
    connect CDD_GmG2kcaMcuCfg.BattVltgSwd2 -> BattVltg.BattVltgSwd2
    connect CDD_GmG2kcaMcuCfg.BattVltg -> BattVltgCorrln.BattVltg
    connect CDD_GmG2kcaMcuCfg.BattVltgSwd1 -> BattVltgCorrln.BattVltgSwd1
    connect CDD_GmG2kcaMcuCfg.BattVltgSwd2 -> BattVltgCorrln.BattVltgSwd2
    connect CDD_GmG2kcaMcuCfg.EcuT -> EcuTMeas.EcuT
    connect CDD_GmG2kcaMcuCfg.BattVltg -> PwrDiscnct.BattVltg
    connect CDD_GmG2kcaMcuCfg.BattVltgSwd1 -> PwrDiscnct.BattVltgSwd1
    connect CDD_GmG2kcaMcuCfg.BattVltgSwd2 -> PwrDiscnct.BattVltgSwd2
    connect CDD_HwTq0Meas.HwTq0MeasHwTq0AutTrim -> CmnMfgSrv.HwTq0MeasHwTq0AutTrim
    connect CDD_HwTq0Meas.HwTq0MeasHwTq0ClrTrim -> CmnMfgSrv.HwTq0MeasHwTq0ClrTrim
    connect CDD_HwTq0Meas.HwTq0MeasHwTq0ReadTrim -> CmnMfgSrv.HwTq0MeasHwTq0ReadTrim
    connect CDD_HwTq0Meas.HwTq0MeasHwTq0TrimPrfmdSts -> CmnMfgSrv.HwTq0MeasHwTq0TrimPrfmdSts
    connect CDD_HwTq0Meas.HwTq0MeasHwTq0WrTrim -> CmnMfgSrv.HwTq0MeasHwTq0WrTrim
    connect CDD_HwTq0Meas.RackLimrEotSig0Avl -> EotLrng.HwAgEotSig0Avl
    connect CDD_HwTq0Meas.RackLimrCcwEotSig0 -> EotLrng.HwAgEotSig0Ccw
    connect CDD_HwTq0Meas.RackLimrCwEotSig0 -> EotLrng.HwAgEotSig0Cw
    connect CDD_HwTq0Meas.HwTq0 -> HwTqArbn.HwTqA
    connect CDD_HwTq0Meas.HwTq0Qlfr -> HwTqArbn.HwTqAQlfr
    connect CDD_HwTq0Meas.HwTq0RollgCntr -> HwTqArbn.HwTqARollgCntr
    connect CDD_HwTq0Meas.HwTq0 -> HwTqCorrln.HwTqA
    connect CDD_HwTq0Meas.HwTq0Qlfr -> HwTqCorrln.HwTqAQlfr
    connect CDD_HwTq0Meas.HwTq0RollgCntr -> HwTqCorrln.HwTqARollgCntr
    connect CDD_HwTq1Meas.HwTq1MeasHwTq1AutTrim -> CmnMfgSrv.HwTq1MeasHwTq1AutTrim
    connect CDD_HwTq1Meas.HwTq1MeasHwTq1ClrTrim -> CmnMfgSrv.HwTq1MeasHwTq1ClrTrim
    connect CDD_HwTq1Meas.HwTq1MeasHwTq1ReadTrim -> CmnMfgSrv.HwTq1MeasHwTq1ReadTrim
    connect CDD_HwTq1Meas.HwTq1MeasHwTq1TrimPrfmdSts -> CmnMfgSrv.HwTq1MeasHwTq1TrimPrfmdSts
    connect CDD_HwTq1Meas.HwTq1MeasHwTq1WrTrim -> CmnMfgSrv.HwTq1MeasHwTq1WrTrim
    connect CDD_HwTq1Meas.RackLimrEotSig1Avl -> EotLrng.HwAgEotSig1Avl
    connect CDD_HwTq1Meas.RackLimrCcwEotSig1 -> EotLrng.HwAgEotSig1Ccw
    connect CDD_HwTq1Meas.RackLimrCwEotSig1 -> EotLrng.HwAgEotSig1Cw
    connect CDD_HwTq1Meas.HwTq1 -> HwTqArbn.HwTqB
    connect CDD_HwTq1Meas.HwTq1Qlfr -> HwTqArbn.HwTqBQlfr
    connect CDD_HwTq1Meas.HwTq1RollgCntr -> HwTqArbn.HwTqBRollgCntr
    connect CDD_HwTq1Meas.HwTq1 -> HwTqCorrln.HwTqB
    connect CDD_HwTq1Meas.HwTq1Qlfr -> HwTqCorrln.HwTqBQlfr
    connect CDD_HwTq1Meas.HwTq1RollgCntr -> HwTqCorrln.HwTqBRollgCntr
    connect CDD_HwTq2Meas.HwTq2MeasHwTq2AutTrim -> CmnMfgSrv.HwTq2MeasHwTq2AutTrim
    connect CDD_HwTq2Meas.HwTq2MeasHwTq2ClrTrim -> CmnMfgSrv.HwTq2MeasHwTq2ClrTrim
    connect CDD_HwTq2Meas.HwTq2MeasHwTq2ReadTrim -> CmnMfgSrv.HwTq2MeasHwTq2ReadTrim
    connect CDD_HwTq2Meas.HwTq2MeasHwTq2TrimPrfmdSts -> CmnMfgSrv.HwTq2MeasHwTq2TrimPrfmdSts
    connect CDD_HwTq2Meas.HwTq2MeasHwTq2WrTrim -> CmnMfgSrv.HwTq2MeasHwTq2WrTrim
    connect CDD_HwTq2Meas.HwTq2 -> HwTqArbn.HwTqC
    connect CDD_HwTq2Meas.HwTq2Qlfr -> HwTqArbn.HwTqCQlfr
    connect CDD_HwTq2Meas.HwTq2RollgCntr -> HwTqArbn.HwTqCRollgCntr
    connect CDD_HwTq2Meas.HwTq2 -> HwTqCorrln.HwTqC
    connect CDD_HwTq2Meas.HwTq2Qlfr -> HwTqCorrln.HwTqCQlfr
    connect CDD_HwTq2Meas.HwTq2RollgCntr -> HwTqCorrln.HwTqCRollgCntr
    connect CDD_HwTq3Meas.HwTq3MeasHwTq3AutTrim -> CmnMfgSrv.HwTq3MeasHwTq3AutTrim
    connect CDD_HwTq3Meas.HwTq3MeasHwTq3ClrTrim -> CmnMfgSrv.HwTq3MeasHwTq3ClrTrim
    connect CDD_HwTq3Meas.HwTq3MeasHwTq3ReadTrim -> CmnMfgSrv.HwTq3MeasHwTq3ReadTrim
    connect CDD_HwTq3Meas.HwTq3MeasHwTq3TrimPrfmdSts -> CmnMfgSrv.HwTq3MeasHwTq3TrimPrfmdSts
    connect CDD_HwTq3Meas.HwTq3MeasHwTq3WrTrim -> CmnMfgSrv.HwTq3MeasHwTq3WrTrim
    connect CDD_HwTq3Meas.HwTq3 -> HwTqArbn.HwTqD
    connect CDD_HwTq3Meas.HwTq3Qlfr -> HwTqArbn.HwTqDQlfr
    connect CDD_HwTq3Meas.HwTq3RollgCntr -> HwTqArbn.HwTqDRollgCntr
    connect CDD_HwTq3Meas.HwTq3 -> HwTqCorrln.HwTqD
    connect CDD_HwTq3Meas.HwTq3Qlfr -> HwTqCorrln.HwTqDQlfr
    connect CDD_HwTq3Meas.HwTq3RollgCntr -> HwTqCorrln.HwTqDRollgCntr
    connect CDD_MotAg0Meas.MotAg0MeclQlfr -> CDD_MotCtrlMgr.MotAg0MeclQlfr
    connect CDD_MotAg0Meas.MotAg0MeclQlfr -> MotAgCorrln.MotAgAMeclQlfr
    connect CDD_MotAg1Meas.MotAg1MeclQlfr -> CDD_MotCtrlMgr.MotAg1MeclQlfr
    connect CDD_MotAg1Meas.MotAg1MeclQlfr -> MotAgCorrln.MotAgBMeclQlfr
    connect CDD_MotAgCmp.MotAgCmpBackEmfRead -> CmnMfgSrv.MotAgCmpBackEmfRead
    connect CDD_MotAgCmp.MotAgCmpBackEmfWr -> CmnMfgSrv.MotAgCmpBackEmfWr
    connect CDD_MotAgCmp.MotAgCumvAlgndMrf -> MotQuadDetn.MotAgCumvAlgndMrf
    connect CDD_MotCtrlMgr.MotCurrAdcVlyA -> CDD_CurrMeas.MotCurrAdcVlyA
    connect CDD_MotCtrlMgr.MotCurrAdcVlyB -> CDD_CurrMeas.MotCurrAdcVlyB
    connect CDD_MotCtrlMgr.MotCurrAdcVlyC -> CDD_CurrMeas.MotCurrAdcVlyC
    connect CDD_MotCtrlMgr.Ntc5DErrCnt -> CDD_CurrMeas.Ntc5DErrCnt
    connect CDD_MotCtrlMgr.Ntc6DErrCnt -> CDD_CurrMeas.Ntc6DErrCnt
    connect CDD_MotCtrlMgr.MotAgCumvAlgndMrfRev -> CDD_MotAgCmp.MotAgCumvAlgndMrfRev
    connect CDD_MotCtrlMgr.MotAgBuf -> CDD_MotVel.MotAgBuf
    connect CDD_MotCtrlMgr.MotAgBufIdx -> CDD_MotVel.MotAgBufIdx
    connect CDD_MotCtrlMgr.MotAgTiBuf -> CDD_MotVel.MotAgTiBuf
    connect CDD_MotCtrlMgr.MotCurrCorrdA -> CurrMeasCorrln.MotCurrCorrdA
    connect CDD_MotCtrlMgr.MotCurrCorrdB -> CurrMeasCorrln.MotCurrCorrdB
    connect CDD_MotCtrlMgr.MotCurrCorrdC -> CurrMeasCorrln.MotCurrCorrdC
    connect CDD_MotCtrlMgr.MotCurrCorrdD -> CurrMeasCorrln.MotCurrCorrdD
    connect CDD_MotCtrlMgr.MotCurrCorrdE -> CurrMeasCorrln.MotCurrCorrdE
    connect CDD_MotCtrlMgr.MotCurrCorrdF -> CurrMeasCorrln.MotCurrCorrdF
    connect CDD_MotCtrlMgr.MotCurrRollgCntr1 -> CurrMeasCorrln.MotCurrRollgCntr1
    connect CDD_MotCtrlMgr.MotCurrRollgCntr2 -> CurrMeasCorrln.MotCurrRollgCntr2
    connect CDD_MotCtrlMgr.MotAg0Mecl -> MotAgCorrln.MotAgAMecl
    connect CDD_MotCtrlMgr.MotAg1Mecl -> MotAgCorrln.MotAgBMecl
    connect CDD_MotCtrlMgr.MotCurrDax -> MotCurrPeakEstimn.MotCurrDax
    connect CDD_MotCtrlMgr.MotCurrQax -> MotCurrPeakEstimn.MotCurrQax
    connect CDD_MotCtrlMgr.PhaOnTiSumA -> MotDrvDiagc.PhaOnTiSumA
    connect CDD_MotCtrlMgr.PhaOnTiSumB -> MotDrvDiagc.PhaOnTiSumB
    connect CDD_MotCtrlMgr.PhaOnTiSumC -> MotDrvDiagc.PhaOnTiSumC
    connect CDD_MotVel.MotVelMrf -> CDD_CurrMeas.MotVelMrf
    connect CDD_MotVel.MotVelMrf -> CDD_MotCtrlMgr.MotVelMrf
    connect CDD_MotVel.MotVelCrf -> Dampg.MotVelCrf
    connect CDD_MotVel.MotVelCrf -> DutyCycThermProtn.MotVelCrf
    connect CDD_MotVel.MotVelCrf -> EotLrng.MotVelCrf
    connect CDD_MotVel.MotVelCrf -> EotProtn.MotVelCrf
    connect CDD_MotVel.HwVel -> FltInj.HwVel
    connect CDD_MotVel.HwVel -> GmMsg1E5BusChassisExp.HwVel
    connect CDD_MotVel.HwVel -> GmMsg1E5BusHiSpd.HwVel
    connect CDD_MotVel.HwVel -> GmStrtStop.HwVel
    connect CDD_MotVel.MotVelCrf -> HiLoadStallLimr.MotVelCrf
    connect CDD_MotVel.MotVelCrf -> InertiaCmpVel.MotVelCrf
    connect CDD_MotVel.MotVelMrf -> MotCurrRegCfg.MotVelMrf
    connect CDD_MotVel.MotVelMrf -> MotRefMdl.MotVelMrf
    connect CDD_MotVel.MotVelCrf -> MotTqTranlDampg.MotVelCrf
    connect CDD_MotVel.HwVel -> PullCmpActv.HwVel
    connect CDD_MotVel.MotVelMrf -> PwrLimr.MotVelMrf
    connect CDD_MotVel.HwVel -> Rtn.HwVel
    connect CDD_MotVel.HwVel -> TEstimn.HwVel
    connect CDD_MotVel.MotVelCrf -> TqLoa.MotVelCrf
    connect CDD_NxtrTi.GetRefTmr1MicroSec32bit -> CDD_DmaCfgAndUse.GetRefTmr1MicroSec32bit
    connect CDD_NxtrTi.GetTiSpan1MicroSec32bit -> CDD_DmaCfgAndUse.GetTiSpan1MicroSec32bit
    connect CDD_NxtrTi.GetRefTmr1MicroSec32bit -> CDD_GmG2kcaMcuCfg.GetRefTmr1MicroSec32bit
    connect CDD_NxtrTi.GetTiSpan1MicroSec32bit -> CDD_GmG2kcaMcuCfg.GetTiSpan1MicroSec32bit
    connect CDD_NxtrTi.GetRefTmr1MicroSec32bit -> CDD_HwTq0Meas.GetRefTmr1MicroSec32bit
    connect CDD_NxtrTi.GetTiSpan1MicroSec32bit -> CDD_HwTq0Meas.GetTiSpan1MicroSec32bit
    connect CDD_NxtrTi.GetRefTmr1MicroSec32bit -> CDD_HwTq1Meas.GetRefTmr1MicroSec32bit
    connect CDD_NxtrTi.GetTiSpan1MicroSec32bit -> CDD_HwTq1Meas.GetTiSpan1MicroSec32bit
    connect CDD_NxtrTi.GetRefTmr1MicroSec32bit -> CDD_HwTq2Meas.GetRefTmr1MicroSec32bit
    connect CDD_NxtrTi.GetTiSpan1MicroSec32bit -> CDD_HwTq2Meas.GetTiSpan1MicroSec32bit
    connect CDD_NxtrTi.GetRefTmr1MicroSec32bit -> CDD_HwTq3Meas.GetRefTmr1MicroSec32bit
    connect CDD_NxtrTi.GetTiSpan1MicroSec32bit -> CDD_HwTq3Meas.GetTiSpan1MicroSec32bit
    connect CDD_NxtrTi.GetRefTmr100MicroSec32bit -> CmnMfgSrv.GetRefTmr100MicroSec32bit1
    connect CDD_NxtrTi.GetTiSpan100MicroSec32bit -> CmnMfgSrv.GetTiSpan100MicroSec32bit1
    connect CDD_NxtrTi.GetRefTmr100MicroSec32bit -> CustDiagc.GetRefTmr100MicroSec32bit
    connect CDD_NxtrTi.GetTiSpan100MicroSec32bit -> CustDiagc.GetTiSpan100MicroSec32bit
    connect CDD_NxtrTi.GetRefTmr100MicroSec32bit -> EotLrng.GetRefTmr100MicroSec32bit
    connect CDD_NxtrTi.GetTiSpan100MicroSec32bit -> EotLrng.GetTiSpan100MicroSec32bit
    connect CDD_NxtrTi.GetRefTmr100MicroSec32bit -> FltInj.GetRefTmr100MicroSec32bit
    connect CDD_NxtrTi.GetTiSpan100MicroSec32bit -> FltInj.GetTiSpan100MicroSec32bit
    connect CDD_NxtrTi.GetRefTmr100MicroSec32bit -> GmMsg0C9BusHiSpd.GetRefTmr100MicroSec32bit
    connect CDD_NxtrTi.GetTiSpan100MicroSec32bit -> GmMsg0C9BusHiSpd.GetTiSpan100MicroSec32bit
    connect CDD_NxtrTi.GetRefTmr100MicroSec32bit -> GmMsg17DBusHiSpd.GetRefTmr100MicroSec32bit
    connect CDD_NxtrTi.GetTiSpan100MicroSec32bit -> GmMsg17DBusHiSpd.GetTiSpan100MicroSec32bit
    connect CDD_NxtrTi.GetRefTmr100MicroSec32bit -> GmMsg180BusChassisExp.GetRefTmr100MicroSec32bit
    connect CDD_NxtrTi.GetTiSpan100MicroSec32bit -> GmMsg180BusChassisExp.GetTiSpan100MicroSec32bit
    connect CDD_NxtrTi.GetRefTmr100MicroSec32bit -> GmMsg180BusHiSpd.GetRefTmr100MicroSec32bit
    connect CDD_NxtrTi.GetTiSpan100MicroSec32bit -> GmMsg180BusHiSpd.GetTiSpan100MicroSec32bit
    connect CDD_NxtrTi.GetRefTmr100MicroSec32bit -> GmMsg182BusChassisExp.GetRefTmr100MicroSec32bit
    connect CDD_NxtrTi.GetTiSpan100MicroSec32bit -> GmMsg182BusChassisExp.GetTiSpan100MicroSec32bit
    connect CDD_NxtrTi.GetRefTmr100MicroSec32bit -> GmMsg1E9BusHiSpd.GetRefTmr100MicroSec32bit
    connect CDD_NxtrTi.GetTiSpan100MicroSec32bit -> GmMsg1E9BusHiSpd.GetTiSpan100MicroSec32bit
    connect CDD_NxtrTi.GetTiSpan100MicroSec32bit -> GmMsg1F1BusHiSpd.GetTiSpan100MicroSec32bit
    connect CDD_NxtrTi.GetRefTmr100MicroSec32bit -> GmMsg1F5BusHiSpd.GetRefTmr100MicroSec32bit
    connect CDD_NxtrTi.GetTiSpan100MicroSec32bit -> GmMsg1F5BusHiSpd.GetTiSpan100MicroSec32bit
    connect CDD_NxtrTi.GetRefTmr100MicroSec32bit -> GmMsg214BusHiSpd.GetRefTmr100MicroSec32bit
    connect CDD_NxtrTi.GetTiSpan100MicroSec32bit -> GmMsg214BusHiSpd.GetTiSpan100MicroSec32bit
    connect CDD_NxtrTi.GetTiSpan100MicroSec32bit -> GmMsg232BusHiSpd.GetTiSpan100MicroSec32bit
    connect CDD_NxtrTi.GetRefTmr100MicroSec32bit -> GmMsg337BusChassisExp.GetRefTmr100MicroSec32bit
    connect CDD_NxtrTi.GetTiSpan100MicroSec32bit -> GmMsg337BusChassisExp.GetTiSpan100MicroSec32bit
    connect CDD_NxtrTi.GetRefTmr100MicroSec32bit -> GmMsg348BusChassisExp.GetRefTmr100MicroSec32bit
    connect CDD_NxtrTi.GetTiSpan100MicroSec32bit -> GmMsg348BusChassisExp.GetTiSpan100MicroSec32bit
    connect CDD_NxtrTi.GetRefTmr100MicroSec32bit -> GmMsg348BusHiSpd.GetRefTmr100MicroSec32bit
    connect CDD_NxtrTi.GetTiSpan100MicroSec32bit -> GmMsg348BusHiSpd.GetTiSpan100MicroSec32bit
    connect CDD_NxtrTi.GetRefTmr100MicroSec32bit -> GmMsg34ABusChassisExp.GetRefTmr100MicroSec32bit
    connect CDD_NxtrTi.GetTiSpan100MicroSec32bit -> GmMsg34ABusChassisExp.GetTiSpan100MicroSec32bit
    connect CDD_NxtrTi.GetRefTmr100MicroSec32bit -> GmMsg34ABusHiSpd.GetRefTmr100MicroSec32bit
    connect CDD_NxtrTi.GetTiSpan100MicroSec32bit -> GmMsg34ABusHiSpd.GetTiSpan100MicroSec32bit
    connect CDD_NxtrTi.GetRefTmr100MicroSec32bit -> GmMsg3F1BusHiSpd.GetRefTmr100MicroSec32bit
    connect CDD_NxtrTi.GetTiSpan100MicroSec32bit -> GmMsg3F1BusHiSpd.GetTiSpan100MicroSec32bit
    connect CDD_NxtrTi.GetRefTmr100MicroSec32bit -> GmOvrlStMgr.GetRefTmr100MicroSec32bit
    connect CDD_NxtrTi.GetTiSpan100MicroSec32bit -> GmOvrlStMgr.GetTiSpan100MicroSec32bit
    connect CDD_NxtrTi.GetRefTmr100MicroSec32bit -> GmStrtStop.GetRefTmr100MicroSec32bit
    connect CDD_NxtrTi.GetTiSpan100MicroSec32bit -> GmStrtStop.GetTiSpan100MicroSec32bit
    connect CDD_NxtrTi.GetRefTmr100MicroSec32bit -> GmVehPwrMod.GetRefTmr100MicroSec32bit
    connect CDD_NxtrTi.GetTiSpan100MicroSec32bit -> GmVehPwrMod.GetTiSpan100MicroSec32bit
    connect CDD_NxtrTi.GetRefTmr1MicroSec32bit -> HwAg0Meas.GetRefTmr1MicroSec32bit
    connect CDD_NxtrTi.GetTiSpan1MicroSec32bit -> HwAg0Meas.GetTiSpan1MicroSec32bit
    connect CDD_NxtrTi.GetRefTmr1MicroSec32bit -> HwAg1Meas.GetRefTmr1MicroSec32bit
    connect CDD_NxtrTi.GetTiSpan1MicroSec32bit -> HwAg1Meas.GetTiSpan1MicroSec32bit
    connect CDD_NxtrTi.GetRefTmr100MicroSec32bit -> HwAgSysArbn.GetRefTmr100MicroSec32bit
    connect CDD_NxtrTi.GetTiSpan100MicroSec32bit -> HwAgSysArbn.GetTiSpan100MicroSec32bit
    connect CDD_NxtrTi.GetRefTmr100MicroSec32bit -> MotTqTranlDampg.GetRefTmr100MicroSec32bit
    connect CDD_NxtrTi.GetTiSpan100MicroSec32bit -> MotTqTranlDampg.GetTiSpan100MicroSec32bit
    connect CDD_NxtrTi.GetRefTmr100MicroSec32bit -> PullCmpActv.GetRefTmr100MicroSec32bit
    connect CDD_NxtrTi.GetTiSpan100MicroSec32bit -> PullCmpActv.GetTiSpan100MicroSec32bit
    connect CDD_NxtrTi.GetRefTmr100MicroSec32bit -> PwrLimr.GetRefTmr100MicroSec32bit
    connect CDD_NxtrTi.GetTiSpan100MicroSec32bit -> PwrLimr.GetTiSpan100MicroSec32bit
    connect CDD_NxtrTi.GetRefTmr100MicroSec32bit -> SerlComInpProxy.GetRefTmr100MicroSec32bit
    connect CDD_Tauj0CfgAndUse.PhaOnTiMeasdA -> MotDrvDiagc.PhaOnTiMeasdA
    connect CDD_Tauj0CfgAndUse.PhaOnTiMeasdB -> MotDrvDiagc.PhaOnTiMeasdB
    connect CDD_Tauj0CfgAndUse.PhaOnTiMeasdC -> MotDrvDiagc.PhaOnTiMeasdC
    connect CDD_Tauj1CfgAndUse.PhaOnTiMeasdD -> MotDrvDiagc.PhaOnTiMeasdD
    connect CDD_Tauj1CfgAndUse.PhaOnTiMeasdE -> MotDrvDiagc.PhaOnTiMeasdE
    connect CDD_Tauj1CfgAndUse.PhaOnTiMeasdF -> MotDrvDiagc.PhaOnTiMeasdF
    connect CmnMfgSrv.AssiLnrGain -> Assi.AssiLnrGain
    connect CmnMfgSrv.AssiLnrGainEna -> Assi.AssiLnrGainEna
    connect CmnMfgSrv.CmnMfgSrvCmnMfgSrvMaiFct -> CmnMfgSrvIf.CmnMfgSrvCmnMfgSrvMaiFct
    connect CmnMfgSrv.DampgCmdBasDi -> Dampg.DampgCmdBasDi
    connect CmnMfgSrv.MfgDiagcInhb -> DiagcMgr.MfgDiagcInhb
    connect CmnMfgSrv.MfgEnaSt -> DiagcMgr.MfgEnaSt
    connect CmnMfgSrv.EotProtnDi -> EotProtn.EotProtnDi
    connect CmnMfgSrv.StallMotTqLimDi -> HiLoadStallLimr.StallMotTqLimDi
    connect CmnMfgSrv.HysCmpCmdDi -> HysCmp.HysCmpCmdDi
    connect CmnMfgSrv.InertiaCmpVelCmdDi -> InertiaCmpVel.InertiaCmpVelCmdDi
    connect CmnMfgSrv.PullCmpCmdDi -> PullCmpActv.PullCmpCmdDi
    connect CmnMfgSrv.PullCmpLrngDi -> PullCmpActv.PullCmpLrngDi
    connect CmnMfgSrv.RtnCmdDi -> Rtn.RtnCmdDi
    connect CmnMfgSrv.AssiMechTEstimnDi -> TEstimn.AssiMechTEstimnDi
    connect CmnMfgSrvIf.CmnMfgSrvIfCmnMfgSrvIfImdtTx -> CmnMfgSrv.CmnMfgSrvIfCmnMfgSrvIfImdtTx
    connect CurrMeasCorrln.CurrMeasCorrlnSts -> CDD_MotCtrlMgr.CurrMeasCorrlnSts
    connect CurrMeasCorrln.CurrMeasIdptSig -> LoaMgr.CurrMeasIdptSig
    connect DiagcMgr.DiagcStsIvtr1Inactv -> BattVltgCorrln.DiagcStsIvtr1Inactv
    connect DiagcMgr.DiagcStsIvtr2Inactv -> BattVltgCorrln.DiagcStsIvtr2Inactv
    connect DiagcMgr.DiagcStsIvtr1Inactv -> CDD_CurrMeas.DiagcStsIvtr1Inactv
    connect DiagcMgr.DiagcStsIvtr2Inactv -> CDD_CurrMeas.DiagcStsIvtr2Inactv
    connect DiagcMgr.DiagcStsIvtr1Inactv -> CDD_MotCtrlMgr.DiagcStsIvtr1Inactv
    connect DiagcMgr.DiagcStsIvtr2Inactv -> CDD_MotCtrlMgr.DiagcStsIvtr2Inactv
    connect DiagcMgr.ReadNtcFltAry -> CmnMfgSrv.ReadNtcFltAry
    connect DiagcMgr.DiagcStsIvtr1Inactv -> CurrMeasCorrln.DiagcStsIvtr1Inactv
    connect DiagcMgr.DiagcStsIvtr2Inactv -> CurrMeasCorrln.DiagcStsIvtr2Inactv
    connect DiagcMgr.DiagcMgrIninCore -> DiagcMgrProxyAppl10.DiagcMgrIninCore
    connect DiagcMgr.GetNtcActvCore -> DiagcMgrProxyAppl10.GetNtcActvCore
    connect DiagcMgr.GetNtcQlfrStsCore -> DiagcMgrProxyAppl10.GetNtcQlfrStsCore
    connect DiagcMgr.GetNtcStsCore -> DiagcMgrProxyAppl10.GetNtcStsCore
    connect DiagcMgr.SetNtcStsCore -> DiagcMgrProxyAppl10.SetNtcStsCore
    connect DiagcMgr.DiagcMgrIninCore -> DiagcMgrProxyAppl6.DiagcMgrIninCore
    connect DiagcMgr.GetNtcActvCore -> DiagcMgrProxyAppl6.GetNtcActvCore
    connect DiagcMgr.GetNtcQlfrStsCore -> DiagcMgrProxyAppl6.GetNtcQlfrStsCore
    connect DiagcMgr.GetNtcStsCore -> DiagcMgrProxyAppl6.GetNtcStsCore
    connect DiagcMgr.SetNtcStsCore -> DiagcMgrProxyAppl6.SetNtcStsCore
    connect DiagcMgr.DiagcStsLimdTPrfmnc -> DutyCycThermProtn.DiagcStsLimdTPrfmnc
    connect DiagcMgr.DiagcStsLimdTPrfmnc -> EcuTMeas.DiagcStsLimdTPrfmnc
    connect DiagcMgr.SysStFltOutpReqDi -> GmMsg184BusHiSpd.SysStFltOutpReqDi
    connect DiagcMgr.DiagcStsIvtr1Inactv -> LoaMgr.DiagcStsIvtr1Inactv
    connect DiagcMgr.DiagcStsIvtr2Inactv -> LoaMgr.DiagcStsIvtr2Inactv
    connect DiagcMgr.DiagcStsIvtr1Inactv -> MotDrvDiagc.DiagcStsIvtr1Inactv
    connect DiagcMgr.DiagcStsIvtr2Inactv -> MotDrvDiagc.DiagcStsIvtr2Inactv
    connect DiagcMgr.DiagcStsCtrldShtDwnFltPrsnt -> MotTqTranlDampg.DiagcStsCtrldShtDwnFltPrsnt
    connect DiagcMgr.SysDiMotTqCmdSca -> StOutpCtrl.SysDiMotTqCmdSca
    connect DiagcMgr.SysDiRampRate -> StOutpCtrl.SysDiRampRate
    connect DiagcMgr.SysStFltOutpReqDi -> SysStMod.SysStFltOutpReqDi
    connect DiagcMgrProxyAppl10.GetNtcQlfrSts10 -> AssiSumLim.GetNtcQlfrSts
    connect DiagcMgrProxyAppl10.SetNtcSts10 -> AssiSumLim.SetNtcSts
    connect DiagcMgrProxyAppl10.GetNtcQlfrSts10 -> BattVltgCorrln.GetNtcQlfrSts
    connect DiagcMgrProxyAppl10.SetNtcSts10 -> BattVltgCorrln.SetNtcSts
    connect DiagcMgrProxyAppl10.GetNtcQlfrSts10 -> CDD_CurrMeas.GetNtcQlfrSts
    connect DiagcMgrProxyAppl10.SetNtcSts10 -> CDD_CurrMeas.SetNtcSts
    connect DiagcMgrProxyAppl10.SetNtcSts10 -> CDD_ExcpnHndlg.SetNtcSts
    connect DiagcMgrProxyAppl10.GetNtcQlfrSts10 -> CDD_FlsMem.GetNtcQlfrSts
    connect DiagcMgrProxyAppl10.SetNtcSts10 -> CDD_FlsMem.SetNtcSts
    connect DiagcMgrProxyAppl10.GetNtcQlfrSts10 -> CDD_HwTq0Meas.GetNtcQlfrSts
    connect DiagcMgrProxyAppl10.SetNtcSts10 -> CDD_HwTq0Meas.SetNtcSts
    connect DiagcMgrProxyAppl10.GetNtcQlfrSts10 -> CDD_HwTq1Meas.GetNtcQlfrSts
    connect DiagcMgrProxyAppl10.SetNtcSts10 -> CDD_HwTq1Meas.SetNtcSts
    connect DiagcMgrProxyAppl10.GetNtcQlfrSts10 -> CDD_HwTq2Meas.GetNtcQlfrSts
    connect DiagcMgrProxyAppl10.SetNtcSts10 -> CDD_HwTq2Meas.SetNtcSts
    connect DiagcMgrProxyAppl10.GetNtcQlfrSts10 -> CDD_HwTq3Meas.GetNtcQlfrSts
    connect DiagcMgrProxyAppl10.SetNtcSts10 -> CDD_HwTq3Meas.SetNtcSts
    connect DiagcMgrProxyAppl10.GetNtcQlfrSts10 -> CDD_MotAg0Meas.GetNtcQlfrSts
    connect DiagcMgrProxyAppl10.SetNtcSts10 -> CDD_MotAg0Meas.SetNtcSts
    connect DiagcMgrProxyAppl10.GetNtcQlfrSts10 -> CDD_MotAg1Meas.GetNtcQlfrSts
    connect DiagcMgrProxyAppl10.SetNtcSts10 -> CDD_MotAg1Meas.SetNtcSts
    connect DiagcMgrProxyAppl10.SetNtcSts10 -> CDD_NxtrTi.SetNtcSts
    connect DiagcMgrProxyAppl10.SetNtcSts10 -> CDD_RamMem.SetNtcSts
    connect DiagcMgrProxyAppl10.GetNtcQlfrSts10 -> CurrMeasCorrln.GetNtcQlfrSts
    connect DiagcMgrProxyAppl10.SetNtcSts10 -> CurrMeasCorrln.SetNtcSts
    connect DiagcMgrProxyAppl10.GetDiagcDataAppl10 -> DiagcMgr.GetDiagcDataAppl10
    connect DiagcMgrProxyAppl10.GetNtcInfoAppl10 -> DiagcMgr.GetNtcInfoAppl10
    connect DiagcMgrProxyAppl10.SetNtcSts10 -> DutyCycThermProtn.SetNtcSts
    connect DiagcMgrProxyAppl10.SetNtcSts10 -> EcuTMeas.SetNtcSts
    connect DiagcMgrProxyAppl10.GetNtcQlfrSts10 -> EotLrng.GetNtcQlfrSts
    connect DiagcMgrProxyAppl10.SetNtcSts10 -> EotLrng.SetNtcSts
    connect DiagcMgrProxyAppl10.SetNtcSts10 -> GmVehSpdArbn.SetNtcSts
    connect DiagcMgrProxyAppl10.GetNtcQlfrSts10 -> HwAg0Meas.GetNtcQlfrSts
    connect DiagcMgrProxyAppl10.SetNtcSts10 -> HwAg0Meas.SetNtcSts
    connect DiagcMgrProxyAppl10.GetNtcQlfrSts10 -> HwAg1Meas.GetNtcQlfrSts
    connect DiagcMgrProxyAppl10.SetNtcSts10 -> HwAg1Meas.SetNtcSts
    connect DiagcMgrProxyAppl10.GetNtcQlfrSts10 -> HwTqCorrln.GetNtcQlfrSts
    connect DiagcMgrProxyAppl10.SetNtcSts10 -> HwTqCorrln.SetNtcSts
    connect DiagcMgrProxyAppl10.SetNtcSts10 -> LoaMgr.SetNtcSts
    connect DiagcMgrProxyAppl10.GetNtcQlfrSts10 -> MotAgCorrln.GetNtcQlfrSts
    connect DiagcMgrProxyAppl10.SetNtcSts10 -> MotAgCorrln.SetNtcSts
    connect DiagcMgrProxyAppl10.SetNtcSts10 -> MotDrvDiagc.SetNtcSts
    connect DiagcMgrProxyAppl10.GetNtcQlfrSts10 -> PwrDiscnct.GetNtcQlfrSts
    connect DiagcMgrProxyAppl10.SetNtcSts10 -> PwrDiscnct.SetNtcSts
    connect DiagcMgrProxyAppl10.SetNtcSts10 -> PwrLimr.SetNtcSts
    connect DiagcMgrProxyAppl10.SetNtcSts10 -> PwrSply.SetNtcSts
    connect DiagcMgrProxyAppl10.SetNtcSts10 -> TmplMonr.SetNtcSts
    connect DiagcMgrProxyAppl10.SetNtcSts10 -> TunSelnMngt.SetNtcSts
    connect DiagcMgrProxyAppl6.GetDiagcDataAppl6 -> DiagcMgr.GetDiagcDataAppl6
    connect DiagcMgrProxyAppl6.GetNtcInfoAppl6 -> DiagcMgr.GetNtcInfoAppl6
    connect DiagcMgrProxyAppl6.SetNtcSts6 -> GmMsg0C9BusHiSpd.SetNtcSts
    connect DiagcMgrProxyAppl6.SetNtcSts6 -> GmMsg17DBusHiSpd.SetNtcSts
    connect DiagcMgrProxyAppl6.SetNtcSts6 -> GmMsg180BusChassisExp.SetNtcSts
    connect DiagcMgrProxyAppl6.SetNtcSts6 -> GmMsg180BusHiSpd.SetNtcSts
    connect DiagcMgrProxyAppl6.SetNtcSts6 -> GmMsg182BusChassisExp.SetNtcSts
    connect DiagcMgrProxyAppl6.SetNtcSts6 -> GmMsg1E9BusHiSpd.SetNtcSts
    connect DiagcMgrProxyAppl6.SetNtcSts6 -> GmMsg1F1BusHiSpd.SetNtcSts
    connect DiagcMgrProxyAppl6.SetNtcSts6 -> GmMsg1F5BusHiSpd.SetNtcSts
    connect DiagcMgrProxyAppl6.SetNtcSts6 -> GmMsg214BusHiSpd.SetNtcSts
    connect DiagcMgrProxyAppl6.SetNtcSts6 -> GmMsg232BusHiSpd.SetNtcSts
    connect DiagcMgrProxyAppl6.SetNtcSts6 -> GmMsg337BusChassisExp.SetNtcSts
    connect DiagcMgrProxyAppl6.SetNtcSts6 -> GmMsg348BusChassisExp.SetNtcSts
    connect DiagcMgrProxyAppl6.SetNtcSts6 -> GmMsg348BusHiSpd.SetNtcSts
    connect DiagcMgrProxyAppl6.SetNtcSts6 -> GmMsg34ABusChassisExp.SetNtcSts
    connect DiagcMgrProxyAppl6.SetNtcSts6 -> GmMsg34ABusHiSpd.SetNtcSts
    connect DiagcMgrProxyAppl6.SetNtcSts6 -> GmMsg3F1BusHiSpd.SetNtcSts
    connect DiagcMgrProxyAppl6.SetNtcSts6 -> PartNr.SetNtcSts
    connect DutyCycThermProtn.ThermLimSlowFilMax -> Assi.ThermLimSlowFilMax
    connect DutyCycThermProtn.ThermRednFac -> AssiSumLim.ThermRednFac
    connect DutyCycThermProtn.ThermMotTqLim -> LimrCdng.ThermMotTqLim
    connect EcuTMeas.EcuTFild -> CDD_MotCtrlMgr.EcuTFild
    connect EcuTMeas.EcuTFild -> DutyCycThermProtn.EcuTFild
    connect EcuTMeas.EcuTFild -> TEstimn.EcuTFild
    connect EotLrng.SerlComRstEot -> CmnMfgSrv.SerlComRstEot
    connect EotLrng.HwAgCcwDetd -> EotProtn.HwAgCcwDetd
    connect EotLrng.HwAgCwDetd -> EotProtn.HwAgCwDetd
    connect EotLrng.HwAgEotCcw -> EotProtn.HwAgEotCcw
    connect EotLrng.HwAgEotCw -> EotProtn.HwAgEotCw
    connect EotLrng.HwAgEotCcw -> GmOvrlStMgr.HwAgEotCcw
    connect EotLrng.HwAgEotCw -> GmOvrlStMgr.HwAgEotCw
    connect EotLrng.HwAgEotCcw -> VehSpdLimr.HwAgEotCcw
    connect EotLrng.HwAgEotCw -> VehSpdLimr.HwAgEotCw
    connect EotProtn.EotAssiSca -> LimrCdng.EotAssiSca
    connect EotProtn.EotMotTqLim -> LimrCdng.EotMotTqLim
    connect FltInj.FltInj_f32 -> Assi.FltInj_f32
    connect FltInj.FltInj_f32 -> CDD_HwTq0Meas.FltInj_f32
    connect FltInj.FltInj_u08 -> CDD_HwTq0Meas.FltInj_u08
    connect FltInj.FltInj_f32 -> CDD_HwTq2Meas.FltInj_f32
    connect FltInj.FltInj_f32 -> Dampg.FltInj_f32
    connect FltInj.FltInj_f32 -> HwAg0Meas.FltInj_f32
    connect FltInj.FltInj_u08 -> HwAg0Meas.FltInj_u08
    connect FltInj.FltInj_f32 -> HwAgSysArbn.FltInj_f32
    connect FltInj.FltInj_u08 -> HwTqCorrln.FltInj_u08
    connect FltInj.FltInj_f32 -> HysCmp.FltInj_f32
    connect FltInj.FltInj_f32 -> InertiaCmpVel.FltInj_f32
    connect FltInj.FltInj_f32 -> LimrCdng.FltInj_f32
    connect FltInj.FltInj_u08 -> MotAgCorrln.FltInj_u08
    connect FltInj.FltInj_f32 -> Rtn.FltInj_f32
    connect FltInj.FltInj_f32 -> StabyCmp.FltInj_f32
    connect FltInj.FltInj_f32 -> VehSigCdng.FltInj_f32
    connect GmMsg0C9BusHiSpd.EngRunActv -> GmMsg1F1BusHiSpd.EngRunActv
    connect GmMsg0C9BusHiSpd.EngSpd -> GmStrtStop.EngSpd
    connect GmMsg0C9BusHiSpd.InvldMsg0C9 -> GmStrtStop.Msg0C9BusHiSpdInvld
    connect GmMsg0C9BusHiSpd.MissMsg0C9 -> GmStrtStop.Msg0C9BusHiSpdMiss
    connect GmMsg0C9BusHiSpd.EngRunActv -> GmVehPwrMod.EngRunActv
    connect GmMsg0C9BusHiSpd.MissMsg0C9 -> GmVehPwrMod.Msg0C9Miss
    connect GmMsg17DBusHiSpd.InvldMsg17D -> GmOvrlStMgr.Msg17DBusHiSpdInvld
    connect GmMsg17DBusHiSpd.MissMsg17D -> GmOvrlStMgr.Msg17DBusHiSpdMiss
    connect GmMsg180BusChassisExp.InvldMsg180BusChassisExp -> GmOvrlStMgr.Msg180BusChassisExpInvld
    connect GmMsg180BusChassisExp.MissMsg180BusChassisExp -> GmOvrlStMgr.Msg180BusChassisExpMiss
    connect GmMsg180BusChassisExp.EscCmd -> GmTqArbn.EscCmd
    connect GmMsg180BusHiSpd.InvldMsg180BusHiSpd -> GmOvrlStMgr.Msg180BusHiSpdInvld
    connect GmMsg180BusHiSpd.MissMsg180BusHiSpd -> GmOvrlStMgr.Msg180BusHiSpdMiss
    connect GmMsg182BusChassisExp.SerlComVehLgtA -> VehSigCdng.VehLgtASerlCom
    connect GmMsg184BusHiSpd.HandsOffSteerWhlDetnMod -> SerlComOutpProxy.HandsOffSteerWhlDetnMod
    connect GmMsg184BusHiSpd.HandsOffSteerWhlDetnSt -> SerlComOutpProxy.HandsOffSteerWhlDetnSt
    connect GmMsg184BusHiSpd.HandsOffSteerWhlDetnStVld -> SerlComOutpProxy.HandsOffSteerWhlDetnStVld
    connect GmMsg184BusHiSpd.LkaDrvrAppldTq -> SerlComOutpProxy.LkaDrvrAppldTq
    connect GmMsg184BusHiSpd.LkaDrvrAppldTqVld -> SerlComOutpProxy.LkaDrvrAppldTqVld
    connect GmMsg184BusHiSpd.LkaElecPwrSteerTotTqDlvd -> SerlComOutpProxy.LkaElecPwrSteerTotTqDlvd
    connect GmMsg184BusHiSpd.LkaTqOvrlDeltaTqDlvd -> SerlComOutpProxy.LkaTqOvrlDeltaTqDlvd
    connect GmMsg184BusHiSpd.LkaTqOvrlDlvdRollgCntr -> SerlComOutpProxy.LkaTqOvrlDlvdRollgCntr
    connect GmMsg184BusHiSpd.LkaTqOvrlStsChks -> SerlComOutpProxy.LkaTqOvrlStsChks
    connect GmMsg184BusHiSpd.LkaTqOvrlTqDlvdSts -> SerlComOutpProxy.LkaTqOvrlTqDlvdSts
    connect GmMsg1CABusChassisExp.ElecPwrSteerTotTqDlvd -> SerlComOutpProxy.ElecPwrSteerTotTqDlvd
    connect GmMsg1CABusChassisExp.TqOvrlDeltaTqDlvd -> SerlComOutpProxy.TqOvrlDeltaTqDlvd
    connect GmMsg1CABusChassisExp.TqOvrlDlvdChks -> SerlComOutpProxy.TqOvrlDlvdChks
    connect GmMsg1CABusChassisExp.TqOvrlDlvdRollgCntr -> SerlComOutpProxy.TqOvrlDlvdRollgCntr
    connect GmMsg1CABusChassisExp.TqOvrlTqDlvdSts -> SerlComOutpProxy.TqOvrlTqDlvdSts
    connect GmMsg1E5BusChassisExp.SteerWhlAgAlvRollgCntBusChassisExp -> SerlComOutpProxy.SteerWhlAgAlvRollgCntBusChassisExp
    connect GmMsg1E5BusChassisExp.SteerWhlAgBusChassisExp -> SerlComOutpProxy.SteerWhlAgBusChassisExp
    connect GmMsg1E5BusChassisExp.SteerWhlAgGrdtBusChassisExp -> SerlComOutpProxy.SteerWhlAgGrdtBusChassisExp
    connect GmMsg1E5BusChassisExp.SteerWhlAgGrdtMaskBusChassisExp -> SerlComOutpProxy.SteerWhlAgGrdtMaskBusChassisExp
    connect GmMsg1E5BusChassisExp.SteerWhlAgGrdtVldBusChassisExp -> SerlComOutpProxy.SteerWhlAgGrdtVldBusChassisExp
    connect GmMsg1E5BusChassisExp.SteerWhlAgMaskBusChassisExp -> SerlComOutpProxy.SteerWhlAgMaskBusChassisExp
    connect GmMsg1E5BusChassisExp.SteerWhlAgSnsrCalStsBusChassisExp -> SerlComOutpProxy.SteerWhlAgSnsrCalStsBusChassisExp
    connect GmMsg1E5BusChassisExp.SteerWhlAgSnsrChksBusChassisExp -> SerlComOutpProxy.SteerWhlAgSnsrChksBusChassisExp
    connect GmMsg1E5BusChassisExp.SteerWhlAgSnsrTypBusChassisExp -> SerlComOutpProxy.SteerWhlAgSnsrTypBusChassisExp
    connect GmMsg1E5BusChassisExp.SteerWhlAgVldBusChassisExp -> SerlComOutpProxy.SteerWhlAgVldBusChassisExp
    connect GmMsg1E5BusHiSpd.SteerWhlAgAlvRollgCntBusHiSpd -> SerlComOutpProxy.SteerWhlAgAlvRollgCntBusHiSpd
    connect GmMsg1E5BusHiSpd.SteerWhlAgBusHiSpd -> SerlComOutpProxy.SteerWhlAgBusHiSpd
    connect GmMsg1E5BusHiSpd.SteerWhlAgGrdtBusHiSpd -> SerlComOutpProxy.SteerWhlAgGrdtBusHiSpd
    connect GmMsg1E5BusHiSpd.SteerWhlAgGrdtMaskBusHiSpd -> SerlComOutpProxy.SteerWhlAgGrdtMaskBusHiSpd
    connect GmMsg1E5BusHiSpd.SteerWhlAgGrdtVldBusHiSpd -> SerlComOutpProxy.SteerWhlAgGrdtVldBusHiSpd
    connect GmMsg1E5BusHiSpd.SteerWhlAgMaskBusHiSpd -> SerlComOutpProxy.SteerWhlAgMaskBusHiSpd
    connect GmMsg1E5BusHiSpd.SteerWhlAgSnsrCalStsBusHiSpd -> SerlComOutpProxy.SteerWhlAgSnsrCalStsBusHiSpd
    connect GmMsg1E5BusHiSpd.SteerWhlAgSnsrChksBusHiSpd -> SerlComOutpProxy.SteerWhlAgSnsrChksBusHiSpd
    connect GmMsg1E5BusHiSpd.SteerWhlAgSnsrTypBusHiSpd -> SerlComOutpProxy.SteerWhlAgSnsrTypBusHiSpd
    connect GmMsg1E5BusHiSpd.SteerWhlAgVldBusHiSpd -> SerlComOutpProxy.SteerWhlAgVldBusHiSpd
    connect GmMsg1E9BusHiSpd.VehStabyEnhmtActv -> GmMsg214BusHiSpd.VehStabyEnhmtActv
    connect GmMsg1E9BusHiSpd.InvldMsg1E9 -> GmOvrlStMgr.Msg1E9BusHiSpdInvld
    connect GmMsg1E9BusHiSpd.MissMsg1E9 -> GmOvrlStMgr.Msg1E9BusHiSpdMiss
    connect GmMsg1E9BusHiSpd.VehStabyEnhmtActv -> GmOvrlStMgr.VehStabyEnhmtActv
    connect GmMsg1E9BusHiSpd.SerlComLatA -> VehSigCdng.VehLatASerlCom
    connect GmMsg1F1BusHiSpd.MissMsg1F1 -> GmVehPwrMod.Msg1F1Miss
    connect GmMsg1F1BusHiSpd.SysPwrModRun -> GmVehPwrMod.SysPwrModRun
    connect GmMsg1F1BusHiSpd.SysPwrModRun -> PartNr.SysPwrModRun
    connect GmMsg1F5BusHiSpd.InvldMsg1F5 -> GmOvrlStMgr.Msg1F5BusHiSpdInvld
    connect GmMsg1F5BusHiSpd.ShiftLvrInRvs -> GmOvrlStMgr.ShiftLvrRvs
    connect GmMsg214BusHiSpd.RdntVehStabyEnhmtActv -> GmMsg1E9BusHiSpd.RdntVehStabyEnhmtActv
    connect GmMsg214BusHiSpd.AbsProtd -> GmOvrlStMgr.AbsActvProtd
    connect GmMsg214BusHiSpd.VehStabyEnhmtInvld -> GmOvrlStMgr.Msg214BusHiSpdInvld
    connect GmMsg214BusHiSpd.MissMsg214 -> GmOvrlStMgr.Msg214BusHiSpdMiss
    connect GmMsg335BusChassisExp.DrvrSteerIntvDetd -> SerlComOutpProxy.DrvrSteerIntvDetd
    connect GmMsg335BusChassisExp.DrvrSteerIntvDetdProtnVal -> SerlComOutpProxy.DrvrSteerIntvDetdProtnVal
    connect GmMsg335BusChassisExp.DrvrSteerIntvDetdRollgCntr -> SerlComOutpProxy.DrvrSteerIntvDetdRollgCntr
    connect GmMsg335BusChassisExp.DrvrSteerIntvDetdVld -> SerlComOutpProxy.DrvrSteerIntvDetdVld
    connect GmMsg335BusChassisExp.ElecPowerSteerAvlSts -> SerlComOutpProxy.ElecPowerSteerAvlSts
    connect GmMsg335BusChassisExp.ElecPowerSteerAvlStsProtnVal -> SerlComOutpProxy.ElecPowerSteerAvlStsProtnVal
    connect GmMsg335BusChassisExp.ElecPowerSteerAvlStsRollgCntr -> SerlComOutpProxy.ElecPowerSteerAvlStsRollgCntr
    connect GmMsg337BusChassisExp.SteerWhlAgReqTarAg -> GmOvrlStMgr.HwAgTar
    connect GmMsg337BusChassisExp.FbReqActv -> GmOvrlStMgr.HwHaptcEna
    connect GmMsg337BusChassisExp.InvldMsg337 -> GmOvrlStMgr.Msg337BusChassisExpInvld
    connect GmMsg337BusChassisExp.MissMsg337 -> GmOvrlStMgr.Msg337BusChassisExpMiss
    connect GmMsg348BusChassisExp.WhlGndVelLeDrvnBusChassisExp -> GmVehSpdArbn.WhlGndVelLeDrvnBusChassisExp
    connect GmMsg348BusChassisExp.WhlGndVelLeDrvnStuckBusChassisExp -> GmVehSpdArbn.WhlGndVelLeDrvnStuckBusChassisExp
    connect GmMsg348BusChassisExp.WhlGndVelLeDrvnVldBusChassisExp -> GmVehSpdArbn.WhlGndVelLeDrvnVldBusChassisExp
    connect GmMsg348BusChassisExp.WhlGndVelRiDrvnBusChassisExp -> GmVehSpdArbn.WhlGndVelRiDrvnBusChassisExp
    connect GmMsg348BusChassisExp.WhlGndVelRiDrvnStuckBusChassisExp -> GmVehSpdArbn.WhlGndVelRiDrvnStuckBusChassisExp
    connect GmMsg348BusChassisExp.WhlGndVelRiDrvnVldBusChassisExp -> GmVehSpdArbn.WhlGndVelRiDrvnVldBusChassisExp
    connect GmMsg348BusHiSpd.WhlGndVelLeDrvnBusHiSpd -> GmVehSpdArbn.WhlGndVelLeDrvnBusHiSpd
    connect GmMsg348BusHiSpd.WhlGndVelLeDrvnStuckBusHiSpd -> GmVehSpdArbn.WhlGndVelLeDrvnStuckBusHiSpd
    connect GmMsg348BusHiSpd.WhlGndVelLeDrvnVldBusHiSpd -> GmVehSpdArbn.WhlGndVelLeDrvnVldBusHiSpd
    connect GmMsg348BusHiSpd.WhlGndVelRiDrvnBusHiSpd -> GmVehSpdArbn.WhlGndVelRiDrvnBusHiSpd
    connect GmMsg348BusHiSpd.WhlGndVelRiDrvnStuckBusHiSpd -> GmVehSpdArbn.WhlGndVelRiDrvnStuckBusHiSpd
    connect GmMsg348BusHiSpd.WhlGndVelRiDrvnVldBusHiSpd -> GmVehSpdArbn.WhlGndVelRiDrvnVldBusHiSpd
    connect GmMsg34ABusChassisExp.WhlGndVelLeNonDrvnBusChassisExp -> GmVehSpdArbn.WhlGndVelLeNonDrvnBusChassisExp
    connect GmMsg34ABusChassisExp.WhlGndVelLeNonDrvnStuckBusChassisExp -> GmVehSpdArbn.WhlGndVelLeNonDrvnStuckBusChassisExp
    connect GmMsg34ABusChassisExp.WhlGndVelLeNonDrvnVldBusChassisExp -> GmVehSpdArbn.WhlGndVelLeNonDrvnVldBusChassisExp
    connect GmMsg34ABusChassisExp.WhlGndVelRiNonDrvnBusChassisExp -> GmVehSpdArbn.WhlGndVelRiNonDrvnBusChassisExp
    connect GmMsg34ABusChassisExp.WhlGndVelRiNonDrvnStuckBusChassisExp -> GmVehSpdArbn.WhlGndVelRiNonDrvnStuckBusChassisExp
    connect GmMsg34ABusChassisExp.WhlGndVelRiNonDrvnVldBusChassisExp -> GmVehSpdArbn.WhlGndVelRiNonDrvnVldBusChassisExp
    connect GmMsg34ABusHiSpd.WhlGndVelLeNonDrvnBusHiSpd -> GmVehSpdArbn.WhlGndVelLeNonDrvnBusHiSpd
    connect GmMsg34ABusHiSpd.WhlGndVelLeNonDrvnStuckBusHiSpd -> GmVehSpdArbn.WhlGndVelLeNonDrvnStuckBusHiSpd
    connect GmMsg34ABusHiSpd.WhlGndVelLeNonDrvnVldBusHiSpd -> GmVehSpdArbn.WhlGndVelLeNonDrvnVldBusHiSpd
    connect GmMsg34ABusHiSpd.WhlGndVelRiNonDrvnBusHiSpd -> GmVehSpdArbn.WhlGndVelRiNonDrvnBusHiSpd
    connect GmMsg34ABusHiSpd.WhlGndVelRiNonDrvnStuckBusHiSpd -> GmVehSpdArbn.WhlGndVelRiNonDrvnStuckBusHiSpd
    connect GmMsg34ABusHiSpd.WhlGndVelRiNonDrvnVldBusHiSpd -> GmVehSpdArbn.WhlGndVelRiNonDrvnVldBusHiSpd
    connect GmMsg3F1BusHiSpd.AmbT -> TEstimn.AmbT
    connect GmOvrlStMgr.LkaSt -> GmMsg184BusHiSpd.LkaSt
    connect GmOvrlStMgr.EscSt -> GmMsg1CABusChassisExp.EscSt
    connect GmOvrlStMgr.ApaDrvrIntvDetd -> GmMsg335BusChassisExp.ApaDrvrIntvDetd
    connect GmOvrlStMgr.ApaSt -> GmMsg335BusChassisExp.ApaSt
    connect GmOvrlStMgr.EscSt -> GmTqArbn.EscSt
    connect GmStrtStop.VehStrtStopMotTqCmdSca -> StOutpCtrl.VehStrtStopMotTqCmdSca
    connect GmStrtStop.VehStrtStopRampRate -> StOutpCtrl.VehStrtStopRampRate
    connect GmTqArbn.AssiCmdBasSca -> Assi.AssiCmdBasSca
    connect GmTqArbn.HwTqOvrl -> Assi.HwTqOvrl
    connect GmTqArbn.MotTqCmdOvrl -> AssiSumLim.MotTqCmdOvrl
    connect GmTqArbn.DampgCmdSca -> Dampg.DampgCmdSca
    connect GmTqArbn.RtnCmdSca -> Rtn.RtnCmdSca
    connect GmTqArbn.AssiCmdBasSca -> StabyCmp.AssiCmdBasSca
    connect GmVehPwrMod.VehPwrModDftVehSpdEna -> GmVehSpdArbn.VehPwrModDftVehSpdEna
    connect GmVehPwrMod.SysOperMotTqCmdSca -> StOutpCtrl.SysOperMotTqCmdSca
    connect GmVehPwrMod.SysOperRampRate -> StOutpCtrl.SysOperRampRate
    connect GmVehPwrMod.PwrSplyEnaReq -> SysStMod.PwrSplyEnaReq
    connect GmVehPwrMod.SysStReqEna -> SysStMod.SysStReqEna
    connect GmVehSpdArbn.VehSpdMaxSecur -> GmOvrlStMgr.VehSpdSecurMax
    connect GmVehSpdArbn.VehSpdMinSecur -> GmOvrlStMgr.VehSpdSecurMin
    connect GmVehSpdArbn.VehSpdMaxSecur -> GmTqArbn.VehSpdMaxSecur
    connect GmVehSpdArbn.VehSpdArbd -> GmVehPwrMod.VehSpdArbd
    connect GmVehSpdArbn.VehSpdSnsrVld -> GmVehPwrMod.VehSpdSnsrVld
    connect GmVehSpdArbn.VehSpdArbd -> VehSigCdng.VehSpdSerlCom
    connect GmVehSpdArbn.VehSpdArbdVld -> VehSigCdng.VehSpdVldSerlCom
    connect HiLoadStallLimr.StallMotTqLim -> LimrCdng.StallMotTqLim
    connect HwAg0Meas.HwAg0MeasHwAg0AutTrim -> CmnMfgSrv.HwAg0MeasHwAg0AutoTrim
    connect HwAg0Meas.HwAg0MeasHwAg0ClrTrim -> CmnMfgSrv.HwAg0MeasHwAg0ClrTrim
    connect HwAg0Meas.HwAg0MeasHwAg0ReadTrim -> CmnMfgSrv.HwAg0MeasHwAg0ReadTrim
    connect HwAg0Meas.HwAg0MeasHwAg0TrimPrfmdSts -> CmnMfgSrv.HwAg0MeasHwAg0TrimPrfmdSts
    connect HwAg0Meas.HwAg0MeasHwAg0WrTrim -> CmnMfgSrv.HwAg0MeasHwAg0WrTrim
    connect HwAg0Meas.HwAg0 -> HwAgArbn.HwAgA
    connect HwAg0Meas.HwAg0Qlfr -> HwAgArbn.HwAgAQlfr
    connect HwAg0Meas.HwAg0 -> HwAgCorrln.HwAgA
    connect HwAg0Meas.HwAg0Qlfr -> HwAgCorrln.HwAgAQlfr
    connect HwAg0Meas.HwAg0RollgCntr -> HwAgCorrln.HwAgARollgCntr
    connect HwAg1Meas.HwAg1MeasHwAg1AutTrim -> CmnMfgSrv.HwAg1MeasHwAg1AutoTrim
    connect HwAg1Meas.HwAg1MeasHwAg1ClrTrim -> CmnMfgSrv.HwAg1MeasHwAg1ClrTrim
    connect HwAg1Meas.HwAg1MeasHwAg1ReadTrim -> CmnMfgSrv.HwAg1MeasHwAg1ReadTrim
    connect HwAg1Meas.HwAg1MeasHwAg1TrimPrfmdSts -> CmnMfgSrv.HwAg1MeasHwAg1TrimPrfmdSts
    connect HwAg1Meas.HwAg1MeasHwAg1WrTrim -> CmnMfgSrv.HwAg1MeasHwAg1WrTrim
    connect HwAgCorrln.HwAgCorrlnSt -> HwAgArbn.HwAgCorrlnSt
    connect HwAgCorrln.HwAgIdptSig -> HwAgSysArbn.HwAgIdptSig
    connect HwAgSysArbn.PinionAgConf -> EotLrng.HwAgAuthy
    connect HwAgSysArbn.PinionAgConf -> EotProtn.HwAgAuthy
    connect HwAgSysArbn.HwAgToSerlCom -> GmMsg1E5BusChassisExp.HwAg
    connect HwAgSysArbn.HwAgStsToSerlCom -> GmMsg1E5BusChassisExp.HwAgStsToSerlCom
    connect HwAgSysArbn.HwAgToSerlCom -> GmMsg1E5BusHiSpd.HwAg
    connect HwAgSysArbn.HwAgStsToSerlCom -> GmMsg1E5BusHiSpd.HwAgStsToSerlCom
    connect HwAgSysArbn.PinionAg -> MotTqTranlDampg.HwAg
    connect HwAgSysArbn.PinionAgConf -> PullCmpActv.PinionAgConf
    connect HwAgSysArbn.PinionAg -> Rtn.HwAg
    connect HwAgSysArbn.PinionAgConf -> Rtn.HwAgAuthySca
    connect HwAgSysArbn.PinionAg -> TqLoa.PinionAg
    connect HwAgSysArbn.PinionAgConf -> TqLoa.PinionAgConf
    connect HwAgSysArbn.HwAgFinal -> VehSpdLimr.HwAg
    connect HwAgSysArbn.PinionAgConf -> VehSpdLimr.HwAgAuthy
    connect HwTqArbn.HwTqChA -> HwTqCorrln.HwTqChA
    connect HwTqArbn.HwTqChB -> HwTqCorrln.HwTqChB
    connect HwTqCorrln.HwTqCorrlnSts -> HwTqArbn.HwTqCorrlnSts
    connect HwTqCorrln.HwTqIdptSig -> LoaMgr.HwTqIdptSig
    connect IoHwAb.SetFctGpioPhaALowrCmd -> CDD_TSG31CfgAndUse.IoHwAb_SetFctGpioPhaALowrCmd
    connect IoHwAb.SetFctGpioPhaAUpprCmd -> CDD_TSG31CfgAndUse.IoHwAb_SetFctGpioPhaAUpprCmd
    connect IoHwAb.SetFctGpioPhaBLowrCmd -> CDD_TSG31CfgAndUse.IoHwAb_SetFctGpioPhaBLowrCmd
    connect IoHwAb.SetFctGpioPhaBUpprCmd -> CDD_TSG31CfgAndUse.IoHwAb_SetFctGpioPhaBUpprCmd
    connect IoHwAb.SetFctGpioPhaCLowrCmd -> CDD_TSG31CfgAndUse.IoHwAb_SetFctGpioPhaCLowrCmd
    connect IoHwAb.SetFctGpioPhaCUpprCmd -> CDD_TSG31CfgAndUse.IoHwAb_SetFctGpioPhaCUpprCmd
    connect IoHwAb.SetFctPeriphPhaALowrCmd -> CDD_TSG31CfgAndUse.IoHwAb_SetFctPeriphPhaALowrCmd
    connect IoHwAb.SetFctPeriphPhaAUpprCmd -> CDD_TSG31CfgAndUse.IoHwAb_SetFctPeriphPhaAUpprCmd
    connect IoHwAb.SetFctPeriphPhaBLowrCmd -> CDD_TSG31CfgAndUse.IoHwAb_SetFctPeriphPhaBLowrCmd
    connect IoHwAb.SetFctPeriphPhaBUpprCmd -> CDD_TSG31CfgAndUse.IoHwAb_SetFctPeriphPhaBUpprCmd
    connect IoHwAb.SetFctPeriphPhaCLowrCmd -> CDD_TSG31CfgAndUse.IoHwAb_SetFctPeriphPhaCLowrCmd
    connect IoHwAb.SetFctPeriphPhaCUpprCmd -> CDD_TSG31CfgAndUse.IoHwAb_SetFctPeriphPhaCUpprCmd
    connect IoHwAb.SetGpioPhaALowrCmd -> CDD_TSG31CfgAndUse.IoHwAb_SetGpioPhaALowrCmd
    connect IoHwAb.SetGpioPhaAUpprCmd -> CDD_TSG31CfgAndUse.IoHwAb_SetGpioPhaAUpprCmd
    connect IoHwAb.SetGpioPhaBLowrCmd -> CDD_TSG31CfgAndUse.IoHwAb_SetGpioPhaBLowrCmd
    connect IoHwAb.SetGpioPhaBUpprCmd -> CDD_TSG31CfgAndUse.IoHwAb_SetGpioPhaBUpprCmd
    connect IoHwAb.SetGpioPhaCLowrCmd -> CDD_TSG31CfgAndUse.IoHwAb_SetGpioPhaCLowrCmd
    connect IoHwAb.SetGpioPhaCUpprCmd -> CDD_TSG31CfgAndUse.IoHwAb_SetGpioPhaCUpprCmd
    connect IoHwAb.GetGpioMcuEna -> GmVehPwrMod.IoHwAb_GetGpioMcuEna
    connect IoHwAb.GetGpioPwrOutpEnaFb -> TmplMonr.IoHwAb_GetGpioPwrOutpEnaFb
    connect IoHwAb.SetGpioSysFlt2A -> TmplMonr.IoHwAb_SetGpioSysFlt2A
    connect IoHwAb.SetGpioTmplMonrWdg -> TmplMonr.IoHwAb_SetGpioTmplMonrWdg
    connect LimrCdng.EotAssiScaCdnd -> AssiSumLim.EotAssiSca
    connect LimrCdng.EotMotTqLimCdnd -> AssiSumLim.EotMotTqLim
    connect LimrCdng.StallMotTqLimCdnd -> AssiSumLim.StallMotTqLim
    connect LimrCdng.SysMotTqCmdScaCdnd -> AssiSumLim.SysMotTqCmdSca
    connect LimrCdng.ThermMotTqLimCdnd -> AssiSumLim.ThermMotTqLim
    connect LimrCdng.VehSpdMotTqLimCdnd -> AssiSumLim.VehSpdMotTqLim
    connect LoaMgr.HwTqLoaMtgtnEna -> AssiSumLim.HwTqLoaMtgtnEna
    connect LoaMgr.IvtrLoaMtgtnEna -> CDD_MotCtrlMgr.IvtrLoaMtgtnEna
    connect LoaMgr.CurrMeasLoaMtgtnEna -> CDD_MotCtrlMgr.CurrMeasLoaMtgtnEna
    connect LoaMgr.LoaSt -> GmOvrlStMgr.LoaSt
    connect LoaMgr.CurrMeasLoaMtgtnEna -> MotCurrPeakEstimn.CurrMeasLoaMtgtnEna
    connect LoaMgr.IvtrLoaMtgtnEna -> MotCurrRegCfg.IvtrLoaMtgtnEna
    connect LoaMgr.CurrMeasLoaMtgtnEna -> MotCurrRegCfg.CurrMeasLoaMtgtnEna
    connect LoaMgr.IvtrLoaMtgtnEna -> MotRefMdl.IvtrLoaMtgtnEna
    connect LoaMgr.CurrMeasLoaMtgtnEna -> MotRefMdl.CurrMeasLoaMtgtnEna
    connect LoaMgr.LoaSt -> MotTqTranlDampg.LoaSt
    connect LoaMgr.IvtrLoaMtgtnEna -> PwrLimr.IvtrLoaMtgtnEna
    connect LoaMgr.LoaSca -> StOutpCtrl.LoaSca
    connect LoaMgr.LoaRateLim -> StOutpCtrl.LoaRateLim
    connect LoaMgr.MotAgLoaMtgtnEna -> TqLoa.MotAgLoaMtgtnEna
    connect MotAgCorrln.MotAgMeclCorrlnSt -> CDD_MotCtrlMgr.MotAgMeclCorrlnSt
    connect MotAgCorrln.MotAgMeclIdptSig -> LoaMgr.MotAgMeclIdptSig
    connect MotCtrlPrmEstimn.GetMotPrmNomEol -> CmnMfgSrv.GetMotPrmNomEol
    connect MotCtrlPrmEstimn.SetMotPrmNomEol -> CmnMfgSrv.SetMotPrmNomEol
    connect MotCtrlPrmEstimn.MotInduDaxEstimd -> MotCurrRegCfg.MotInduDaxEstimd
    connect MotCtrlPrmEstimn.MotInduQaxEstimd -> MotCurrRegCfg.MotInduQaxEstimd
    connect MotCtrlPrmEstimn.MotREstimd -> MotCurrRegCfg.MotREstimd
    connect MotCtrlPrmEstimn.MotBackEmfConEstimd -> MotRefMdl.MotBackEmfConEstimd
    connect MotCtrlPrmEstimn.MotInduDaxEstimd -> MotRefMdl.MotInduDaxEstimd
    connect MotCtrlPrmEstimn.MotInduQaxEstimd -> MotRefMdl.MotInduQaxEstimd
    connect MotCtrlPrmEstimn.MotREstimd -> MotRefMdl.MotREstimd
    connect MotCtrlPrmEstimn.MotBackEmfConEstimd -> PwrLimr.MotBackEmfConEstimd
    connect MotCurrPeakEstimn.MotCurrPeakEstimd -> DutyCycThermProtn.MotCurrPeakEstimd
    connect MotCurrPeakEstimn.MotCurrPeakEstimdFild -> DutyCycThermProtn.MotCurrPeakEstimdFild
    connect MotCurrPeakEstimn.MotCurrPeakEstimdFild -> TEstimn.MotCurrPeakEstimd
    connect MotCurrRegCfg.MotAgElecDly -> CDD_MotCtrlMgr.MotAgElecDly
    connect MotCurrRegCfg.MotDampgDax -> CDD_MotCtrlMgr.MotDampgDax
    connect MotCurrRegCfg.MotDampgQax -> CDD_MotCtrlMgr.MotDampgQax
    connect MotCurrRegCfg.MotIntglGainDax -> CDD_MotCtrlMgr.MotIntglGainDax
    connect MotCurrRegCfg.MotIntglGainQax -> CDD_MotCtrlMgr.MotIntglGainQax
    connect MotCurrRegCfg.MotPropGainDax -> CDD_MotCtrlMgr.MotPropGainDax
    connect MotCurrRegCfg.MotPropGainQax -> CDD_MotCtrlMgr.MotPropGainQax
    connect MotQuadDetn.MotQuad -> MotRefMdl.MotQuad
    connect MotRefMdl.MotCurrDaxCmd -> CDD_MotCtrlMgr.MotCurrDaxCmd
    connect MotRefMdl.MotCurrDaxMax -> CDD_MotCtrlMgr.MotCurrDaxMax
    connect MotRefMdl.MotCurrQaxCmd -> CDD_MotCtrlMgr.MotCurrQaxCmd
    connect MotRefMdl.MotReacncDax -> CDD_MotCtrlMgr.MotReacncDax
    connect MotRefMdl.MotReacncQax -> CDD_MotCtrlMgr.MotReacncQax
    connect MotRefMdl.MotVltgDaxFf -> CDD_MotCtrlMgr.MotVltgDaxFf
    connect MotRefMdl.MotVltgQaxFf -> CDD_MotCtrlMgr.MotVltgQaxFf
    connect MotRefMdl.MotCurrDaxCmd -> MotCtrlPrmEstimn.MotCurrDaxCmd
    connect MotRefMdl.MotCurrQaxCmd -> MotCtrlPrmEstimn.MotCurrQaxCmd
    connect MotRefMdl.MotCurrDaxCmd -> MotCurrPeakEstimn.MotCurrDaxCmd
    connect MotRefMdl.MotCurrQaxCmd -> MotCurrPeakEstimn.MotCurrQaxCmd
    connect MotTqTranlDampg.MotTqCmdMrfDampd -> PwrLimr.MotTqCmdMrf
    connect PartNr.CustMfgEnSt -> CustDiagc.CustMfgEnaSt
    connect PartNr.PartNrBasMdlPartNrAlphaCodRd -> CustDiagc.PartNrBasMdlPartNrAlphaCodRd
    connect PartNr.PartNrBasMdlPartNrRd -> CustDiagc.PartNrBasMdlPartNrRd
    connect PartNr.PartNrCalProgdStsRd -> CustDiagc.PartNrCalProgdStsRd
    connect PartNr.PartNrCalProgdStsWr -> CustDiagc.PartNrCalProgdStsWr
    connect PartNr.PartNrCcaMfgTrakgRd -> CustDiagc.PartNrCcaMfgTrakgRd
    connect PartNr.PartNrCmpdVehPartnProdtStructRd -> CustDiagc.PartNrCmpdVehPartnProdtStructRd
    connect PartNr.PartNrCtrlPidKeyChk -> CustDiagc.PartNrCtrlPidKeyChk
    connect PartNr.PartNrCtrlPidKeyWr -> CustDiagc.PartNrCtrlPidKeyWr
    connect PartNr.PartNrCtrlPidSeedRd -> CustDiagc.PartNrCtrlPidSeedRd
    connect PartNr.PartNrCustMfgEnaCntrRd -> CustDiagc.PartNrCustMfgEnaCntrRd
    connect PartNr.PartNrCustMfgEnaCntrWr -> CustDiagc.PartNrCustMfgEnaCntrWr
    connect PartNr.PartNrDataUniversalNrSysIdRd -> CustDiagc.PartNrDataUniversalNrSysIdRd
    connect PartNr.PartNrEndMdlPartNrAlphaCodRd -> CustDiagc.PartNrEndMdlPartNrAlphaCodRd
    connect PartNr.PartNrEndMdlPartNrAlphaCodWr -> CustDiagc.PartNrEndMdlPartNrAlphaCodWr
    connect PartNr.PartNrEndMdlPartNrRd -> CustDiagc.PartNrEndMdlPartNrRd
    connect PartNr.PartNrEndMdlPartNrWr -> CustDiagc.PartNrEndMdlPartNrWr
    connect PartNr.PartNrLstRepairShopCodRd -> CustDiagc.PartNrLstRepairShopCodRd
    connect PartNr.PartNrNxtrMfgTrakgRd -> CustDiagc.PartNrNxtrMfgTrakgRd
    connect PartNr.PartNrNxtrMfgTrakgWr -> CustDiagc.PartNrNxtrMfgTrakgWr
    connect PartNr.PartNrProgmDateRd -> CustDiagc.PartNrProgmDateRd
    connect PartNr.PartNrProgmDateWr -> CustDiagc.PartNrProgmDateWr
    connect PartNr.PartNrProgmSessionKeyChk -> CustDiagc.PartNrProgmSessionKeyChk
    connect PartNr.PartNrProgmSessionSeedRd -> CustDiagc.PartNrProgmSessionSeedRd
    connect PartNr.PartNrRepairShopCodRd -> CustDiagc.PartNrRepairShopCodRd
    connect PartNr.PartNrRepairShopCodWr -> CustDiagc.PartNrRepairShopCodWr
    connect PartNr.PartNrSysCodVersNrRd -> CustDiagc.PartNrSysCodVersNrRd
    connect PartNr.PartNrSysCodVersNrWr -> CustDiagc.PartNrSysCodVersNrWr
    connect PartNr.PartNrSysNameRd -> CustDiagc.PartNrSysNameRd
    connect PartNr.PartNrSysNameWr -> CustDiagc.PartNrSysNameWr
    connect PartNr.PartNrVinDataRd -> CustDiagc.PartNrVinDataRd
    connect PartNr.PartNrVinDataWr -> CustDiagc.PartNrVinDataWr
    connect PolarityCfg.HwTq{0..3}Polarity -> CDD_HwTq{0..3}Meas.HwTq{0..3}Polarity
    connect PolarityCfg.AssiMechPolarity -> CDD_MotAgCmp.AssiMechPolarity
    connect PolarityCfg.MotAgMecl0Polarity -> CDD_MotCtrlMgr.MotAgMecl0Polarity
    connect PolarityCfg.MotAgMecl1Polarity -> CDD_MotCtrlMgr.MotAgMecl1Polarity
    connect PolarityCfg.MotElecMeclPolarity -> CDD_MotCtrlMgr.MotElecMeclPolarity
    connect PolarityCfg.AssiMechPolarity -> CDD_MotVel.AssiMechPolarity
    connect PolarityCfg.MotElecMeclPolarity -> CDD_SinVltgGenn.MotElecMeclPolarity
    connect PolarityCfg.PolarityCfgRead -> CmnMfgSrv.PolarityCfgRead
    connect PolarityCfg.PolarityCfgWr -> CmnMfgSrv.PolarityCfgWr
    connect PolarityCfg.HwAg0Polarity -> HwAg0Meas.HwAg0Polarity
    connect PolarityCfg.HwAg1Polarity -> HwAg1Meas.HwAg1Polarity
    connect PolarityCfg.AssiMechPolarity -> MotTqTranlDampg.AssiMechPolarity
    connect PullCmpActv.PullCmpCmd -> AssiSumLim.PullCmpCmd
    connect PullCmpActv.GetPullCmpPrm -> CmnMfgSrv.GetPullCmpPrm
    connect PullCmpActv.RstPullCmp -> CmnMfgSrv.RstPullCmp
    connect PullCmpActv.SetPullCmpLongTerm -> CmnMfgSrv.SetPullCmpLongTerm
    connect PullCmpActv.SetPullCmpShoTerm -> CmnMfgSrv.SetPullCmpShoTerm
    connect PwrDiscnct.PwrDiscnctATestCmpl -> PwrUpSeq.PwrDiscnctATestCmpl
    connect PwrDiscnct.PwrDiscnctBTestCmpl -> PwrUpSeq.PwrDiscnctBTestCmpl
    connect PwrLimr.PwrLimrRednFac -> AssiSumLim.PwrLimrRednFac
    connect PwrUpSeq.StrtUpSt -> BattVltgCorrln.StrtUpSt
    connect PwrUpSeq.StrtUpSt -> CDD_CurrMeas.StrtUpSt
    connect PwrUpSeq.StrtUpSt -> PwrDiscnct.StrtUpSt
    connect PwrUpSeq.StrtUpSt -> SysStMod.StrtUpSt
    connect PwrUpSeq.SysStWrmIninCmpl -> SysStMod.SysStWrmIninCmpl
    connect PwrUpSeq.StrtUpSt -> TmplMonr.StrtUpSt
    connect SerlComInpProxy.SerlComInpProxyGmLanIdRd -> CustDiagc.PartNrGmLanIdRd
    connect SerlComInpProxy.EngRunActvRaw -> GmMsg0C9BusHiSpd.EngRunActvRaw
    connect SerlComInpProxy.EngSpdRaw -> GmMsg0C9BusHiSpd.EngSpdRaw
    connect SerlComInpProxy.EngSpdStsRaw -> GmMsg0C9BusHiSpd.EngSpdStsRaw
    connect SerlComInpProxy.LstRxnTiMsg0C9 -> GmMsg0C9BusHiSpd.LstRxnTiMsg0C9
    connect SerlComInpProxy.PtCrkActvRaw -> GmMsg0C9BusHiSpd.PtCrkActvRaw
    connect SerlComInpProxy.LstRxnTiMsg17D -> GmMsg17DBusHiSpd.LstRxnTiMsg17D
    connect SerlComInpProxy.VehStabyEnhmtStsRaw -> GmMsg17DBusHiSpd.VehStabyEnhmtStsRaw
    connect SerlComInpProxy.LstRxnTiMsg180BusChassisExp -> GmMsg180BusChassisExp.LstRxnTiMsg180BusChassisExp
    connect SerlComInpProxy.TqOvrlAlvRollgCntrRaw -> GmMsg180BusChassisExp.TqOvrlAlvRollgCntrRaw
    connect SerlComInpProxy.TqOvrlCmdChksRaw -> GmMsg180BusChassisExp.TqOvrlCmdChksRaw
    connect SerlComInpProxy.TqOvrlDeltaTqCmdActvRaw -> GmMsg180BusChassisExp.TqOvrlDeltaTqCmdActvRaw
    connect SerlComInpProxy.TqOvrlDeltaTqCmdValRaw -> GmMsg180BusChassisExp.TqOvrlDeltaTqCmdValRaw
    connect SerlComInpProxy.LkaCmdProtnValRaw -> GmMsg180BusHiSpd.LkaCmdProtnValRaw
    connect SerlComInpProxy.LkaCmdRollgCntrRaw -> GmMsg180BusHiSpd.LkaCmdRollgCntrRaw
    connect SerlComInpProxy.LkaCmdTqReqActvRaw -> GmMsg180BusHiSpd.LkaCmdTqReqActvRaw
    connect SerlComInpProxy.LkaCmdTqValRaw -> GmMsg180BusHiSpd.LkaCmdTqValRaw
    connect SerlComInpProxy.LstRxnTiMsg180BusHiSpd -> GmMsg180BusHiSpd.LstRxnTiMsg180BusHiSpd
    connect SerlComInpProxy.LstRxnTiMsg182 -> GmMsg182BusChassisExp.LstRxnTiMsg182
    connect SerlComInpProxy.VehDynOverUnderSteerVldRaw -> GmMsg182BusChassisExp.VehDynOverUnderSteerVldRaw
    connect SerlComInpProxy.VehStabyEnhmtLgtALoReslRaw -> GmMsg182BusChassisExp.VehStabyEnhmtLgtALoReslRaw
